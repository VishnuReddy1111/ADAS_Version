[part 2 of 5: package /MICROSAR/Dem_swc/ComponentTypes]
AUTOSAR XML (schema 00048)
package /MICROSAR/Dem_swc/ComponentTypes  (continued)
  service sw component type DemSatellite_0: category=SERVICE_COMPONENT  (continued)
    behavior DemSatellite_0InternalBehavior: handle-termination-and-restart=NO-SUPPORT, included-data-type-set=data-type=[Dem_EventIdType, Dem_RatioIdType, Dem_EventStatusType, Dem_UdsStatusByteType, Dem_DTCFormatType, Dem_InitMonitorReasonType, Dem_OperationCycleStateType, Dem_DTCStatusMaskType, Dem_IndicatorStatusType, Dem_MaxDataValueType, Dem_DTCKindType, Dem_DTCGroupType, Dem_IumprDenomCondIdType, Dem_IumprDenomCondStatusType, Dem_DebounceResetStatusType, Dem_DebouncingStateType, Dem_IumprReadinessGroupType, Dem_DTRControlType, Dem_DTCSeverityType, Dem_MonitorStatusType]  (continued)
      3146 x operation invoked event:  (continued)
        OpEventGetFaultDetectionCounter_GetFaultDetectionCounter_EvtInfo_AutoCreatedDemEvent_MyECU_6c1a0d52_FrDemCtrlTestResultRef: start-on-event=DemSatellite_0InternalBehavior/GetFaultDetectionCounter, operation=EvtInfo_AutoCreatedDemEvent_MyECU_6c1a0d52_FrDemCtrlTestResultRef.GetFaultDetectionCounter
        OpEventGetFaultDetectionCounter_GetFaultDetectionCounter_EvtInfo_AutoCreatedDemEvent_LIN_E_TIMEOUT: start-on-event=DemSatellite_0InternalBehavior/GetFaultDetectionCounter, operation=EvtInfo_AutoCreatedDemEvent_LIN_E_TIMEOUT.GetFaultDetectionCounter
        OpEventGetFaultDetectionCounter_GetFaultDetectionCounter_EvtInfo_AutoCreatedDemEvent_McuModuleConfiguration_MCU_E_CLOCK_FAILURE: start-on-event=DemSatellite_0InternalBehavior/GetFaultDetectionCounter, operation=EvtInfo_AutoCreatedDemEvent_McuModuleConfiguration_MCU_E_CLOCK_FAILURE.GetFaultDetectionCounter
        OpEventGetFaultDetectionCounter_GetFaultDetectionCounter_EvtInfo_AutoCreatedDemEvent_NVM_E_WRONG_BLOCK_ID: start-on-event=DemSatellite_0InternalBehavior/GetFaultDetectionCounter, operation=EvtInfo_AutoCreatedDemEvent_NVM_E_WRONG_BLOCK_ID.GetFaultDetectionCounter
        OpEventGetFaultDetectionCounter_GetFaultDetectionCounter_EvtInfo_AutoCreatedDemEvent_NVM_E_WRITE_PROTECTED: start-on-event=DemSatellite_0InternalBehavior/GetFaultDetectionCounter, operation=EvtInfo_AutoCreatedDemEvent_NVM_E_WRITE_PROTECTED.GetFaultDetectionCounter
        OpEventGetFaultDetectionCounter_GetFaultDetectionCounter_EvtInfo_AutoCreatedDemEvent_NVM_E_VERIFY_FAILED: start-on-event=DemSatellite_0InternalBehavior/GetFaultDetectionCounter, operation=EvtInfo_AutoCreatedDemEvent_NVM_E_VERIFY_FAILED.GetFaultDetectionCounter
        OpEventGetFaultDetectionCounter_GetFaultDetectionCounter_EvtInfo_AutoCreatedDemEvent_NVM_E_REQ_FAILED: start-on-event=DemSatellite_0InternalBehavior/GetFaultDetectionCounter, operation=EvtInfo_AutoCreatedDemEvent_NVM_E_REQ_FAILED.GetFaultDetectionCounter
        OpEventGetFaultDetectionCounter_GetFaultDetectionCounter_EvtInfo_AutoCreatedDemEvent_NVM_E_QUEUE_OVERFLOW: start-on-event=DemSatellite_0InternalBehavior/GetFaultDetectionCounter, operation=EvtInfo_AutoCreatedDemEvent_NVM_E_QUEUE_OVERFLOW.GetFaultDetectionCounter
        OpEventGetFaultDetectionCounter_GetFaultDetectionCounter_EvtInfo_AutoCreatedDemEvent_NVM_E_LOSS_OF_REDUNDANCY: start-on-event=DemSatellite_0InternalBehavior/GetFaultDetectionCounter, operation=EvtInfo_AutoCreatedDemEvent_NVM_E_LOSS_OF_REDUNDANCY.GetFaultDetectionCounter
        OpEventGetFaultDetectionCounter_GetFaultDetectionCounter_EvtInfo_AutoCreatedDemEvent_NVM_E_INTEGRITY_FAILED: start-on-event=DemSatellite_0InternalBehavior/GetFaultDetectionCounter, operation=EvtInfo_AutoCreatedDemEvent_NVM_E_INTEGRITY_FAILED.GetFaultDetectionCounter
        OpEventGetFaultDetectionCounter_GetFaultDetectionCounter_EvtInfo_AutoCreatedDemEvent_XFRM_E_MALFORMED_MESSAGE_2: start-on-event=DemSatellite_0InternalBehavior/GetFaultDetectionCounter, operation=EvtInfo_AutoCreatedDemEvent_XFRM_E_MALFORMED_MESSAGE_2.GetFaultDetectionCounter
        OpEventGetFaultDetectionCounter_GetFaultDetectionCounter_EvtInfo_AutoCreatedDemEvent_EEP_E_WRITE_FAILED_1: start-on-event=DemSatellite_0InternalBehavior/GetFaultDetectionCounter, operation=EvtInfo_AutoCreatedDemEvent_EEP_E_WRITE_FAILED_1.GetFaultDetectionCounter
        OpEventGetFaultDetectionCounter_GetFaultDetectionCounter_EvtInfo_AutoCreatedDemEvent_EEP_E_READ_FAILED_1: start-on-event=DemSatellite_0InternalBehavior/GetFaultDetectionCounter, operation=EvtInfo_AutoCreatedDemEvent_EEP_E_READ_FAILED_1.GetFaultDetectionCounter
        OpEventGetFaultDetectionCounter_GetFaultDetectionCounter_EvtInfo_AutoCreatedDemEvent_EEP_E_ERASE_FAILED_1: start-on-event=DemSatellite_0InternalBehavior/GetFaultDetectionCounter, operation=EvtInfo_AutoCreatedDemEvent_EEP_E_ERASE_FAILED_1.GetFaultDetectionCounter
        OpEventGetFaultDetectionCounter_GetFaultDetectionCounter_EvtInfo_AutoCreatedDemEvent_EEP_E_COMPARE_FAILED_1: start-on-event=DemSatellite_0InternalBehavior/GetFaultDetectionCounter, operation=EvtInfo_AutoCreatedDemEvent_EEP_E_COMPARE_FAILED_1.GetFaultDetectionCounter
        OpEventGetFaultDetectionCounter_GetFaultDetectionCounter_EvtInfo_AutoCreatedDemEvent_FLS_E_WRITE_FAILED_1: start-on-event=DemSatellite_0InternalBehavior/GetFaultDetectionCounter, operation=EvtInfo_AutoCreatedDemEvent_FLS_E_WRITE_FAILED_1.GetFaultDetectionCounter
        OpEventGetFaultDetectionCounter_GetFaultDetectionCounter_EvtInfo_AutoCreatedDemEvent_FLS_E_UNEXPECTED_FLASH_ID_1: start-on-event=DemSatellite_0InternalBehavior/GetFaultDetectionCounter, operation=EvtInfo_AutoCreatedDemEvent_FLS_E_UNEXPECTED_FLASH_ID_1.GetFaultDetectionCounter
        OpEventGetFaultDetectionCounter_GetFaultDetectionCounter_EvtInfo_AutoCreatedDemEvent_FLS_E_READ_FAILED_1: start-on-event=DemSatellite_0InternalBehavior/GetFaultDetectionCounter, operation=EvtInfo_AutoCreatedDemEvent_FLS_E_READ_FAILED_1.GetFaultDetectionCounter
        OpEventGetFaultDetectionCounter_GetFaultDetectionCounter_EvtInfo_AutoCreatedDemEvent_FLS_E_ERASE_FAILED_1: start-on-event=DemSatellite_0InternalBehavior/GetFaultDetectionCounter, operation=EvtInfo_AutoCreatedDemEvent_FLS_E_ERASE_FAILED_1.GetFaultDetectionCounter
        OpEventGetFaultDetectionCounter_GetFaultDetectionCounter_EvtInfo_AutoCreatedDemEvent_FLS_E_COMPARE_FAILED_1: start-on-event=DemSatellite_0InternalBehavior/GetFaultDetectionCounter, operation=EvtInfo_AutoCreatedDemEvent_FLS_E_COMPARE_FAILED_1.GetFaultDetectionCounter
        OpEventGetFaultDetectionCounter_GetFaultDetectionCounter_EvtInfo_AutoCreatedDemEvent_MyECU_6c1a0d52_FrDemCtrlTestResultRef_1: start-on-event=DemSatellite_0InternalBehavior/GetFaultDetectionCounter, operation=EvtInfo_AutoCreatedDemEvent_MyECU_6c1a0d52_FrDemCtrlTestResultRef_1.GetFaultDetectionCounter
        OpEventGetFaultDetectionCounter_GetFaultDetectionCounter_EvtInfo_AutoCreatedDemEvent_McuModuleConfiguration_MCU_E_CLOCK_0053dbfe: start-on-event=DemSatellite_0InternalBehavior/GetFaultDetectionCounter, operation=EvtInfo_AutoCreatedDemEvent_McuModuleConfiguration_MCU_E_CLOCK_FAILURE_1.GetFaultDetectionCounter
        OpEventGetFaultDetectionCounter_GetFaultDetectionCounter_EvtInfo_AutoCreatedDemEvent_XCP_E_INIT_FAILED: start-on-event=DemSatellite_0InternalBehavior/GetFaultDetectionCounter, operation=EvtInfo_AutoCreatedDemEvent_XCP_E_INIT_FAILED.GetFaultDetectionCounter
        OpEventGetEventFreezeFrameDataEx_GetEventFreezeFrameDataEx_EvtInfo_AutoCreatedDemEvent_BswMConfig_BswMReportFailToDemRef: start-on-event=DemSatellite_0InternalBehavior/GetEventFreezeFrameDataEx, operation=EvtInfo_AutoCreatedDemEvent_BswMConfig_BswMReportFailToDemRef.GetEventFreezeFrameDataEx
        OpEventGetEventFreezeFrameDataEx_GetEventFreezeFrameDataEx_EvtInfo_AutoCreatedDemEvent_CHNL_346f2748_CANSM_E_MODE_REQUE_3803679d: start-on-event=DemSatellite_0InternalBehavior/GetEventFreezeFrameDataEx, operation=EvtInfo_AutoCreatedDemEvent_CHNL_346f2748_CANSM_E_MODE_REQUEST_TIMEOUT.GetEventFreezeFrameDataEx
        OpEventGetEventFreezeFrameDataEx_GetEventFreezeFrameDataEx_EvtInfo_AutoCreatedDemEvent_CHNL_346f2748_CANSM_E_BUS_OFF: start-on-event=DemSatellite_0InternalBehavior/GetEventFreezeFrameDataEx, operation=EvtInfo_AutoCreatedDemEvent_CHNL_346f2748_CANSM_E_BUS_OFF.GetEventFreezeFrameDataEx
        OpEventGetEventFreezeFrameDataEx_GetEventFreezeFrameDataEx_EvtInfo_AutoCreatedDemEvent_XFRM_E_MALFORMED_MESSAGE: start-on-event=DemSatellite_0InternalBehavior/GetEventFreezeFrameDataEx, operation=EvtInfo_AutoCreatedDemEvent_XFRM_E_MALFORMED_MESSAGE.GetEventFreezeFrameDataEx
        OpEventGetEventFreezeFrameDataEx_GetEventFreezeFrameDataEx_EvtInfo_AutoCreatedDemEvent_XFRM_E_MALFORMED_MESSAGE_1: start-on-event=DemSatellite_0InternalBehavior/GetEventFreezeFrameDataEx, operation=EvtInfo_AutoCreatedDemEvent_XFRM_E_MALFORMED_MESSAGE_1.GetEventFreezeFrameDataEx
        OpEventGetEventFreezeFrameDataEx_GetEventFreezeFrameDataEx_EvtInfo_AutoCreatedDemEvent_ECUM_E_RAM_CHECK_FAILED: start-on-event=DemSatellite_0InternalBehavior/GetEventFreezeFrameDataEx, operation=EvtInfo_AutoCreatedDemEvent_ECUM_E_RAM_CHECK_FAILED.GetEventFreezeFrameDataEx
        OpEventGetEventFreezeFrameDataEx_GetEventFreezeFrameDataEx_EvtInfo_AutoCreatedDemEvent_ECUM_E_IMPROPER_CALLER: start-on-event=DemSatellite_0InternalBehavior/GetEventFreezeFrameDataEx, operation=EvtInfo_AutoCreatedDemEvent_ECUM_E_IMPROPER_CALLER.GetEventFreezeFrameDataEx
        OpEventGetEventFreezeFrameDataEx_GetEventFreezeFrameDataEx_EvtInfo_AutoCreatedDemEvent_ECUM_E_CONFIGURATION_DATA_INCONSISTENT: start-on-event=DemSatellite_0InternalBehavior/GetEventFreezeFrameDataEx, operation=EvtInfo_AutoCreatedDemEvent_ECUM_E_CONFIGURATION_DATA_INCONSISTENT.GetEventFreezeFrameDataEx
        OpEventGetEventFreezeFrameDataEx_GetEventFreezeFrameDataEx_EvtInfo_AutoCreatedDemEvent_ECUM_E_ALL_RUN_REQUESTS_KILLED: start-on-event=DemSatellite_0InternalBehavior/GetEventFreezeFrameDataEx, operation=EvtInfo_AutoCreatedDemEvent_ECUM_E_ALL_RUN_REQUESTS_KILLED.GetEventFreezeFrameDataEx
        OpEventGetEventFreezeFrameDataEx_GetEventFreezeFrameDataEx_EvtInfo_AutoCreatedDemEvent_EEP_E_WRITE_FAILED: start-on-event=DemSatellite_0InternalBehavior/GetEventFreezeFrameDataEx, operation=EvtInfo_AutoCreatedDemEvent_EEP_E_WRITE_FAILED.GetEventFreezeFrameDataEx
        OpEventGetEventFreezeFrameDataEx_GetEventFreezeFrameDataEx_EvtInfo_AutoCreatedDemEvent_EEP_E_READ_FAILED: start-on-event=DemSatellite_0InternalBehavior/GetEventFreezeFrameDataEx, operation=EvtInfo_AutoCreatedDemEvent_EEP_E_READ_FAILED.GetEventFreezeFrameDataEx
        OpEventGetEventFreezeFrameDataEx_GetEventFreezeFrameDataEx_EvtInfo_AutoCreatedDemEvent_EEP_E_ERASE_FAILED: start-on-event=DemSatellite_0InternalBehavior/GetEventFreezeFrameDataEx, operation=EvtInfo_AutoCreatedDemEvent_EEP_E_ERASE_FAILED.GetEventFreezeFrameDataEx
        OpEventGetEventFreezeFrameDataEx_GetEventFreezeFrameDataEx_EvtInfo_AutoCreatedDemEvent_EEP_E_COMPARE_FAILED: start-on-event=DemSatellite_0InternalBehavior/GetEventFreezeFrameDataEx, operation=EvtInfo_AutoCreatedDemEvent_EEP_E_COMPARE_FAILED.GetEventFreezeFrameDataEx
        OpEventGetEventFreezeFrameDataEx_GetEventFreezeFrameDataEx_EvtInfo_AutoCreatedDemEvent_FLS_E_WRITE_FAILED: start-on-event=DemSatellite_0InternalBehavior/GetEventFreezeFrameDataEx, operation=EvtInfo_AutoCreatedDemEvent_FLS_E_WRITE_FAILED.GetEventFreezeFrameDataEx
        OpEventGetEventFreezeFrameDataEx_GetEventFreezeFrameDataEx_EvtInfo_AutoCreatedDemEvent_FLS_E_UNEXPECTED_FLASH_ID: start-on-event=DemSatellite_0InternalBehavior/GetEventFreezeFrameDataEx, operation=EvtInfo_AutoCreatedDemEvent_FLS_E_UNEXPECTED_FLASH_ID.GetEventFreezeFrameDataEx
        OpEventGetEventFreezeFrameDataEx_GetEventFreezeFrameDataEx_EvtInfo_AutoCreatedDemEvent_FLS_E_READ_FAILED: start-on-event=DemSatellite_0InternalBehavior/GetEventFreezeFrameDataEx, operation=EvtInfo_AutoCreatedDemEvent_FLS_E_READ_FAILED.GetEventFreezeFrameDataEx
        OpEventGetEventFreezeFrameDataEx_GetEventFreezeFrameDataEx_EvtInfo_AutoCreatedDemEvent_FLS_E_ERASE_FAILED: start-on-event=DemSatellite_0InternalBehavior/GetEventFreezeFrameDataEx, operation=EvtInfo_AutoCreatedDemEvent_FLS_E_ERASE_FAILED.GetEventFreezeFrameDataEx
        OpEventGetEventFreezeFrameDataEx_GetEventFreezeFrameDataEx_EvtInfo_AutoCreatedDemEvent_FLS_E_COMPARE_FAILED: start-on-event=DemSatellite_0InternalBehavior/GetEventFreezeFrameDataEx, operation=EvtInfo_AutoCreatedDemEvent_FLS_E_COMPARE_FAILED.GetEventFreezeFrameDataEx
        OpEventGetEventFreezeFrameDataEx_GetEventFreezeFrameDataEx_EvtInfo_AutoCreatedDemEvent_MyECU_6c1a0d52_FrDemCtrlTestResultRef: start-on-event=DemSatellite_0InternalBehavior/GetEventFreezeFrameDataEx, operation=EvtInfo_AutoCreatedDemEvent_MyECU_6c1a0d52_FrDemCtrlTestResultRef.GetEventFreezeFrameDataEx
        OpEventGetEventFreezeFrameDataEx_GetEventFreezeFrameDataEx_EvtInfo_AutoCreatedDemEvent_LIN_E_TIMEOUT: start-on-event=DemSatellite_0InternalBehavior/GetEventFreezeFrameDataEx, operation=EvtInfo_AutoCreatedDemEvent_LIN_E_TIMEOUT.GetEventFreezeFrameDataEx
        OpEventGetEventFreezeFrameDataEx_GetEventFreezeFrameDataEx_EvtInfo_AutoCreatedDemEvent_McuModuleConfiguration_MCU_E_CLO_23816e70: start-on-event=DemSatellite_0InternalBehavior/GetEventFreezeFrameDataEx, operation=EvtInfo_AutoCreatedDemEvent_McuModuleConfiguration_MCU_E_CLOCK_FAILURE.GetEventFreezeFrameDataEx
        OpEventGetEventFreezeFrameDataEx_GetEventFreezeFrameDataEx_EvtInfo_AutoCreatedDemEvent_NVM_E_WRONG_BLOCK_ID: start-on-event=DemSatellite_0InternalBehavior/GetEventFreezeFrameDataEx, operation=EvtInfo_AutoCreatedDemEvent_NVM_E_WRONG_BLOCK_ID.GetEventFreezeFrameDataEx
        OpEventGetEventFreezeFrameDataEx_GetEventFreezeFrameDataEx_EvtInfo_AutoCreatedDemEvent_NVM_E_WRITE_PROTECTED: start-on-event=DemSatellite_0InternalBehavior/GetEventFreezeFrameDataEx, operation=EvtInfo_AutoCreatedDemEvent_NVM_E_WRITE_PROTECTED.GetEventFreezeFrameDataEx
        OpEventGetEventFreezeFrameDataEx_GetEventFreezeFrameDataEx_EvtInfo_AutoCreatedDemEvent_NVM_E_VERIFY_FAILED: start-on-event=DemSatellite_0InternalBehavior/GetEventFreezeFrameDataEx, operation=EvtInfo_AutoCreatedDemEvent_NVM_E_VERIFY_FAILED.GetEventFreezeFrameDataEx
        OpEventGetEventFreezeFrameDataEx_GetEventFreezeFrameDataEx_EvtInfo_AutoCreatedDemEvent_NVM_E_REQ_FAILED: start-on-event=DemSatellite_0InternalBehavior/GetEventFreezeFrameDataEx, operation=EvtInfo_AutoCreatedDemEvent_NVM_E_REQ_FAILED.GetEventFreezeFrameDataEx
        OpEventGetEventFreezeFrameDataEx_GetEventFreezeFrameDataEx_EvtInfo_AutoCreatedDemEvent_NVM_E_QUEUE_OVERFLOW: start-on-event=DemSatellite_0InternalBehavior/GetEventFreezeFrameDataEx, operation=EvtInfo_AutoCreatedDemEvent_NVM_E_QUEUE_OVERFLOW.GetEventFreezeFrameDataEx
        OpEventGetEventFreezeFrameDataEx_GetEventFreezeFrameDataEx_EvtInfo_AutoCreatedDemEvent_NVM_E_LOSS_OF_REDUNDANCY: start-on-event=DemSatellite_0InternalBehavior/GetEventFreezeFrameDataEx, operation=EvtInfo_AutoCreatedDemEvent_NVM_E_LOSS_OF_REDUNDANCY.GetEventFreezeFrameDataEx
        OpEventGetEventFreezeFrameDataEx_GetEventFreezeFrameDataEx_EvtInfo_AutoCreatedDemEvent_NVM_E_INTEGRITY_FAILED: start-on-event=DemSatellite_0InternalBehavior/GetEventFreezeFrameDataEx, operation=EvtInfo_AutoCreatedDemEvent_NVM_E_INTEGRITY_FAILED.GetEventFreezeFrameDataEx
        OpEventGetEventFreezeFrameDataEx_GetEventFreezeFrameDataEx_EvtInfo_AutoCreatedDemEvent_XFRM_E_MALFORMED_MESSAGE_2: start-on-event=DemSatellite_0InternalBehavior/GetEventFreezeFrameDataEx, operation=EvtInfo_AutoCreatedDemEvent_XFRM_E_MALFORMED_MESSAGE_2.GetEventFreezeFrameDataEx
        OpEventGetEventFreezeFrameDataEx_GetEventFreezeFrameDataEx_EvtInfo_AutoCreatedDemEvent_EEP_E_WRITE_FAILED_1: start-on-event=DemSatellite_0InternalBehavior/GetEventFreezeFrameDataEx, operation=EvtInfo_AutoCreatedDemEvent_EEP_E_WRITE_FAILED_1.GetEventFreezeFrameDataEx
        OpEventGetEventFreezeFrameDataEx_GetEventFreezeFrameDataEx_EvtInfo_AutoCreatedDemEvent_EEP_E_READ_FAILED_1: start-on-event=DemSatellite_0InternalBehavior/GetEventFreezeFrameDataEx, operation=EvtInfo_AutoCreatedDemEvent_EEP_E_READ_FAILED_1.GetEventFreezeFrameDataEx
        OpEventGetEventFreezeFrameDataEx_GetEventFreezeFrameDataEx_EvtInfo_AutoCreatedDemEvent_EEP_E_ERASE_FAILED_1: start-on-event=DemSatellite_0InternalBehavior/GetEventFreezeFrameDataEx, operation=EvtInfo_AutoCreatedDemEvent_EEP_E_ERASE_FAILED_1.GetEventFreezeFrameDataEx
        OpEventGetEventFreezeFrameDataEx_GetEventFreezeFrameDataEx_EvtInfo_AutoCreatedDemEvent_EEP_E_COMPARE_FAILED_1: start-on-event=DemSatellite_0InternalBehavior/GetEventFreezeFrameDataEx, operation=EvtInfo_AutoCreatedDemEvent_EEP_E_COMPARE_FAILED_1.GetEventFreezeFrameDataEx
        OpEventGetEventFreezeFrameDataEx_GetEventFreezeFrameDataEx_EvtInfo_AutoCreatedDemEvent_FLS_E_WRITE_FAILED_1: start-on-event=DemSatellite_0InternalBehavior/GetEventFreezeFrameDataEx, operation=EvtInfo_AutoCreatedDemEvent_FLS_E_WRITE_FAILED_1.GetEventFreezeFrameDataEx
        OpEventGetEventFreezeFrameDataEx_GetEventFreezeFrameDataEx_EvtInfo_AutoCreatedDemEvent_FLS_E_UNEXPECTED_FLASH_ID_1: start-on-event=DemSatellite_0InternalBehavior/GetEventFreezeFrameDataEx, operation=EvtInfo_AutoCreatedDemEvent_FLS_E_UNEXPECTED_FLASH_ID_1.GetEventFreezeFrameDataEx
        OpEventGetEventFreezeFrameDataEx_GetEventFreezeFrameDataEx_EvtInfo_AutoCreatedDemEvent_FLS_E_READ_FAILED_1: start-on-event=DemSatellite_0InternalBehavior/GetEventFreezeFrameDataEx, operation=EvtInfo_AutoCreatedDemEvent_FLS_E_READ_FAILED_1.GetEventFreezeFrameDataEx
        OpEventGetEventFreezeFrameDataEx_GetEventFreezeFrameDataEx_EvtInfo_AutoCreatedDemEvent_FLS_E_ERASE_FAILED_1: start-on-event=DemSatellite_0InternalBehavior/GetEventFreezeFrameDataEx, operation=EvtInfo_AutoCreatedDemEvent_FLS_E_ERASE_FAILED_1.GetEventFreezeFrameDataEx
        OpEventGetEventFreezeFrameDataEx_GetEventFreezeFrameDataEx_EvtInfo_AutoCreatedDemEvent_FLS_E_COMPARE_FAILED_1: start-on-event=DemSatellite_0InternalBehavior/GetEventFreezeFrameDataEx, operation=EvtInfo_AutoCreatedDemEvent_FLS_E_COMPARE_FAILED_1.GetEventFreezeFrameDataEx
        OpEventGetEventFreezeFrameDataEx_GetEventFreezeFrameDataEx_EvtInfo_AutoCreatedDemEvent_MyECU_6c1a0d52_FrDemCtrlTestResultRef_1: start-on-event=DemSatellite_0InternalBehavior/GetEventFreezeFrameDataEx, operation=EvtInfo_AutoCreatedDemEvent_MyECU_6c1a0d52_FrDemCtrlTestResultRef_1.GetEventFreezeFrameDataEx
        OpEventGetEventFreezeFrameDataEx_GetEventFreezeFrameDataEx_EvtInfo_AutoCreatedDemEvent_McuModuleConfiguration_MCU_E_CLO_a8114576: start-on-event=DemSatellite_0InternalBehavior/GetEventFreezeFrameDataEx, operation=EvtInfo_AutoCreatedDemEvent_McuModuleConfiguration_MCU_E_CLOCK_FAILURE_1.GetEventFreezeFrameDataEx
        OpEventGetEventFreezeFrameDataEx_GetEventFreezeFrameDataEx_EvtInfo_AutoCreatedDemEvent_XCP_E_INIT_FAILED: start-on-event=DemSatellite_0InternalBehavior/GetEventFreezeFrameDataEx, operation=EvtInfo_AutoCreatedDemEvent_XCP_E_INIT_FAILED.GetEventFreezeFrameDataEx
        OpEventGetEventExtendedDataRecordEx_GetEventExtendedDataRecordEx_EvtInfo_AutoCreatedDemEvent_BswMConfig_BswMReportFailToDemRef: start-on-event=DemSatellite_0InternalBehavior/GetEventExtendedDataRecordEx, operation=EvtInfo_AutoCreatedDemEvent_BswMConfig_BswMReportFailToDemRef.GetEventExtendedDataRecordEx
        OpEventGetEventExtendedDataRecordEx_GetEventExtendedDataRecordEx_EvtInfo_AutoCreatedDemEvent_CHNL_346f2748_CANSM_E_MODE_da20ac36: start-on-event=DemSatellite_0InternalBehavior/GetEventExtendedDataRecordEx, operation=EvtInfo_AutoCreatedDemEvent_CHNL_346f2748_CANSM_E_MODE_REQUEST_TIMEOUT.GetEventExtendedDataRecordEx
        OpEventGetEventExtendedDataRecordEx_GetEventExtendedDataRecordEx_EvtInfo_AutoCreatedDemEvent_CHNL_346f2748_CANSM_E_BUS_OFF: start-on-event=DemSatellite_0InternalBehavior/GetEventExtendedDataRecordEx, operation=EvtInfo_AutoCreatedDemEvent_CHNL_346f2748_CANSM_E_BUS_OFF.GetEventExtendedDataRecordEx
        OpEventGetEventExtendedDataRecordEx_GetEventExtendedDataRecordEx_EvtInfo_AutoCreatedDemEvent_XFRM_E_MALFORMED_MESSAGE: start-on-event=DemSatellite_0InternalBehavior/GetEventExtendedDataRecordEx, operation=EvtInfo_AutoCreatedDemEvent_XFRM_E_MALFORMED_MESSAGE.GetEventExtendedDataRecordEx
        OpEventGetEventExtendedDataRecordEx_GetEventExtendedDataRecordEx_EvtInfo_AutoCreatedDemEvent_XFRM_E_MALFORMED_MESSAGE_1: start-on-event=DemSatellite_0InternalBehavior/GetEventExtendedDataRecordEx, operation=EvtInfo_AutoCreatedDemEvent_XFRM_E_MALFORMED_MESSAGE_1.GetEventExtendedDataRecordEx
        OpEventGetEventExtendedDataRecordEx_GetEventExtendedDataRecordEx_EvtInfo_AutoCreatedDemEvent_ECUM_E_RAM_CHECK_FAILED: start-on-event=DemSatellite_0InternalBehavior/GetEventExtendedDataRecordEx, operation=EvtInfo_AutoCreatedDemEvent_ECUM_E_RAM_CHECK_FAILED.GetEventExtendedDataRecordEx
        OpEventGetEventExtendedDataRecordEx_GetEventExtendedDataRecordEx_EvtInfo_AutoCreatedDemEvent_ECUM_E_IMPROPER_CALLER: start-on-event=DemSatellite_0InternalBehavior/GetEventExtendedDataRecordEx, operation=EvtInfo_AutoCreatedDemEvent_ECUM_E_IMPROPER_CALLER.GetEventExtendedDataRecordEx
        OpEventGetEventExtendedDataRecordEx_GetEventExtendedDataRecordEx_EvtInfo_AutoCreatedDemEvent_ECUM_E_CONFIGURATION_DATA_22f5ed01: start-on-event=DemSatellite_0InternalBehavior/GetEventExtendedDataRecordEx, operation=EvtInfo_AutoCreatedDemEvent_ECUM_E_CONFIGURATION_DATA_INCONSISTENT.GetEventExtendedDataRecordEx
        OpEventGetEventExtendedDataRecordEx_GetEventExtendedDataRecordEx_EvtInfo_AutoCreatedDemEvent_ECUM_E_ALL_RUN_REQUESTS_KILLED: start-on-event=DemSatellite_0InternalBehavior/GetEventExtendedDataRecordEx, operation=EvtInfo_AutoCreatedDemEvent_ECUM_E_ALL_RUN_REQUESTS_KILLED.GetEventExtendedDataRecordEx
        OpEventGetEventExtendedDataRecordEx_GetEventExtendedDataRecordEx_EvtInfo_AutoCreatedDemEvent_EEP_E_WRITE_FAILED: start-on-event=DemSatellite_0InternalBehavior/GetEventExtendedDataRecordEx, operation=EvtInfo_AutoCreatedDemEvent_EEP_E_WRITE_FAILED.GetEventExtendedDataRecordEx
        OpEventGetEventExtendedDataRecordEx_GetEventExtendedDataRecordEx_EvtInfo_AutoCreatedDemEvent_EEP_E_READ_FAILED: start-on-event=DemSatellite_0InternalBehavior/GetEventExtendedDataRecordEx, operation=EvtInfo_AutoCreatedDemEvent_EEP_E_READ_FAILED.GetEventExtendedDataRecordEx
        OpEventGetEventExtendedDataRecordEx_GetEventExtendedDataRecordEx_EvtInfo_AutoCreatedDemEvent_EEP_E_ERASE_FAILED: start-on-event=DemSatellite_0InternalBehavior/GetEventExtendedDataRecordEx, operation=EvtInfo_AutoCreatedDemEvent_EEP_E_ERASE_FAILED.GetEventExtendedDataRecordEx
        OpEventGetEventExtendedDataRecordEx_GetEventExtendedDataRecordEx_EvtInfo_AutoCreatedDemEvent_EEP_E_COMPARE_FAILED: start-on-event=DemSatellite_0InternalBehavior/GetEventExtendedDataRecordEx, operation=EvtInfo_AutoCreatedDemEvent_EEP_E_COMPARE_FAILED.GetEventExtendedDataRecordEx
        OpEventGetEventExtendedDataRecordEx_GetEventExtendedDataRecordEx_EvtInfo_AutoCreatedDemEvent_FLS_E_WRITE_FAILED: start-on-event=DemSatellite_0InternalBehavior/GetEventExtendedDataRecordEx, operation=EvtInfo_AutoCreatedDemEvent_FLS_E_WRITE_FAILED.GetEventExtendedDataRecordEx
        OpEventGetEventExtendedDataRecordEx_GetEventExtendedDataRecordEx_EvtInfo_AutoCreatedDemEvent_FLS_E_UNEXPECTED_FLASH_ID: start-on-event=DemSatellite_0InternalBehavior/GetEventExtendedDataRecordEx, operation=EvtInfo_AutoCreatedDemEvent_FLS_E_UNEXPECTED_FLASH_ID.GetEventExtendedDataRecordEx
        OpEventGetEventExtendedDataRecordEx_GetEventExtendedDataRecordEx_EvtInfo_AutoCreatedDemEvent_FLS_E_READ_FAILED: start-on-event=DemSatellite_0InternalBehavior/GetEventExtendedDataRecordEx, operation=EvtInfo_AutoCreatedDemEvent_FLS_E_READ_FAILED.GetEventExtendedDataRecordEx
        OpEventGetEventExtendedDataRecordEx_GetEventExtendedDataRecordEx_EvtInfo_AutoCreatedDemEvent_FLS_E_ERASE_FAILED: start-on-event=DemSatellite_0InternalBehavior/GetEventExtendedDataRecordEx, operation=EvtInfo_AutoCreatedDemEvent_FLS_E_ERASE_FAILED.GetEventExtendedDataRecordEx
        OpEventGetEventExtendedDataRecordEx_GetEventExtendedDataRecordEx_EvtInfo_AutoCreatedDemEvent_FLS_E_COMPARE_FAILED: start-on-event=DemSatellite_0InternalBehavior/GetEventExtendedDataRecordEx, operation=EvtInfo_AutoCreatedDemEvent_FLS_E_COMPARE_FAILED.GetEventExtendedDataRecordEx
        OpEventGetEventExtendedDataRecordEx_GetEventExtendedDataRecordEx_EvtInfo_AutoCreatedDemEvent_MyECU_6c1a0d52_FrDemCtrlTe_ccda8acf: start-on-event=DemSatellite_0InternalBehavior/GetEventExtendedDataRecordEx, operation=EvtInfo_AutoCreatedDemEvent_MyECU_6c1a0d52_FrDemCtrlTestResultRef.GetEventExtendedDataRecordEx
        OpEventGetEventExtendedDataRecordEx_GetEventExtendedDataRecordEx_EvtInfo_AutoCreatedDemEvent_LIN_E_TIMEOUT: start-on-event=DemSatellite_0InternalBehavior/GetEventExtendedDataRecordEx, operation=EvtInfo_AutoCreatedDemEvent_LIN_E_TIMEOUT.GetEventExtendedDataRecordEx
        OpEventGetEventExtendedDataRecordEx_GetEventExtendedDataRecordEx_EvtInfo_AutoCreatedDemEvent_McuModuleConfiguration_MCU_c1a2a5db: start-on-event=DemSatellite_0InternalBehavior/GetEventExtendedDataRecordEx, operation=EvtInfo_AutoCreatedDemEvent_McuModuleConfiguration_MCU_E_CLOCK_FAILURE.GetEventExtendedDataRecordEx
        OpEventGetEventExtendedDataRecordEx_GetEventExtendedDataRecordEx_EvtInfo_AutoCreatedDemEvent_NVM_E_WRONG_BLOCK_ID: start-on-event=DemSatellite_0InternalBehavior/GetEventExtendedDataRecordEx, operation=EvtInfo_AutoCreatedDemEvent_NVM_E_WRONG_BLOCK_ID.GetEventExtendedDataRecordEx
        OpEventGetEventExtendedDataRecordEx_GetEventExtendedDataRecordEx_EvtInfo_AutoCreatedDemEvent_NVM_E_WRITE_PROTECTED: start-on-event=DemSatellite_0InternalBehavior/GetEventExtendedDataRecordEx, operation=EvtInfo_AutoCreatedDemEvent_NVM_E_WRITE_PROTECTED.GetEventExtendedDataRecordEx
        OpEventGetEventExtendedDataRecordEx_GetEventExtendedDataRecordEx_EvtInfo_AutoCreatedDemEvent_NVM_E_VERIFY_FAILED: start-on-event=DemSatellite_0InternalBehavior/GetEventExtendedDataRecordEx, operation=EvtInfo_AutoCreatedDemEvent_NVM_E_VERIFY_FAILED.GetEventExtendedDataRecordEx
        OpEventGetEventExtendedDataRecordEx_GetEventExtendedDataRecordEx_EvtInfo_AutoCreatedDemEvent_NVM_E_REQ_FAILED: start-on-event=DemSatellite_0InternalBehavior/GetEventExtendedDataRecordEx, operation=EvtInfo_AutoCreatedDemEvent_NVM_E_REQ_FAILED.GetEventExtendedDataRecordEx
        OpEventGetEventExtendedDataRecordEx_GetEventExtendedDataRecordEx_EvtInfo_AutoCreatedDemEvent_NVM_E_QUEUE_OVERFLOW: start-on-event=DemSatellite_0InternalBehavior/GetEventExtendedDataRecordEx, operation=EvtInfo_AutoCreatedDemEvent_NVM_E_QUEUE_OVERFLOW.GetEventExtendedDataRecordEx
        OpEventGetEventExtendedDataRecordEx_GetEventExtendedDataRecordEx_EvtInfo_AutoCreatedDemEvent_NVM_E_LOSS_OF_REDUNDANCY: start-on-event=DemSatellite_0InternalBehavior/GetEventExtendedDataRecordEx, operation=EvtInfo_AutoCreatedDemEvent_NVM_E_LOSS_OF_REDUNDANCY.GetEventExtendedDataRecordEx
        OpEventGetEventExtendedDataRecordEx_GetEventExtendedDataRecordEx_EvtInfo_AutoCreatedDemEvent_NVM_E_INTEGRITY_FAILED: start-on-event=DemSatellite_0InternalBehavior/GetEventExtendedDataRecordEx, operation=EvtInfo_AutoCreatedDemEvent_NVM_E_INTEGRITY_FAILED.GetEventExtendedDataRecordEx
        OpEventGetEventExtendedDataRecordEx_GetEventExtendedDataRecordEx_EvtInfo_AutoCreatedDemEvent_XFRM_E_MALFORMED_MESSAGE_2: start-on-event=DemSatellite_0InternalBehavior/GetEventExtendedDataRecordEx, operation=EvtInfo_AutoCreatedDemEvent_XFRM_E_MALFORMED_MESSAGE_2.GetEventExtendedDataRecordEx
        OpEventGetEventExtendedDataRecordEx_GetEventExtendedDataRecordEx_EvtInfo_AutoCreatedDemEvent_EEP_E_WRITE_FAILED_1: start-on-event=DemSatellite_0InternalBehavior/GetEventExtendedDataRecordEx, operation=EvtInfo_AutoCreatedDemEvent_EEP_E_WRITE_FAILED_1.GetEventExtendedDataRecordEx
        OpEventGetEventExtendedDataRecordEx_GetEventExtendedDataRecordEx_EvtInfo_AutoCreatedDemEvent_EEP_E_READ_FAILED_1: start-on-event=DemSatellite_0InternalBehavior/GetEventExtendedDataRecordEx, operation=EvtInfo_AutoCreatedDemEvent_EEP_E_READ_FAILED_1.GetEventExtendedDataRecordEx
        OpEventGetEventExtendedDataRecordEx_GetEventExtendedDataRecordEx_EvtInfo_AutoCreatedDemEvent_EEP_E_ERASE_FAILED_1: start-on-event=DemSatellite_0InternalBehavior/GetEventExtendedDataRecordEx, operation=EvtInfo_AutoCreatedDemEvent_EEP_E_ERASE_FAILED_1.GetEventExtendedDataRecordEx
        OpEventGetEventExtendedDataRecordEx_GetEventExtendedDataRecordEx_EvtInfo_AutoCreatedDemEvent_EEP_E_COMPARE_FAILED_1: start-on-event=DemSatellite_0InternalBehavior/GetEventExtendedDataRecordEx, operation=EvtInfo_AutoCreatedDemEvent_EEP_E_COMPARE_FAILED_1.GetEventExtendedDataRecordEx
        OpEventGetEventExtendedDataRecordEx_GetEventExtendedDataRecordEx_EvtInfo_AutoCreatedDemEvent_FLS_E_WRITE_FAILED_1: start-on-event=DemSatellite_0InternalBehavior/GetEventExtendedDataRecordEx, operation=EvtInfo_AutoCreatedDemEvent_FLS_E_WRITE_FAILED_1.GetEventExtendedDataRecordEx
        OpEventGetEventExtendedDataRecordEx_GetEventExtendedDataRecordEx_EvtInfo_AutoCreatedDemEvent_FLS_E_UNEXPECTED_FLASH_ID_1: start-on-event=DemSatellite_0InternalBehavior/GetEventExtendedDataRecordEx, operation=EvtInfo_AutoCreatedDemEvent_FLS_E_UNEXPECTED_FLASH_ID_1.GetEventExtendedDataRecordEx
        OpEventGetEventExtendedDataRecordEx_GetEventExtendedDataRecordEx_EvtInfo_AutoCreatedDemEvent_FLS_E_READ_FAILED_1: start-on-event=DemSatellite_0InternalBehavior/GetEventExtendedDataRecordEx, operation=EvtInfo_AutoCreatedDemEvent_FLS_E_READ_FAILED_1.GetEventExtendedDataRecordEx
        OpEventGetEventExtendedDataRecordEx_GetEventExtendedDataRecordEx_EvtInfo_AutoCreatedDemEvent_FLS_E_ERASE_FAILED_1: start-on-event=DemSatellite_0InternalBehavior/GetEventExtendedDataRecordEx, operation=EvtInfo_AutoCreatedDemEvent_FLS_E_ERASE_FAILED_1.GetEventExtendedDataRecordEx
        OpEventGetEventExtendedDataRecordEx_GetEventExtendedDataRecordEx_EvtInfo_AutoCreatedDemEvent_FLS_E_COMPARE_FAILED_1: start-on-event=DemSatellite_0InternalBehavior/GetEventExtendedDataRecordEx, operation=EvtInfo_AutoCreatedDemEvent_FLS_E_COMPARE_FAILED_1.GetEventExtendedDataRecordEx
        OpEventGetEventExtendedDataRecordEx_GetEventExtendedDataRecordEx_EvtInfo_AutoCreatedDemEvent_MyECU_6c1a0d52_FrDemCtrlTe_6c2b3e3b: start-on-event=DemSatellite_0InternalBehavior/GetEventExtendedDataRecordEx, operation=EvtInfo_AutoCreatedDemEvent_MyECU_6c1a0d52_FrDemCtrlTestResultRef_1.GetEventExtendedDataRecordEx
        OpEventGetEventExtendedDataRecordEx_GetEventExtendedDataRecordEx_EvtInfo_AutoCreatedDemEvent_McuModuleConfiguration_MCU_e954d94f: start-on-event=DemSatellite_0InternalBehavior/GetEventExtendedDataRecordEx, operation=EvtInfo_AutoCreatedDemEvent_McuModuleConfiguration_MCU_E_CLOCK_FAILURE_1.GetEventExtendedDataRecordEx
        OpEventGetEventExtendedDataRecordEx_GetEventExtendedDataRecordEx_EvtInfo_AutoCreatedDemEvent_XCP_E_INIT_FAILED: start-on-event=DemSatellite_0InternalBehavior/GetEventExtendedDataRecordEx, operation=EvtInfo_AutoCreatedDemEvent_XCP_E_INIT_FAILED.GetEventExtendedDataRecordEx
        OpEventGetEventEnableCondition_GetEventEnableCondition_EvtInfo_AutoCreatedDemEvent_BswMConfig_BswMReportFailToDemRef: start-on-event=DemSatellite_0InternalBehavior/GetEventEnableCondition, operation=EvtInfo_AutoCreatedDemEvent_BswMConfig_BswMReportFailToDemRef.GetEventEnableCondition
        OpEventGetEventEnableCondition_GetEventEnableCondition_EvtInfo_AutoCreatedDemEvent_CHNL_346f2748_CANSM_E_MODE_REQUEST_TIMEOUT: start-on-event=DemSatellite_0InternalBehavior/GetEventEnableCondition, operation=EvtInfo_AutoCreatedDemEvent_CHNL_346f2748_CANSM_E_MODE_REQUEST_TIMEOUT.GetEventEnableCondition
        OpEventGetEventEnableCondition_GetEventEnableCondition_EvtInfo_AutoCreatedDemEvent_CHNL_346f2748_CANSM_E_BUS_OFF: start-on-event=DemSatellite_0InternalBehavior/GetEventEnableCondition, operation=EvtInfo_AutoCreatedDemEvent_CHNL_346f2748_CANSM_E_BUS_OFF.GetEventEnableCondition
        OpEventGetEventEnableCondition_GetEventEnableCondition_EvtInfo_AutoCreatedDemEvent_XFRM_E_MALFORMED_MESSAGE: start-on-event=DemSatellite_0InternalBehavior/GetEventEnableCondition, operation=EvtInfo_AutoCreatedDemEvent_XFRM_E_MALFORMED_MESSAGE.GetEventEnableCondition
        OpEventGetEventEnableCondition_GetEventEnableCondition_EvtInfo_AutoCreatedDemEvent_XFRM_E_MALFORMED_MESSAGE_1: start-on-event=DemSatellite_0InternalBehavior/GetEventEnableCondition, operation=EvtInfo_AutoCreatedDemEvent_XFRM_E_MALFORMED_MESSAGE_1.GetEventEnableCondition
        OpEventGetEventEnableCondition_GetEventEnableCondition_EvtInfo_AutoCreatedDemEvent_ECUM_E_RAM_CHECK_FAILED: start-on-event=DemSatellite_0InternalBehavior/GetEventEnableCondition, operation=EvtInfo_AutoCreatedDemEvent_ECUM_E_RAM_CHECK_FAILED.GetEventEnableCondition
        OpEventGetEventEnableCondition_GetEventEnableCondition_EvtInfo_AutoCreatedDemEvent_ECUM_E_IMPROPER_CALLER: start-on-event=DemSatellite_0InternalBehavior/GetEventEnableCondition, operation=EvtInfo_AutoCreatedDemEvent_ECUM_E_IMPROPER_CALLER.GetEventEnableCondition
        OpEventGetEventEnableCondition_GetEventEnableCondition_EvtInfo_AutoCreatedDemEvent_ECUM_E_CONFIGURATION_DATA_INCONSISTENT: start-on-event=DemSatellite_0InternalBehavior/GetEventEnableCondition, operation=EvtInfo_AutoCreatedDemEvent_ECUM_E_CONFIGURATION_DATA_INCONSISTENT.GetEventEnableCondition
        OpEventGetEventEnableCondition_GetEventEnableCondition_EvtInfo_AutoCreatedDemEvent_ECUM_E_ALL_RUN_REQUESTS_KILLED: start-on-event=DemSatellite_0InternalBehavior/GetEventEnableCondition, operation=EvtInfo_AutoCreatedDemEvent_ECUM_E_ALL_RUN_REQUESTS_KILLED.GetEventEnableCondition
        OpEventGetEventEnableCondition_GetEventEnableCondition_EvtInfo_AutoCreatedDemEvent_EEP_E_WRITE_FAILED: start-on-event=DemSatellite_0InternalBehavior/GetEventEnableCondition, operation=EvtInfo_AutoCreatedDemEvent_EEP_E_WRITE_FAILED.GetEventEnableCondition
        OpEventGetEventEnableCondition_GetEventEnableCondition_EvtInfo_AutoCreatedDemEvent_EEP_E_READ_FAILED: start-on-event=DemSatellite_0InternalBehavior/GetEventEnableCondition, operation=EvtInfo_AutoCreatedDemEvent_EEP_E_READ_FAILED.GetEventEnableCondition
        OpEventGetEventEnableCondition_GetEventEnableCondition_EvtInfo_AutoCreatedDemEvent_EEP_E_ERASE_FAILED: start-on-event=DemSatellite_0InternalBehavior/GetEventEnableCondition, operation=EvtInfo_AutoCreatedDemEvent_EEP_E_ERASE_FAILED.GetEventEnableCondition
        OpEventGetEventEnableCondition_GetEventEnableCondition_EvtInfo_AutoCreatedDemEvent_EEP_E_COMPARE_FAILED: start-on-event=DemSatellite_0InternalBehavior/GetEventEnableCondition, operation=EvtInfo_AutoCreatedDemEvent_EEP_E_COMPARE_FAILED.GetEventEnableCondition
        OpEventGetEventEnableCondition_GetEventEnableCondition_EvtInfo_AutoCreatedDemEvent_FLS_E_WRITE_FAILED: start-on-event=DemSatellite_0InternalBehavior/GetEventEnableCondition, operation=EvtInfo_AutoCreatedDemEvent_FLS_E_WRITE_FAILED.GetEventEnableCondition
        OpEventGetEventEnableCondition_GetEventEnableCondition_EvtInfo_AutoCreatedDemEvent_FLS_E_UNEXPECTED_FLASH_ID: start-on-event=DemSatellite_0InternalBehavior/GetEventEnableCondition, operation=EvtInfo_AutoCreatedDemEvent_FLS_E_UNEXPECTED_FLASH_ID.GetEventEnableCondition
        OpEventGetEventEnableCondition_GetEventEnableCondition_EvtInfo_AutoCreatedDemEvent_FLS_E_READ_FAILED: start-on-event=DemSatellite_0InternalBehavior/GetEventEnableCondition, operation=EvtInfo_AutoCreatedDemEvent_FLS_E_READ_FAILED.GetEventEnableCondition
        OpEventGetEventEnableCondition_GetEventEnableCondition_EvtInfo_AutoCreatedDemEvent_FLS_E_ERASE_FAILED: start-on-event=DemSatellite_0InternalBehavior/GetEventEnableCondition, operation=EvtInfo_AutoCreatedDemEvent_FLS_E_ERASE_FAILED.GetEventEnableCondition
        OpEventGetEventEnableCondition_GetEventEnableCondition_EvtInfo_AutoCreatedDemEvent_FLS_E_COMPARE_FAILED: start-on-event=DemSatellite_0InternalBehavior/GetEventEnableCondition, operation=EvtInfo_AutoCreatedDemEvent_FLS_E_COMPARE_FAILED.GetEventEnableCondition
        OpEventGetEventEnableCondition_GetEventEnableCondition_EvtInfo_AutoCreatedDemEvent_MyECU_6c1a0d52_FrDemCtrlTestResultRef: start-on-event=DemSatellite_0InternalBehavior/GetEventEnableCondition, operation=EvtInfo_AutoCreatedDemEvent_MyECU_6c1a0d52_FrDemCtrlTestResultRef.GetEventEnableCondition
        OpEventGetEventEnableCondition_GetEventEnableCondition_EvtInfo_AutoCreatedDemEvent_LIN_E_TIMEOUT: start-on-event=DemSatellite_0InternalBehavior/GetEventEnableCondition, operation=EvtInfo_AutoCreatedDemEvent_LIN_E_TIMEOUT.GetEventEnableCondition
        OpEventGetEventEnableCondition_GetEventEnableCondition_EvtInfo_AutoCreatedDemEvent_McuModuleConfiguration_MCU_E_CLOCK_FAILURE: start-on-event=DemSatellite_0InternalBehavior/GetEventEnableCondition, operation=EvtInfo_AutoCreatedDemEvent_McuModuleConfiguration_MCU_E_CLOCK_FAILURE.GetEventEnableCondition
        OpEventGetEventEnableCondition_GetEventEnableCondition_EvtInfo_AutoCreatedDemEvent_NVM_E_WRONG_BLOCK_ID: start-on-event=DemSatellite_0InternalBehavior/GetEventEnableCondition, operation=EvtInfo_AutoCreatedDemEvent_NVM_E_WRONG_BLOCK_ID.GetEventEnableCondition
        OpEventGetEventEnableCondition_GetEventEnableCondition_EvtInfo_AutoCreatedDemEvent_NVM_E_WRITE_PROTECTED: start-on-event=DemSatellite_0InternalBehavior/GetEventEnableCondition, operation=EvtInfo_AutoCreatedDemEvent_NVM_E_WRITE_PROTECTED.GetEventEnableCondition
        OpEventGetEventEnableCondition_GetEventEnableCondition_EvtInfo_AutoCreatedDemEvent_NVM_E_VERIFY_FAILED: start-on-event=DemSatellite_0InternalBehavior/GetEventEnableCondition, operation=EvtInfo_AutoCreatedDemEvent_NVM_E_VERIFY_FAILED.GetEventEnableCondition
        OpEventGetEventEnableCondition_GetEventEnableCondition_EvtInfo_AutoCreatedDemEvent_NVM_E_REQ_FAILED: start-on-event=DemSatellite_0InternalBehavior/GetEventEnableCondition, operation=EvtInfo_AutoCreatedDemEvent_NVM_E_REQ_FAILED.GetEventEnableCondition
        OpEventGetEventEnableCondition_GetEventEnableCondition_EvtInfo_AutoCreatedDemEvent_NVM_E_QUEUE_OVERFLOW: start-on-event=DemSatellite_0InternalBehavior/GetEventEnableCondition, operation=EvtInfo_AutoCreatedDemEvent_NVM_E_QUEUE_OVERFLOW.GetEventEnableCondition
        OpEventGetEventEnableCondition_GetEventEnableCondition_EvtInfo_AutoCreatedDemEvent_NVM_E_LOSS_OF_REDUNDANCY: start-on-event=DemSatellite_0InternalBehavior/GetEventEnableCondition, operation=EvtInfo_AutoCreatedDemEvent_NVM_E_LOSS_OF_REDUNDANCY.GetEventEnableCondition
        OpEventGetEventEnableCondition_GetEventEnableCondition_EvtInfo_AutoCreatedDemEvent_NVM_E_INTEGRITY_FAILED: start-on-event=DemSatellite_0InternalBehavior/GetEventEnableCondition, operation=EvtInfo_AutoCreatedDemEvent_NVM_E_INTEGRITY_FAILED.GetEventEnableCondition
        OpEventGetEventEnableCondition_GetEventEnableCondition_EvtInfo_AutoCreatedDemEvent_XFRM_E_MALFORMED_MESSAGE_2: start-on-event=DemSatellite_0InternalBehavior/GetEventEnableCondition, operation=EvtInfo_AutoCreatedDemEvent_XFRM_E_MALFORMED_MESSAGE_2.GetEventEnableCondition
        OpEventGetEventEnableCondition_GetEventEnableCondition_EvtInfo_AutoCreatedDemEvent_EEP_E_WRITE_FAILED_1: start-on-event=DemSatellite_0InternalBehavior/GetEventEnableCondition, operation=EvtInfo_AutoCreatedDemEvent_EEP_E_WRITE_FAILED_1.GetEventEnableCondition
        OpEventGetEventEnableCondition_GetEventEnableCondition_EvtInfo_AutoCreatedDemEvent_EEP_E_READ_FAILED_1: start-on-event=DemSatellite_0InternalBehavior/GetEventEnableCondition, operation=EvtInfo_AutoCreatedDemEvent_EEP_E_READ_FAILED_1.GetEventEnableCondition
        OpEventGetEventEnableCondition_GetEventEnableCondition_EvtInfo_AutoCreatedDemEvent_EEP_E_ERASE_FAILED_1: start-on-event=DemSatellite_0InternalBehavior/GetEventEnableCondition, operation=EvtInfo_AutoCreatedDemEvent_EEP_E_ERASE_FAILED_1.GetEventEnableCondition
        OpEventGetEventEnableCondition_GetEventEnableCondition_EvtInfo_AutoCreatedDemEvent_EEP_E_COMPARE_FAILED_1: start-on-event=DemSatellite_0InternalBehavior/GetEventEnableCondition, operation=EvtInfo_AutoCreatedDemEvent_EEP_E_COMPARE_FAILED_1.GetEventEnableCondition
        OpEventGetEventEnableCondition_GetEventEnableCondition_EvtInfo_AutoCreatedDemEvent_FLS_E_WRITE_FAILED_1: start-on-event=DemSatellite_0InternalBehavior/GetEventEnableCondition, operation=EvtInfo_AutoCreatedDemEvent_FLS_E_WRITE_FAILED_1.GetEventEnableCondition
        OpEventGetEventEnableCondition_GetEventEnableCondition_EvtInfo_AutoCreatedDemEvent_FLS_E_UNEXPECTED_FLASH_ID_1: start-on-event=DemSatellite_0InternalBehavior/GetEventEnableCondition, operation=EvtInfo_AutoCreatedDemEvent_FLS_E_UNEXPECTED_FLASH_ID_1.GetEventEnableCondition
        OpEventGetEventEnableCondition_GetEventEnableCondition_EvtInfo_AutoCreatedDemEvent_FLS_E_READ_FAILED_1: start-on-event=DemSatellite_0InternalBehavior/GetEventEnableCondition, operation=EvtInfo_AutoCreatedDemEvent_FLS_E_READ_FAILED_1.GetEventEnableCondition
        OpEventGetEventEnableCondition_GetEventEnableCondition_EvtInfo_AutoCreatedDemEvent_FLS_E_ERASE_FAILED_1: start-on-event=DemSatellite_0InternalBehavior/GetEventEnableCondition, operation=EvtInfo_AutoCreatedDemEvent_FLS_E_ERASE_FAILED_1.GetEventEnableCondition
        OpEventGetEventEnableCondition_GetEventEnableCondition_EvtInfo_AutoCreatedDemEvent_FLS_E_COMPARE_FAILED_1: start-on-event=DemSatellite_0InternalBehavior/GetEventEnableCondition, operation=EvtInfo_AutoCreatedDemEvent_FLS_E_COMPARE_FAILED_1.GetEventEnableCondition
        OpEventGetEventEnableCondition_GetEventEnableCondition_EvtInfo_AutoCreatedDemEvent_MyECU_6c1a0d52_FrDemCtrlTestResultRef_1: start-on-event=DemSatellite_0InternalBehavior/GetEventEnableCondition, operation=EvtInfo_AutoCreatedDemEvent_MyECU_6c1a0d52_FrDemCtrlTestResultRef_1.GetEventEnableCondition
        OpEventGetEventEnableCondition_GetEventEnableCondition_EvtInfo_AutoCreatedDemEvent_McuModuleConfiguration_MCU_E_CLOCK_FAILURE_1: start-on-event=DemSatellite_0InternalBehavior/GetEventEnableCondition, operation=EvtInfo_AutoCreatedDemEvent_McuModuleConfiguration_MCU_E_CLOCK_FAILURE_1.GetEventEnableCondition
        OpEventGetEventEnableCondition_GetEventEnableCondition_EvtInfo_AutoCreatedDemEvent_XCP_E_INIT_FAILED: start-on-event=DemSatellite_0InternalBehavior/GetEventEnableCondition, operation=EvtInfo_AutoCreatedDemEvent_XCP_E_INIT_FAILED.GetEventEnableCondition
        OpEventGetDebouncingOfEvent_GetDebouncingOfEvent_EvtInfo_AutoCreatedDemEvent_BswMConfig_BswMReportFailToDemRef: start-on-event=DemSatellite_0InternalBehavior/GetDebouncingOfEvent, operation=EvtInfo_AutoCreatedDemEvent_BswMConfig_BswMReportFailToDemRef.GetDebouncingOfEvent
        OpEventGetDebouncingOfEvent_GetDebouncingOfEvent_EvtInfo_AutoCreatedDemEvent_CHNL_346f2748_CANSM_E_MODE_REQUEST_TIMEOUT: start-on-event=DemSatellite_0InternalBehavior/GetDebouncingOfEvent, operation=EvtInfo_AutoCreatedDemEvent_CHNL_346f2748_CANSM_E_MODE_REQUEST_TIMEOUT.GetDebouncingOfEvent
        OpEventGetDebouncingOfEvent_GetDebouncingOfEvent_EvtInfo_AutoCreatedDemEvent_CHNL_346f2748_CANSM_E_BUS_OFF: start-on-event=DemSatellite_0InternalBehavior/GetDebouncingOfEvent, operation=EvtInfo_AutoCreatedDemEvent_CHNL_346f2748_CANSM_E_BUS_OFF.GetDebouncingOfEvent
        OpEventGetDebouncingOfEvent_GetDebouncingOfEvent_EvtInfo_AutoCreatedDemEvent_XFRM_E_MALFORMED_MESSAGE: start-on-event=DemSatellite_0InternalBehavior/GetDebouncingOfEvent, operation=EvtInfo_AutoCreatedDemEvent_XFRM_E_MALFORMED_MESSAGE.GetDebouncingOfEvent
        OpEventGetDebouncingOfEvent_GetDebouncingOfEvent_EvtInfo_AutoCreatedDemEvent_XFRM_E_MALFORMED_MESSAGE_1: start-on-event=DemSatellite_0InternalBehavior/GetDebouncingOfEvent, operation=EvtInfo_AutoCreatedDemEvent_XFRM_E_MALFORMED_MESSAGE_1.GetDebouncingOfEvent
        OpEventGetDebouncingOfEvent_GetDebouncingOfEvent_EvtInfo_AutoCreatedDemEvent_ECUM_E_RAM_CHECK_FAILED: start-on-event=DemSatellite_0InternalBehavior/GetDebouncingOfEvent, operation=EvtInfo_AutoCreatedDemEvent_ECUM_E_RAM_CHECK_FAILED.GetDebouncingOfEvent
        OpEventGetDebouncingOfEvent_GetDebouncingOfEvent_EvtInfo_AutoCreatedDemEvent_ECUM_E_IMPROPER_CALLER: start-on-event=DemSatellite_0InternalBehavior/GetDebouncingOfEvent, operation=EvtInfo_AutoCreatedDemEvent_ECUM_E_IMPROPER_CALLER.GetDebouncingOfEvent
        OpEventGetDebouncingOfEvent_GetDebouncingOfEvent_EvtInfo_AutoCreatedDemEvent_ECUM_E_CONFIGURATION_DATA_INCONSISTENT: start-on-event=DemSatellite_0InternalBehavior/GetDebouncingOfEvent, operation=EvtInfo_AutoCreatedDemEvent_ECUM_E_CONFIGURATION_DATA_INCONSISTENT.GetDebouncingOfEvent
        OpEventGetDebouncingOfEvent_GetDebouncingOfEvent_EvtInfo_AutoCreatedDemEvent_ECUM_E_ALL_RUN_REQUESTS_KILLED: start-on-event=DemSatellite_0InternalBehavior/GetDebouncingOfEvent, operation=EvtInfo_AutoCreatedDemEvent_ECUM_E_ALL_RUN_REQUESTS_KILLED.GetDebouncingOfEvent
        OpEventGetDebouncingOfEvent_GetDebouncingOfEvent_EvtInfo_AutoCreatedDemEvent_EEP_E_WRITE_FAILED: start-on-event=DemSatellite_0InternalBehavior/GetDebouncingOfEvent, operation=EvtInfo_AutoCreatedDemEvent_EEP_E_WRITE_FAILED.GetDebouncingOfEvent
        OpEventGetDebouncingOfEvent_GetDebouncingOfEvent_EvtInfo_AutoCreatedDemEvent_EEP_E_READ_FAILED: start-on-event=DemSatellite_0InternalBehavior/GetDebouncingOfEvent, operation=EvtInfo_AutoCreatedDemEvent_EEP_E_READ_FAILED.GetDebouncingOfEvent
        OpEventGetDebouncingOfEvent_GetDebouncingOfEvent_EvtInfo_AutoCreatedDemEvent_EEP_E_ERASE_FAILED: start-on-event=DemSatellite_0InternalBehavior/GetDebouncingOfEvent, operation=EvtInfo_AutoCreatedDemEvent_EEP_E_ERASE_FAILED.GetDebouncingOfEvent
        OpEventGetDebouncingOfEvent_GetDebouncingOfEvent_EvtInfo_AutoCreatedDemEvent_EEP_E_COMPARE_FAILED: start-on-event=DemSatellite_0InternalBehavior/GetDebouncingOfEvent, operation=EvtInfo_AutoCreatedDemEvent_EEP_E_COMPARE_FAILED.GetDebouncingOfEvent
        OpEventGetDebouncingOfEvent_GetDebouncingOfEvent_EvtInfo_AutoCreatedDemEvent_FLS_E_WRITE_FAILED: start-on-event=DemSatellite_0InternalBehavior/GetDebouncingOfEvent, operation=EvtInfo_AutoCreatedDemEvent_FLS_E_WRITE_FAILED.GetDebouncingOfEvent
        OpEventGetDebouncingOfEvent_GetDebouncingOfEvent_EvtInfo_AutoCreatedDemEvent_FLS_E_UNEXPECTED_FLASH_ID: start-on-event=DemSatellite_0InternalBehavior/GetDebouncingOfEvent, operation=EvtInfo_AutoCreatedDemEvent_FLS_E_UNEXPECTED_FLASH_ID.GetDebouncingOfEvent
        OpEventGetDebouncingOfEvent_GetDebouncingOfEvent_EvtInfo_AutoCreatedDemEvent_FLS_E_READ_FAILED: start-on-event=DemSatellite_0InternalBehavior/GetDebouncingOfEvent, operation=EvtInfo_AutoCreatedDemEvent_FLS_E_READ_FAILED.GetDebouncingOfEvent
        OpEventGetDebouncingOfEvent_GetDebouncingOfEvent_EvtInfo_AutoCreatedDemEvent_FLS_E_ERASE_FAILED: start-on-event=DemSatellite_0InternalBehavior/GetDebouncingOfEvent, operation=EvtInfo_AutoCreatedDemEvent_FLS_E_ERASE_FAILED.GetDebouncingOfEvent
        OpEventGetDebouncingOfEvent_GetDebouncingOfEvent_EvtInfo_AutoCreatedDemEvent_FLS_E_COMPARE_FAILED: start-on-event=DemSatellite_0InternalBehavior/GetDebouncingOfEvent, operation=EvtInfo_AutoCreatedDemEvent_FLS_E_COMPARE_FAILED.GetDebouncingOfEvent
        OpEventGetDebouncingOfEvent_GetDebouncingOfEvent_EvtInfo_AutoCreatedDemEvent_MyECU_6c1a0d52_FrDemCtrlTestResultRef: start-on-event=DemSatellite_0InternalBehavior/GetDebouncingOfEvent, operation=EvtInfo_AutoCreatedDemEvent_MyECU_6c1a0d52_FrDemCtrlTestResultRef.GetDebouncingOfEvent
        OpEventGetDebouncingOfEvent_GetDebouncingOfEvent_EvtInfo_AutoCreatedDemEvent_LIN_E_TIMEOUT: start-on-event=DemSatellite_0InternalBehavior/GetDebouncingOfEvent, operation=EvtInfo_AutoCreatedDemEvent_LIN_E_TIMEOUT.GetDebouncingOfEvent
        OpEventGetDebouncingOfEvent_GetDebouncingOfEvent_EvtInfo_AutoCreatedDemEvent_McuModuleConfiguration_MCU_E_CLOCK_FAILURE: start-on-event=DemSatellite_0InternalBehavior/GetDebouncingOfEvent, operation=EvtInfo_AutoCreatedDemEvent_McuModuleConfiguration_MCU_E_CLOCK_FAILURE.GetDebouncingOfEvent
        OpEventGetDebouncingOfEvent_GetDebouncingOfEvent_EvtInfo_AutoCreatedDemEvent_NVM_E_WRONG_BLOCK_ID: start-on-event=DemSatellite_0InternalBehavior/GetDebouncingOfEvent, operation=EvtInfo_AutoCreatedDemEvent_NVM_E_WRONG_BLOCK_ID.GetDebouncingOfEvent
        OpEventGetDebouncingOfEvent_GetDebouncingOfEvent_EvtInfo_AutoCreatedDemEvent_NVM_E_WRITE_PROTECTED: start-on-event=DemSatellite_0InternalBehavior/GetDebouncingOfEvent, operation=EvtInfo_AutoCreatedDemEvent_NVM_E_WRITE_PROTECTED.GetDebouncingOfEvent
        OpEventGetDebouncingOfEvent_GetDebouncingOfEvent_EvtInfo_AutoCreatedDemEvent_NVM_E_VERIFY_FAILED: start-on-event=DemSatellite_0InternalBehavior/GetDebouncingOfEvent, operation=EvtInfo_AutoCreatedDemEvent_NVM_E_VERIFY_FAILED.GetDebouncingOfEvent
        OpEventGetDebouncingOfEvent_GetDebouncingOfEvent_EvtInfo_AutoCreatedDemEvent_NVM_E_REQ_FAILED: start-on-event=DemSatellite_0InternalBehavior/GetDebouncingOfEvent, operation=EvtInfo_AutoCreatedDemEvent_NVM_E_REQ_FAILED.GetDebouncingOfEvent
        OpEventGetDebouncingOfEvent_GetDebouncingOfEvent_EvtInfo_AutoCreatedDemEvent_NVM_E_QUEUE_OVERFLOW: start-on-event=DemSatellite_0InternalBehavior/GetDebouncingOfEvent, operation=EvtInfo_AutoCreatedDemEvent_NVM_E_QUEUE_OVERFLOW.GetDebouncingOfEvent
        OpEventGetDebouncingOfEvent_GetDebouncingOfEvent_EvtInfo_AutoCreatedDemEvent_NVM_E_LOSS_OF_REDUNDANCY: start-on-event=DemSatellite_0InternalBehavior/GetDebouncingOfEvent, operation=EvtInfo_AutoCreatedDemEvent_NVM_E_LOSS_OF_REDUNDANCY.GetDebouncingOfEvent
        OpEventGetDebouncingOfEvent_GetDebouncingOfEvent_EvtInfo_AutoCreatedDemEvent_NVM_E_INTEGRITY_FAILED: start-on-event=DemSatellite_0InternalBehavior/GetDebouncingOfEvent, operation=EvtInfo_AutoCreatedDemEvent_NVM_E_INTEGRITY_FAILED.GetDebouncingOfEvent
        OpEventGetDebouncingOfEvent_GetDebouncingOfEvent_EvtInfo_AutoCreatedDemEvent_XFRM_E_MALFORMED_MESSAGE_2: start-on-event=DemSatellite_0InternalBehavior/GetDebouncingOfEvent, operation=EvtInfo_AutoCreatedDemEvent_XFRM_E_MALFORMED_MESSAGE_2.GetDebouncingOfEvent
        OpEventGetDebouncingOfEvent_GetDebouncingOfEvent_EvtInfo_AutoCreatedDemEvent_EEP_E_WRITE_FAILED_1: start-on-event=DemSatellite_0InternalBehavior/GetDebouncingOfEvent, operation=EvtInfo_AutoCreatedDemEvent_EEP_E_WRITE_FAILED_1.GetDebouncingOfEvent
        OpEventGetDebouncingOfEvent_GetDebouncingOfEvent_EvtInfo_AutoCreatedDemEvent_EEP_E_READ_FAILED_1: start-on-event=DemSatellite_0InternalBehavior/GetDebouncingOfEvent, operation=EvtInfo_AutoCreatedDemEvent_EEP_E_READ_FAILED_1.GetDebouncingOfEvent
        OpEventGetDebouncingOfEvent_GetDebouncingOfEvent_EvtInfo_AutoCreatedDemEvent_EEP_E_ERASE_FAILED_1: start-on-event=DemSatellite_0InternalBehavior/GetDebouncingOfEvent, operation=EvtInfo_AutoCreatedDemEvent_EEP_E_ERASE_FAILED_1.GetDebouncingOfEvent
        OpEventGetDebouncingOfEvent_GetDebouncingOfEvent_EvtInfo_AutoCreatedDemEvent_EEP_E_COMPARE_FAILED_1: start-on-event=DemSatellite_0InternalBehavior/GetDebouncingOfEvent, operation=EvtInfo_AutoCreatedDemEvent_EEP_E_COMPARE_FAILED_1.GetDebouncingOfEvent
        OpEventGetDebouncingOfEvent_GetDebouncingOfEvent_EvtInfo_AutoCreatedDemEvent_FLS_E_WRITE_FAILED_1: start-on-event=DemSatellite_0InternalBehavior/GetDebouncingOfEvent, operation=EvtInfo_AutoCreatedDemEvent_FLS_E_WRITE_FAILED_1.GetDebouncingOfEvent
        OpEventGetDebouncingOfEvent_GetDebouncingOfEvent_EvtInfo_AutoCreatedDemEvent_FLS_E_UNEXPECTED_FLASH_ID_1: start-on-event=DemSatellite_0InternalBehavior/GetDebouncingOfEvent, operation=EvtInfo_AutoCreatedDemEvent_FLS_E_UNEXPECTED_FLASH_ID_1.GetDebouncingOfEvent
        OpEventGetDebouncingOfEvent_GetDebouncingOfEvent_EvtInfo_AutoCreatedDemEvent_FLS_E_READ_FAILED_1: start-on-event=DemSatellite_0InternalBehavior/GetDebouncingOfEvent, operation=EvtInfo_AutoCreatedDemEvent_FLS_E_READ_FAILED_1.GetDebouncingOfEvent
        OpEventGetDebouncingOfEvent_GetDebouncingOfEvent_EvtInfo_AutoCreatedDemEvent_FLS_E_ERASE_FAILED_1: start-on-event=DemSatellite_0InternalBehavior/GetDebouncingOfEvent, operation=EvtInfo_AutoCreatedDemEvent_FLS_E_ERASE_FAILED_1.GetDebouncingOfEvent
        OpEventGetDebouncingOfEvent_GetDebouncingOfEvent_EvtInfo_AutoCreatedDemEvent_FLS_E_COMPARE_FAILED_1: start-on-event=DemSatellite_0InternalBehavior/GetDebouncingOfEvent, operation=EvtInfo_AutoCreatedDemEvent_FLS_E_COMPARE_FAILED_1.GetDebouncingOfEvent
        OpEventGetDebouncingOfEvent_GetDebouncingOfEvent_EvtInfo_AutoCreatedDemEvent_MyECU_6c1a0d52_FrDemCtrlTestResultRef_1: start-on-event=DemSatellite_0InternalBehavior/GetDebouncingOfEvent, operation=EvtInfo_AutoCreatedDemEvent_MyECU_6c1a0d52_FrDemCtrlTestResultRef_1.GetDebouncingOfEvent
        OpEventGetDebouncingOfEvent_GetDebouncingOfEvent_EvtInfo_AutoCreatedDemEvent_McuModuleConfiguration_MCU_E_CLOCK_FAILURE_1: start-on-event=DemSatellite_0InternalBehavior/GetDebouncingOfEvent, operation=EvtInfo_AutoCreatedDemEvent_McuModuleConfiguration_MCU_E_CLOCK_FAILURE_1.GetDebouncingOfEvent
        OpEventGetDebouncingOfEvent_GetDebouncingOfEvent_EvtInfo_AutoCreatedDemEvent_XCP_E_INIT_FAILED: start-on-event=DemSatellite_0InternalBehavior/GetDebouncingOfEvent, operation=EvtInfo_AutoCreatedDemEvent_XCP_E_INIT_FAILED.GetDebouncingOfEvent
        OpEventGetMonitorStatus_GetMonitorStatus_EvtInfo_AutoCreatedDemEvent_BswMConfig_BswMReportFailToDemRef: start-on-event=DemSatellite_0InternalBehavior/GetMonitorStatus, operation=EvtInfo_AutoCreatedDemEvent_BswMConfig_BswMReportFailToDemRef.GetMonitorStatus
        OpEventGetMonitorStatus_GetMonitorStatus_EvtInfo_AutoCreatedDemEvent_CHNL_346f2748_CANSM_E_MODE_REQUEST_TIMEOUT: start-on-event=DemSatellite_0InternalBehavior/GetMonitorStatus, operation=EvtInfo_AutoCreatedDemEvent_CHNL_346f2748_CANSM_E_MODE_REQUEST_TIMEOUT.GetMonitorStatus
        OpEventGetMonitorStatus_GetMonitorStatus_EvtInfo_AutoCreatedDemEvent_CHNL_346f2748_CANSM_E_BUS_OFF: start-on-event=DemSatellite_0InternalBehavior/GetMonitorStatus, operation=EvtInfo_AutoCreatedDemEvent_CHNL_346f2748_CANSM_E_BUS_OFF.GetMonitorStatus
        OpEventGetMonitorStatus_GetMonitorStatus_EvtInfo_AutoCreatedDemEvent_XFRM_E_MALFORMED_MESSAGE: start-on-event=DemSatellite_0InternalBehavior/GetMonitorStatus, operation=EvtInfo_AutoCreatedDemEvent_XFRM_E_MALFORMED_MESSAGE.GetMonitorStatus
        OpEventGetMonitorStatus_GetMonitorStatus_EvtInfo_AutoCreatedDemEvent_XFRM_E_MALFORMED_MESSAGE_1: start-on-event=DemSatellite_0InternalBehavior/GetMonitorStatus, operation=EvtInfo_AutoCreatedDemEvent_XFRM_E_MALFORMED_MESSAGE_1.GetMonitorStatus
        OpEventGetMonitorStatus_GetMonitorStatus_EvtInfo_AutoCreatedDemEvent_ECUM_E_RAM_CHECK_FAILED: start-on-event=DemSatellite_0InternalBehavior/GetMonitorStatus, operation=EvtInfo_AutoCreatedDemEvent_ECUM_E_RAM_CHECK_FAILED.GetMonitorStatus
        OpEventGetMonitorStatus_GetMonitorStatus_EvtInfo_AutoCreatedDemEvent_ECUM_E_IMPROPER_CALLER: start-on-event=DemSatellite_0InternalBehavior/GetMonitorStatus, operation=EvtInfo_AutoCreatedDemEvent_ECUM_E_IMPROPER_CALLER.GetMonitorStatus
        OpEventGetMonitorStatus_GetMonitorStatus_EvtInfo_AutoCreatedDemEvent_ECUM_E_CONFIGURATION_DATA_INCONSISTENT: start-on-event=DemSatellite_0InternalBehavior/GetMonitorStatus, operation=EvtInfo_AutoCreatedDemEvent_ECUM_E_CONFIGURATION_DATA_INCONSISTENT.GetMonitorStatus
        OpEventGetMonitorStatus_GetMonitorStatus_EvtInfo_AutoCreatedDemEvent_ECUM_E_ALL_RUN_REQUESTS_KILLED: start-on-event=DemSatellite_0InternalBehavior/GetMonitorStatus, operation=EvtInfo_AutoCreatedDemEvent_ECUM_E_ALL_RUN_REQUESTS_KILLED.GetMonitorStatus
        OpEventGetMonitorStatus_GetMonitorStatus_EvtInfo_AutoCreatedDemEvent_EEP_E_WRITE_FAILED: start-on-event=DemSatellite_0InternalBehavior/GetMonitorStatus, operation=EvtInfo_AutoCreatedDemEvent_EEP_E_WRITE_FAILED.GetMonitorStatus
        OpEventGetMonitorStatus_GetMonitorStatus_EvtInfo_AutoCreatedDemEvent_EEP_E_READ_FAILED: start-on-event=DemSatellite_0InternalBehavior/GetMonitorStatus, operation=EvtInfo_AutoCreatedDemEvent_EEP_E_READ_FAILED.GetMonitorStatus
        OpEventGetMonitorStatus_GetMonitorStatus_EvtInfo_AutoCreatedDemEvent_EEP_E_ERASE_FAILED: start-on-event=DemSatellite_0InternalBehavior/GetMonitorStatus, operation=EvtInfo_AutoCreatedDemEvent_EEP_E_ERASE_FAILED.GetMonitorStatus
        OpEventGetMonitorStatus_GetMonitorStatus_EvtInfo_AutoCreatedDemEvent_EEP_E_COMPARE_FAILED: start-on-event=DemSatellite_0InternalBehavior/GetMonitorStatus, operation=EvtInfo_AutoCreatedDemEvent_EEP_E_COMPARE_FAILED.GetMonitorStatus
        OpEventGetMonitorStatus_GetMonitorStatus_EvtInfo_AutoCreatedDemEvent_FLS_E_WRITE_FAILED: start-on-event=DemSatellite_0InternalBehavior/GetMonitorStatus, operation=EvtInfo_AutoCreatedDemEvent_FLS_E_WRITE_FAILED.GetMonitorStatus
        OpEventGetMonitorStatus_GetMonitorStatus_EvtInfo_AutoCreatedDemEvent_FLS_E_UNEXPECTED_FLASH_ID: start-on-event=DemSatellite_0InternalBehavior/GetMonitorStatus, operation=EvtInfo_AutoCreatedDemEvent_FLS_E_UNEXPECTED_FLASH_ID.GetMonitorStatus
        OpEventGetMonitorStatus_GetMonitorStatus_EvtInfo_AutoCreatedDemEvent_FLS_E_READ_FAILED: start-on-event=DemSatellite_0InternalBehavior/GetMonitorStatus, operation=EvtInfo_AutoCreatedDemEvent_FLS_E_READ_FAILED.GetMonitorStatus
        OpEventGetMonitorStatus_GetMonitorStatus_EvtInfo_AutoCreatedDemEvent_FLS_E_ERASE_FAILED: start-on-event=DemSatellite_0InternalBehavior/GetMonitorStatus, operation=EvtInfo_AutoCreatedDemEvent_FLS_E_ERASE_FAILED.GetMonitorStatus
        OpEventGetMonitorStatus_GetMonitorStatus_EvtInfo_AutoCreatedDemEvent_FLS_E_COMPARE_FAILED: start-on-event=DemSatellite_0InternalBehavior/GetMonitorStatus, operation=EvtInfo_AutoCreatedDemEvent_FLS_E_COMPARE_FAILED.GetMonitorStatus
        OpEventGetMonitorStatus_GetMonitorStatus_EvtInfo_AutoCreatedDemEvent_MyECU_6c1a0d52_FrDemCtrlTestResultRef: start-on-event=DemSatellite_0InternalBehavior/GetMonitorStatus, operation=EvtInfo_AutoCreatedDemEvent_MyECU_6c1a0d52_FrDemCtrlTestResultRef.GetMonitorStatus
        OpEventGetMonitorStatus_GetMonitorStatus_EvtInfo_AutoCreatedDemEvent_LIN_E_TIMEOUT: start-on-event=DemSatellite_0InternalBehavior/GetMonitorStatus, operation=EvtInfo_AutoCreatedDemEvent_LIN_E_TIMEOUT.GetMonitorStatus
        OpEventGetMonitorStatus_GetMonitorStatus_EvtInfo_AutoCreatedDemEvent_McuModuleConfiguration_MCU_E_CLOCK_FAILURE: start-on-event=DemSatellite_0InternalBehavior/GetMonitorStatus, operation=EvtInfo_AutoCreatedDemEvent_McuModuleConfiguration_MCU_E_CLOCK_FAILURE.GetMonitorStatus
        OpEventGetMonitorStatus_GetMonitorStatus_EvtInfo_AutoCreatedDemEvent_NVM_E_WRONG_BLOCK_ID: start-on-event=DemSatellite_0InternalBehavior/GetMonitorStatus, operation=EvtInfo_AutoCreatedDemEvent_NVM_E_WRONG_BLOCK_ID.GetMonitorStatus
        OpEventGetMonitorStatus_GetMonitorStatus_EvtInfo_AutoCreatedDemEvent_NVM_E_WRITE_PROTECTED: start-on-event=DemSatellite_0InternalBehavior/GetMonitorStatus, operation=EvtInfo_AutoCreatedDemEvent_NVM_E_WRITE_PROTECTED.GetMonitorStatus
        OpEventGetMonitorStatus_GetMonitorStatus_EvtInfo_AutoCreatedDemEvent_NVM_E_VERIFY_FAILED: start-on-event=DemSatellite_0InternalBehavior/GetMonitorStatus, operation=EvtInfo_AutoCreatedDemEvent_NVM_E_VERIFY_FAILED.GetMonitorStatus
        OpEventGetMonitorStatus_GetMonitorStatus_EvtInfo_AutoCreatedDemEvent_NVM_E_REQ_FAILED: start-on-event=DemSatellite_0InternalBehavior/GetMonitorStatus, operation=EvtInfo_AutoCreatedDemEvent_NVM_E_REQ_FAILED.GetMonitorStatus
        OpEventGetMonitorStatus_GetMonitorStatus_EvtInfo_AutoCreatedDemEvent_NVM_E_QUEUE_OVERFLOW: start-on-event=DemSatellite_0InternalBehavior/GetMonitorStatus, operation=EvtInfo_AutoCreatedDemEvent_NVM_E_QUEUE_OVERFLOW.GetMonitorStatus
        OpEventGetMonitorStatus_GetMonitorStatus_EvtInfo_AutoCreatedDemEvent_NVM_E_LOSS_OF_REDUNDANCY: start-on-event=DemSatellite_0InternalBehavior/GetMonitorStatus, operation=EvtInfo_AutoCreatedDemEvent_NVM_E_LOSS_OF_REDUNDANCY.GetMonitorStatus
        OpEventGetMonitorStatus_GetMonitorStatus_EvtInfo_AutoCreatedDemEvent_NVM_E_INTEGRITY_FAILED: start-on-event=DemSatellite_0InternalBehavior/GetMonitorStatus, operation=EvtInfo_AutoCreatedDemEvent_NVM_E_INTEGRITY_FAILED.GetMonitorStatus
        OpEventGetMonitorStatus_GetMonitorStatus_EvtInfo_AutoCreatedDemEvent_XFRM_E_MALFORMED_MESSAGE_2: start-on-event=DemSatellite_0InternalBehavior/GetMonitorStatus, operation=EvtInfo_AutoCreatedDemEvent_XFRM_E_MALFORMED_MESSAGE_2.GetMonitorStatus
        OpEventGetMonitorStatus_GetMonitorStatus_EvtInfo_AutoCreatedDemEvent_EEP_E_WRITE_FAILED_1: start-on-event=DemSatellite_0InternalBehavior/GetMonitorStatus, operation=EvtInfo_AutoCreatedDemEvent_EEP_E_WRITE_FAILED_1.GetMonitorStatus
        OpEventGetMonitorStatus_GetMonitorStatus_EvtInfo_AutoCreatedDemEvent_EEP_E_READ_FAILED_1: start-on-event=DemSatellite_0InternalBehavior/GetMonitorStatus, operation=EvtInfo_AutoCreatedDemEvent_EEP_E_READ_FAILED_1.GetMonitorStatus
        OpEventGetMonitorStatus_GetMonitorStatus_EvtInfo_AutoCreatedDemEvent_EEP_E_ERASE_FAILED_1: start-on-event=DemSatellite_0InternalBehavior/GetMonitorStatus, operation=EvtInfo_AutoCreatedDemEvent_EEP_E_ERASE_FAILED_1.GetMonitorStatus
        OpEventGetMonitorStatus_GetMonitorStatus_EvtInfo_AutoCreatedDemEvent_EEP_E_COMPARE_FAILED_1: start-on-event=DemSatellite_0InternalBehavior/GetMonitorStatus, operation=EvtInfo_AutoCreatedDemEvent_EEP_E_COMPARE_FAILED_1.GetMonitorStatus
        OpEventGetMonitorStatus_GetMonitorStatus_EvtInfo_AutoCreatedDemEvent_FLS_E_WRITE_FAILED_1: start-on-event=DemSatellite_0InternalBehavior/GetMonitorStatus, operation=EvtInfo_AutoCreatedDemEvent_FLS_E_WRITE_FAILED_1.GetMonitorStatus
        OpEventGetMonitorStatus_GetMonitorStatus_EvtInfo_AutoCreatedDemEvent_FLS_E_UNEXPECTED_FLASH_ID_1: start-on-event=DemSatellite_0InternalBehavior/GetMonitorStatus, operation=EvtInfo_AutoCreatedDemEvent_FLS_E_UNEXPECTED_FLASH_ID_1.GetMonitorStatus
        OpEventGetMonitorStatus_GetMonitorStatus_EvtInfo_AutoCreatedDemEvent_FLS_E_READ_FAILED_1: start-on-event=DemSatellite_0InternalBehavior/GetMonitorStatus, operation=EvtInfo_AutoCreatedDemEvent_FLS_E_READ_FAILED_1.GetMonitorStatus
        OpEventGetMonitorStatus_GetMonitorStatus_EvtInfo_AutoCreatedDemEvent_FLS_E_ERASE_FAILED_1: start-on-event=DemSatellite_0InternalBehavior/GetMonitorStatus, operation=EvtInfo_AutoCreatedDemEvent_FLS_E_ERASE_FAILED_1.GetMonitorStatus
        OpEventGetMonitorStatus_GetMonitorStatus_EvtInfo_AutoCreatedDemEvent_FLS_E_COMPARE_FAILED_1: start-on-event=DemSatellite_0InternalBehavior/GetMonitorStatus, operation=EvtInfo_AutoCreatedDemEvent_FLS_E_COMPARE_FAILED_1.GetMonitorStatus
        OpEventGetMonitorStatus_GetMonitorStatus_EvtInfo_AutoCreatedDemEvent_MyECU_6c1a0d52_FrDemCtrlTestResultRef_1: start-on-event=DemSatellite_0InternalBehavior/GetMonitorStatus, operation=EvtInfo_AutoCreatedDemEvent_MyECU_6c1a0d52_FrDemCtrlTestResultRef_1.GetMonitorStatus
        OpEventGetMonitorStatus_GetMonitorStatus_EvtInfo_AutoCreatedDemEvent_McuModuleConfiguration_MCU_E_CLOCK_FAILURE_1: start-on-event=DemSatellite_0InternalBehavior/GetMonitorStatus, operation=EvtInfo_AutoCreatedDemEvent_McuModuleConfiguration_MCU_E_CLOCK_FAILURE_1.GetMonitorStatus
        OpEventGetMonitorStatus_GetMonitorStatus_EvtInfo_AutoCreatedDemEvent_XCP_E_INIT_FAILED: start-on-event=DemSatellite_0InternalBehavior/GetMonitorStatus, operation=EvtInfo_AutoCreatedDemEvent_XCP_E_INIT_FAILED.GetMonitorStatus
        OpEventGetEventUdsStatus_GetEventUdsStatus_EvtInfo_DEM_EVENT_StartApplication: start-on-event=DemSatellite_0InternalBehavior/GetEventUdsStatus, operation=EvtInfo_DEM_EVENT_StartApplication.GetEventUdsStatus
        OpEventGetEventUdsStatus_GetEventUdsStatus_Event_DEM_EVENT_StartApplication: start-on-event=DemSatellite_0InternalBehavior/GetEventUdsStatus, operation=Event_DEM_EVENT_StartApplication.GetEventUdsStatus
        OpEventGetEventStatus_GetEventStatus_EvtInfo_DEM_EVENT_StartApplication: start-on-event=DemSatellite_0InternalBehavior/GetEventStatus, operation=EvtInfo_DEM_EVENT_StartApplication.GetEventStatus
        OpEventGetEventStatus_GetEventStatus_Event_DEM_EVENT_StartApplication: start-on-event=DemSatellite_0InternalBehavior/GetEventStatus, operation=Event_DEM_EVENT_StartApplication.GetEventStatus
        OpEventGetEventFailed_GetEventFailed_EvtInfo_DEM_EVENT_StartApplication: start-on-event=DemSatellite_0InternalBehavior/GetEventFailed, operation=EvtInfo_DEM_EVENT_StartApplication.GetEventFailed
        OpEventGetEventFailed_GetEventFailed_Event_DEM_EVENT_StartApplication: start-on-event=DemSatellite_0InternalBehavior/GetEventFailed, operation=Event_DEM_EVENT_StartApplication.GetEventFailed
        OpEventGetEventTested_GetEventTested_EvtInfo_DEM_EVENT_StartApplication: start-on-event=DemSatellite_0InternalBehavior/GetEventTested, operation=EvtInfo_DEM_EVENT_StartApplication.GetEventTested
        OpEventGetEventTested_GetEventTested_Event_DEM_EVENT_StartApplication: start-on-event=DemSatellite_0InternalBehavior/GetEventTested, operation=Event_DEM_EVENT_StartApplication.GetEventTested
        OpEventGetDTCOfEvent_GetDTCOfEvent_EvtInfo_DEM_EVENT_StartApplication: start-on-event=DemSatellite_0InternalBehavior/GetDTCOfEvent, operation=EvtInfo_DEM_EVENT_StartApplication.GetDTCOfEvent
        OpEventGetDTCOfEvent_GetDTCOfEvent_Event_DEM_EVENT_StartApplication: start-on-event=DemSatellite_0InternalBehavior/GetDTCOfEvent, operation=Event_DEM_EVENT_StartApplication.GetDTCOfEvent
        OpEventGetFaultDetectionCounter_GetFaultDetectionCounter_EvtInfo_DEM_EVENT_StartApplication: start-on-event=DemSatellite_0InternalBehavior/GetFaultDetectionCounter, operation=EvtInfo_DEM_EVENT_StartApplication.GetFaultDetectionCounter
        OpEventGetFaultDetectionCounter_GetFaultDetectionCounter_Event_DEM_EVENT_StartApplication: start-on-event=DemSatellite_0InternalBehavior/GetFaultDetectionCounter, operation=Event_DEM_EVENT_StartApplication.GetFaultDetectionCounter
        OpEventGetEventFreezeFrameDataEx_GetEventFreezeFrameDataEx_EvtInfo_DEM_EVENT_StartApplication: start-on-event=DemSatellite_0InternalBehavior/GetEventFreezeFrameDataEx, operation=EvtInfo_DEM_EVENT_StartApplication.GetEventFreezeFrameDataEx
        OpEventGetEventFreezeFrameDataEx_GetEventFreezeFrameDataEx_Event_DEM_EVENT_StartApplication: start-on-event=DemSatellite_0InternalBehavior/GetEventFreezeFrameDataEx, operation=Event_DEM_EVENT_StartApplication.GetEventFreezeFrameDataEx
        OpEventGetEventExtendedDataRecordEx_GetEventExtendedDataRecordEx_EvtInfo_DEM_EVENT_StartApplication: start-on-event=DemSatellite_0InternalBehavior/GetEventExtendedDataRecordEx, operation=EvtInfo_DEM_EVENT_StartApplication.GetEventExtendedDataRecordEx
        OpEventGetEventExtendedDataRecordEx_GetEventExtendedDataRecordEx_Event_DEM_EVENT_StartApplication: start-on-event=DemSatellite_0InternalBehavior/GetEventExtendedDataRecordEx, operation=Event_DEM_EVENT_StartApplication.GetEventExtendedDataRecordEx
        OpEventGetEventEnableCondition_GetEventEnableCondition_EvtInfo_DEM_EVENT_StartApplication: start-on-event=DemSatellite_0InternalBehavior/GetEventEnableCondition, operation=EvtInfo_DEM_EVENT_StartApplication.GetEventEnableCondition
        OpEventGetDebouncingOfEvent_GetDebouncingOfEvent_EvtInfo_DEM_EVENT_StartApplication: start-on-event=DemSatellite_0InternalBehavior/GetDebouncingOfEvent, operation=EvtInfo_DEM_EVENT_StartApplication.GetDebouncingOfEvent
        OpEventGetMonitorStatus_GetMonitorStatus_EvtInfo_DEM_EVENT_StartApplication: start-on-event=DemSatellite_0InternalBehavior/GetMonitorStatus, operation=EvtInfo_DEM_EVENT_StartApplication.GetMonitorStatus
        OpEventSetEventStatus_SetEventStatus_Event_DEM_EVENT_StartApplication: start-on-event=SetEventStatus, operation=Event_DEM_EVENT_StartApplication.SetEventStatus
        OpEventResetEventStatus_ResetEventStatus_Event_DEM_EVENT_StartApplication: start-on-event=ResetEventStatus, operation=Event_DEM_EVENT_StartApplication.ResetEventStatus
        OpEventResetEventDebounceStatus_ResetEventDebounceStatus_Event_DEM_EVENT_StartApplication: start-on-event=ResetEventDebounceStatus, operation=Event_DEM_EVENT_StartApplication.ResetEventDebounceStatus
        OpEventGetEventUdsStatus_GetEventUdsStatus_EvtInfo_AutoCreatedDemEvent_WDG_E_MODE_FAILED: start-on-event=DemSatellite_0InternalBehavior/GetEventUdsStatus, operation=EvtInfo_AutoCreatedDemEvent_WDG_E_MODE_FAILED.GetEventUdsStatus
        OpEventGetEventUdsStatus_GetEventUdsStatus_EvtInfo_AutoCreatedDemEvent_WDG_E_DISABLE_REJECTED: start-on-event=DemSatellite_0InternalBehavior/GetEventUdsStatus, operation=EvtInfo_AutoCreatedDemEvent_WDG_E_DISABLE_REJECTED.GetEventUdsStatus
        OpEventGetEventUdsStatus_GetEventUdsStatus_EvtInfo_AutoCreatedDemEvent_WdgMDemEventParameterRefs_WDGM_E_SET_MODE: start-on-event=DemSatellite_0InternalBehavior/GetEventUdsStatus, operation=EvtInfo_AutoCreatedDemEvent_WdgMDemEventParameterRefs_WDGM_E_SET_MODE.GetEventUdsStatus
        OpEventGetEventUdsStatus_GetEventUdsStatus_EvtInfo_AutoCreatedDemEvent_WdgMDemEventParameterRefs_WDGM_E_MONITORING: start-on-event=DemSatellite_0InternalBehavior/GetEventUdsStatus, operation=EvtInfo_AutoCreatedDemEvent_WdgMDemEventParameterRefs_WDGM_E_MONITORING.GetEventUdsStatus
        OpEventGetEventUdsStatus_GetEventUdsStatus_EvtInfo_AutoCreatedDemEvent_WdgMDemEventParameterRefs_WDGM_E_IMPROPER_CALLER: start-on-event=DemSatellite_0InternalBehavior/GetEventUdsStatus, operation=EvtInfo_AutoCreatedDemEvent_WdgMDemEventParameterRefs_WDGM_E_IMPROPER_CALLER.GetEventUdsStatus
        OpEventGetEventStatus_GetEventStatus_EvtInfo_AutoCreatedDemEvent_WDG_E_MODE_FAILED: start-on-event=DemSatellite_0InternalBehavior/GetEventStatus, operation=EvtInfo_AutoCreatedDemEvent_WDG_E_MODE_FAILED.GetEventStatus
        OpEventGetEventStatus_GetEventStatus_EvtInfo_AutoCreatedDemEvent_WDG_E_DISABLE_REJECTED: start-on-event=DemSatellite_0InternalBehavior/GetEventStatus, operation=EvtInfo_AutoCreatedDemEvent_WDG_E_DISABLE_REJECTED.GetEventStatus
        OpEventGetEventStatus_GetEventStatus_EvtInfo_AutoCreatedDemEvent_WdgMDemEventParameterRefs_WDGM_E_SET_MODE: start-on-event=DemSatellite_0InternalBehavior/GetEventStatus, operation=EvtInfo_AutoCreatedDemEvent_WdgMDemEventParameterRefs_WDGM_E_SET_MODE.GetEventStatus
        OpEventGetEventStatus_GetEventStatus_EvtInfo_AutoCreatedDemEvent_WdgMDemEventParameterRefs_WDGM_E_MONITORING: start-on-event=DemSatellite_0InternalBehavior/GetEventStatus, operation=EvtInfo_AutoCreatedDemEvent_WdgMDemEventParameterRefs_WDGM_E_MONITORING.GetEventStatus
        OpEventGetEventStatus_GetEventStatus_EvtInfo_AutoCreatedDemEvent_WdgMDemEventParameterRefs_WDGM_E_IMPROPER_CALLER: start-on-event=DemSatellite_0InternalBehavior/GetEventStatus, operation=EvtInfo_AutoCreatedDemEvent_WdgMDemEventParameterRefs_WDGM_E_IMPROPER_CALLER.GetEventStatus
        OpEventGetEventFailed_GetEventFailed_EvtInfo_AutoCreatedDemEvent_WDG_E_MODE_FAILED: start-on-event=DemSatellite_0InternalBehavior/GetEventFailed, operation=EvtInfo_AutoCreatedDemEvent_WDG_E_MODE_FAILED.GetEventFailed
        OpEventGetEventFailed_GetEventFailed_EvtInfo_AutoCreatedDemEvent_WDG_E_DISABLE_REJECTED: start-on-event=DemSatellite_0InternalBehavior/GetEventFailed, operation=EvtInfo_AutoCreatedDemEvent_WDG_E_DISABLE_REJECTED.GetEventFailed
        OpEventGetEventFailed_GetEventFailed_EvtInfo_AutoCreatedDemEvent_WdgMDemEventParameterRefs_WDGM_E_SET_MODE: start-on-event=DemSatellite_0InternalBehavior/GetEventFailed, operation=EvtInfo_AutoCreatedDemEvent_WdgMDemEventParameterRefs_WDGM_E_SET_MODE.GetEventFailed
        OpEventGetEventFailed_GetEventFailed_EvtInfo_AutoCreatedDemEvent_WdgMDemEventParameterRefs_WDGM_E_MONITORING: start-on-event=DemSatellite_0InternalBehavior/GetEventFailed, operation=EvtInfo_AutoCreatedDemEvent_WdgMDemEventParameterRefs_WDGM_E_MONITORING.GetEventFailed
        OpEventGetEventFailed_GetEventFailed_EvtInfo_AutoCreatedDemEvent_WdgMDemEventParameterRefs_WDGM_E_IMPROPER_CALLER: start-on-event=DemSatellite_0InternalBehavior/GetEventFailed, operation=EvtInfo_AutoCreatedDemEvent_WdgMDemEventParameterRefs_WDGM_E_IMPROPER_CALLER.GetEventFailed
        OpEventGetEventTested_GetEventTested_EvtInfo_AutoCreatedDemEvent_WDG_E_MODE_FAILED: start-on-event=DemSatellite_0InternalBehavior/GetEventTested, operation=EvtInfo_AutoCreatedDemEvent_WDG_E_MODE_FAILED.GetEventTested
        OpEventGetEventTested_GetEventTested_EvtInfo_AutoCreatedDemEvent_WDG_E_DISABLE_REJECTED: start-on-event=DemSatellite_0InternalBehavior/GetEventTested, operation=EvtInfo_AutoCreatedDemEvent_WDG_E_DISABLE_REJECTED.GetEventTested
        OpEventGetEventTested_GetEventTested_EvtInfo_AutoCreatedDemEvent_WdgMDemEventParameterRefs_WDGM_E_SET_MODE: start-on-event=DemSatellite_0InternalBehavior/GetEventTested, operation=EvtInfo_AutoCreatedDemEvent_WdgMDemEventParameterRefs_WDGM_E_SET_MODE.GetEventTested
        OpEventGetEventTested_GetEventTested_EvtInfo_AutoCreatedDemEvent_WdgMDemEventParameterRefs_WDGM_E_MONITORING: start-on-event=DemSatellite_0InternalBehavior/GetEventTested, operation=EvtInfo_AutoCreatedDemEvent_WdgMDemEventParameterRefs_WDGM_E_MONITORING.GetEventTested
        OpEventGetEventTested_GetEventTested_EvtInfo_AutoCreatedDemEvent_WdgMDemEventParameterRefs_WDGM_E_IMPROPER_CALLER: start-on-event=DemSatellite_0InternalBehavior/GetEventTested, operation=EvtInfo_AutoCreatedDemEvent_WdgMDemEventParameterRefs_WDGM_E_IMPROPER_CALLER.GetEventTested
        OpEventGetDTCOfEvent_GetDTCOfEvent_EvtInfo_AutoCreatedDemEvent_WDG_E_MODE_FAILED: start-on-event=DemSatellite_0InternalBehavior/GetDTCOfEvent, operation=EvtInfo_AutoCreatedDemEvent_WDG_E_MODE_FAILED.GetDTCOfEvent
        OpEventGetDTCOfEvent_GetDTCOfEvent_EvtInfo_AutoCreatedDemEvent_WDG_E_DISABLE_REJECTED: start-on-event=DemSatellite_0InternalBehavior/GetDTCOfEvent, operation=EvtInfo_AutoCreatedDemEvent_WDG_E_DISABLE_REJECTED.GetDTCOfEvent
        OpEventGetDTCOfEvent_GetDTCOfEvent_EvtInfo_AutoCreatedDemEvent_WdgMDemEventParameterRefs_WDGM_E_SET_MODE: start-on-event=DemSatellite_0InternalBehavior/GetDTCOfEvent, operation=EvtInfo_AutoCreatedDemEvent_WdgMDemEventParameterRefs_WDGM_E_SET_MODE.GetDTCOfEvent
        OpEventGetDTCOfEvent_GetDTCOfEvent_EvtInfo_AutoCreatedDemEvent_WdgMDemEventParameterRefs_WDGM_E_MONITORING: start-on-event=DemSatellite_0InternalBehavior/GetDTCOfEvent, operation=EvtInfo_AutoCreatedDemEvent_WdgMDemEventParameterRefs_WDGM_E_MONITORING.GetDTCOfEvent
        OpEventGetDTCOfEvent_GetDTCOfEvent_EvtInfo_AutoCreatedDemEvent_WdgMDemEventParameterRefs_WDGM_E_IMPROPER_CALLER: start-on-event=DemSatellite_0InternalBehavior/GetDTCOfEvent, operation=EvtInfo_AutoCreatedDemEvent_WdgMDemEventParameterRefs_WDGM_E_IMPROPER_CALLER.GetDTCOfEvent
        OpEventGetFaultDetectionCounter_GetFaultDetectionCounter_EvtInfo_AutoCreatedDemEvent_WDG_E_MODE_FAILED: start-on-event=DemSatellite_0InternalBehavior/GetFaultDetectionCounter, operation=EvtInfo_AutoCreatedDemEvent_WDG_E_MODE_FAILED.GetFaultDetectionCounter
        OpEventGetFaultDetectionCounter_GetFaultDetectionCounter_EvtInfo_AutoCreatedDemEvent_WDG_E_DISABLE_REJECTED: start-on-event=DemSatellite_0InternalBehavior/GetFaultDetectionCounter, operation=EvtInfo_AutoCreatedDemEvent_WDG_E_DISABLE_REJECTED.GetFaultDetectionCounter
        OpEventGetFaultDetectionCounter_GetFaultDetectionCounter_EvtInfo_AutoCreatedDemEvent_WdgMDemEventParameterRefs_WDGM_E_SET_MODE: start-on-event=DemSatellite_0InternalBehavior/GetFaultDetectionCounter, operation=EvtInfo_AutoCreatedDemEvent_WdgMDemEventParameterRefs_WDGM_E_SET_MODE.GetFaultDetectionCounter
        OpEventGetFaultDetectionCounter_GetFaultDetectionCounter_EvtInfo_AutoCreatedDemEvent_WdgMDemEventParameterRefs_WDGM_E_MONITORING: start-on-event=DemSatellite_0InternalBehavior/GetFaultDetectionCounter, operation=EvtInfo_AutoCreatedDemEvent_WdgMDemEventParameterRefs_WDGM_E_MONITORING.GetFaultDetectionCounter
        OpEventGetFaultDetectionCounter_GetFaultDetectionCounter_EvtInfo_AutoCreatedDemEvent_WdgMDemEventParameterRefs_WDGM_E_I_dd3e13c9: start-on-event=DemSatellite_0InternalBehavior/GetFaultDetectionCounter, operation=EvtInfo_AutoCreatedDemEvent_WdgMDemEventParameterRefs_WDGM_E_IMPROPER_CALLER.GetFaultDetectionCounter
        OpEventGetEventFreezeFrameDataEx_GetEventFreezeFrameDataEx_EvtInfo_AutoCreatedDemEvent_WDG_E_MODE_FAILED: start-on-event=DemSatellite_0InternalBehavior/GetEventFreezeFrameDataEx, operation=EvtInfo_AutoCreatedDemEvent_WDG_E_MODE_FAILED.GetEventFreezeFrameDataEx
        OpEventGetEventFreezeFrameDataEx_GetEventFreezeFrameDataEx_EvtInfo_AutoCreatedDemEvent_WDG_E_DISABLE_REJECTED: start-on-event=DemSatellite_0InternalBehavior/GetEventFreezeFrameDataEx, operation=EvtInfo_AutoCreatedDemEvent_WDG_E_DISABLE_REJECTED.GetEventFreezeFrameDataEx
        OpEventGetEventFreezeFrameDataEx_GetEventFreezeFrameDataEx_EvtInfo_AutoCreatedDemEvent_WdgMDemEventParameterRefs_WDGM_E_SET_MODE: start-on-event=DemSatellite_0InternalBehavior/GetEventFreezeFrameDataEx, operation=EvtInfo_AutoCreatedDemEvent_WdgMDemEventParameterRefs_WDGM_E_SET_MODE.GetEventFreezeFrameDataEx
        OpEventGetEventFreezeFrameDataEx_GetEventFreezeFrameDataEx_EvtInfo_AutoCreatedDemEvent_WdgMDemEventParameterRefs_WDGM_E_0eebc99a: start-on-event=DemSatellite_0InternalBehavior/GetEventFreezeFrameDataEx, operation=EvtInfo_AutoCreatedDemEvent_WdgMDemEventParameterRefs_WDGM_E_MONITORING.GetEventFreezeFrameDataEx
        OpEventGetEventFreezeFrameDataEx_GetEventFreezeFrameDataEx_EvtInfo_AutoCreatedDemEvent_WdgMDemEventParameterRefs_WDGM_E_181c1eba: start-on-event=DemSatellite_0InternalBehavior/GetEventFreezeFrameDataEx, operation=EvtInfo_AutoCreatedDemEvent_WdgMDemEventParameterRefs_WDGM_E_IMPROPER_CALLER.GetEventFreezeFrameDataEx
        OpEventGetEventExtendedDataRecordEx_GetEventExtendedDataRecordEx_EvtInfo_AutoCreatedDemEvent_WDG_E_MODE_FAILED: start-on-event=DemSatellite_0InternalBehavior/GetEventExtendedDataRecordEx, operation=EvtInfo_AutoCreatedDemEvent_WDG_E_MODE_FAILED.GetEventExtendedDataRecordEx
        OpEventGetEventExtendedDataRecordEx_GetEventExtendedDataRecordEx_EvtInfo_AutoCreatedDemEvent_WDG_E_DISABLE_REJECTED: start-on-event=DemSatellite_0InternalBehavior/GetEventExtendedDataRecordEx, operation=EvtInfo_AutoCreatedDemEvent_WDG_E_DISABLE_REJECTED.GetEventExtendedDataRecordEx
        OpEventGetEventExtendedDataRecordEx_GetEventExtendedDataRecordEx_EvtInfo_AutoCreatedDemEvent_WdgMDemEventParameterRefs_b296a566: start-on-event=DemSatellite_0InternalBehavior/GetEventExtendedDataRecordEx, operation=EvtInfo_AutoCreatedDemEvent_WdgMDemEventParameterRefs_WDGM_E_SET_MODE.GetEventExtendedDataRecordEx
        OpEventGetEventExtendedDataRecordEx_GetEventExtendedDataRecordEx_EvtInfo_AutoCreatedDemEvent_WdgMDemEventParameterRefs_4f0d9031: start-on-event=DemSatellite_0InternalBehavior/GetEventExtendedDataRecordEx, operation=EvtInfo_AutoCreatedDemEvent_WdgMDemEventParameterRefs_WDGM_E_MONITORING.GetEventExtendedDataRecordEx
        OpEventGetEventExtendedDataRecordEx_GetEventExtendedDataRecordEx_EvtInfo_AutoCreatedDemEvent_WdgMDemEventParameterRefs_ede32243: start-on-event=DemSatellite_0InternalBehavior/GetEventExtendedDataRecordEx, operation=EvtInfo_AutoCreatedDemEvent_WdgMDemEventParameterRefs_WDGM_E_IMPROPER_CALLER.GetEventExtendedDataRecordEx
        OpEventGetEventEnableCondition_GetEventEnableCondition_EvtInfo_AutoCreatedDemEvent_WDG_E_MODE_FAILED: start-on-event=DemSatellite_0InternalBehavior/GetEventEnableCondition, operation=EvtInfo_AutoCreatedDemEvent_WDG_E_MODE_FAILED.GetEventEnableCondition
        OpEventGetEventEnableCondition_GetEventEnableCondition_EvtInfo_AutoCreatedDemEvent_WDG_E_DISABLE_REJECTED: start-on-event=DemSatellite_0InternalBehavior/GetEventEnableCondition, operation=EvtInfo_AutoCreatedDemEvent_WDG_E_DISABLE_REJECTED.GetEventEnableCondition
        OpEventGetEventEnableCondition_GetEventEnableCondition_EvtInfo_AutoCreatedDemEvent_WdgMDemEventParameterRefs_WDGM_E_SET_MODE: start-on-event=DemSatellite_0InternalBehavior/GetEventEnableCondition, operation=EvtInfo_AutoCreatedDemEvent_WdgMDemEventParameterRefs_WDGM_E_SET_MODE.GetEventEnableCondition
        OpEventGetEventEnableCondition_GetEventEnableCondition_EvtInfo_AutoCreatedDemEvent_WdgMDemEventParameterRefs_WDGM_E_MONITORING: start-on-event=DemSatellite_0InternalBehavior/GetEventEnableCondition, operation=EvtInfo_AutoCreatedDemEvent_WdgMDemEventParameterRefs_WDGM_E_MONITORING.GetEventEnableCondition
        OpEventGetEventEnableCondition_GetEventEnableCondition_EvtInfo_AutoCreatedDemEvent_WdgMDemEventParameterRefs_WDGM_E_IMP_da3ce818: start-on-event=DemSatellite_0InternalBehavior/GetEventEnableCondition, operation=EvtInfo_AutoCreatedDemEvent_WdgMDemEventParameterRefs_WDGM_E_IMPROPER_CALLER.GetEventEnableCondition
        OpEventGetDebouncingOfEvent_GetDebouncingOfEvent_EvtInfo_AutoCreatedDemEvent_WDG_E_MODE_FAILED: start-on-event=DemSatellite_0InternalBehavior/GetDebouncingOfEvent, operation=EvtInfo_AutoCreatedDemEvent_WDG_E_MODE_FAILED.GetDebouncingOfEvent
        OpEventGetDebouncingOfEvent_GetDebouncingOfEvent_EvtInfo_AutoCreatedDemEvent_WDG_E_DISABLE_REJECTED: start-on-event=DemSatellite_0InternalBehavior/GetDebouncingOfEvent, operation=EvtInfo_AutoCreatedDemEvent_WDG_E_DISABLE_REJECTED.GetDebouncingOfEvent
        OpEventGetDebouncingOfEvent_GetDebouncingOfEvent_EvtInfo_AutoCreatedDemEvent_WdgMDemEventParameterRefs_WDGM_E_SET_MODE: start-on-event=DemSatellite_0InternalBehavior/GetDebouncingOfEvent, operation=EvtInfo_AutoCreatedDemEvent_WdgMDemEventParameterRefs_WDGM_E_SET_MODE.GetDebouncingOfEvent
        OpEventGetDebouncingOfEvent_GetDebouncingOfEvent_EvtInfo_AutoCreatedDemEvent_WdgMDemEventParameterRefs_WDGM_E_MONITORING: start-on-event=DemSatellite_0InternalBehavior/GetDebouncingOfEvent, operation=EvtInfo_AutoCreatedDemEvent_WdgMDemEventParameterRefs_WDGM_E_MONITORING.GetDebouncingOfEvent
        OpEventGetDebouncingOfEvent_GetDebouncingOfEvent_EvtInfo_AutoCreatedDemEvent_WdgMDemEventParameterRefs_WDGM_E_IMPROPER_CALLER: start-on-event=DemSatellite_0InternalBehavior/GetDebouncingOfEvent, operation=EvtInfo_AutoCreatedDemEvent_WdgMDemEventParameterRefs_WDGM_E_IMPROPER_CALLER.GetDebouncingOfEvent
        OpEventGetMonitorStatus_GetMonitorStatus_EvtInfo_AutoCreatedDemEvent_WDG_E_MODE_FAILED: start-on-event=DemSatellite_0InternalBehavior/GetMonitorStatus, operation=EvtInfo_AutoCreatedDemEvent_WDG_E_MODE_FAILED.GetMonitorStatus
        OpEventGetMonitorStatus_GetMonitorStatus_EvtInfo_AutoCreatedDemEvent_WDG_E_DISABLE_REJECTED: start-on-event=DemSatellite_0InternalBehavior/GetMonitorStatus, operation=EvtInfo_AutoCreatedDemEvent_WDG_E_DISABLE_REJECTED.GetMonitorStatus
        OpEventGetMonitorStatus_GetMonitorStatus_EvtInfo_AutoCreatedDemEvent_WdgMDemEventParameterRefs_WDGM_E_SET_MODE: start-on-event=DemSatellite_0InternalBehavior/GetMonitorStatus, operation=EvtInfo_AutoCreatedDemEvent_WdgMDemEventParameterRefs_WDGM_E_SET_MODE.GetMonitorStatus
        OpEventGetMonitorStatus_GetMonitorStatus_EvtInfo_AutoCreatedDemEvent_WdgMDemEventParameterRefs_WDGM_E_MONITORING: start-on-event=DemSatellite_0InternalBehavior/GetMonitorStatus, operation=EvtInfo_AutoCreatedDemEvent_WdgMDemEventParameterRefs_WDGM_E_MONITORING.GetMonitorStatus
        OpEventGetMonitorStatus_GetMonitorStatus_EvtInfo_AutoCreatedDemEvent_WdgMDemEventParameterRefs_WDGM_E_IMPROPER_CALLER: start-on-event=DemSatellite_0InternalBehavior/GetMonitorStatus, operation=EvtInfo_AutoCreatedDemEvent_WdgMDemEventParameterRefs_WDGM_E_IMPROPER_CALLER.GetMonitorStatus
        OpEventGetEventUdsStatus_GetEventUdsStatus_GeneralEvtInfo: start-on-event=DemSatellite_0InternalBehavior/GetEventUdsStatus, operation=GeneralEvtInfo.GetEventUdsStatus
        OpEventGetEventStatus_GetEventStatus_GeneralEvtInfo: start-on-event=DemSatellite_0InternalBehavior/GetEventStatus, operation=GeneralEvtInfo.GetEventStatus
        OpEventGetEventFailed_GetEventFailed_GeneralEvtInfo: start-on-event=DemSatellite_0InternalBehavior/GetEventFailed, operation=GeneralEvtInfo.GetEventFailed
        OpEventGetEventTested_GetEventTested_GeneralEvtInfo: start-on-event=DemSatellite_0InternalBehavior/GetEventTested, operation=GeneralEvtInfo.GetEventTested
        OpEventGetDTCOfEvent_GetDTCOfEvent_GeneralEvtInfo: start-on-event=DemSatellite_0InternalBehavior/GetDTCOfEvent, operation=GeneralEvtInfo.GetDTCOfEvent
        OpEventGetFaultDetectionCounter_GetFaultDetectionCounter_GeneralEvtInfo: start-on-event=DemSatellite_0InternalBehavior/GetFaultDetectionCounter, operation=GeneralEvtInfo.GetFaultDetectionCounter
        OpEventGetEventFreezeFrameDataEx_GetEventFreezeFrameDataEx_GeneralEvtInfo: start-on-event=DemSatellite_0InternalBehavior/GetEventFreezeFrameDataEx, operation=GeneralEvtInfo.GetEventFreezeFrameDataEx
        OpEventGetEventExtendedDataRecordEx_GetEventExtendedDataRecordEx_GeneralEvtInfo: start-on-event=DemSatellite_0InternalBehavior/GetEventExtendedDataRecordEx, operation=GeneralEvtInfo.GetEventExtendedDataRecordEx
        OpEventGetEventEnableCondition_GetEventEnableCondition_GeneralEvtInfo: start-on-event=DemSatellite_0InternalBehavior/GetEventEnableCondition, operation=GeneralEvtInfo.GetEventEnableCondition
        OpEventGetDebouncingOfEvent_GetDebouncingOfEvent_GeneralEvtInfo: start-on-event=DemSatellite_0InternalBehavior/GetDebouncingOfEvent, operation=GeneralEvtInfo.GetDebouncingOfEvent
        OpEventGetMonitorStatus_GetMonitorStatus_GeneralEvtInfo: start-on-event=DemSatellite_0InternalBehavior/GetMonitorStatus, operation=GeneralEvtInfo.GetMonitorStatus
        OpEventGetEventUdsStatus_GetEventUdsStatus_EvtInfo_AutoCreatedDemEvent_FeeDemEventParameterRefs_FEE_E_WRITE_CYCLES_EXHAUSTED: start-on-event=DemSatellite_0InternalBehavior/GetEventUdsStatus, operation=EvtInfo_AutoCreatedDemEvent_FeeDemEventParameterRefs_FEE_E_WRITE_CYCLES_EXHAUSTED.GetEventUdsStatus
        OpEventGetEventUdsStatus_GetEventUdsStatus_EvtInfo_AutoCreatedDemEvent_FeeDemEventParameterRefs_FEE_E_WRITE: start-on-event=DemSatellite_0InternalBehavior/GetEventUdsStatus, operation=EvtInfo_AutoCreatedDemEvent_FeeDemEventParameterRefs_FEE_E_WRITE.GetEventUdsStatus
        OpEventGetEventUdsStatus_GetEventUdsStatus_EvtInfo_AutoCreatedDemEvent_FeeDemEventParameterRefs_FEE_E_UNCONFIG_BLK_EXCEEDED: start-on-event=DemSatellite_0InternalBehavior/GetEventUdsStatus, operation=EvtInfo_AutoCreatedDemEvent_FeeDemEventParameterRefs_FEE_E_UNCONFIG_BLK_EXCEEDED.GetEventUdsStatus
        OpEventGetEventUdsStatus_GetEventUdsStatus_EvtInfo_AutoCreatedDemEvent_FeeDemEventParameterRefs_FEE_E_READ: start-on-event=DemSatellite_0InternalBehavior/GetEventUdsStatus, operation=EvtInfo_AutoCreatedDemEvent_FeeDemEventParameterRefs_FEE_E_READ.GetEventUdsStatus
        OpEventGetEventUdsStatus_GetEventUdsStatus_EvtInfo_AutoCreatedDemEvent_FeeDemEventParameterRefs_FEE_E_INVALIDATE: start-on-event=DemSatellite_0InternalBehavior/GetEventUdsStatus, operation=EvtInfo_AutoCreatedDemEvent_FeeDemEventParameterRefs_FEE_E_INVALIDATE.GetEventUdsStatus
        OpEventGetEventUdsStatus_GetEventUdsStatus_EvtInfo_AutoCreatedDemEvent_FeeDemEventParameterRefs_FEE_E_GC_WRITE: start-on-event=DemSatellite_0InternalBehavior/GetEventUdsStatus, operation=EvtInfo_AutoCreatedDemEvent_FeeDemEventParameterRefs_FEE_E_GC_WRITE.GetEventUdsStatus
        OpEventGetEventUdsStatus_GetEventUdsStatus_EvtInfo_AutoCreatedDemEvent_FeeDemEventParameterRefs_FEE_E_GC_TRIG: start-on-event=DemSatellite_0InternalBehavior/GetEventUdsStatus, operation=EvtInfo_AutoCreatedDemEvent_FeeDemEventParameterRefs_FEE_E_GC_TRIG.GetEventUdsStatus
        OpEventGetEventUdsStatus_GetEventUdsStatus_EvtInfo_AutoCreatedDemEvent_FeeDemEventParameterRefs_FEE_E_GC_READ: start-on-event=DemSatellite_0InternalBehavior/GetEventUdsStatus, operation=EvtInfo_AutoCreatedDemEvent_FeeDemEventParameterRefs_FEE_E_GC_READ.GetEventUdsStatus
        OpEventGetEventUdsStatus_GetEventUdsStatus_EvtInfo_AutoCreatedDemEvent_FeeDemEventParameterRefs_FEE_E_GC_INIT: start-on-event=DemSatellite_0InternalBehavior/GetEventUdsStatus, operation=EvtInfo_AutoCreatedDemEvent_FeeDemEventParameterRefs_FEE_E_GC_INIT.GetEventUdsStatus
        OpEventGetEventUdsStatus_GetEventUdsStatus_EvtInfo_AutoCreatedDemEvent_FeeDemEventParameterRefs_FEE_E_GC_ERASE: start-on-event=DemSatellite_0InternalBehavior/GetEventUdsStatus, operation=EvtInfo_AutoCreatedDemEvent_FeeDemEventParameterRefs_FEE_E_GC_ERASE.GetEventUdsStatus
        OpEventGetEventStatus_GetEventStatus_EvtInfo_AutoCreatedDemEvent_FeeDemEventParameterRefs_FEE_E_WRITE_CYCLES_EXHAUSTED: start-on-event=DemSatellite_0InternalBehavior/GetEventStatus, operation=EvtInfo_AutoCreatedDemEvent_FeeDemEventParameterRefs_FEE_E_WRITE_CYCLES_EXHAUSTED.GetEventStatus
        OpEventGetEventStatus_GetEventStatus_EvtInfo_AutoCreatedDemEvent_FeeDemEventParameterRefs_FEE_E_WRITE: start-on-event=DemSatellite_0InternalBehavior/GetEventStatus, operation=EvtInfo_AutoCreatedDemEvent_FeeDemEventParameterRefs_FEE_E_WRITE.GetEventStatus
        OpEventGetEventStatus_GetEventStatus_EvtInfo_AutoCreatedDemEvent_FeeDemEventParameterRefs_FEE_E_UNCONFIG_BLK_EXCEEDED: start-on-event=DemSatellite_0InternalBehavior/GetEventStatus, operation=EvtInfo_AutoCreatedDemEvent_FeeDemEventParameterRefs_FEE_E_UNCONFIG_BLK_EXCEEDED.GetEventStatus
        OpEventGetEventStatus_GetEventStatus_EvtInfo_AutoCreatedDemEvent_FeeDemEventParameterRefs_FEE_E_READ: start-on-event=DemSatellite_0InternalBehavior/GetEventStatus, operation=EvtInfo_AutoCreatedDemEvent_FeeDemEventParameterRefs_FEE_E_READ.GetEventStatus
        OpEventGetEventStatus_GetEventStatus_EvtInfo_AutoCreatedDemEvent_FeeDemEventParameterRefs_FEE_E_INVALIDATE: start-on-event=DemSatellite_0InternalBehavior/GetEventStatus, operation=EvtInfo_AutoCreatedDemEvent_FeeDemEventParameterRefs_FEE_E_INVALIDATE.GetEventStatus
        OpEventGetEventStatus_GetEventStatus_EvtInfo_AutoCreatedDemEvent_FeeDemEventParameterRefs_FEE_E_GC_WRITE: start-on-event=DemSatellite_0InternalBehavior/GetEventStatus, operation=EvtInfo_AutoCreatedDemEvent_FeeDemEventParameterRefs_FEE_E_GC_WRITE.GetEventStatus
        OpEventGetEventStatus_GetEventStatus_EvtInfo_AutoCreatedDemEvent_FeeDemEventParameterRefs_FEE_E_GC_TRIG: start-on-event=DemSatellite_0InternalBehavior/GetEventStatus, operation=EvtInfo_AutoCreatedDemEvent_FeeDemEventParameterRefs_FEE_E_GC_TRIG.GetEventStatus
        OpEventGetEventStatus_GetEventStatus_EvtInfo_AutoCreatedDemEvent_FeeDemEventParameterRefs_FEE_E_GC_READ: start-on-event=DemSatellite_0InternalBehavior/GetEventStatus, operation=EvtInfo_AutoCreatedDemEvent_FeeDemEventParameterRefs_FEE_E_GC_READ.GetEventStatus
        OpEventGetEventStatus_GetEventStatus_EvtInfo_AutoCreatedDemEvent_FeeDemEventParameterRefs_FEE_E_GC_INIT: start-on-event=DemSatellite_0InternalBehavior/GetEventStatus, operation=EvtInfo_AutoCreatedDemEvent_FeeDemEventParameterRefs_FEE_E_GC_INIT.GetEventStatus
        OpEventGetEventStatus_GetEventStatus_EvtInfo_AutoCreatedDemEvent_FeeDemEventParameterRefs_FEE_E_GC_ERASE: start-on-event=DemSatellite_0InternalBehavior/GetEventStatus, operation=EvtInfo_AutoCreatedDemEvent_FeeDemEventParameterRefs_FEE_E_GC_ERASE.GetEventStatus
        OpEventGetEventFailed_GetEventFailed_EvtInfo_AutoCreatedDemEvent_FeeDemEventParameterRefs_FEE_E_WRITE_CYCLES_EXHAUSTED: start-on-event=DemSatellite_0InternalBehavior/GetEventFailed, operation=EvtInfo_AutoCreatedDemEvent_FeeDemEventParameterRefs_FEE_E_WRITE_CYCLES_EXHAUSTED.GetEventFailed
        OpEventGetEventFailed_GetEventFailed_EvtInfo_AutoCreatedDemEvent_FeeDemEventParameterRefs_FEE_E_WRITE: start-on-event=DemSatellite_0InternalBehavior/GetEventFailed, operation=EvtInfo_AutoCreatedDemEvent_FeeDemEventParameterRefs_FEE_E_WRITE.GetEventFailed
        OpEventGetEventFailed_GetEventFailed_EvtInfo_AutoCreatedDemEvent_FeeDemEventParameterRefs_FEE_E_UNCONFIG_BLK_EXCEEDED: start-on-event=DemSatellite_0InternalBehavior/GetEventFailed, operation=EvtInfo_AutoCreatedDemEvent_FeeDemEventParameterRefs_FEE_E_UNCONFIG_BLK_EXCEEDED.GetEventFailed
        OpEventGetEventFailed_GetEventFailed_EvtInfo_AutoCreatedDemEvent_FeeDemEventParameterRefs_FEE_E_READ: start-on-event=DemSatellite_0InternalBehavior/GetEventFailed, operation=EvtInfo_AutoCreatedDemEvent_FeeDemEventParameterRefs_FEE_E_READ.GetEventFailed
        OpEventGetEventFailed_GetEventFailed_EvtInfo_AutoCreatedDemEvent_FeeDemEventParameterRefs_FEE_E_INVALIDATE: start-on-event=DemSatellite_0InternalBehavior/GetEventFailed, operation=EvtInfo_AutoCreatedDemEvent_FeeDemEventParameterRefs_FEE_E_INVALIDATE.GetEventFailed
        OpEventGetEventFailed_GetEventFailed_EvtInfo_AutoCreatedDemEvent_FeeDemEventParameterRefs_FEE_E_GC_WRITE: start-on-event=DemSatellite_0InternalBehavior/GetEventFailed, operation=EvtInfo_AutoCreatedDemEvent_FeeDemEventParameterRefs_FEE_E_GC_WRITE.GetEventFailed
        OpEventGetEventFailed_GetEventFailed_EvtInfo_AutoCreatedDemEvent_FeeDemEventParameterRefs_FEE_E_GC_TRIG: start-on-event=DemSatellite_0InternalBehavior/GetEventFailed, operation=EvtInfo_AutoCreatedDemEvent_FeeDemEventParameterRefs_FEE_E_GC_TRIG.GetEventFailed
        OpEventGetEventFailed_GetEventFailed_EvtInfo_AutoCreatedDemEvent_FeeDemEventParameterRefs_FEE_E_GC_READ: start-on-event=DemSatellite_0InternalBehavior/GetEventFailed, operation=EvtInfo_AutoCreatedDemEvent_FeeDemEventParameterRefs_FEE_E_GC_READ.GetEventFailed
        OpEventGetEventFailed_GetEventFailed_EvtInfo_AutoCreatedDemEvent_FeeDemEventParameterRefs_FEE_E_GC_INIT: start-on-event=DemSatellite_0InternalBehavior/GetEventFailed, operation=EvtInfo_AutoCreatedDemEvent_FeeDemEventParameterRefs_FEE_E_GC_INIT.GetEventFailed
        OpEventGetEventFailed_GetEventFailed_EvtInfo_AutoCreatedDemEvent_FeeDemEventParameterRefs_FEE_E_GC_ERASE: start-on-event=DemSatellite_0InternalBehavior/GetEventFailed, operation=EvtInfo_AutoCreatedDemEvent_FeeDemEventParameterRefs_FEE_E_GC_ERASE.GetEventFailed
        OpEventGetEventTested_GetEventTested_EvtInfo_AutoCreatedDemEvent_FeeDemEventParameterRefs_FEE_E_WRITE_CYCLES_EXHAUSTED: start-on-event=DemSatellite_0InternalBehavior/GetEventTested, operation=EvtInfo_AutoCreatedDemEvent_FeeDemEventParameterRefs_FEE_E_WRITE_CYCLES_EXHAUSTED.GetEventTested
        OpEventGetEventTested_GetEventTested_EvtInfo_AutoCreatedDemEvent_FeeDemEventParameterRefs_FEE_E_WRITE: start-on-event=DemSatellite_0InternalBehavior/GetEventTested, operation=EvtInfo_AutoCreatedDemEvent_FeeDemEventParameterRefs_FEE_E_WRITE.GetEventTested
        OpEventGetEventTested_GetEventTested_EvtInfo_AutoCreatedDemEvent_FeeDemEventParameterRefs_FEE_E_UNCONFIG_BLK_EXCEEDED: start-on-event=DemSatellite_0InternalBehavior/GetEventTested, operation=EvtInfo_AutoCreatedDemEvent_FeeDemEventParameterRefs_FEE_E_UNCONFIG_BLK_EXCEEDED.GetEventTested
        OpEventGetEventTested_GetEventTested_EvtInfo_AutoCreatedDemEvent_FeeDemEventParameterRefs_FEE_E_READ: start-on-event=DemSatellite_0InternalBehavior/GetEventTested, operation=EvtInfo_AutoCreatedDemEvent_FeeDemEventParameterRefs_FEE_E_READ.GetEventTested
        OpEventGetEventTested_GetEventTested_EvtInfo_AutoCreatedDemEvent_FeeDemEventParameterRefs_FEE_E_INVALIDATE: start-on-event=DemSatellite_0InternalBehavior/GetEventTested, operation=EvtInfo_AutoCreatedDemEvent_FeeDemEventParameterRefs_FEE_E_INVALIDATE.GetEventTested
        OpEventGetEventTested_GetEventTested_EvtInfo_AutoCreatedDemEvent_FeeDemEventParameterRefs_FEE_E_GC_WRITE: start-on-event=DemSatellite_0InternalBehavior/GetEventTested, operation=EvtInfo_AutoCreatedDemEvent_FeeDemEventParameterRefs_FEE_E_GC_WRITE.GetEventTested
        OpEventGetEventTested_GetEventTested_EvtInfo_AutoCreatedDemEvent_FeeDemEventParameterRefs_FEE_E_GC_TRIG: start-on-event=DemSatellite_0InternalBehavior/GetEventTested, operation=EvtInfo_AutoCreatedDemEvent_FeeDemEventParameterRefs_FEE_E_GC_TRIG.GetEventTested
        OpEventGetEventTested_GetEventTested_EvtInfo_AutoCreatedDemEvent_FeeDemEventParameterRefs_FEE_E_GC_READ: start-on-event=DemSatellite_0InternalBehavior/GetEventTested, operation=EvtInfo_AutoCreatedDemEvent_FeeDemEventParameterRefs_FEE_E_GC_READ.GetEventTested
        OpEventGetEventTested_GetEventTested_EvtInfo_AutoCreatedDemEvent_FeeDemEventParameterRefs_FEE_E_GC_INIT: start-on-event=DemSatellite_0InternalBehavior/GetEventTested, operation=EvtInfo_AutoCreatedDemEvent_FeeDemEventParameterRefs_FEE_E_GC_INIT.GetEventTested
        OpEventGetEventTested_GetEventTested_EvtInfo_AutoCreatedDemEvent_FeeDemEventParameterRefs_FEE_E_GC_ERASE: start-on-event=DemSatellite_0InternalBehavior/GetEventTested, operation=EvtInfo_AutoCreatedDemEvent_FeeDemEventParameterRefs_FEE_E_GC_ERASE.GetEventTested
        OpEventGetDTCOfEvent_GetDTCOfEvent_EvtInfo_AutoCreatedDemEvent_FeeDemEventParameterRefs_FEE_E_WRITE_CYCLES_EXHAUSTED: start-on-event=DemSatellite_0InternalBehavior/GetDTCOfEvent, operation=EvtInfo_AutoCreatedDemEvent_FeeDemEventParameterRefs_FEE_E_WRITE_CYCLES_EXHAUSTED.GetDTCOfEvent
        OpEventGetDTCOfEvent_GetDTCOfEvent_EvtInfo_AutoCreatedDemEvent_FeeDemEventParameterRefs_FEE_E_WRITE: start-on-event=DemSatellite_0InternalBehavior/GetDTCOfEvent, operation=EvtInfo_AutoCreatedDemEvent_FeeDemEventParameterRefs_FEE_E_WRITE.GetDTCOfEvent
        OpEventGetDTCOfEvent_GetDTCOfEvent_EvtInfo_AutoCreatedDemEvent_FeeDemEventParameterRefs_FEE_E_UNCONFIG_BLK_EXCEEDED: start-on-event=DemSatellite_0InternalBehavior/GetDTCOfEvent, operation=EvtInfo_AutoCreatedDemEvent_FeeDemEventParameterRefs_FEE_E_UNCONFIG_BLK_EXCEEDED.GetDTCOfEvent
        OpEventGetDTCOfEvent_GetDTCOfEvent_EvtInfo_AutoCreatedDemEvent_FeeDemEventParameterRefs_FEE_E_READ: start-on-event=DemSatellite_0InternalBehavior/GetDTCOfEvent, operation=EvtInfo_AutoCreatedDemEvent_FeeDemEventParameterRefs_FEE_E_READ.GetDTCOfEvent
        OpEventGetDTCOfEvent_GetDTCOfEvent_EvtInfo_AutoCreatedDemEvent_FeeDemEventParameterRefs_FEE_E_INVALIDATE: start-on-event=DemSatellite_0InternalBehavior/GetDTCOfEvent, operation=EvtInfo_AutoCreatedDemEvent_FeeDemEventParameterRefs_FEE_E_INVALIDATE.GetDTCOfEvent
        OpEventGetDTCOfEvent_GetDTCOfEvent_EvtInfo_AutoCreatedDemEvent_FeeDemEventParameterRefs_FEE_E_GC_WRITE: start-on-event=DemSatellite_0InternalBehavior/GetDTCOfEvent, operation=EvtInfo_AutoCreatedDemEvent_FeeDemEventParameterRefs_FEE_E_GC_WRITE.GetDTCOfEvent
        OpEventGetDTCOfEvent_GetDTCOfEvent_EvtInfo_AutoCreatedDemEvent_FeeDemEventParameterRefs_FEE_E_GC_TRIG: start-on-event=DemSatellite_0InternalBehavior/GetDTCOfEvent, operation=EvtInfo_AutoCreatedDemEvent_FeeDemEventParameterRefs_FEE_E_GC_TRIG.GetDTCOfEvent
        OpEventGetDTCOfEvent_GetDTCOfEvent_EvtInfo_AutoCreatedDemEvent_FeeDemEventParameterRefs_FEE_E_GC_READ: start-on-event=DemSatellite_0InternalBehavior/GetDTCOfEvent, operation=EvtInfo_AutoCreatedDemEvent_FeeDemEventParameterRefs_FEE_E_GC_READ.GetDTCOfEvent
        OpEventGetDTCOfEvent_GetDTCOfEvent_EvtInfo_AutoCreatedDemEvent_FeeDemEventParameterRefs_FEE_E_GC_INIT: start-on-event=DemSatellite_0InternalBehavior/GetDTCOfEvent, operation=EvtInfo_AutoCreatedDemEvent_FeeDemEventParameterRefs_FEE_E_GC_INIT.GetDTCOfEvent
        OpEventGetDTCOfEvent_GetDTCOfEvent_EvtInfo_AutoCreatedDemEvent_FeeDemEventParameterRefs_FEE_E_GC_ERASE: start-on-event=DemSatellite_0InternalBehavior/GetDTCOfEvent, operation=EvtInfo_AutoCreatedDemEvent_FeeDemEventParameterRefs_FEE_E_GC_ERASE.GetDTCOfEvent
        OpEventGetFaultDetectionCounter_GetFaultDetectionCounter_EvtInfo_AutoCreatedDemEvent_FeeDemEventParameterRefs_FEE_E_WRI_323b157e: start-on-event=DemSatellite_0InternalBehavior/GetFaultDetectionCounter, operation=EvtInfo_AutoCreatedDemEvent_FeeDemEventParameterRefs_FEE_E_WRITE_CYCLES_EXHAUSTED.GetFaultDetectionCounter
        OpEventGetFaultDetectionCounter_GetFaultDetectionCounter_EvtInfo_AutoCreatedDemEvent_FeeDemEventParameterRefs_FEE_E_WRITE: start-on-event=DemSatellite_0InternalBehavior/GetFaultDetectionCounter, operation=EvtInfo_AutoCreatedDemEvent_FeeDemEventParameterRefs_FEE_E_WRITE.GetFaultDetectionCounter
        OpEventGetFaultDetectionCounter_GetFaultDetectionCounter_EvtInfo_AutoCreatedDemEvent_FeeDemEventParameterRefs_FEE_E_UNC_abe7ea16: start-on-event=DemSatellite_0InternalBehavior/GetFaultDetectionCounter, operation=EvtInfo_AutoCreatedDemEvent_FeeDemEventParameterRefs_FEE_E_UNCONFIG_BLK_EXCEEDED.GetFaultDetectionCounter
        OpEventGetFaultDetectionCounter_GetFaultDetectionCounter_EvtInfo_AutoCreatedDemEvent_FeeDemEventParameterRefs_FEE_E_READ: start-on-event=DemSatellite_0InternalBehavior/GetFaultDetectionCounter, operation=EvtInfo_AutoCreatedDemEvent_FeeDemEventParameterRefs_FEE_E_READ.GetFaultDetectionCounter
        OpEventGetFaultDetectionCounter_GetFaultDetectionCounter_EvtInfo_AutoCreatedDemEvent_FeeDemEventParameterRefs_FEE_E_INVALIDATE: start-on-event=DemSatellite_0InternalBehavior/GetFaultDetectionCounter, operation=EvtInfo_AutoCreatedDemEvent_FeeDemEventParameterRefs_FEE_E_INVALIDATE.GetFaultDetectionCounter
        OpEventGetFaultDetectionCounter_GetFaultDetectionCounter_EvtInfo_AutoCreatedDemEvent_FeeDemEventParameterRefs_FEE_E_GC_WRITE: start-on-event=DemSatellite_0InternalBehavior/GetFaultDetectionCounter, operation=EvtInfo_AutoCreatedDemEvent_FeeDemEventParameterRefs_FEE_E_GC_WRITE.GetFaultDetectionCounter
        OpEventGetFaultDetectionCounter_GetFaultDetectionCounter_EvtInfo_AutoCreatedDemEvent_FeeDemEventParameterRefs_FEE_E_GC_TRIG: start-on-event=DemSatellite_0InternalBehavior/GetFaultDetectionCounter, operation=EvtInfo_AutoCreatedDemEvent_FeeDemEventParameterRefs_FEE_E_GC_TRIG.GetFaultDetectionCounter
        OpEventGetFaultDetectionCounter_GetFaultDetectionCounter_EvtInfo_AutoCreatedDemEvent_FeeDemEventParameterRefs_FEE_E_GC_READ: start-on-event=DemSatellite_0InternalBehavior/GetFaultDetectionCounter, operation=EvtInfo_AutoCreatedDemEvent_FeeDemEventParameterRefs_FEE_E_GC_READ.GetFaultDetectionCounter
        OpEventGetFaultDetectionCounter_GetFaultDetectionCounter_EvtInfo_AutoCreatedDemEvent_FeeDemEventParameterRefs_FEE_E_GC_INIT: start-on-event=DemSatellite_0InternalBehavior/GetFaultDetectionCounter, operation=EvtInfo_AutoCreatedDemEvent_FeeDemEventParameterRefs_FEE_E_GC_INIT.GetFaultDetectionCounter
        OpEventGetFaultDetectionCounter_GetFaultDetectionCounter_EvtInfo_AutoCreatedDemEvent_FeeDemEventParameterRefs_FEE_E_GC_ERASE: start-on-event=DemSatellite_0InternalBehavior/GetFaultDetectionCounter, operation=EvtInfo_AutoCreatedDemEvent_FeeDemEventParameterRefs_FEE_E_GC_ERASE.GetFaultDetectionCounter
        OpEventGetEventFreezeFrameDataEx_GetEventFreezeFrameDataEx_EvtInfo_AutoCreatedDemEvent_FeeDemEventParameterRefs_FEE_E_W_f367e639: start-on-event=DemSatellite_0InternalBehavior/GetEventFreezeFrameDataEx, operation=EvtInfo_AutoCreatedDemEvent_FeeDemEventParameterRefs_FEE_E_WRITE_CYCLES_EXHAUSTED.GetEventFreezeFrameDataEx
        OpEventGetEventFreezeFrameDataEx_GetEventFreezeFrameDataEx_EvtInfo_AutoCreatedDemEvent_FeeDemEventParameterRefs_FEE_E_WRITE: start-on-event=DemSatellite_0InternalBehavior/GetEventFreezeFrameDataEx, operation=EvtInfo_AutoCreatedDemEvent_FeeDemEventParameterRefs_FEE_E_WRITE.GetEventFreezeFrameDataEx
        OpEventGetEventFreezeFrameDataEx_GetEventFreezeFrameDataEx_EvtInfo_AutoCreatedDemEvent_FeeDemEventParameterRefs_FEE_E_U_96090628: start-on-event=DemSatellite_0InternalBehavior/GetEventFreezeFrameDataEx, operation=EvtInfo_AutoCreatedDemEvent_FeeDemEventParameterRefs_FEE_E_UNCONFIG_BLK_EXCEEDED.GetEventFreezeFrameDataEx
        OpEventGetEventFreezeFrameDataEx_GetEventFreezeFrameDataEx_EvtInfo_AutoCreatedDemEvent_FeeDemEventParameterRefs_FEE_E_READ: start-on-event=DemSatellite_0InternalBehavior/GetEventFreezeFrameDataEx, operation=EvtInfo_AutoCreatedDemEvent_FeeDemEventParameterRefs_FEE_E_READ.GetEventFreezeFrameDataEx
        OpEventGetEventFreezeFrameDataEx_GetEventFreezeFrameDataEx_EvtInfo_AutoCreatedDemEvent_FeeDemEventParameterRefs_FEE_E_INVALIDATE: start-on-event=DemSatellite_0InternalBehavior/GetEventFreezeFrameDataEx, operation=EvtInfo_AutoCreatedDemEvent_FeeDemEventParameterRefs_FEE_E_INVALIDATE.GetEventFreezeFrameDataEx
        OpEventGetEventFreezeFrameDataEx_GetEventFreezeFrameDataEx_EvtInfo_AutoCreatedDemEvent_FeeDemEventParameterRefs_FEE_E_GC_WRITE: start-on-event=DemSatellite_0InternalBehavior/GetEventFreezeFrameDataEx, operation=EvtInfo_AutoCreatedDemEvent_FeeDemEventParameterRefs_FEE_E_GC_WRITE.GetEventFreezeFrameDataEx
        OpEventGetEventFreezeFrameDataEx_GetEventFreezeFrameDataEx_EvtInfo_AutoCreatedDemEvent_FeeDemEventParameterRefs_FEE_E_GC_TRIG: start-on-event=DemSatellite_0InternalBehavior/GetEventFreezeFrameDataEx, operation=EvtInfo_AutoCreatedDemEvent_FeeDemEventParameterRefs_FEE_E_GC_TRIG.GetEventFreezeFrameDataEx
        OpEventGetEventFreezeFrameDataEx_GetEventFreezeFrameDataEx_EvtInfo_AutoCreatedDemEvent_FeeDemEventParameterRefs_FEE_E_GC_READ: start-on-event=DemSatellite_0InternalBehavior/GetEventFreezeFrameDataEx, operation=EvtInfo_AutoCreatedDemEvent_FeeDemEventParameterRefs_FEE_E_GC_READ.GetEventFreezeFrameDataEx
        OpEventGetEventFreezeFrameDataEx_GetEventFreezeFrameDataEx_EvtInfo_AutoCreatedDemEvent_FeeDemEventParameterRefs_FEE_E_GC_INIT: start-on-event=DemSatellite_0InternalBehavior/GetEventFreezeFrameDataEx, operation=EvtInfo_AutoCreatedDemEvent_FeeDemEventParameterRefs_FEE_E_GC_INIT.GetEventFreezeFrameDataEx
        OpEventGetEventFreezeFrameDataEx_GetEventFreezeFrameDataEx_EvtInfo_AutoCreatedDemEvent_FeeDemEventParameterRefs_FEE_E_GC_ERASE: start-on-event=DemSatellite_0InternalBehavior/GetEventFreezeFrameDataEx, operation=EvtInfo_AutoCreatedDemEvent_FeeDemEventParameterRefs_FEE_E_GC_ERASE.GetEventFreezeFrameDataEx
        OpEventGetEventExtendedDataRecordEx_GetEventExtendedDataRecordEx_EvtInfo_AutoCreatedDemEvent_FeeDemEventParameterRefs_F_dbedb219: start-on-event=DemSatellite_0InternalBehavior/GetEventExtendedDataRecordEx, operation=EvtInfo_AutoCreatedDemEvent_FeeDemEventParameterRefs_FEE_E_WRITE_CYCLES_EXHAUSTED.GetEventExtendedDataRecordEx
        OpEventGetEventExtendedDataRecordEx_GetEventExtendedDataRecordEx_EvtInfo_AutoCreatedDemEvent_FeeDemEventParameterRefs_F_6c48ac91: start-on-event=DemSatellite_0InternalBehavior/GetEventExtendedDataRecordEx, operation=EvtInfo_AutoCreatedDemEvent_FeeDemEventParameterRefs_FEE_E_WRITE.GetEventExtendedDataRecordEx
        OpEventGetEventExtendedDataRecordEx_GetEventExtendedDataRecordEx_EvtInfo_AutoCreatedDemEvent_FeeDemEventParameterRefs_F_1ee5b810: start-on-event=DemSatellite_0InternalBehavior/GetEventExtendedDataRecordEx, operation=EvtInfo_AutoCreatedDemEvent_FeeDemEventParameterRefs_FEE_E_UNCONFIG_BLK_EXCEEDED.GetEventExtendedDataRecordEx
        OpEventGetEventExtendedDataRecordEx_GetEventExtendedDataRecordEx_EvtInfo_AutoCreatedDemEvent_FeeDemEventParameterRefs_FEE_E_READ: start-on-event=DemSatellite_0InternalBehavior/GetEventExtendedDataRecordEx, operation=EvtInfo_AutoCreatedDemEvent_FeeDemEventParameterRefs_FEE_E_READ.GetEventExtendedDataRecordEx
        OpEventGetEventExtendedDataRecordEx_GetEventExtendedDataRecordEx_EvtInfo_AutoCreatedDemEvent_FeeDemEventParameterRefs_F_b6755921: start-on-event=DemSatellite_0InternalBehavior/GetEventExtendedDataRecordEx, operation=EvtInfo_AutoCreatedDemEvent_FeeDemEventParameterRefs_FEE_E_INVALIDATE.GetEventExtendedDataRecordEx
        OpEventGetEventExtendedDataRecordEx_GetEventExtendedDataRecordEx_EvtInfo_AutoCreatedDemEvent_FeeDemEventParameterRefs_F_3cfcf8df: start-on-event=DemSatellite_0InternalBehavior/GetEventExtendedDataRecordEx, operation=EvtInfo_AutoCreatedDemEvent_FeeDemEventParameterRefs_FEE_E_GC_WRITE.GetEventExtendedDataRecordEx
        OpEventGetEventExtendedDataRecordEx_GetEventExtendedDataRecordEx_EvtInfo_AutoCreatedDemEvent_FeeDemEventParameterRefs_F_667d9077: start-on-event=DemSatellite_0InternalBehavior/GetEventExtendedDataRecordEx, operation=EvtInfo_AutoCreatedDemEvent_FeeDemEventParameterRefs_FEE_E_GC_TRIG.GetEventExtendedDataRecordEx
        OpEventGetEventExtendedDataRecordEx_GetEventExtendedDataRecordEx_EvtInfo_AutoCreatedDemEvent_FeeDemEventParameterRefs_F_0bafa1ec: start-on-event=DemSatellite_0InternalBehavior/GetEventExtendedDataRecordEx, operation=EvtInfo_AutoCreatedDemEvent_FeeDemEventParameterRefs_FEE_E_GC_READ.GetEventExtendedDataRecordEx
        OpEventGetEventExtendedDataRecordEx_GetEventExtendedDataRecordEx_EvtInfo_AutoCreatedDemEvent_FeeDemEventParameterRefs_F_558c04ff: start-on-event=DemSatellite_0InternalBehavior/GetEventExtendedDataRecordEx, operation=EvtInfo_AutoCreatedDemEvent_FeeDemEventParameterRefs_FEE_E_GC_INIT.GetEventExtendedDataRecordEx
        OpEventGetEventExtendedDataRecordEx_GetEventExtendedDataRecordEx_EvtInfo_AutoCreatedDemEvent_FeeDemEventParameterRefs_F_678efb42: start-on-event=DemSatellite_0InternalBehavior/GetEventExtendedDataRecordEx, operation=EvtInfo_AutoCreatedDemEvent_FeeDemEventParameterRefs_FEE_E_GC_ERASE.GetEventExtendedDataRecordEx
        OpEventGetEventEnableCondition_GetEventEnableCondition_EvtInfo_AutoCreatedDemEvent_FeeDemEventParameterRefs_FEE_E_WRITE_9b0c9098: start-on-event=DemSatellite_0InternalBehavior/GetEventEnableCondition, operation=EvtInfo_AutoCreatedDemEvent_FeeDemEventParameterRefs_FEE_E_WRITE_CYCLES_EXHAUSTED.GetEventEnableCondition
        OpEventGetEventEnableCondition_GetEventEnableCondition_EvtInfo_AutoCreatedDemEvent_FeeDemEventParameterRefs_FEE_E_WRITE: start-on-event=DemSatellite_0InternalBehavior/GetEventEnableCondition, operation=EvtInfo_AutoCreatedDemEvent_FeeDemEventParameterRefs_FEE_E_WRITE.GetEventEnableCondition
        OpEventGetEventEnableCondition_GetEventEnableCondition_EvtInfo_AutoCreatedDemEvent_FeeDemEventParameterRefs_FEE_E_UNCON_20cc5ffa: start-on-event=DemSatellite_0InternalBehavior/GetEventEnableCondition, operation=EvtInfo_AutoCreatedDemEvent_FeeDemEventParameterRefs_FEE_E_UNCONFIG_BLK_EXCEEDED.GetEventEnableCondition
        OpEventGetEventEnableCondition_GetEventEnableCondition_EvtInfo_AutoCreatedDemEvent_FeeDemEventParameterRefs_FEE_E_READ: start-on-event=DemSatellite_0InternalBehavior/GetEventEnableCondition, operation=EvtInfo_AutoCreatedDemEvent_FeeDemEventParameterRefs_FEE_E_READ.GetEventEnableCondition
        OpEventGetEventEnableCondition_GetEventEnableCondition_EvtInfo_AutoCreatedDemEvent_FeeDemEventParameterRefs_FEE_E_INVALIDATE: start-on-event=DemSatellite_0InternalBehavior/GetEventEnableCondition, operation=EvtInfo_AutoCreatedDemEvent_FeeDemEventParameterRefs_FEE_E_INVALIDATE.GetEventEnableCondition
        OpEventGetEventEnableCondition_GetEventEnableCondition_EvtInfo_AutoCreatedDemEvent_FeeDemEventParameterRefs_FEE_E_GC_WRITE: start-on-event=DemSatellite_0InternalBehavior/GetEventEnableCondition, operation=EvtInfo_AutoCreatedDemEvent_FeeDemEventParameterRefs_FEE_E_GC_WRITE.GetEventEnableCondition
        OpEventGetEventEnableCondition_GetEventEnableCondition_EvtInfo_AutoCreatedDemEvent_FeeDemEventParameterRefs_FEE_E_GC_TRIG: start-on-event=DemSatellite_0InternalBehavior/GetEventEnableCondition, operation=EvtInfo_AutoCreatedDemEvent_FeeDemEventParameterRefs_FEE_E_GC_TRIG.GetEventEnableCondition
        OpEventGetEventEnableCondition_GetEventEnableCondition_EvtInfo_AutoCreatedDemEvent_FeeDemEventParameterRefs_FEE_E_GC_READ: start-on-event=DemSatellite_0InternalBehavior/GetEventEnableCondition, operation=EvtInfo_AutoCreatedDemEvent_FeeDemEventParameterRefs_FEE_E_GC_READ.GetEventEnableCondition
        OpEventGetEventEnableCondition_GetEventEnableCondition_EvtInfo_AutoCreatedDemEvent_FeeDemEventParameterRefs_FEE_E_GC_INIT: start-on-event=DemSatellite_0InternalBehavior/GetEventEnableCondition, operation=EvtInfo_AutoCreatedDemEvent_FeeDemEventParameterRefs_FEE_E_GC_INIT.GetEventEnableCondition
        OpEventGetEventEnableCondition_GetEventEnableCondition_EvtInfo_AutoCreatedDemEvent_FeeDemEventParameterRefs_FEE_E_GC_ERASE: start-on-event=DemSatellite_0InternalBehavior/GetEventEnableCondition, operation=EvtInfo_AutoCreatedDemEvent_FeeDemEventParameterRefs_FEE_E_GC_ERASE.GetEventEnableCondition
        OpEventGetDebouncingOfEvent_GetDebouncingOfEvent_EvtInfo_AutoCreatedDemEvent_FeeDemEventParameterRefs_FEE_E_WRITE_CYCLE_58734919: start-on-event=DemSatellite_0InternalBehavior/GetDebouncingOfEvent, operation=EvtInfo_AutoCreatedDemEvent_FeeDemEventParameterRefs_FEE_E_WRITE_CYCLES_EXHAUSTED.GetDebouncingOfEvent
        OpEventGetDebouncingOfEvent_GetDebouncingOfEvent_EvtInfo_AutoCreatedDemEvent_FeeDemEventParameterRefs_FEE_E_WRITE: start-on-event=DemSatellite_0InternalBehavior/GetDebouncingOfEvent, operation=EvtInfo_AutoCreatedDemEvent_FeeDemEventParameterRefs_FEE_E_WRITE.GetDebouncingOfEvent
        OpEventGetDebouncingOfEvent_GetDebouncingOfEvent_EvtInfo_AutoCreatedDemEvent_FeeDemEventParameterRefs_FEE_E_UNCONFIG_BL_539b7f07: start-on-event=DemSatellite_0InternalBehavior/GetDebouncingOfEvent, operation=EvtInfo_AutoCreatedDemEvent_FeeDemEventParameterRefs_FEE_E_UNCONFIG_BLK_EXCEEDED.GetDebouncingOfEvent
        OpEventGetDebouncingOfEvent_GetDebouncingOfEvent_EvtInfo_AutoCreatedDemEvent_FeeDemEventParameterRefs_FEE_E_READ: start-on-event=DemSatellite_0InternalBehavior/GetDebouncingOfEvent, operation=EvtInfo_AutoCreatedDemEvent_FeeDemEventParameterRefs_FEE_E_READ.GetDebouncingOfEvent
        OpEventGetDebouncingOfEvent_GetDebouncingOfEvent_EvtInfo_AutoCreatedDemEvent_FeeDemEventParameterRefs_FEE_E_INVALIDATE: start-on-event=DemSatellite_0InternalBehavior/GetDebouncingOfEvent, operation=EvtInfo_AutoCreatedDemEvent_FeeDemEventParameterRefs_FEE_E_INVALIDATE.GetDebouncingOfEvent
        OpEventGetDebouncingOfEvent_GetDebouncingOfEvent_EvtInfo_AutoCreatedDemEvent_FeeDemEventParameterRefs_FEE_E_GC_WRITE: start-on-event=DemSatellite_0InternalBehavior/GetDebouncingOfEvent, operation=EvtInfo_AutoCreatedDemEvent_FeeDemEventParameterRefs_FEE_E_GC_WRITE.GetDebouncingOfEvent
        OpEventGetDebouncingOfEvent_GetDebouncingOfEvent_EvtInfo_AutoCreatedDemEvent_FeeDemEventParameterRefs_FEE_E_GC_TRIG: start-on-event=DemSatellite_0InternalBehavior/GetDebouncingOfEvent, operation=EvtInfo_AutoCreatedDemEvent_FeeDemEventParameterRefs_FEE_E_GC_TRIG.GetDebouncingOfEvent
        OpEventGetDebouncingOfEvent_GetDebouncingOfEvent_EvtInfo_AutoCreatedDemEvent_FeeDemEventParameterRefs_FEE_E_GC_READ: start-on-event=DemSatellite_0InternalBehavior/GetDebouncingOfEvent, operation=EvtInfo_AutoCreatedDemEvent_FeeDemEventParameterRefs_FEE_E_GC_READ.GetDebouncingOfEvent
        OpEventGetDebouncingOfEvent_GetDebouncingOfEvent_EvtInfo_AutoCreatedDemEvent_FeeDemEventParameterRefs_FEE_E_GC_INIT: start-on-event=DemSatellite_0InternalBehavior/GetDebouncingOfEvent, operation=EvtInfo_AutoCreatedDemEvent_FeeDemEventParameterRefs_FEE_E_GC_INIT.GetDebouncingOfEvent
        OpEventGetDebouncingOfEvent_GetDebouncingOfEvent_EvtInfo_AutoCreatedDemEvent_FeeDemEventParameterRefs_FEE_E_GC_ERASE: start-on-event=DemSatellite_0InternalBehavior/GetDebouncingOfEvent, operation=EvtInfo_AutoCreatedDemEvent_FeeDemEventParameterRefs_FEE_E_GC_ERASE.GetDebouncingOfEvent
        OpEventGetMonitorStatus_GetMonitorStatus_EvtInfo_AutoCreatedDemEvent_FeeDemEventParameterRefs_FEE_E_WRITE_CYCLES_EXHAUSTED: start-on-event=DemSatellite_0InternalBehavior/GetMonitorStatus, operation=EvtInfo_AutoCreatedDemEvent_FeeDemEventParameterRefs_FEE_E_WRITE_CYCLES_EXHAUSTED.GetMonitorStatus
        OpEventGetMonitorStatus_GetMonitorStatus_EvtInfo_AutoCreatedDemEvent_FeeDemEventParameterRefs_FEE_E_WRITE: start-on-event=DemSatellite_0InternalBehavior/GetMonitorStatus, operation=EvtInfo_AutoCreatedDemEvent_FeeDemEventParameterRefs_FEE_E_WRITE.GetMonitorStatus
        OpEventGetMonitorStatus_GetMonitorStatus_EvtInfo_AutoCreatedDemEvent_FeeDemEventParameterRefs_FEE_E_UNCONFIG_BLK_EXCEEDED: start-on-event=DemSatellite_0InternalBehavior/GetMonitorStatus, operation=EvtInfo_AutoCreatedDemEvent_FeeDemEventParameterRefs_FEE_E_UNCONFIG_BLK_EXCEEDED.GetMonitorStatus
        OpEventGetMonitorStatus_GetMonitorStatus_EvtInfo_AutoCreatedDemEvent_FeeDemEventParameterRefs_FEE_E_READ: start-on-event=DemSatellite_0InternalBehavior/GetMonitorStatus, operation=EvtInfo_AutoCreatedDemEvent_FeeDemEventParameterRefs_FEE_E_READ.GetMonitorStatus
        OpEventGetMonitorStatus_GetMonitorStatus_EvtInfo_AutoCreatedDemEvent_FeeDemEventParameterRefs_FEE_E_INVALIDATE: start-on-event=DemSatellite_0InternalBehavior/GetMonitorStatus, operation=EvtInfo_AutoCreatedDemEvent_FeeDemEventParameterRefs_FEE_E_INVALIDATE.GetMonitorStatus
        OpEventGetMonitorStatus_GetMonitorStatus_EvtInfo_AutoCreatedDemEvent_FeeDemEventParameterRefs_FEE_E_GC_WRITE: start-on-event=DemSatellite_0InternalBehavior/GetMonitorStatus, operation=EvtInfo_AutoCreatedDemEvent_FeeDemEventParameterRefs_FEE_E_GC_WRITE.GetMonitorStatus
        OpEventGetMonitorStatus_GetMonitorStatus_EvtInfo_AutoCreatedDemEvent_FeeDemEventParameterRefs_FEE_E_GC_TRIG: start-on-event=DemSatellite_0InternalBehavior/GetMonitorStatus, operation=EvtInfo_AutoCreatedDemEvent_FeeDemEventParameterRefs_FEE_E_GC_TRIG.GetMonitorStatus
        OpEventGetMonitorStatus_GetMonitorStatus_EvtInfo_AutoCreatedDemEvent_FeeDemEventParameterRefs_FEE_E_GC_READ: start-on-event=DemSatellite_0InternalBehavior/GetMonitorStatus, operation=EvtInfo_AutoCreatedDemEvent_FeeDemEventParameterRefs_FEE_E_GC_READ.GetMonitorStatus
        OpEventGetMonitorStatus_GetMonitorStatus_EvtInfo_AutoCreatedDemEvent_FeeDemEventParameterRefs_FEE_E_GC_INIT: start-on-event=DemSatellite_0InternalBehavior/GetMonitorStatus, operation=EvtInfo_AutoCreatedDemEvent_FeeDemEventParameterRefs_FEE_E_GC_INIT.GetMonitorStatus
        OpEventGetMonitorStatus_GetMonitorStatus_EvtInfo_AutoCreatedDemEvent_FeeDemEventParameterRefs_FEE_E_GC_ERASE: start-on-event=DemSatellite_0InternalBehavior/GetMonitorStatus, operation=EvtInfo_AutoCreatedDemEvent_FeeDemEventParameterRefs_FEE_E_GC_ERASE.GetMonitorStatus
        OpEventGetEventUdsStatus_GetEventUdsStatus_EvtInfo_DTC_0x100000: start-on-event=DemSatellite_0InternalBehavior/GetEventUdsStatus, operation=EvtInfo_DTC_0x100000.GetEventUdsStatus
        OpEventGetEventUdsStatus_GetEventUdsStatus_Event_DTC_0x100000: start-on-event=DemSatellite_0InternalBehavior/GetEventUdsStatus, operation=Event_DTC_0x100000.GetEventUdsStatus
        OpEventGetEventUdsStatus_GetEventUdsStatus_EvtInfo_DTC_0x100002: start-on-event=DemSatellite_0InternalBehavior/GetEventUdsStatus, operation=EvtInfo_DTC_0x100002.GetEventUdsStatus
        OpEventGetEventUdsStatus_GetEventUdsStatus_Event_DTC_0x100002: start-on-event=DemSatellite_0InternalBehavior/GetEventUdsStatus, operation=Event_DTC_0x100002.GetEventUdsStatus
        OpEventGetEventUdsStatus_GetEventUdsStatus_EvtInfo_DTC_0x100003: start-on-event=DemSatellite_0InternalBehavior/GetEventUdsStatus, operation=EvtInfo_DTC_0x100003.GetEventUdsStatus
        OpEventGetEventUdsStatus_GetEventUdsStatus_Event_DTC_0x100003: start-on-event=DemSatellite_0InternalBehavior/GetEventUdsStatus, operation=Event_DTC_0x100003.GetEventUdsStatus
        OpEventGetEventUdsStatus_GetEventUdsStatus_EvtInfo_DTC_0xc12490: start-on-event=DemSatellite_0InternalBehavior/GetEventUdsStatus, operation=EvtInfo_DTC_0xc12490.GetEventUdsStatus
        OpEventGetEventUdsStatus_GetEventUdsStatus_Event_DTC_0xc12490: start-on-event=DemSatellite_0InternalBehavior/GetEventUdsStatus, operation=Event_DTC_0xc12490.GetEventUdsStatus
        OpEventGetEventUdsStatus_GetEventUdsStatus_EvtInfo_DTC_0x100009: start-on-event=DemSatellite_0InternalBehavior/GetEventUdsStatus, operation=EvtInfo_DTC_0x100009.GetEventUdsStatus
        OpEventGetEventUdsStatus_GetEventUdsStatus_Event_DTC_0x100009: start-on-event=DemSatellite_0InternalBehavior/GetEventUdsStatus, operation=Event_DTC_0x100009.GetEventUdsStatus
        OpEventGetEventUdsStatus_GetEventUdsStatus_EvtInfo_DTC_0xd40200: start-on-event=DemSatellite_0InternalBehavior/GetEventUdsStatus, operation=EvtInfo_DTC_0xd40200.GetEventUdsStatus
        OpEventGetEventUdsStatus_GetEventUdsStatus_Event_DTC_0xd40200: start-on-event=DemSatellite_0InternalBehavior/GetEventUdsStatus, operation=Event_DTC_0xd40200.GetEventUdsStatus
        OpEventGetEventUdsStatus_GetEventUdsStatus_EvtInfo_DTC_0x00b050: start-on-event=DemSatellite_0InternalBehavior/GetEventUdsStatus, operation=EvtInfo_DTC_0x00b050.GetEventUdsStatus
        OpEventGetEventUdsStatus_GetEventUdsStatus_Event_DTC_0x00b050: start-on-event=DemSatellite_0InternalBehavior/GetEventUdsStatus, operation=Event_DTC_0x00b050.GetEventUdsStatus
        OpEventGetEventUdsStatus_GetEventUdsStatus_EvtInfo_DTC_0x10000f: start-on-event=DemSatellite_0InternalBehavior/GetEventUdsStatus, operation=EvtInfo_DTC_0x10000f.GetEventUdsStatus
        OpEventGetEventUdsStatus_GetEventUdsStatus_Event_DTC_0x10000f: start-on-event=DemSatellite_0InternalBehavior/GetEventUdsStatus, operation=Event_DTC_0x10000f.GetEventUdsStatus
        OpEventGetEventUdsStatus_GetEventUdsStatus_EvtInfo_DTC_0x10001a: start-on-event=DemSatellite_0InternalBehavior/GetEventUdsStatus, operation=EvtInfo_DTC_0x10001a.GetEventUdsStatus
        OpEventGetEventUdsStatus_GetEventUdsStatus_Event_DTC_0x10001a: start-on-event=DemSatellite_0InternalBehavior/GetEventUdsStatus, operation=Event_DTC_0x10001a.GetEventUdsStatus
        OpEventGetEventUdsStatus_GetEventUdsStatus_EvtInfo_DTC_0x10001c: start-on-event=DemSatellite_0InternalBehavior/GetEventUdsStatus, operation=EvtInfo_DTC_0x10001c.GetEventUdsStatus
        OpEventGetEventUdsStatus_GetEventUdsStatus_Event_DTC_0x10001c: start-on-event=DemSatellite_0InternalBehavior/GetEventUdsStatus, operation=Event_DTC_0x10001c.GetEventUdsStatus
        OpEventGetEventUdsStatus_GetEventUdsStatus_EvtInfo_DTC_0x100011: start-on-event=DemSatellite_0InternalBehavior/GetEventUdsStatus, operation=EvtInfo_DTC_0x100011.GetEventUdsStatus
        OpEventGetEventUdsStatus_GetEventUdsStatus_Event_DTC_0x100011: start-on-event=DemSatellite_0InternalBehavior/GetEventUdsStatus, operation=Event_DTC_0x100011.GetEventUdsStatus
        OpEventGetEventUdsStatus_GetEventUdsStatus_EvtInfo_DTC_0x100012: start-on-event=DemSatellite_0InternalBehavior/GetEventUdsStatus, operation=EvtInfo_DTC_0x100012.GetEventUdsStatus
        OpEventGetEventUdsStatus_GetEventUdsStatus_Event_DTC_0x100012: start-on-event=DemSatellite_0InternalBehavior/GetEventUdsStatus, operation=Event_DTC_0x100012.GetEventUdsStatus
        OpEventGetEventUdsStatus_GetEventUdsStatus_EvtInfo_DTC_0x100010: start-on-event=DemSatellite_0InternalBehavior/GetEventUdsStatus, operation=EvtInfo_DTC_0x100010.GetEventUdsStatus
        OpEventGetEventUdsStatus_GetEventUdsStatus_Event_DTC_0x100010: start-on-event=DemSatellite_0InternalBehavior/GetEventUdsStatus, operation=Event_DTC_0x100010.GetEventUdsStatus
        OpEventGetEventUdsStatus_GetEventUdsStatus_EvtInfo_DTC_0x100013: start-on-event=DemSatellite_0InternalBehavior/GetEventUdsStatus, operation=EvtInfo_DTC_0x100013.GetEventUdsStatus
        OpEventGetEventUdsStatus_GetEventUdsStatus_Event_DTC_0x100013: start-on-event=DemSatellite_0InternalBehavior/GetEventUdsStatus, operation=Event_DTC_0x100013.GetEventUdsStatus
        OpEventGetEventUdsStatus_GetEventUdsStatus_EvtInfo_DTC_0x10000a: start-on-event=DemSatellite_0InternalBehavior/GetEventUdsStatus, operation=EvtInfo_DTC_0x10000a.GetEventUdsStatus
        OpEventGetEventUdsStatus_GetEventUdsStatus_Event_DTC_0x10000a: start-on-event=DemSatellite_0InternalBehavior/GetEventUdsStatus, operation=Event_DTC_0x10000a.GetEventUdsStatus
        OpEventGetEventUdsStatus_GetEventUdsStatus_EvtInfo_DTC_0x10000d: start-on-event=DemSatellite_0InternalBehavior/GetEventUdsStatus, operation=EvtInfo_DTC_0x10000d.GetEventUdsStatus
        OpEventGetEventUdsStatus_GetEventUdsStatus_Event_DTC_0x10000d: start-on-event=DemSatellite_0InternalBehavior/GetEventUdsStatus, operation=Event_DTC_0x10000d.GetEventUdsStatus
        OpEventGetEventUdsStatus_GetEventUdsStatus_EvtInfo_DTC_0x10000e: start-on-event=DemSatellite_0InternalBehavior/GetEventUdsStatus, operation=EvtInfo_DTC_0x10000e.GetEventUdsStatus
        OpEventGetEventUdsStatus_GetEventUdsStatus_Event_DTC_0x10000e: start-on-event=DemSatellite_0InternalBehavior/GetEventUdsStatus, operation=Event_DTC_0x10000e.GetEventUdsStatus
        OpEventGetEventUdsStatus_GetEventUdsStatus_EvtInfo_DTC_0x10000b: start-on-event=DemSatellite_0InternalBehavior/GetEventUdsStatus, operation=EvtInfo_DTC_0x10000b.GetEventUdsStatus
        OpEventGetEventUdsStatus_GetEventUdsStatus_Event_DTC_0x10000b: start-on-event=DemSatellite_0InternalBehavior/GetEventUdsStatus, operation=Event_DTC_0x10000b.GetEventUdsStatus
        OpEventGetEventUdsStatus_GetEventUdsStatus_EvtInfo_DTC_0x100044: start-on-event=DemSatellite_0InternalBehavior/GetEventUdsStatus, operation=EvtInfo_DTC_0x100044.GetEventUdsStatus
        OpEventGetEventUdsStatus_GetEventUdsStatus_Event_DTC_0x100044: start-on-event=DemSatellite_0InternalBehavior/GetEventUdsStatus, operation=Event_DTC_0x100044.GetEventUdsStatus
        OpEventGetEventUdsStatus_GetEventUdsStatus_EvtInfo_DTC_0x100042: start-on-event=DemSatellite_0InternalBehavior/GetEventUdsStatus, operation=EvtInfo_DTC_0x100042.GetEventUdsStatus
        OpEventGetEventUdsStatus_GetEventUdsStatus_Event_DTC_0x100042: start-on-event=DemSatellite_0InternalBehavior/GetEventUdsStatus, operation=Event_DTC_0x100042.GetEventUdsStatus
        OpEventGetEventUdsStatus_GetEventUdsStatus_EvtInfo_DTC_0x100043: start-on-event=DemSatellite_0InternalBehavior/GetEventUdsStatus, operation=EvtInfo_DTC_0x100043.GetEventUdsStatus
        OpEventGetEventUdsStatus_GetEventUdsStatus_Event_DTC_0x100043: start-on-event=DemSatellite_0InternalBehavior/GetEventUdsStatus, operation=Event_DTC_0x100043.GetEventUdsStatus
        OpEventGetEventUdsStatus_GetEventUdsStatus_EvtInfo_DTC_0xd12c20: start-on-event=DemSatellite_0InternalBehavior/GetEventUdsStatus, operation=EvtInfo_DTC_0xd12c20.GetEventUdsStatus
        OpEventGetEventUdsStatus_GetEventUdsStatus_Event_DTC_0xd12c20: start-on-event=DemSatellite_0InternalBehavior/GetEventUdsStatus, operation=Event_DTC_0xd12c20.GetEventUdsStatus
        OpEventGetEventUdsStatus_GetEventUdsStatus_EvtInfo_DTC_0xd12c21: start-on-event=DemSatellite_0InternalBehavior/GetEventUdsStatus, operation=EvtInfo_DTC_0xd12c21.GetEventUdsStatus
        OpEventGetEventUdsStatus_GetEventUdsStatus_Event_DTC_0xd12c21: start-on-event=DemSatellite_0InternalBehavior/GetEventUdsStatus, operation=Event_DTC_0xd12c21.GetEventUdsStatus
        OpEventGetEventUdsStatus_GetEventUdsStatus_EvtInfo_DTC_0xd01200: start-on-event=DemSatellite_0InternalBehavior/GetEventUdsStatus, operation=EvtInfo_DTC_0xd01200.GetEventUdsStatus
        OpEventGetEventUdsStatus_GetEventUdsStatus_Event_DTC_0xd01200: start-on-event=DemSatellite_0InternalBehavior/GetEventUdsStatus, operation=Event_DTC_0xd01200.GetEventUdsStatus
        OpEventGetEventUdsStatus_GetEventUdsStatus_EvtInfo_DTC_0xd12c23: start-on-event=DemSatellite_0InternalBehavior/GetEventUdsStatus, operation=EvtInfo_DTC_0xd12c23.GetEventUdsStatus
        OpEventGetEventUdsStatus_GetEventUdsStatus_Event_DTC_0xd12c23: start-on-event=DemSatellite_0InternalBehavior/GetEventUdsStatus, operation=Event_DTC_0xd12c23.GetEventUdsStatus
        OpEventGetEventUdsStatus_GetEventUdsStatus_EvtInfo_DTC_0x100041: start-on-event=DemSatellite_0InternalBehavior/GetEventUdsStatus, operation=EvtInfo_DTC_0x100041.GetEventUdsStatus
        OpEventGetEventUdsStatus_GetEventUdsStatus_Event_DTC_0x100041: start-on-event=DemSatellite_0InternalBehavior/GetEventUdsStatus, operation=Event_DTC_0x100041.GetEventUdsStatus
        OpEventGetEventUdsStatus_GetEventUdsStatus_EvtInfo_DTC_0xd12101: start-on-event=DemSatellite_0InternalBehavior/GetEventUdsStatus, operation=EvtInfo_DTC_0xd12101.GetEventUdsStatus
        OpEventGetEventUdsStatus_GetEventUdsStatus_Event_DTC_0xd12101: start-on-event=DemSatellite_0InternalBehavior/GetEventUdsStatus, operation=Event_DTC_0xd12101.GetEventUdsStatus
        OpEventGetEventUdsStatus_GetEventUdsStatus_EvtInfo_DTC_0xd12102: start-on-event=DemSatellite_0InternalBehavior/GetEventUdsStatus, operation=EvtInfo_DTC_0xd12102.GetEventUdsStatus
        OpEventGetEventUdsStatus_GetEventUdsStatus_Event_DTC_0xd12102: start-on-event=DemSatellite_0InternalBehavior/GetEventUdsStatus, operation=Event_DTC_0xd12102.GetEventUdsStatus
        OpEventGetEventUdsStatus_GetEventUdsStatus_EvtInfo_DTC_0xd12103: start-on-event=DemSatellite_0InternalBehavior/GetEventUdsStatus, operation=EvtInfo_DTC_0xd12103.GetEventUdsStatus
        OpEventGetEventUdsStatus_GetEventUdsStatus_Event_DTC_0xd12103: start-on-event=DemSatellite_0InternalBehavior/GetEventUdsStatus, operation=Event_DTC_0xd12103.GetEventUdsStatus
        OpEventGetEventUdsStatus_GetEventUdsStatus_EvtInfo_DTC_0x100033: start-on-event=DemSatellite_0InternalBehavior/GetEventUdsStatus, operation=EvtInfo_DTC_0x100033.GetEventUdsStatus
        OpEventGetEventUdsStatus_GetEventUdsStatus_Event_DTC_0x100033: start-on-event=DemSatellite_0InternalBehavior/GetEventUdsStatus, operation=Event_DTC_0x100033.GetEventUdsStatus
        OpEventGetEventUdsStatus_GetEventUdsStatus_EvtInfo_DTC_0x100034: start-on-event=DemSatellite_0InternalBehavior/GetEventUdsStatus, operation=EvtInfo_DTC_0x100034.GetEventUdsStatus
        OpEventGetEventUdsStatus_GetEventUdsStatus_Event_DTC_0x100034: start-on-event=DemSatellite_0InternalBehavior/GetEventUdsStatus, operation=Event_DTC_0x100034.GetEventUdsStatus
        OpEventGetEventUdsStatus_GetEventUdsStatus_EvtInfo_DTC_0x100031: start-on-event=DemSatellite_0InternalBehavior/GetEventUdsStatus, operation=EvtInfo_DTC_0x100031.GetEventUdsStatus
        OpEventGetEventUdsStatus_GetEventUdsStatus_Event_DTC_0x100031: start-on-event=DemSatellite_0InternalBehavior/GetEventUdsStatus, operation=Event_DTC_0x100031.GetEventUdsStatus
        OpEventGetEventUdsStatus_GetEventUdsStatus_EvtInfo_DTC_0x100032: start-on-event=DemSatellite_0InternalBehavior/GetEventUdsStatus, operation=EvtInfo_DTC_0x100032.GetEventUdsStatus
        OpEventGetEventUdsStatus_GetEventUdsStatus_Event_DTC_0x100032: start-on-event=DemSatellite_0InternalBehavior/GetEventUdsStatus, operation=Event_DTC_0x100032.GetEventUdsStatus
        OpEventGetEventUdsStatus_GetEventUdsStatus_EvtInfo_DTC_0x100035: start-on-event=DemSatellite_0InternalBehavior/GetEventUdsStatus, operation=EvtInfo_DTC_0x100035.GetEventUdsStatus
        OpEventGetEventUdsStatus_GetEventUdsStatus_Event_DTC_0x100035: start-on-event=DemSatellite_0InternalBehavior/GetEventUdsStatus, operation=Event_DTC_0x100035.GetEventUdsStatus
        OpEventGetEventUdsStatus_GetEventUdsStatus_EvtInfo_DTC_0xd12c30: start-on-event=DemSatellite_0InternalBehavior/GetEventUdsStatus, operation=EvtInfo_DTC_0xd12c30.GetEventUdsStatus
        OpEventGetEventUdsStatus_GetEventUdsStatus_Event_DTC_0xd12c30: start-on-event=DemSatellite_0InternalBehavior/GetEventUdsStatus, operation=Event_DTC_0xd12c30.GetEventUdsStatus
        OpEventGetEventUdsStatus_GetEventUdsStatus_EvtInfo_DTC_0x100036: start-on-event=DemSatellite_0InternalBehavior/GetEventUdsStatus, operation=EvtInfo_DTC_0x100036.GetEventUdsStatus
        OpEventGetEventUdsStatus_GetEventUdsStatus_Event_DTC_0x100036: start-on-event=DemSatellite_0InternalBehavior/GetEventUdsStatus, operation=Event_DTC_0x100036.GetEventUdsStatus
        OpEventGetEventUdsStatus_GetEventUdsStatus_EvtInfo_DTC_0x333000: start-on-event=DemSatellite_0InternalBehavior/GetEventUdsStatus, operation=EvtInfo_DTC_0x333000.GetEventUdsStatus
        OpEventGetEventUdsStatus_GetEventUdsStatus_Event_DTC_0x333000: start-on-event=DemSatellite_0InternalBehavior/GetEventUdsStatus, operation=Event_DTC_0x333000.GetEventUdsStatus
        OpEventGetEventUdsStatus_GetEventUdsStatus_EvtInfo_DTC_0xd12112: start-on-event=DemSatellite_0InternalBehavior/GetEventUdsStatus, operation=EvtInfo_DTC_0xd12112.GetEventUdsStatus
        OpEventGetEventUdsStatus_GetEventUdsStatus_Event_DTC_0xd12112: start-on-event=DemSatellite_0InternalBehavior/GetEventUdsStatus, operation=Event_DTC_0xd12112.GetEventUdsStatus
        OpEventGetEventUdsStatus_GetEventUdsStatus_EvtInfo_DTC_0xd12114: start-on-event=DemSatellite_0InternalBehavior/GetEventUdsStatus, operation=EvtInfo_DTC_0xd12114.GetEventUdsStatus
        OpEventGetEventUdsStatus_GetEventUdsStatus_Event_DTC_0xd12114: start-on-event=DemSatellite_0InternalBehavior/GetEventUdsStatus, operation=Event_DTC_0xd12114.GetEventUdsStatus
        OpEventGetEventUdsStatus_GetEventUdsStatus_EvtInfo_DTC_0xd12115: start-on-event=DemSatellite_0InternalBehavior/GetEventUdsStatus, operation=EvtInfo_DTC_0xd12115.GetEventUdsStatus
        OpEventGetEventUdsStatus_GetEventUdsStatus_Event_DTC_0xd12115: start-on-event=DemSatellite_0InternalBehavior/GetEventUdsStatus, operation=Event_DTC_0xd12115.GetEventUdsStatus
        OpEventGetEventUdsStatus_GetEventUdsStatus_EvtInfo_DTC_0xd12116: start-on-event=DemSatellite_0InternalBehavior/GetEventUdsStatus, operation=EvtInfo_DTC_0xd12116.GetEventUdsStatus
        OpEventGetEventUdsStatus_GetEventUdsStatus_Event_DTC_0xd12116: start-on-event=DemSatellite_0InternalBehavior/GetEventUdsStatus, operation=Event_DTC_0xd12116.GetEventUdsStatus
        OpEventGetEventUdsStatus_GetEventUdsStatus_EvtInfo_DTC_0xd12117: start-on-event=DemSatellite_0InternalBehavior/GetEventUdsStatus, operation=EvtInfo_DTC_0xd12117.GetEventUdsStatus
        OpEventGetEventUdsStatus_GetEventUdsStatus_Event_DTC_0xd12117: start-on-event=DemSatellite_0InternalBehavior/GetEventUdsStatus, operation=Event_DTC_0xd12117.GetEventUdsStatus
        OpEventGetEventUdsStatus_GetEventUdsStatus_EvtInfo_DTC_0xd12118: start-on-event=DemSatellite_0InternalBehavior/GetEventUdsStatus, operation=EvtInfo_DTC_0xd12118.GetEventUdsStatus
        OpEventGetEventUdsStatus_GetEventUdsStatus_Event_DTC_0xd12118: start-on-event=DemSatellite_0InternalBehavior/GetEventUdsStatus, operation=Event_DTC_0xd12118.GetEventUdsStatus
        OpEventGetEventUdsStatus_GetEventUdsStatus_EvtInfo_DTC_0xd12119: start-on-event=DemSatellite_0InternalBehavior/GetEventUdsStatus, operation=EvtInfo_DTC_0xd12119.GetEventUdsStatus
        OpEventGetEventUdsStatus_GetEventUdsStatus_Event_DTC_0xd12119: start-on-event=DemSatellite_0InternalBehavior/GetEventUdsStatus, operation=Event_DTC_0xd12119.GetEventUdsStatus
        OpEventGetEventUdsStatus_GetEventUdsStatus_EvtInfo_DTC_0xd01100: start-on-event=DemSatellite_0InternalBehavior/GetEventUdsStatus, operation=EvtInfo_DTC_0xd01100.GetEventUdsStatus
        OpEventGetEventUdsStatus_GetEventUdsStatus_Event_DTC_0xd01100: start-on-event=DemSatellite_0InternalBehavior/GetEventUdsStatus, operation=Event_DTC_0xd01100.GetEventUdsStatus
        OpEventGetEventUdsStatus_GetEventUdsStatus_EvtInfo_DTC_0xd12c00: start-on-event=DemSatellite_0InternalBehavior/GetEventUdsStatus, operation=EvtInfo_DTC_0xd12c00.GetEventUdsStatus
        OpEventGetEventUdsStatus_GetEventUdsStatus_Event_DTC_0xd12c00: start-on-event=DemSatellite_0InternalBehavior/GetEventUdsStatus, operation=Event_DTC_0xd12c00.GetEventUdsStatus
        OpEventGetEventUdsStatus_GetEventUdsStatus_EvtInfo_DTC_0xd12c01: start-on-event=DemSatellite_0InternalBehavior/GetEventUdsStatus, operation=EvtInfo_DTC_0xd12c01.GetEventUdsStatus
        OpEventGetEventUdsStatus_GetEventUdsStatus_Event_DTC_0xd12c01: start-on-event=DemSatellite_0InternalBehavior/GetEventUdsStatus, operation=Event_DTC_0xd12c01.GetEventUdsStatus
        OpEventGetEventUdsStatus_GetEventUdsStatus_EvtInfo_DTC_0xd12c08: start-on-event=DemSatellite_0InternalBehavior/GetEventUdsStatus, operation=EvtInfo_DTC_0xd12c08.GetEventUdsStatus
        OpEventGetEventUdsStatus_GetEventUdsStatus_Event_DTC_0xd12c08: start-on-event=DemSatellite_0InternalBehavior/GetEventUdsStatus, operation=Event_DTC_0xd12c08.GetEventUdsStatus
        OpEventGetEventUdsStatus_GetEventUdsStatus_EvtInfo_DTC_0xd12c14: start-on-event=DemSatellite_0InternalBehavior/GetEventUdsStatus, operation=EvtInfo_DTC_0xd12c14.GetEventUdsStatus
        OpEventGetEventUdsStatus_GetEventUdsStatus_Event_DTC_0xd12c14: start-on-event=DemSatellite_0InternalBehavior/GetEventUdsStatus, operation=Event_DTC_0xd12c14.GetEventUdsStatus
        OpEventGetEventUdsStatus_GetEventUdsStatus_EvtInfo_DTC_0xd12c17: start-on-event=DemSatellite_0InternalBehavior/GetEventUdsStatus, operation=EvtInfo_DTC_0xd12c17.GetEventUdsStatus
        OpEventGetEventUdsStatus_GetEventUdsStatus_Event_DTC_0xd12c17: start-on-event=DemSatellite_0InternalBehavior/GetEventUdsStatus, operation=Event_DTC_0xd12c17.GetEventUdsStatus
        OpEventGetEventUdsStatus_GetEventUdsStatus_EvtInfo_DTC_0xd12c16: start-on-event=DemSatellite_0InternalBehavior/GetEventUdsStatus, operation=EvtInfo_DTC_0xd12c16.GetEventUdsStatus
        OpEventGetEventUdsStatus_GetEventUdsStatus_Event_DTC_0xd12c16: start-on-event=DemSatellite_0InternalBehavior/GetEventUdsStatus, operation=Event_DTC_0xd12c16.GetEventUdsStatus
        OpEventGetEventUdsStatus_GetEventUdsStatus_EvtInfo_DTC_0xd12c18: start-on-event=DemSatellite_0InternalBehavior/GetEventUdsStatus, operation=EvtInfo_DTC_0xd12c18.GetEventUdsStatus
        OpEventGetEventUdsStatus_GetEventUdsStatus_Event_DTC_0xd12c18: start-on-event=DemSatellite_0InternalBehavior/GetEventUdsStatus, operation=Event_DTC_0xd12c18.GetEventUdsStatus
        OpEventGetEventUdsStatus_GetEventUdsStatus_EvtInfo_DTC_0xd40100: start-on-event=DemSatellite_0InternalBehavior/GetEventUdsStatus, operation=EvtInfo_DTC_0xd40100.GetEventUdsStatus
        OpEventGetEventUdsStatus_GetEventUdsStatus_Event_DTC_0xd40100: start-on-event=DemSatellite_0InternalBehavior/GetEventUdsStatus, operation=Event_DTC_0xd40100.GetEventUdsStatus
        OpEventGetEventUdsStatus_GetEventUdsStatus_EvtInfo_DTC_0x000080: start-on-event=DemSatellite_0InternalBehavior/GetEventUdsStatus, operation=EvtInfo_DTC_0x000080.GetEventUdsStatus
        OpEventGetEventUdsStatus_GetEventUdsStatus_Event_DTC_0x000080: start-on-event=DemSatellite_0InternalBehavior/GetEventUdsStatus, operation=Event_DTC_0x000080.GetEventUdsStatus
        OpEventGetEventUdsStatus_GetEventUdsStatus_EvtInfo_DTC_0xd12025: start-on-event=DemSatellite_0InternalBehavior/GetEventUdsStatus, operation=EvtInfo_DTC_0xd12025.GetEventUdsStatus
        OpEventGetEventUdsStatus_GetEventUdsStatus_Event_DTC_0xd12025: start-on-event=DemSatellite_0InternalBehavior/GetEventUdsStatus, operation=Event_DTC_0xd12025.GetEventUdsStatus
        OpEventGetEventUdsStatus_GetEventUdsStatus_EvtInfo_DTC_0xd12026: start-on-event=DemSatellite_0InternalBehavior/GetEventUdsStatus, operation=EvtInfo_DTC_0xd12026.GetEventUdsStatus
        OpEventGetEventUdsStatus_GetEventUdsStatus_Event_DTC_0xd12026: start-on-event=DemSatellite_0InternalBehavior/GetEventUdsStatus, operation=Event_DTC_0xd12026.GetEventUdsStatus
        OpEventGetEventUdsStatus_GetEventUdsStatus_EvtInfo_DTC_0x120022: start-on-event=DemSatellite_0InternalBehavior/GetEventUdsStatus, operation=EvtInfo_DTC_0x120022.GetEventUdsStatus
        OpEventGetEventUdsStatus_GetEventUdsStatus_Event_DTC_0x120022: start-on-event=DemSatellite_0InternalBehavior/GetEventUdsStatus, operation=Event_DTC_0x120022.GetEventUdsStatus
        OpEventGetEventUdsStatus_GetEventUdsStatus_EvtInfo_DTC_0x120020: start-on-event=DemSatellite_0InternalBehavior/GetEventUdsStatus, operation=EvtInfo_DTC_0x120020.GetEventUdsStatus
        OpEventGetEventUdsStatus_GetEventUdsStatus_Event_DTC_0x120020: start-on-event=DemSatellite_0InternalBehavior/GetEventUdsStatus, operation=Event_DTC_0x120020.GetEventUdsStatus
        OpEventGetEventUdsStatus_GetEventUdsStatus_EvtInfo_DTC_0x170400: start-on-event=DemSatellite_0InternalBehavior/GetEventUdsStatus, operation=EvtInfo_DTC_0x170400.GetEventUdsStatus
        OpEventGetEventUdsStatus_GetEventUdsStatus_Event_DTC_0x170400: start-on-event=DemSatellite_0InternalBehavior/GetEventUdsStatus, operation=Event_DTC_0x170400.GetEventUdsStatus
        OpEventGetEventUdsStatus_GetEventUdsStatus_EvtInfo_DTC_0xd12159: start-on-event=DemSatellite_0InternalBehavior/GetEventUdsStatus, operation=EvtInfo_DTC_0xd12159.GetEventUdsStatus
        OpEventGetEventUdsStatus_GetEventUdsStatus_Event_DTC_0xd12159: start-on-event=DemSatellite_0InternalBehavior/GetEventUdsStatus, operation=Event_DTC_0xd12159.GetEventUdsStatus
        OpEventGetEventUdsStatus_GetEventUdsStatus_EvtInfo_DTC_0x00a009: start-on-event=DemSatellite_0InternalBehavior/GetEventUdsStatus, operation=EvtInfo_DTC_0x00a009.GetEventUdsStatus
        OpEventGetEventUdsStatus_GetEventUdsStatus_Event_DTC_0x00a009: start-on-event=DemSatellite_0InternalBehavior/GetEventUdsStatus, operation=Event_DTC_0x00a009.GetEventUdsStatus
        OpEventGetEventUdsStatus_GetEventUdsStatus_EvtInfo_DTC_0xd1210b: start-on-event=DemSatellite_0InternalBehavior/GetEventUdsStatus, operation=EvtInfo_DTC_0xd1210b.GetEventUdsStatus
        OpEventGetEventUdsStatus_GetEventUdsStatus_Event_DTC_0xd1210b: start-on-event=DemSatellite_0InternalBehavior/GetEventUdsStatus, operation=Event_DTC_0xd1210b.GetEventUdsStatus
        OpEventGetEventUdsStatus_GetEventUdsStatus_EvtInfo_DTC_0xd1210c: start-on-event=DemSatellite_0InternalBehavior/GetEventUdsStatus, operation=EvtInfo_DTC_0xd1210c.GetEventUdsStatus
        OpEventGetEventUdsStatus_GetEventUdsStatus_Event_DTC_0xd1210c: start-on-event=DemSatellite_0InternalBehavior/GetEventUdsStatus, operation=Event_DTC_0xd1210c.GetEventUdsStatus
        OpEventGetEventUdsStatus_GetEventUdsStatus_EvtInfo_DTC_0xd1210d: start-on-event=DemSatellite_0InternalBehavior/GetEventUdsStatus, operation=EvtInfo_DTC_0xd1210d.GetEventUdsStatus
        OpEventGetEventUdsStatus_GetEventUdsStatus_Event_DTC_0xd1210d: start-on-event=DemSatellite_0InternalBehavior/GetEventUdsStatus, operation=Event_DTC_0xd1210d.GetEventUdsStatus
        OpEventGetEventUdsStatus_GetEventUdsStatus_EvtInfo_DTC_0xd1210e: start-on-event=DemSatellite_0InternalBehavior/GetEventUdsStatus, operation=EvtInfo_DTC_0xd1210e.GetEventUdsStatus
        OpEventGetEventUdsStatus_GetEventUdsStatus_Event_DTC_0xd1210e: start-on-event=DemSatellite_0InternalBehavior/GetEventUdsStatus, operation=Event_DTC_0xd1210e.GetEventUdsStatus
        OpEventGetEventUdsStatus_GetEventUdsStatus_EvtInfo_DTC_0xd1210f: start-on-event=DemSatellite_0InternalBehavior/GetEventUdsStatus, operation=EvtInfo_DTC_0xd1210f.GetEventUdsStatus
        OpEventGetEventUdsStatus_GetEventUdsStatus_Event_DTC_0xd1210f: start-on-event=DemSatellite_0InternalBehavior/GetEventUdsStatus, operation=Event_DTC_0xd1210f.GetEventUdsStatus
        OpEventGetEventUdsStatus_GetEventUdsStatus_EvtInfo_DTC_0xd12000: start-on-event=DemSatellite_0InternalBehavior/GetEventUdsStatus, operation=EvtInfo_DTC_0xd12000.GetEventUdsStatus
        OpEventGetEventUdsStatus_GetEventUdsStatus_Event_DTC_0xd12000: start-on-event=DemSatellite_0InternalBehavior/GetEventUdsStatus, operation=Event_DTC_0xd12000.GetEventUdsStatus
        OpEventGetEventUdsStatus_GetEventUdsStatus_EvtInfo_DTC_0xd12001: start-on-event=DemSatellite_0InternalBehavior/GetEventUdsStatus, operation=EvtInfo_DTC_0xd12001.GetEventUdsStatus
        OpEventGetEventUdsStatus_GetEventUdsStatus_Event_DTC_0xd12001: start-on-event=DemSatellite_0InternalBehavior/GetEventUdsStatus, operation=Event_DTC_0xd12001.GetEventUdsStatus
        OpEventGetEventUdsStatus_GetEventUdsStatus_EvtInfo_DTC_0xd12002: start-on-event=DemSatellite_0InternalBehavior/GetEventUdsStatus, operation=EvtInfo_DTC_0xd12002.GetEventUdsStatus
        OpEventGetEventUdsStatus_GetEventUdsStatus_Event_DTC_0xd12002: start-on-event=DemSatellite_0InternalBehavior/GetEventUdsStatus, operation=Event_DTC_0xd12002.GetEventUdsStatus
        OpEventGetEventUdsStatus_GetEventUdsStatus_EvtInfo_DTC_0xd12004: start-on-event=DemSatellite_0InternalBehavior/GetEventUdsStatus, operation=EvtInfo_DTC_0xd12004.GetEventUdsStatus
        OpEventGetEventUdsStatus_GetEventUdsStatus_Event_DTC_0xd12004: start-on-event=DemSatellite_0InternalBehavior/GetEventUdsStatus, operation=Event_DTC_0xd12004.GetEventUdsStatus
        OpEventGetEventUdsStatus_GetEventUdsStatus_EvtInfo_DTC_0xe40004: start-on-event=DemSatellite_0InternalBehavior/GetEventUdsStatus, operation=EvtInfo_DTC_0xe40004.GetEventUdsStatus
        OpEventGetEventUdsStatus_GetEventUdsStatus_Event_DTC_0xe40004: start-on-event=DemSatellite_0InternalBehavior/GetEventUdsStatus, operation=Event_DTC_0xe40004.GetEventUdsStatus
        OpEventGetEventUdsStatus_GetEventUdsStatus_EvtInfo_DTC_0x00a00a: start-on-event=DemSatellite_0InternalBehavior/GetEventUdsStatus, operation=EvtInfo_DTC_0x00a00a.GetEventUdsStatus
        OpEventGetEventUdsStatus_GetEventUdsStatus_Event_DTC_0x00a00a: start-on-event=DemSatellite_0InternalBehavior/GetEventUdsStatus, operation=Event_DTC_0x00a00a.GetEventUdsStatus
        OpEventGetEventUdsStatus_GetEventUdsStatus_EvtInfo_DTC_0xe40005: start-on-event=DemSatellite_0InternalBehavior/GetEventUdsStatus, operation=EvtInfo_DTC_0xe40005.GetEventUdsStatus
        OpEventGetEventUdsStatus_GetEventUdsStatus_Event_DTC_0xe40005: start-on-event=DemSatellite_0InternalBehavior/GetEventUdsStatus, operation=Event_DTC_0xe40005.GetEventUdsStatus
        OpEventGetEventUdsStatus_GetEventUdsStatus_EvtInfo_DTC_0xe40002: start-on-event=DemSatellite_0InternalBehavior/GetEventUdsStatus, operation=EvtInfo_DTC_0xe40002.GetEventUdsStatus
        OpEventGetEventUdsStatus_GetEventUdsStatus_Event_DTC_0xe40002: start-on-event=DemSatellite_0InternalBehavior/GetEventUdsStatus, operation=Event_DTC_0xe40002.GetEventUdsStatus
        OpEventGetEventUdsStatus_GetEventUdsStatus_EvtInfo_DTC_0xe40003: start-on-event=DemSatellite_0InternalBehavior/GetEventUdsStatus, operation=EvtInfo_DTC_0xe40003.GetEventUdsStatus
        OpEventGetEventUdsStatus_GetEventUdsStatus_Event_DTC_0xe40003: start-on-event=DemSatellite_0InternalBehavior/GetEventUdsStatus, operation=Event_DTC_0xe40003.GetEventUdsStatus
        OpEventGetEventUdsStatus_GetEventUdsStatus_EvtInfo_DTC_0xe40000: start-on-event=DemSatellite_0InternalBehavior/GetEventUdsStatus, operation=EvtInfo_DTC_0xe40000.GetEventUdsStatus
        OpEventGetEventUdsStatus_GetEventUdsStatus_Event_DTC_0xe40000: start-on-event=DemSatellite_0InternalBehavior/GetEventUdsStatus, operation=Event_DTC_0xe40000.GetEventUdsStatus
        OpEventGetEventUdsStatus_GetEventUdsStatus_EvtInfo_DTC_0xe40001: start-on-event=DemSatellite_0InternalBehavior/GetEventUdsStatus, operation=EvtInfo_DTC_0xe40001.GetEventUdsStatus
        OpEventGetEventUdsStatus_GetEventUdsStatus_Event_DTC_0xe40001: start-on-event=DemSatellite_0InternalBehavior/GetEventUdsStatus, operation=Event_DTC_0xe40001.GetEventUdsStatus
        OpEventGetEventUdsStatus_GetEventUdsStatus_EvtInfo_DTC_0x00a00b: start-on-event=DemSatellite_0InternalBehavior/GetEventUdsStatus, operation=EvtInfo_DTC_0x00a00b.GetEventUdsStatus
        OpEventGetEventUdsStatus_GetEventUdsStatus_Event_DTC_0x00a00b: start-on-event=DemSatellite_0InternalBehavior/GetEventUdsStatus, operation=Event_DTC_0x00a00b.GetEventUdsStatus
        OpEventGetEventUdsStatus_GetEventUdsStatus_EvtInfo_DTC_0xd1211d: start-on-event=DemSatellite_0InternalBehavior/GetEventUdsStatus, operation=EvtInfo_DTC_0xd1211d.GetEventUdsStatus
        OpEventGetEventUdsStatus_GetEventUdsStatus_Event_DTC_0xd1211d: start-on-event=DemSatellite_0InternalBehavior/GetEventUdsStatus, operation=Event_DTC_0xd1211d.GetEventUdsStatus
        OpEventGetEventUdsStatus_GetEventUdsStatus_EvtInfo_DTC_0xd12011: start-on-event=DemSatellite_0InternalBehavior/GetEventUdsStatus, operation=EvtInfo_DTC_0xd12011.GetEventUdsStatus
        OpEventGetEventUdsStatus_GetEventUdsStatus_Event_DTC_0xd12011: start-on-event=DemSatellite_0InternalBehavior/GetEventUdsStatus, operation=Event_DTC_0xd12011.GetEventUdsStatus
        OpEventGetEventUdsStatus_GetEventUdsStatus_EvtInfo_DTC_0xe40013: start-on-event=DemSatellite_0InternalBehavior/GetEventUdsStatus, operation=EvtInfo_DTC_0xe40013.GetEventUdsStatus
        OpEventGetEventUdsStatus_GetEventUdsStatus_Event_DTC_0xe40013: start-on-event=DemSatellite_0InternalBehavior/GetEventUdsStatus, operation=Event_DTC_0xe40013.GetEventUdsStatus
        OpEventGetEventUdsStatus_GetEventUdsStatus_EvtInfo_DTC_0xd13b51: start-on-event=DemSatellite_0InternalBehavior/GetEventUdsStatus, operation=EvtInfo_DTC_0xd13b51.GetEventUdsStatus
        OpEventGetEventUdsStatus_GetEventUdsStatus_Event_DTC_0xd13b51: start-on-event=DemSatellite_0InternalBehavior/GetEventUdsStatus, operation=Event_DTC_0xd13b51.GetEventUdsStatus
        OpEventGetEventUdsStatus_GetEventUdsStatus_EvtInfo_DTC_0xd13b50: start-on-event=DemSatellite_0InternalBehavior/GetEventUdsStatus, operation=EvtInfo_DTC_0xd13b50.GetEventUdsStatus
        OpEventGetEventUdsStatus_GetEventUdsStatus_Event_DTC_0xd13b50: start-on-event=DemSatellite_0InternalBehavior/GetEventUdsStatus, operation=Event_DTC_0xd13b50.GetEventUdsStatus
        OpEventGetEventUdsStatus_GetEventUdsStatus_EvtInfo_DTC_0xe40011: start-on-event=DemSatellite_0InternalBehavior/GetEventUdsStatus, operation=EvtInfo_DTC_0xe40011.GetEventUdsStatus
        OpEventGetEventUdsStatus_GetEventUdsStatus_Event_DTC_0xe40011: start-on-event=DemSatellite_0InternalBehavior/GetEventUdsStatus, operation=Event_DTC_0xe40011.GetEventUdsStatus
        OpEventGetEventUdsStatus_GetEventUdsStatus_EvtInfo_DTC_0xe40012: start-on-event=DemSatellite_0InternalBehavior/GetEventUdsStatus, operation=EvtInfo_DTC_0xe40012.GetEventUdsStatus
        OpEventGetEventUdsStatus_GetEventUdsStatus_Event_DTC_0xe40012: start-on-event=DemSatellite_0InternalBehavior/GetEventUdsStatus, operation=Event_DTC_0xe40012.GetEventUdsStatus
        OpEventGetEventUdsStatus_GetEventUdsStatus_EvtInfo_DTC_0x100203: start-on-event=DemSatellite_0InternalBehavior/GetEventUdsStatus, operation=EvtInfo_DTC_0x100203.GetEventUdsStatus
        OpEventGetEventUdsStatus_GetEventUdsStatus_Event_DTC_0x100203: start-on-event=DemSatellite_0InternalBehavior/GetEventUdsStatus, operation=Event_DTC_0x100203.GetEventUdsStatus
        OpEventGetEventUdsStatus_GetEventUdsStatus_EvtInfo_DTC_0xe40010: start-on-event=DemSatellite_0InternalBehavior/GetEventUdsStatus, operation=EvtInfo_DTC_0xe40010.GetEventUdsStatus
        OpEventGetEventUdsStatus_GetEventUdsStatus_Event_DTC_0xe40010: start-on-event=DemSatellite_0InternalBehavior/GetEventUdsStatus, operation=Event_DTC_0xe40010.GetEventUdsStatus
        OpEventGetEventUdsStatus_GetEventUdsStatus_EvtInfo_DTC_0x12cb03: start-on-event=DemSatellite_0InternalBehavior/GetEventUdsStatus, operation=EvtInfo_DTC_0x12cb03.GetEventUdsStatus
        OpEventGetEventUdsStatus_GetEventUdsStatus_Event_DTC_0x12cb03: start-on-event=DemSatellite_0InternalBehavior/GetEventUdsStatus, operation=Event_DTC_0x12cb03.GetEventUdsStatus
        OpEventGetEventUdsStatus_GetEventUdsStatus_EvtInfo_DTC_0x12cb04: start-on-event=DemSatellite_0InternalBehavior/GetEventUdsStatus, operation=EvtInfo_DTC_0x12cb04.GetEventUdsStatus
        OpEventGetEventUdsStatus_GetEventUdsStatus_Event_DTC_0x12cb04: start-on-event=DemSatellite_0InternalBehavior/GetEventUdsStatus, operation=Event_DTC_0x12cb04.GetEventUdsStatus
        OpEventGetEventUdsStatus_GetEventUdsStatus_EvtInfo_DTC_0x12cb01: start-on-event=DemSatellite_0InternalBehavior/GetEventUdsStatus, operation=EvtInfo_DTC_0x12cb01.GetEventUdsStatus
        OpEventGetEventUdsStatus_GetEventUdsStatus_Event_DTC_0x12cb01: start-on-event=DemSatellite_0InternalBehavior/GetEventUdsStatus, operation=Event_DTC_0x12cb01.GetEventUdsStatus
        OpEventGetEventUdsStatus_GetEventUdsStatus_EvtInfo_DTC_0x12cb02: start-on-event=DemSatellite_0InternalBehavior/GetEventUdsStatus, operation=EvtInfo_DTC_0x12cb02.GetEventUdsStatus
        OpEventGetEventUdsStatus_GetEventUdsStatus_Event_DTC_0x12cb02: start-on-event=DemSatellite_0InternalBehavior/GetEventUdsStatus, operation=Event_DTC_0x12cb02.GetEventUdsStatus
        OpEventGetEventUdsStatus_GetEventUdsStatus_EvtInfo_DTC_0xe40008: start-on-event=DemSatellite_0InternalBehavior/GetEventUdsStatus, operation=EvtInfo_DTC_0xe40008.GetEventUdsStatus
        OpEventGetEventUdsStatus_GetEventUdsStatus_Event_DTC_0xe40008: start-on-event=DemSatellite_0InternalBehavior/GetEventUdsStatus, operation=Event_DTC_0xe40008.GetEventUdsStatus
        OpEventGetEventUdsStatus_GetEventUdsStatus_EvtInfo_DTC_0xe40009: start-on-event=DemSatellite_0InternalBehavior/GetEventUdsStatus, operation=EvtInfo_DTC_0xe40009.GetEventUdsStatus
        OpEventGetEventUdsStatus_GetEventUdsStatus_Event_DTC_0xe40009: start-on-event=DemSatellite_0InternalBehavior/GetEventUdsStatus, operation=Event_DTC_0xe40009.GetEventUdsStatus
        OpEventGetEventUdsStatus_GetEventUdsStatus_EvtInfo_DTC_0xe40006: start-on-event=DemSatellite_0InternalBehavior/GetEventUdsStatus, operation=EvtInfo_DTC_0xe40006.GetEventUdsStatus
        OpEventGetEventUdsStatus_GetEventUdsStatus_Event_DTC_0xe40006: start-on-event=DemSatellite_0InternalBehavior/GetEventUdsStatus, operation=Event_DTC_0xe40006.GetEventUdsStatus
        OpEventGetEventUdsStatus_GetEventUdsStatus_EvtInfo_DTC_0xe40007: start-on-event=DemSatellite_0InternalBehavior/GetEventUdsStatus, operation=EvtInfo_DTC_0xe40007.GetEventUdsStatus
        OpEventGetEventUdsStatus_GetEventUdsStatus_Event_DTC_0xe40007: start-on-event=DemSatellite_0InternalBehavior/GetEventUdsStatus, operation=Event_DTC_0xe40007.GetEventUdsStatus
        OpEventGetEventUdsStatus_GetEventUdsStatus_EvtInfo_DTC_0xd10301: start-on-event=DemSatellite_0InternalBehavior/GetEventUdsStatus, operation=EvtInfo_DTC_0xd10301.GetEventUdsStatus
        OpEventGetEventUdsStatus_GetEventUdsStatus_Event_DTC_0xd10301: start-on-event=DemSatellite_0InternalBehavior/GetEventUdsStatus, operation=Event_DTC_0xd10301.GetEventUdsStatus
        OpEventGetEventUdsStatus_GetEventUdsStatus_EvtInfo_DTC_0xd10300: start-on-event=DemSatellite_0InternalBehavior/GetEventUdsStatus, operation=EvtInfo_DTC_0xd10300.GetEventUdsStatus
        OpEventGetEventUdsStatus_GetEventUdsStatus_Event_DTC_0xd10300: start-on-event=DemSatellite_0InternalBehavior/GetEventUdsStatus, operation=Event_DTC_0xd10300.GetEventUdsStatus
        OpEventGetEventUdsStatus_GetEventUdsStatus_EvtInfo_DTC_0x170600: start-on-event=DemSatellite_0InternalBehavior/GetEventUdsStatus, operation=EvtInfo_DTC_0x170600.GetEventUdsStatus
        OpEventGetEventUdsStatus_GetEventUdsStatus_Event_DTC_0x170600: start-on-event=DemSatellite_0InternalBehavior/GetEventUdsStatus, operation=Event_DTC_0x170600.GetEventUdsStatus
        OpEventGetEventUdsStatus_GetEventUdsStatus_EvtInfo_DTC_0x000016: start-on-event=DemSatellite_0InternalBehavior/GetEventUdsStatus, operation=EvtInfo_DTC_0x000016.GetEventUdsStatus
        OpEventGetEventUdsStatus_GetEventUdsStatus_Event_DTC_0x000016: start-on-event=DemSatellite_0InternalBehavior/GetEventUdsStatus, operation=Event_DTC_0x000016.GetEventUdsStatus
        OpEventGetEventUdsStatus_GetEventUdsStatus_EvtInfo_DTC_0x000018: start-on-event=DemSatellite_0InternalBehavior/GetEventUdsStatus, operation=EvtInfo_DTC_0x000018.GetEventUdsStatus
        OpEventGetEventUdsStatus_GetEventUdsStatus_Event_DTC_0x000018: start-on-event=DemSatellite_0InternalBehavior/GetEventUdsStatus, operation=Event_DTC_0x000018.GetEventUdsStatus
        OpEventGetEventUdsStatus_GetEventUdsStatus_EvtInfo_DTC_0xd1311d: start-on-event=DemSatellite_0InternalBehavior/GetEventUdsStatus, operation=EvtInfo_DTC_0xd1311d.GetEventUdsStatus
        OpEventGetEventUdsStatus_GetEventUdsStatus_Event_DTC_0xd1311d: start-on-event=DemSatellite_0InternalBehavior/GetEventUdsStatus, operation=Event_DTC_0xd1311d.GetEventUdsStatus
        OpEventGetEventUdsStatus_GetEventUdsStatus_EvtInfo_DTC_0xd1311f: start-on-event=DemSatellite_0InternalBehavior/GetEventUdsStatus, operation=EvtInfo_DTC_0xd1311f.GetEventUdsStatus
        OpEventGetEventUdsStatus_GetEventUdsStatus_Event_DTC_0xd1311f: start-on-event=DemSatellite_0InternalBehavior/GetEventUdsStatus, operation=Event_DTC_0xd1311f.GetEventUdsStatus
        OpEventGetEventUdsStatus_GetEventUdsStatus_EvtInfo_DTC_0xd12160: start-on-event=DemSatellite_0InternalBehavior/GetEventUdsStatus, operation=EvtInfo_DTC_0xd12160.GetEventUdsStatus
        OpEventGetEventUdsStatus_GetEventUdsStatus_Event_DTC_0xd12160: start-on-event=DemSatellite_0InternalBehavior/GetEventUdsStatus, operation=Event_DTC_0xd12160.GetEventUdsStatus
        OpEventGetEventUdsStatus_GetEventUdsStatus_EvtInfo_DTC_0xd12161: start-on-event=DemSatellite_0InternalBehavior/GetEventUdsStatus, operation=EvtInfo_DTC_0xd12161.GetEventUdsStatus
        OpEventGetEventUdsStatus_GetEventUdsStatus_Event_DTC_0xd12161: start-on-event=DemSatellite_0InternalBehavior/GetEventUdsStatus, operation=Event_DTC_0xd12161.GetEventUdsStatus
        OpEventGetEventUdsStatus_GetEventUdsStatus_EvtInfo_DTC_0x170612: start-on-event=DemSatellite_0InternalBehavior/GetEventUdsStatus, operation=EvtInfo_DTC_0x170612.GetEventUdsStatus
        OpEventGetEventUdsStatus_GetEventUdsStatus_Event_DTC_0x170612: start-on-event=DemSatellite_0InternalBehavior/GetEventUdsStatus, operation=Event_DTC_0x170612.GetEventUdsStatus
        OpEventGetEventUdsStatus_GetEventUdsStatus_EvtInfo_DTC_0x000012: start-on-event=DemSatellite_0InternalBehavior/GetEventUdsStatus, operation=EvtInfo_DTC_0x000012.GetEventUdsStatus
        OpEventGetEventUdsStatus_GetEventUdsStatus_Event_DTC_0x000012: start-on-event=DemSatellite_0InternalBehavior/GetEventUdsStatus, operation=Event_DTC_0x000012.GetEventUdsStatus
        OpEventGetEventUdsStatus_GetEventUdsStatus_EvtInfo_DTC_0x170610: start-on-event=DemSatellite_0InternalBehavior/GetEventUdsStatus, operation=EvtInfo_DTC_0x170610.GetEventUdsStatus
        OpEventGetEventUdsStatus_GetEventUdsStatus_Event_DTC_0x170610: start-on-event=DemSatellite_0InternalBehavior/GetEventUdsStatus, operation=Event_DTC_0x170610.GetEventUdsStatus
        OpEventGetEventUdsStatus_GetEventUdsStatus_EvtInfo_DTC_0x000015: start-on-event=DemSatellite_0InternalBehavior/GetEventUdsStatus, operation=EvtInfo_DTC_0x000015.GetEventUdsStatus
        OpEventGetEventUdsStatus_GetEventUdsStatus_Event_DTC_0x000015: start-on-event=DemSatellite_0InternalBehavior/GetEventUdsStatus, operation=Event_DTC_0x000015.GetEventUdsStatus
        OpEventGetEventUdsStatus_GetEventUdsStatus_EvtInfo_DTC_0x170611: start-on-event=DemSatellite_0InternalBehavior/GetEventUdsStatus, operation=EvtInfo_DTC_0x170611.GetEventUdsStatus
        OpEventGetEventUdsStatus_GetEventUdsStatus_Event_DTC_0x170611: start-on-event=DemSatellite_0InternalBehavior/GetEventUdsStatus, operation=Event_DTC_0x170611.GetEventUdsStatus
        OpEventGetEventUdsStatus_GetEventUdsStatus_EvtInfo_DTC_0xd13026: start-on-event=DemSatellite_0InternalBehavior/GetEventUdsStatus, operation=EvtInfo_DTC_0xd13026.GetEventUdsStatus
        OpEventGetEventUdsStatus_GetEventUdsStatus_Event_DTC_0xd13026: start-on-event=DemSatellite_0InternalBehavior/GetEventUdsStatus, operation=Event_DTC_0xd13026.GetEventUdsStatus
        OpEventGetEventUdsStatus_GetEventUdsStatus_EvtInfo_DTC_0x170500: start-on-event=DemSatellite_0InternalBehavior/GetEventUdsStatus, operation=EvtInfo_DTC_0x170500.GetEventUdsStatus
        OpEventGetEventUdsStatus_GetEventUdsStatus_Event_DTC_0x170500: start-on-event=DemSatellite_0InternalBehavior/GetEventUdsStatus, operation=Event_DTC_0x170500.GetEventUdsStatus
