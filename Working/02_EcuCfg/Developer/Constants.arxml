AUTOSAR XML (schema 00044)
package /Constants
  constant specification InitValue_0: value-spec=0 0 0 0 0 0
  constant specification initValue_Array_int: value-spec=[Lit1:0, Lit2:0, Lit3:0, Lit4:0, Lit5:0, Lit6:0]
package /VAG/Services/BAP
  constant specification C_Bool_FALSE: value-spec=0
