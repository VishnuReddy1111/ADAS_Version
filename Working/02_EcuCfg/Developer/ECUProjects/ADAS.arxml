[part 1 of 3: package /E3_1_2_Premium]
AUTOSAR XML (schema 00048)
package /E3_1_2_Premium
  system System: pnc-vector-length=7, pnc-vector-offset=1
    system mapping VectorEthernetDemo_MPPNG
      data-mappings:
        sender-receiver-to-signal-mapping={communication-direction=OUT, data-element=Geltungsbereich_E3_1_2_Premium.SP_IF_KN_Hybrid_01_ECUKnockOutTimer_XIX_Infrastructure_Hybrid_01_XIX_network_infrastructure_XIX_BMC_HV.DE_KN_Hybrid_01_ECUKnockOutTimer, system-signal=KN_Hybrid_01_ECUKnockOutTimer}
        sender-receiver-to-signal-mapping={communication-direction=OUT, data-element=Geltungsbereich_E3_1_2_Premium.SP_IF_KN_Hybrid_01_BusKnockOutTimer_XIX_Infrastructure_Hybrid_01_XIX_network_infrastructure_XIX_BMC_HV.DE_KN_Hybrid_01_BusKnockOutTimer, system-signal=KN_Hybrid_01_BusKnockOutTimer}
        sender-receiver-to-signal-mapping={communication-direction=IN, data-element=Geltungsbereich_E3_1_2_Premium.RP_IF_KST_KL_15_XIX_BMC_HV.DE_KST_KL_15, system-signal=KST_KL_15}
        sender-receiver-to-signal-mapping={communication-direction=IN, data-element=Geltungsbereich_E3_1_2_Premium.RP_IF_DEV_Hybrid_01_Req_00_FD_Data_XIX_Infrastructure_Hybrid_01_XIX_network_infrastructure_XIX_BMC_HV.DE_DEV_Hybrid_01_Req_00_FD_Data, system-signal=DEV_Hybrid_01_Req_00_FD_Data}
        sender-receiver-to-signal-mapping={communication-direction=OUT, data-element=Geltungsbereich_E3_1_2_Premium.SP_IF_DEV_Hybrid_01_Resp_FF_FD_Data_XIX_Infrastructure_Hybrid_01_XIX_network_infrastructure_XIX_BMC_HV.DE_DEV_Hybrid_01_Resp_FF_FD_Data, system-signal=DEV_Hybrid_01_Resp_FF_FD_Data}
        sender-receiver-to-signal-mapping={communication-direction=IN, data-element=Geltungsbereich_E3_1_2_Premium.RP_IF_NVEM_Abschaltstufe_XIX_BMC_HV.DE_NVEM_Abschaltstufe, system-signal=NVEM_Abschaltstufe}
        sender-receiver-to-signal-mapping={communication-direction=IN, data-element=Geltungsbereich_E3_1_2_Premium.RP_IF_SI_NWDF_XIX_BMC_HV.DE_SI_NWDF, system-signal=SI_NWDF}
        sender-receiver-to-signal-mapping={communication-direction=IN, data-element=Geltungsbereich_E3_1_2_Premium.RP_IF_SI_NWDF_30_XIX_BMC_HV.DE_SI_NWDF_30, system-signal=SI_NWDF_30}
        sender-receiver-to-signal-mapping={communication-direction=OUT, data-element=Geltungsbereich_E3_1_2_Premium.SP_IF_BMC_Dauer_Ladeleistung_XIX_BMC_HV.DE_BMC_Dauer_Ladeleistung, system-signal=BMC_Dauer_Ladeleistung}
        sender-receiver-to-signal-mapping={communication-direction=OUT, data-element=Geltungsbereich_E3_1_2_Premium.SP_IF_BMC_ThermSpreizung_XIX_BMC_HV.DE_BMC_ThermSpreizung, system-signal=BMC_ThermSpreizung}
        sender-receiver-to-signal-mapping={communication-direction=OUT, data-element=Geltungsbereich_E3_1_2_Premium.SP_IF_BMC_Temperatur_XIX_BMC_HV.DE_BMC_Temperatur, system-signal=BMC_Temperatur}
        sender-receiver-to-signal-mapping={communication-direction=OUT, data-element=Geltungsbereich_E3_1_2_Premium.SP_IF_BMC_RuecklaufTemperatur_XIX_BMC_HV.DE_BMC_RuecklaufTemperatur, system-signal=BMC_RuecklaufTemperatur}
        sender-receiver-to-signal-mapping={communication-direction=OUT, data-element=Geltungsbereich_E3_1_2_Premium.SP_IF_BMC_VorlaufTemperatur_XIX_BMC_HV.DE_BMC_VorlaufTemperatur, system-signal=BMC_VorlaufTemperatur}
        sender-receiver-to-signal-mapping={communication-direction=OUT, data-element=Geltungsbereich_E3_1_2_Premium.SP_IF_BMC_ThermAuslastung_XIX_BMC_HV.DE_BMC_ThermAuslastung, system-signal=BMC_ThermAuslastung}
        sender-receiver-to-signal-mapping={communication-direction=OUT, data-element=Geltungsbereich_E3_1_2_Premium.SP_IF_BMC_Dauer_Entladeleistung_XIX_BMC_HV.DE_BMC_Dauer_Entladeleistung, system-signal=BMC_Dauer_Entladeleistung}
        sender-receiver-to-signal-mapping={communication-direction=OUT, data-element=Geltungsbereich_E3_1_2_Premium.SP_IF_BMC_NutzbareKapazitaet_XIX_BMC_HV.DE_BMC_NutzbareKapazitaet, system-signal=BMC_NutzbareKapazitaet}
        sender-receiver-to-signal-mapping={communication-direction=IN, data-element=Geltungsbereich_E3_1_2_Premium.RP_IF_CHA_ReqPrgBms_XIX_BMC_HV.DE_CHA_ReqPrgBms, system-signal=CHA_ReqPrgBms}
        sender-receiver-to-signal-mapping={communication-direction=OUT, data-element=Geltungsbereich_E3_1_2_Premium.SP_IF_BMC_VerlustEnergie_XIX_BMC_HV.DE_BMC_VerlustEnergie, system-signal=BMC_VerlustEnergie}
        sender-receiver-to-signal-mapping={communication-direction=OUT, data-element=Geltungsbereich_E3_1_2_Premium.SP_IF_BMC_MaxEnergieinhalt_XIX_BMC_HV.DE_BMC_MaxEnergieinhalt, system-signal=BMC_MaxEnergieinhalt}
        sender-receiver-to-signal-mapping={communication-direction=IN, data-element=Geltungsbereich_E3_1_2_Premium.RP_IF_UH_Jahr_XIX_BMC_HV.DE_UH_Jahr, system-signal=UH_Jahr}
        sender-receiver-to-signal-mapping={communication-direction=IN, data-element=Geltungsbereich_E3_1_2_Premium.RP_IF_UH_Minute_XIX_BMC_HV.DE_UH_Minute, system-signal=UH_Minute}
        sender-receiver-to-signal-mapping={communication-direction=IN, data-element=Geltungsbereich_E3_1_2_Premium.RP_IF_UH_Sekunde_XIX_BMC_HV.DE_UH_Sekunde, system-signal=UH_Sekunde}
        sender-receiver-to-signal-mapping={communication-direction=IN, data-element=Geltungsbereich_E3_1_2_Premium.RP_IF_UH_Stunde_XIX_BMC_HV.DE_UH_Stunde, system-signal=UH_Stunde}
        sender-receiver-to-signal-mapping={communication-direction=IN, data-element=Geltungsbereich_E3_1_2_Premium.RP_IF_UH_Tag_XIX_BMC_HV.DE_UH_Tag, system-signal=UH_Tag}
        sender-receiver-to-signal-mapping={communication-direction=IN, data-element=Geltungsbereich_E3_1_2_Premium.RP_IF_UH_Monat_XIX_BMC_HV.DE_UH_Monat, system-signal=UH_Monat}
        sender-receiver-to-signal-mapping={communication-direction=IN, data-element=Geltungsbereich_E3_1_2_Premium.RP_IF_UI1_Stromintegral_Laden_XIX_BMC_HV.DE_UI1_Stromintegral_Laden, system-signal=UI1_Stromintegral_Laden}
        sender-receiver-to-signal-mapping={communication-direction=IN, data-element=Geltungsbereich_E3_1_2_Premium.RP_IF_UI1_Spannung6_XIX_BMC_HV.DE_UI1_Spannung6, system-signal=UI1_Spannung6}
        sender-receiver-to-signal-mapping={communication-direction=IN, data-element=Geltungsbereich_E3_1_2_Premium.RP_IF_UI1_Temperatur_1_XIX_BMC_HV.DE_UI1_Temperatur_1, system-signal=UI1_Temperatur_1}
        sender-receiver-to-signal-mapping={communication-direction=IN, data-element=Geltungsbereich_E3_1_2_Premium.RP_IF_UI2_Temperatur_1_XIX_BMC_HV.DE_UI2_Temperatur_1, system-signal=UI2_Temperatur_1}
        sender-receiver-to-signal-mapping={communication-direction=IN, data-element=Geltungsbereich_E3_1_2_Premium.RP_IF_UI1_Iso_Neg_XIX_BMC_HV.DE_UI1_Iso_Neg, system-signal=UI1_Iso_Neg}
        sender-receiver-to-signal-mapping={communication-direction=IN, data-element=Geltungsbereich_E3_1_2_Premium.RP_IF_UI2_Stromintegral_Laden_XIX_BMC_HV.DE_UI2_Stromintegral_Laden, system-signal=UI2_Stromintegral_Laden}
        sender-receiver-to-signal-mapping={communication-direction=IN, data-element=Geltungsbereich_E3_1_2_Premium.RP_IF_UI1_Iso_Status_XIX_BMC_HV.DE_UI1_Iso_Status, system-signal=UI1_Iso_Status}
        sender-receiver-to-signal-mapping={communication-direction=IN, data-element=Geltungsbereich_E3_1_2_Premium.RP_IF_UI1_Spannung5_XIX_BMC_HV.DE_UI1_Spannung5, system-signal=UI1_Spannung5}
        sender-receiver-to-signal-mapping={communication-direction=IN, data-element=Geltungsbereich_E3_1_2_Premium.RP_IF_UI2_Stromintegral_Entladen_XIX_BMC_HV.DE_UI2_Stromintegral_Entladen, system-signal=UI2_Stromintegral_Entladen}
        sender-receiver-to-signal-mapping={communication-direction=IN, data-element=Geltungsbereich_E3_1_2_Premium.RP_IF_UI1_Iso_Pos_XIX_BMC_HV.DE_UI1_Iso_Pos, system-signal=UI1_Iso_Pos}
        sender-receiver-to-signal-mapping={communication-direction=IN, data-element=Geltungsbereich_E3_1_2_Premium.RP_IF_UI2_Temperatur_2_XIX_BMC_HV.DE_UI2_Temperatur_2, system-signal=UI2_Temperatur_2}
        sender-receiver-to-signal-mapping={communication-direction=IN, data-element=Geltungsbereich_E3_1_2_Premium.RP_IF_UI1_Spannung4_XIX_BMC_HV.DE_UI1_Spannung4, system-signal=UI1_Spannung4}
        sender-receiver-to-signal-mapping={communication-direction=IN, data-element=Geltungsbereich_E3_1_2_Premium.RP_IF_UI1_Stromintegral_Entladen_XIX_BMC_HV.DE_UI1_Stromintegral_Entladen, system-signal=UI1_Stromintegral_Entladen}
        sender-receiver-to-signal-mapping={communication-direction=IN, data-element=Geltungsbereich_E3_1_2_Premium.RP_IF_UI1_Temperatur_2_XIX_BMC_HV.DE_UI1_Temperatur_2, system-signal=UI1_Temperatur_2}
        sender-receiver-to-signal-mapping={communication-direction=OUT, data-element=Geltungsbereich_E3_1_2_Premium.SP_IF_BMC_Verbrauch_XIX_BMC_HV.DE_BMC_Verbrauch, system-signal=BMC_Verbrauch}
        sender-receiver-to-signal-mapping={communication-direction=OUT, data-element=Geltungsbereich_E3_1_2_Premium.SP_IF_BMC_Rekuperation_XIX_BMC_HV.DE_BMC_Rekuperation, system-signal=BMC_Rekuperation}
        sender-receiver-to-signal-mapping={communication-direction=OUT, data-element=Geltungsbereich_E3_1_2_Premium.SP_IF_BMC_Min_Spannung_XIX_BMC_HV.DE_BMC_Min_Spannung, system-signal=BMC_Min_Spannung}
        sender-receiver-to-signal-mapping={communication-direction=OUT, data-element=Geltungsbereich_E3_1_2_Premium.SP_IF_BMC_Max_Spannung_XIX_BMC_HV.DE_BMC_Max_Spannung, system-signal=BMC_Max_Spannung}
        sender-receiver-to-signal-mapping={communication-direction=IN, data-element=Geltungsbereich_E3_1_2_Premium.RP_IF_UI2_Status_XIX_BMC_HV.DE_UI2_Status, system-signal=UI2_Status}
        sender-receiver-to-signal-mapping={communication-direction=IN, data-element=Geltungsbereich_E3_1_2_Premium.RP_IF_UI1_KompFehlerModus2_15_XIX_BMC_HV.DE_UI1_KompFehlerModus2_15, system-signal=UI1_KompFehlerModus2_15}
        sender-receiver-to-signal-mapping={communication-direction=IN, data-element=Geltungsbereich_E3_1_2_Premium.RP_IF_UI1_KompFehlerModus2_05_XIX_BMC_HV.DE_UI1_KompFehlerModus2_05, system-signal=UI1_KompFehlerModus2_05}
        sender-receiver-to-signal-mapping={communication-direction=IN, data-element=Geltungsbereich_E3_1_2_Premium.RP_IF_UI1_KompFehlerModus2_14_XIX_BMC_HV.DE_UI1_KompFehlerModus2_14, system-signal=UI1_KompFehlerModus2_14}
        sender-receiver-to-signal-mapping={communication-direction=IN, data-element=Geltungsbereich_E3_1_2_Premium.RP_IF_UI1_KompFehlerModus4_14_XIX_BMC_HV.DE_UI1_KompFehlerModus4_14, system-signal=UI1_KompFehlerModus4_14}
        sender-receiver-to-signal-mapping={communication-direction=IN, data-element=Geltungsbereich_E3_1_2_Premium.RP_IF_UI1_KompFehlerModus2_17_XIX_BMC_HV.DE_UI1_KompFehlerModus2_17, system-signal=UI1_KompFehlerModus2_17}
        sender-receiver-to-signal-mapping={communication-direction=IN, data-element=Geltungsbereich_E3_1_2_Premium.RP_IF_UI1_KompFehlerModus2_01_XIX_BMC_HV.DE_UI1_KompFehlerModus2_01, system-signal=UI1_KompFehlerModus2_01}
        sender-receiver-to-signal-mapping={communication-direction=IN, data-element=Geltungsbereich_E3_1_2_Premium.RP_IF_UI1_KompFehlerModus2_19_XIX_BMC_HV.DE_UI1_KompFehlerModus2_19, system-signal=UI1_KompFehlerModus2_19}
        sender-receiver-to-signal-mapping={communication-direction=IN, data-element=Geltungsbereich_E3_1_2_Premium.RP_IF_UI1_KompFehlerModus2_20_XIX_BMC_HV.DE_UI1_KompFehlerModus2_20, system-signal=UI1_KompFehlerModus2_20}
        sender-receiver-to-signal-mapping={communication-direction=IN, data-element=Geltungsbereich_E3_1_2_Premium.RP_IF_UI1_KompFehlerModus2_13_XIX_BMC_HV.DE_UI1_KompFehlerModus2_13, system-signal=UI1_KompFehlerModus2_13}
        sender-receiver-to-signal-mapping={communication-direction=IN, data-element=Geltungsbereich_E3_1_2_Premium.RP_IF_UI1_KompFehlerModus2_12_XIX_BMC_HV.DE_UI1_KompFehlerModus2_12, system-signal=UI1_KompFehlerModus2_12}
        sender-receiver-to-signal-mapping={communication-direction=IN, data-element=Geltungsbereich_E3_1_2_Premium.RP_IF_UI1_KompFehlerModus2_02_XIX_BMC_HV.DE_UI1_KompFehlerModus2_02, system-signal=UI1_KompFehlerModus2_02}
        sender-receiver-to-signal-mapping={communication-direction=IN, data-element=Geltungsbereich_E3_1_2_Premium.RP_IF_UI1_KompFehlerModus4_05_XIX_BMC_HV.DE_UI1_KompFehlerModus4_05, system-signal=UI1_KompFehlerModus4_05}
        sender-receiver-to-signal-mapping={communication-direction=IN, data-element=Geltungsbereich_E3_1_2_Premium.RP_IF_UI1_KompFehlerModus4_11_XIX_BMC_HV.DE_UI1_KompFehlerModus4_11, system-signal=UI1_KompFehlerModus4_11}
        sender-receiver-to-signal-mapping={communication-direction=IN, data-element=Geltungsbereich_E3_1_2_Premium.RP_IF_UI1_KompFehlerModus4_01_XIX_BMC_HV.DE_UI1_KompFehlerModus4_01, system-signal=UI1_KompFehlerModus4_01}
        sender-receiver-to-signal-mapping={communication-direction=IN, data-element=Geltungsbereich_E3_1_2_Premium.RP_IF_UI1_KompFehlerModus4_08_XIX_BMC_HV.DE_UI1_KompFehlerModus4_08, system-signal=UI1_KompFehlerModus4_08}
        sender-receiver-to-signal-mapping={communication-direction=IN, data-element=Geltungsbereich_E3_1_2_Premium.RP_IF_UI1_KompFehlerModus4_02_XIX_BMC_HV.DE_UI1_KompFehlerModus4_02, system-signal=UI1_KompFehlerModus4_02}
        sender-receiver-to-signal-mapping={communication-direction=IN, data-element=Geltungsbereich_E3_1_2_Premium.RP_IF_UI1_KompFehlerModus2_21_XIX_BMC_HV.DE_UI1_KompFehlerModus2_21, system-signal=UI1_KompFehlerModus2_21}
        sender-receiver-to-signal-mapping={communication-direction=IN, data-element=Geltungsbereich_E3_1_2_Premium.RP_IF_UI1_KompFehlerModus4_09_XIX_BMC_HV.DE_UI1_KompFehlerModus4_09, system-signal=UI1_KompFehlerModus4_09}
        sender-receiver-to-signal-mapping={communication-direction=IN, data-element=Geltungsbereich_E3_1_2_Premium.RP_IF_UI1_KompFehlerModus4_06_XIX_BMC_HV.DE_UI1_KompFehlerModus4_06, system-signal=UI1_KompFehlerModus4_06}
        sender-receiver-to-signal-mapping={communication-direction=IN, data-element=Geltungsbereich_E3_1_2_Premium.RP_IF_UI1_KompFehlerModus4_04_XIX_BMC_HV.DE_UI1_KompFehlerModus4_04, system-signal=UI1_KompFehlerModus4_04}
        sender-receiver-to-signal-mapping={communication-direction=IN, data-element=Geltungsbereich_E3_1_2_Premium.RP_IF_UI1_KompFehlerModus2_18_XIX_BMC_HV.DE_UI1_KompFehlerModus2_18, system-signal=UI1_KompFehlerModus2_18}
        sender-receiver-to-signal-mapping={communication-direction=IN, data-element=Geltungsbereich_E3_1_2_Premium.RP_IF_UI1_KompFehlerModus4_03_XIX_BMC_HV.DE_UI1_KompFehlerModus4_03, system-signal=UI1_KompFehlerModus4_03}
        sender-receiver-to-signal-mapping={communication-direction=IN, data-element=Geltungsbereich_E3_1_2_Premium.RP_IF_UI1_KompFehlerModus4_10_XIX_BMC_HV.DE_UI1_KompFehlerModus4_10, system-signal=UI1_KompFehlerModus4_10}
        sender-receiver-to-signal-mapping={communication-direction=IN, data-element=Geltungsbereich_E3_1_2_Premium.RP_IF_UI1_KompFehlerModus4_15_XIX_BMC_HV.DE_UI1_KompFehlerModus4_15, system-signal=UI1_KompFehlerModus4_15}
        sender-receiver-to-signal-mapping={communication-direction=IN, data-element=Geltungsbereich_E3_1_2_Premium.RP_IF_UI1_KompFehlerModus2_23_XIX_BMC_HV.DE_UI1_KompFehlerModus2_23, system-signal=UI1_KompFehlerModus2_23}
        sender-receiver-to-signal-mapping={communication-direction=IN, data-element=Geltungsbereich_E3_1_2_Premium.RP_IF_UI1_KompFehlerModus4_16_XIX_BMC_HV.DE_UI1_KompFehlerModus4_16, system-signal=UI1_KompFehlerModus4_16}
        sender-receiver-to-signal-mapping={communication-direction=IN, data-element=Geltungsbereich_E3_1_2_Premium.RP_IF_UI1_KompFehlerModus2_11_XIX_BMC_HV.DE_UI1_KompFehlerModus2_11, system-signal=UI1_KompFehlerModus2_11}
        sender-receiver-to-signal-mapping={communication-direction=IN, data-element=Geltungsbereich_E3_1_2_Premium.RP_IF_UI1_KompFehlerModus2_07_XIX_BMC_HV.DE_UI1_KompFehlerModus2_07, system-signal=UI1_KompFehlerModus2_07}
        sender-receiver-to-signal-mapping={communication-direction=IN, data-element=Geltungsbereich_E3_1_2_Premium.RP_IF_UI1_KompFehlerModus2_24_XIX_BMC_HV.DE_UI1_KompFehlerModus2_24, system-signal=UI1_KompFehlerModus2_24}
        sender-receiver-to-signal-mapping={communication-direction=IN, data-element=Geltungsbereich_E3_1_2_Premium.RP_IF_UI1_KompFehlerModus4_13_XIX_BMC_HV.DE_UI1_KompFehlerModus4_13, system-signal=UI1_KompFehlerModus4_13}
        sender-receiver-to-signal-mapping={communication-direction=IN, data-element=Geltungsbereich_E3_1_2_Premium.RP_IF_UI1_KompFehlerModus2_08_XIX_BMC_HV.DE_UI1_KompFehlerModus2_08, system-signal=UI1_KompFehlerModus2_08}
        sender-receiver-to-signal-mapping={communication-direction=IN, data-element=Geltungsbereich_E3_1_2_Premium.RP_IF_UI1_KompFehlerModus4_12_XIX_BMC_HV.DE_UI1_KompFehlerModus4_12, system-signal=UI1_KompFehlerModus4_12}
        sender-receiver-to-signal-mapping={communication-direction=IN, data-element=Geltungsbereich_E3_1_2_Premium.RP_IF_UI1_KompFehlerModus2_04_XIX_BMC_HV.DE_UI1_KompFehlerModus2_04, system-signal=UI1_KompFehlerModus2_04}
        sender-receiver-to-signal-mapping={communication-direction=IN, data-element=Geltungsbereich_E3_1_2_Premium.RP_IF_UI1_KompFehlerModus2_06_XIX_BMC_HV.DE_UI1_KompFehlerModus2_06, system-signal=UI1_KompFehlerModus2_06}
        sender-receiver-to-signal-mapping={communication-direction=IN, data-element=Geltungsbereich_E3_1_2_Premium.RP_IF_UI1_KompFehlerModus2_10_XIX_BMC_HV.DE_UI1_KompFehlerModus2_10, system-signal=UI1_KompFehlerModus2_10}
        sender-receiver-to-signal-mapping={communication-direction=IN, data-element=Geltungsbereich_E3_1_2_Premium.RP_IF_UI1_KompFehlerModus2_09_XIX_BMC_HV.DE_UI1_KompFehlerModus2_09, system-signal=UI1_KompFehlerModus2_09}
        sender-receiver-to-signal-mapping={communication-direction=IN, data-element=Geltungsbereich_E3_1_2_Premium.RP_IF_UI1_KompFehlerModus4_07_XIX_BMC_HV.DE_UI1_KompFehlerModus4_07, system-signal=UI1_KompFehlerModus4_07}
        sender-receiver-to-signal-mapping={communication-direction=IN, data-element=Geltungsbereich_E3_1_2_Premium.RP_IF_UI1_KompFehlerModus2_03_XIX_BMC_HV.DE_UI1_KompFehlerModus2_03, system-signal=UI1_KompFehlerModus2_03}
        sender-receiver-to-signal-mapping={communication-direction=IN, data-element=Geltungsbereich_E3_1_2_Premium.RP_IF_UI1_KompFehlerModus2_16_XIX_BMC_HV.DE_UI1_KompFehlerModus2_16, system-signal=UI1_KompFehlerModus2_16}
        sender-receiver-to-signal-mapping={communication-direction=IN, data-element=Geltungsbereich_E3_1_2_Premium.RP_IF_UI1_KompFehlerModus2_22_XIX_BMC_HV.DE_UI1_KompFehlerModus2_22, system-signal=UI1_KompFehlerModus2_22}
        sender-receiver-to-signal-mapping={communication-direction=IN, data-element=Geltungsbereich_E3_1_2_Premium.RP_IF_UI2_KompFehlerModus2_01_XIX_BMC_HV.DE_UI2_KompFehlerModus2_01, system-signal=UI2_KompFehlerModus2_01}
        sender-receiver-to-signal-mapping={communication-direction=IN, data-element=Geltungsbereich_E3_1_2_Premium.RP_IF_UI2_KompFehlerModus2_19_XIX_BMC_HV.DE_UI2_KompFehlerModus2_19, system-signal=UI2_KompFehlerModus2_19}
        sender-receiver-to-signal-mapping={communication-direction=IN, data-element=Geltungsbereich_E3_1_2_Premium.RP_IF_UI2_KompFehlerModus4_09_XIX_BMC_HV.DE_UI2_KompFehlerModus4_09, system-signal=UI2_KompFehlerModus4_09}
        sender-receiver-to-signal-mapping={communication-direction=IN, data-element=Geltungsbereich_E3_1_2_Premium.RP_IF_UI2_KompFehlerModus4_08_XIX_BMC_HV.DE_UI2_KompFehlerModus4_08, system-signal=UI2_KompFehlerModus4_08}
        sender-receiver-to-signal-mapping={communication-direction=IN, data-element=Geltungsbereich_E3_1_2_Premium.RP_IF_UI2_KompFehlerModus4_07_XIX_BMC_HV.DE_UI2_KompFehlerModus4_07, system-signal=UI2_KompFehlerModus4_07}
        sender-receiver-to-signal-mapping={communication-direction=IN, data-element=Geltungsbereich_E3_1_2_Premium.RP_IF_UI2_KompFehlerModus2_02_XIX_BMC_HV.DE_UI2_KompFehlerModus2_02, system-signal=UI2_KompFehlerModus2_02}
        sender-receiver-to-signal-mapping={communication-direction=IN, data-element=Geltungsbereich_E3_1_2_Premium.RP_IF_UI2_KompFehlerModus4_05_XIX_BMC_HV.DE_UI2_KompFehlerModus4_05, system-signal=UI2_KompFehlerModus4_05}
        sender-receiver-to-signal-mapping={communication-direction=IN, data-element=Geltungsbereich_E3_1_2_Premium.RP_IF_UI2_KompFehlerModus4_01_XIX_BMC_HV.DE_UI2_KompFehlerModus4_01, system-signal=UI2_KompFehlerModus4_01}
        sender-receiver-to-signal-mapping={communication-direction=IN, data-element=Geltungsbereich_E3_1_2_Premium.RP_IF_UI2_KompFehlerModus2_13_XIX_BMC_HV.DE_UI2_KompFehlerModus2_13, system-signal=UI2_KompFehlerModus2_13}
        sender-receiver-to-signal-mapping={communication-direction=IN, data-element=Geltungsbereich_E3_1_2_Premium.RP_IF_UI2_KompFehlerModus2_24_XIX_BMC_HV.DE_UI2_KompFehlerModus2_24, system-signal=UI2_KompFehlerModus2_24}
        sender-receiver-to-signal-mapping={communication-direction=IN, data-element=Geltungsbereich_E3_1_2_Premium.RP_IF_UI2_KompFehlerModus2_07_XIX_BMC_HV.DE_UI2_KompFehlerModus2_07, system-signal=UI2_KompFehlerModus2_07}
        sender-receiver-to-signal-mapping={communication-direction=IN, data-element=Geltungsbereich_E3_1_2_Premium.RP_IF_UI2_KompFehlerModus2_10_XIX_BMC_HV.DE_UI2_KompFehlerModus2_10, system-signal=UI2_KompFehlerModus2_10}
        sender-receiver-to-signal-mapping={communication-direction=IN, data-element=Geltungsbereich_E3_1_2_Premium.RP_IF_UI2_KompFehlerModus4_06_XIX_BMC_HV.DE_UI2_KompFehlerModus4_06, system-signal=UI2_KompFehlerModus4_06}
        sender-receiver-to-signal-mapping={communication-direction=IN, data-element=Geltungsbereich_E3_1_2_Premium.RP_IF_UI2_KompFehlerModus4_14_XIX_BMC_HV.DE_UI2_KompFehlerModus4_14, system-signal=UI2_KompFehlerModus4_14}
        sender-receiver-to-signal-mapping={communication-direction=IN, data-element=Geltungsbereich_E3_1_2_Premium.RP_IF_UI2_KompFehlerModus2_08_XIX_BMC_HV.DE_UI2_KompFehlerModus2_08, system-signal=UI2_KompFehlerModus2_08}
        sender-receiver-to-signal-mapping={communication-direction=IN, data-element=Geltungsbereich_E3_1_2_Premium.RP_IF_UI2_KompFehlerModus4_12_XIX_BMC_HV.DE_UI2_KompFehlerModus4_12, system-signal=UI2_KompFehlerModus4_12}
        sender-receiver-to-signal-mapping={communication-direction=IN, data-element=Geltungsbereich_E3_1_2_Premium.RP_IF_UI2_KompFehlerModus2_23_XIX_BMC_HV.DE_UI2_KompFehlerModus2_23, system-signal=UI2_KompFehlerModus2_23}
        sender-receiver-to-signal-mapping={communication-direction=IN, data-element=Geltungsbereich_E3_1_2_Premium.RP_IF_UI2_KompFehlerModus2_20_XIX_BMC_HV.DE_UI2_KompFehlerModus2_20, system-signal=UI2_KompFehlerModus2_20}
        sender-receiver-to-signal-mapping={communication-direction=IN, data-element=Geltungsbereich_E3_1_2_Premium.RP_IF_UI2_KompFehlerModus4_03_XIX_BMC_HV.DE_UI2_KompFehlerModus4_03, system-signal=UI2_KompFehlerModus4_03}
        sender-receiver-to-signal-mapping={communication-direction=IN, data-element=Geltungsbereich_E3_1_2_Premium.RP_IF_UI2_KompFehlerModus2_14_XIX_BMC_HV.DE_UI2_KompFehlerModus2_14, system-signal=UI2_KompFehlerModus2_14}
        sender-receiver-to-signal-mapping={communication-direction=IN, data-element=Geltungsbereich_E3_1_2_Premium.RP_IF_UI2_KompFehlerModus4_13_XIX_BMC_HV.DE_UI2_KompFehlerModus4_13, system-signal=UI2_KompFehlerModus4_13}
        sender-receiver-to-signal-mapping={communication-direction=IN, data-element=Geltungsbereich_E3_1_2_Premium.RP_IF_UI2_KompFehlerModus2_06_XIX_BMC_HV.DE_UI2_KompFehlerModus2_06, system-signal=UI2_KompFehlerModus2_06}
        sender-receiver-to-signal-mapping={communication-direction=IN, data-element=Geltungsbereich_E3_1_2_Premium.RP_IF_UI2_KompFehlerModus4_15_XIX_BMC_HV.DE_UI2_KompFehlerModus4_15, system-signal=UI2_KompFehlerModus4_15}
        sender-receiver-to-signal-mapping={communication-direction=IN, data-element=Geltungsbereich_E3_1_2_Premium.RP_IF_UI2_KompFehlerModus2_11_XIX_BMC_HV.DE_UI2_KompFehlerModus2_11, system-signal=UI2_KompFehlerModus2_11}
        sender-receiver-to-signal-mapping={communication-direction=IN, data-element=Geltungsbereich_E3_1_2_Premium.RP_IF_UI2_KompFehlerModus2_04_XIX_BMC_HV.DE_UI2_KompFehlerModus2_04, system-signal=UI2_KompFehlerModus2_04}
        sender-receiver-to-signal-mapping={communication-direction=IN, data-element=Geltungsbereich_E3_1_2_Premium.RP_IF_UI2_KompFehlerModus2_22_XIX_BMC_HV.DE_UI2_KompFehlerModus2_22, system-signal=UI2_KompFehlerModus2_22}
        sender-receiver-to-signal-mapping={communication-direction=IN, data-element=Geltungsbereich_E3_1_2_Premium.RP_IF_UI2_KompFehlerModus2_18_XIX_BMC_HV.DE_UI2_KompFehlerModus2_18, system-signal=UI2_KompFehlerModus2_18}
        sender-receiver-to-signal-mapping={communication-direction=IN, data-element=Geltungsbereich_E3_1_2_Premium.RP_IF_UI2_KompFehlerModus4_16_XIX_BMC_HV.DE_UI2_KompFehlerModus4_16, system-signal=UI2_KompFehlerModus4_16}
        sender-receiver-to-signal-mapping={communication-direction=IN, data-element=Geltungsbereich_E3_1_2_Premium.RP_IF_UI2_KompFehlerModus2_16_XIX_BMC_HV.DE_UI2_KompFehlerModus2_16, system-signal=UI2_KompFehlerModus2_16}
        sender-receiver-to-signal-mapping={communication-direction=IN, data-element=Geltungsbereich_E3_1_2_Premium.RP_IF_UI2_KompFehlerModus2_09_XIX_BMC_HV.DE_UI2_KompFehlerModus2_09, system-signal=UI2_KompFehlerModus2_09}
        sender-receiver-to-signal-mapping={communication-direction=IN, data-element=Geltungsbereich_E3_1_2_Premium.RP_IF_UI2_KompFehlerModus4_11_XIX_BMC_HV.DE_UI2_KompFehlerModus4_11, system-signal=UI2_KompFehlerModus4_11}
        sender-receiver-to-signal-mapping={communication-direction=IN, data-element=Geltungsbereich_E3_1_2_Premium.RP_IF_UI2_KompFehlerModus2_12_XIX_BMC_HV.DE_UI2_KompFehlerModus2_12, system-signal=UI2_KompFehlerModus2_12}
        sender-receiver-to-signal-mapping={communication-direction=IN, data-element=Geltungsbereich_E3_1_2_Premium.RP_IF_UI2_KompFehlerModus2_05_XIX_BMC_HV.DE_UI2_KompFehlerModus2_05, system-signal=UI2_KompFehlerModus2_05}
        sender-receiver-to-signal-mapping={communication-direction=IN, data-element=Geltungsbereich_E3_1_2_Premium.RP_IF_UI2_KompFehlerModus4_04_XIX_BMC_HV.DE_UI2_KompFehlerModus4_04, system-signal=UI2_KompFehlerModus4_04}
        sender-receiver-to-signal-mapping={communication-direction=IN, data-element=Geltungsbereich_E3_1_2_Premium.RP_IF_UI2_KompFehlerModus2_15_XIX_BMC_HV.DE_UI2_KompFehlerModus2_15, system-signal=UI2_KompFehlerModus2_15}
        sender-receiver-to-signal-mapping={communication-direction=IN, data-element=Geltungsbereich_E3_1_2_Premium.RP_IF_UI2_KompFehlerModus4_10_XIX_BMC_HV.DE_UI2_KompFehlerModus4_10, system-signal=UI2_KompFehlerModus4_10}
        sender-receiver-to-signal-mapping={communication-direction=IN, data-element=Geltungsbereich_E3_1_2_Premium.RP_IF_UI2_KompFehlerModus4_02_XIX_BMC_HV.DE_UI2_KompFehlerModus4_02, system-signal=UI2_KompFehlerModus4_02}
        sender-receiver-to-signal-mapping={communication-direction=IN, data-element=Geltungsbereich_E3_1_2_Premium.RP_IF_UI2_KompFehlerModus2_17_XIX_BMC_HV.DE_UI2_KompFehlerModus2_17, system-signal=UI2_KompFehlerModus2_17}
        sender-receiver-to-signal-mapping={communication-direction=IN, data-element=Geltungsbereich_E3_1_2_Premium.RP_IF_UI2_KompFehlerModus2_03_XIX_BMC_HV.DE_UI2_KompFehlerModus2_03, system-signal=UI2_KompFehlerModus2_03}
        sender-receiver-to-signal-mapping={communication-direction=IN, data-element=Geltungsbereich_E3_1_2_Premium.RP_IF_UI2_KompFehlerModus2_21_XIX_BMC_HV.DE_UI2_KompFehlerModus2_21, system-signal=UI2_KompFehlerModus2_21}
        sender-receiver-to-signal-mapping={communication-direction=IN, data-element=Geltungsbereich_E3_1_2_Premium.RP_IF_UI1_Status_XIX_BMC_HV.DE_UI1_Status, system-signal=UI1_Status}
        sender-receiver-to-signal-mapping={communication-direction=IN, data-element=Geltungsbereich_E3_1_2_Premium.RP_IF_UI1_KompFehlerModus2_25_XIX_BMC_HV.DE_UI1_KompFehlerModus2_25, system-signal=UI1_KompFehlerModus2_25}
        sender-receiver-to-signal-mapping={communication-direction=IN, data-element=Geltungsbereich_E3_1_2_Premium.RP_IF_UI1_KompFehlerModus2_26_XIX_BMC_HV.DE_UI1_KompFehlerModus2_26, system-signal=UI1_KompFehlerModus2_26}
        sender-receiver-to-signal-mapping={communication-direction=IN, data-element=Geltungsbereich_E3_1_2_Premium.RP_IF_UI2_KompFehlerModus2_25_XIX_BMC_HV.DE_UI2_KompFehlerModus2_25, system-signal=UI2_KompFehlerModus2_25}
        sender-receiver-to-signal-mapping={communication-direction=IN, data-element=Geltungsbereich_E3_1_2_Premium.RP_IF_UI2_KompFehlerModus2_26_XIX_BMC_HV.DE_UI2_KompFehlerModus2_26, system-signal=UI2_KompFehlerModus2_26}
        sender-receiver-to-signal-mapping={communication-direction=IN, data-element=Geltungsbereich_E3_1_2_Premium.RP_IF_ZM_HV_Auszeit_HiRes_XIX_BMC_HV.DE_ZM_HV_Auszeit_HiRes, system-signal=ZM_HV_Auszeit_HiRes}
        sender-receiver-to-signal-mapping={communication-direction=OUT, data-element=Geltungsbereich_E3_1_2_Premium.SP_IF_BMC_Abschaltankuendigung_XIX_BMC_HV.DE_BMC_Abschaltankuendigung, system-signal=BMC_Abschaltankuendigung}
        sender-receiver-to-signal-mapping={communication-direction=IN, data-element=Geltungsbereich_E3_1_2_Premium.RP_IF_TME_Therm_IstLeistung_HVBatterie_XIX_BMC_HV.DE_TME_Therm_IstLeistung_HVBatterie, system-signal=TME_Therm_IstLeistung_HVBatterie}
        sender-receiver-to-signal-mapping={communication-direction=IN, data-element=Geltungsbereich_E3_1_2_Premium.RP_IF_SI_T_Mode_XIX_BMC_HV.DE_SI_T_Mode, system-signal=SI_T_Mode}
        sender-receiver-to-signal-mapping={communication-direction=IN, data-element=Geltungsbereich_E3_1_2_Premium.RP_IF_HVEM_BMC_CHA_Wunschleistung_XIX_BMC_HV.DE_HVEM_BMC_CHA_Wunschleistung, system-signal=HVEM_BMC_CHA_Wunschleistung}
        sender-receiver-to-signal-mapping={communication-direction=IN, data-element=Geltungsbereich_E3_1_2_Premium.RP_IF_ZM_HV_Auszeit_XIX_BMC_HV.DE_ZM_HV_Auszeit, system-signal=ZM_HV_Auszeit}
        sender-receiver-to-signal-mapping={communication-direction=IN, data-element=Geltungsbereich_E3_1_2_Premium.RP_IF_ZM_HV_Auszeit_Status_XIX_BMC_HV.DE_ZM_HV_Auszeit_Status, system-signal=ZM_HV_Auszeit_Status}
        sender-receiver-to-signal-mapping={communication-direction=IN, data-element=Geltungsbereich_E3_1_2_Premium.RP_IF_HVEM_SystemMinLeistungsgrenze_XIX_BMC_HV.DE_HVEM_SystemMinLeistungsgrenze, system-signal=HVEM_SystemMinLeistungsgrenze}
        sender-receiver-to-signal-mapping={communication-direction=IN, data-element=Geltungsbereich_E3_1_2_Premium.RP_IF_OTP_Aussen_Temp_ungef_XIX_BMC_HV.DE_OTP_Aussen_Temp_ungef, system-signal=OTP_Aussen_Temp_ungef}
        sender-receiver-to-signal-mapping={communication-direction=OUT, data-element=Geltungsbereich_E3_1_2_Premium.SP_IF_BMC_Energie_Entladen_XIX_BMC_HV.DE_BMC_Energie_Entladen, system-signal=BMC_Energie_Entladen}
        sender-receiver-to-signal-mapping={communication-direction=OUT, data-element=Geltungsbereich_E3_1_2_Premium.SP_IF_BMC_Energie_Laden_XIX_BMC_HV.DE_BMC_Energie_Laden, system-signal=BMC_Energie_Laden}
        sender-receiver-to-signal-mapping={communication-direction=IN, data-element=Geltungsbereich_E3_1_2_Premium.RP_IF_TME_Batt_Kond_Verf_XIX_BMC_HV.DE_TME_Batt_Kond_Verf, system-signal=TME_Batt_Kond_Verf}
        sender-receiver-to-signal-mapping={communication-direction=IN, data-element=Geltungsbereich_E3_1_2_Premium.RP_IF_OTP_Aussen_Temp_OBD_XIX_BMC_HV.DE_OTP_Aussen_Temp_OBD, system-signal=OTP_Aussen_Temp_OBD}
        sender-receiver-to-signal-mapping={communication-direction=OUT, data-element=Geltungsbereich_E3_1_2_Premium.SP_IF_BMC_Bidi_Energie_Absolut_XIX_BMC_HV.DE_BMC_Bidi_Energie_Absolut, system-signal=BMC_Bidi_Energie_Absolut}
        sender-receiver-to-signal-mapping={communication-direction=OUT, data-element=Geltungsbereich_E3_1_2_Premium.SP_IF_BMC_Bidi_GenutzteEnergie_XIX_BMC_HV.DE_BMC_Bidi_GenutzteEnergie, system-signal=BMC_Bidi_GenutzteEnergie}
        sender-receiver-to-signal-mapping={communication-direction=OUT, data-element=Geltungsbereich_E3_1_2_Premium.SP_IF_BMC_Bidi_Min_SoC_XIX_BMC_HV.DE_BMC_Bidi_Min_SoC, system-signal=BMC_Bidi_Min_SoC}
        sender-receiver-to-signal-mapping={communication-direction=OUT, data-element=Geltungsbereich_E3_1_2_Premium.SP_IF_BMC_Bidi_Max_SoC_XIX_BMC_HV.DE_BMC_Bidi_Max_SoC, system-signal=BMC_Bidi_Max_SoC}
        sender-receiver-to-signal-mapping={communication-direction=IN, data-element=Geltungsbereich_E3_1_2_Premium.RP_IF_HVLM_BidiLadeModus_XIX_BMC_HV.DE_HVLM_BidiLadeModus, system-signal=HVLM_BidiLadeModus}
        sender-receiver-to-signal-mapping={communication-direction=IN, data-element=Geltungsbereich_E3_1_2_Premium.RP_IF_HVLE_IstSpannung_HV_XIX_BMC_HV.DE_HVLE_IstSpannung_HV, system-signal=HVLE_IstSpannung_HV}
        sender-receiver-to-signal-mapping={communication-direction=IN, data-element=Geltungsbereich_E3_1_2_Premium.RP_IF_HVLE_OBG_IstModus_XIX_BMC_HV.DE_HVLE_OBG_IstModus, system-signal=HVLE_OBG_IstModus}
        sender-receiver-to-signal-mapping={communication-direction=IN, data-element=Geltungsbereich_E3_1_2_Premium.RP_IF_DC_IstLeistung_HV_XIX_BMC_HV.DE_DC_IstLeistung_HV, system-signal=DC_IstLeistung_HV}
        sender-receiver-to-signal-mapping={communication-direction=IN, data-element=Geltungsbereich_E3_1_2_Premium.RP_IF_HVLM_BCAM_Aktiv_XIX_BMC_HV.DE_HVLM_BCAM_Aktiv, system-signal=HVLM_BCAM_Aktiv}
        sender-receiver-to-signal-mapping={communication-direction=IN, data-element=Geltungsbereich_E3_1_2_Premium.RP_IF_HVEM_MMTR_State_XIX_BMC_HV.DE_HVEM_MMTR_State, system-signal=HVEM_MMTR_State}
        sender-receiver-to-signal-mapping={communication-direction=IN, data-element=Geltungsbereich_E3_1_2_Premium.RP_IF_EKK_HVK_EoHVL_Status_XIX_BMC_HV.DE_EKK_HVK_EoHVL_Status, system-signal=EKK_HVK_EoHVL_Status}
        sender-receiver-to-signal-mapping={communication-direction=OUT, data-element=Geltungsbereich_E3_1_2_Premium.SP_IF_BMC_Max_Entladestrom_02_XIX_BMC_HV.DE_BMC_Max_Entladestrom_02, system-signal=BMC_Max_Entladestrom_02}
        sender-receiver-to-signal-mapping={communication-direction=OUT, data-element=Geltungsbereich_E3_1_2_Premium.SP_IF_BMC_Dauer_Ladeleistung_02_XIX_BMC_HV.DE_BMC_Dauer_Ladeleistung_02, system-signal=BMC_Dauer_Ladeleistung_02}
        sender-receiver-to-signal-mapping={communication-direction=OUT, data-element=Geltungsbereich_E3_1_2_Premium.SP_IF_BMC_Dauer_Entladeleistung_02_XIX_BMC_HV.DE_BMC_Dauer_Entladeleistung_02, system-signal=BMC_Dauer_Entladeleistung_02}
        sender-receiver-to-signal-mapping={communication-direction=OUT, data-element=Geltungsbereich_E3_1_2_Premium.SP_IF_BMC_Max_Ladestrom_02_XIX_BMC_HV.DE_BMC_Max_Ladestrom_02, system-signal=BMC_Max_Ladestrom_02}
        sender-receiver-to-signal-mapping={communication-direction=OUT, data-element=Geltungsbereich_E3_1_2_Premium.SP_IF_BMC_Max_Entladeleistung_02_XIX_BMC_HV.DE_BMC_Max_Entladeleistung_02, system-signal=BMC_Max_Entladeleistung_02}
        sender-receiver-to-signal-mapping={communication-direction=OUT, data-element=Geltungsbereich_E3_1_2_Premium.SP_IF_BMC_Max_Ladeleistung_02_XIX_BMC_HV.DE_BMC_Max_Ladeleistung_02, system-signal=BMC_Max_Ladeleistung_02}
        sender-receiver-to-signal-mapping={communication-direction=IN, data-element=Geltungsbereich_E3_1_2_Premium.RP_IF_HVEM_BMC_CHA_Wunschleistung_02_XIX_BMC_HV.DE_HVEM_BMC_CHA_Wunschleistung_02, system-signal=HVEM_BMC_CHA_Wunschleistung_02}
        sender-receiver-to-signal-mapping={communication-direction=IN, data-element=Geltungsbereich_E3_1_2_Premium.RP_IF_PCM_BMC_VTD_LifeTimeReset_Resp_XIX_BMC_HV.DE_PCM_BMC_VTD_LifeTimeReset_Resp, system-signal=PCM_BMC_VTD_LifeTimeReset_Resp}
        sender-receiver-to-signal-mapping={communication-direction=IN, data-element=Geltungsbereich_E3_1_2_Premium.RP_IF_PCM_BMC_VTD_LifeTimeReset_Req_XIX_BMC_HV.DE_PCM_BMC_VTD_LifeTimeReset_Req, system-signal=PCM_BMC_VTD_LifeTimeReset_Req}
        sender-receiver-to-signal-mapping={communication-direction=IN, data-element=Geltungsbereich_E3_1_2_Premium.RP_IF_PCM_BMC_VTD_Freeze_Req_XIX_BMC_HV.DE_PCM_BMC_VTD_Freeze_Req, system-signal=PCM_BMC_VTD_Freeze_Req}
        sender-receiver-to-signal-mapping={communication-direction=IN, data-element=Geltungsbereich_E3_1_2_Premium.RP_IF_PCM_BMC_VTD_RecentReset_Req_XIX_BMC_HV.DE_PCM_BMC_VTD_RecentReset_Req, system-signal=PCM_BMC_VTD_RecentReset_Req}
        sender-receiver-to-signal-mapping={communication-direction=OUT, data-element=Geltungsbereich_E3_1_2_Premium.SP_IF_BMC_UBE_Indikator_XIX_BMC_HV.DE_BMC_UBE_Indikator, system-signal=BMC_UBE_Indikator}
        sender-receiver-to-signal-mapping={communication-direction=OUT, data-element=Geltungsbereich_E3_1_2_Premium.SP_IF_BMC_Range_Indikator_XIX_BMC_HV.DE_BMC_Range_Indikator, system-signal=BMC_Range_Indikator}
        sender-receiver-to-signal-mapping={communication-direction=OUT, data-element=Geltungsbereich_E3_1_2_Premium.SP_IF_BMC_EnergieVorhalt_XIX_BMC_HV.DE_BMC_EnergieVorhalt, system-signal=BMC_EnergieVorhalt}
        sender-receiver-to-signal-mapping={communication-direction=OUT, data-element=Geltungsbereich_E3_1_2_Premium.SP_IF_BMC_UBE_Indik_last_update_km_XIX_BMC_HV.DE_BMC_UBE_Indik_last_update_km, system-signal=BMC_UBE_Indik_last_update_km}
        sender-receiver-to-signal-mapping={communication-direction=OUT, data-element=Geltungsbereich_E3_1_2_Premium.SP_IF_BMC_ExtLadeleistung_XIX_BMC_HV.DE_BMC_ExtLadeleistung, system-signal=BMC_ExtLadeleistung}
        sender-receiver-to-signal-mapping={communication-direction=IN, data-element=Geltungsbereich_E3_1_2_Premium.RP_IF_DW_Kilometerstand_XIX_BMC_HV.DE_DW_Kilometerstand, system-signal=DW_Kilometerstand}
        sender-receiver-to-signal-mapping={communication-direction=IN, data-element=Geltungsbereich_E3_1_2_Premium.RP_IF_ISO_ALL_01_Req_Data_XIX_diagnosis_infrastructure_Hybrid_01_XIX_diagnosis_infrastructure_XIX_BMC_HV.DE_ISO_ALL_01_Req_Data, system-signal=ISO_ALL_01_Req_Data}
        sender-receiver-to-signal-mapping={communication-direction=OUT, data-element=Geltungsbereich_E3_1_2_Premium.SP_IF_DS_Hybrid_01_MemSel10Changed_XIX_BMC_HV.DE_DS_Hybrid_01_MemSel10Changed, system-signal=DS_Hybrid_01_MemSel10Changed}
        sender-receiver-to-signal-mapping={communication-direction=OUT, data-element=Geltungsbereich_E3_1_2_Premium.SP_IF_DS_Hybrid_01_StMemChanged_XIX_BMC_HV.DE_DS_Hybrid_01_StMemChanged, system-signal=DS_Hybrid_01_StMemChanged}
        sender-receiver-to-signal-mapping={communication-direction=OUT, data-element=Geltungsbereich_E3_1_2_Premium.SP_IF_DS_Hybrid_01_TestFailedChanged_XIX_BMC_HV.DE_DS_Hybrid_01_TestFailedChanged, system-signal=DS_Hybrid_01_TestFailedChanged}
        sender-receiver-to-signal-mapping={communication-direction=OUT, data-element=Geltungsbereich_E3_1_2_Premium.SP_IF_DS_Hybrid_01_WIRChanged_XIX_BMC_HV.DE_DS_Hybrid_01_WIRChanged, system-signal=DS_Hybrid_01_WIRChanged}
        sender-receiver-to-signal-mapping={communication-direction=OUT, data-element=Geltungsbereich_E3_1_2_Premium.SP_IF_DS_Hybrid_01_MemSelChanged_XIX_BMC_HV.DE_DS_Hybrid_01_MemSelChanged, system-signal=DS_Hybrid_01_MemSelChanged}
        sender-receiver-to-signal-mapping={communication-direction=OUT, data-element=Geltungsbereich_E3_1_2_Premium.SP_IF_DS_Hybrid_01_DiagAdr_XIX_BMC_HV.DE_DS_Hybrid_01_DiagAdr, system-signal=DS_Hybrid_01_DiagAdr}
        sender-receiver-to-signal-mapping={communication-direction=IN, data-element=Geltungsbereich_E3_1_2_Premium.RP_IF_OBD_Driving_Cycle_XIX_BMC_HV.DE_OBD_Driving_Cycle, system-signal=OBD_Driving_Cycle}
        sender-receiver-to-signal-mapping={communication-direction=IN, data-element=Geltungsbereich_E3_1_2_Premium.RP_IF_OBD_Normed_Trip_XIX_BMC_HV.DE_OBD_Normed_Trip, system-signal=OBD_Normed_Trip}
        sender-receiver-to-signal-mapping={communication-direction=IN, data-element=Geltungsbereich_E3_1_2_Premium.RP_IF_OBD_Warm_Up_Cycle_XIX_BMC_HV.DE_OBD_Warm_Up_Cycle, system-signal=OBD_Warm_Up_Cycle}
        sender-receiver-to-signal-mapping={communication-direction=IN, data-element=Geltungsbereich_E3_1_2_Premium.RP_IF_OBD_Minimum_Trip_XIX_BMC_HV.DE_OBD_Minimum_Trip, system-signal=OBD_Minimum_Trip}
        sender-receiver-to-signal-mapping={communication-direction=OUT, data-element=Geltungsbereich_E3_1_2_Premium.SP_IF_DS_Hybrid_01_ConfDTCChanged_XIX_BMC_HV.DE_DS_Hybrid_01_ConfDTCChanged, system-signal=DS_Hybrid_01_ConfDTCChanged}
        sender-receiver-to-signal-mapping={communication-direction=OUT, data-element=Geltungsbereich_E3_1_2_Premium.SP_IF_Hybrid_01_SNI_10_XIX_BMC_HV.DE_Hybrid_01_SNI_10, system-signal=Hybrid_01_SNI_10}
        sender-receiver-to-signal-mapping={communication-direction=IN, data-element=Geltungsbereich_E3_1_2_Premium.RP_IF_VDSO_Vx3d_XIX_BMC_HV.DE_VDSO_Vx3d, system-signal=VDSO_Vx3d}
        sender-receiver-to-signal-mapping={communication-direction=IN, data-element=Geltungsbereich_E3_1_2_Premium.RP_IF_OBD_Sperrung_IUMPR_XIX_BMC_HV.DE_OBD_Sperrung_IUMPR, system-signal=OBD_Sperrung_IUMPR}
        sender-receiver-to-signal-mapping={communication-direction=IN, data-element=Geltungsbereich_E3_1_2_Premium.RP_IF_MM_PropulsionSystemActive_XIX_BMC_HV.DE_MM_PropulsionSystemActive, system-signal=MM_PropulsionSystemActive}
        sender-receiver-to-signal-mapping={communication-direction=IN, data-element=Geltungsbereich_E3_1_2_Premium.RP_IF_UI2Sens01_CVN_VLD_XIX_BMC_HV.DE_UI2Sens01_CVN_VLD, system-signal=UI2Sens01_CVN_VLD}
        sender-receiver-to-signal-mapping={communication-direction=IN, data-element=Geltungsbereich_E3_1_2_Premium.RP_IF_UI2Sens02_CVN_VLD_XIX_BMC_HV.DE_UI2Sens02_CVN_VLD, system-signal=UI2Sens02_CVN_VLD}
        sender-receiver-to-signal-mapping={communication-direction=IN, data-element=Geltungsbereich_E3_1_2_Premium.RP_IF_SI_P_Mode_XIX_BMC_HV.DE_SI_P_Mode, system-signal=SI_P_Mode}
        sender-receiver-to-signal-mapping={communication-direction=IN, data-element=Geltungsbereich_E3_1_2_Premium.RP_IF_SI_P_Mode_gueltig_XIX_BMC_HV.DE_SI_P_Mode_gueltig, system-signal=SI_P_Mode_gueltig}
        sender-receiver-to-signal-mapping={communication-direction=IN, data-element=Geltungsbereich_E3_1_2_Premium.RP_IF_UI2Sens01_CALID_Index_12_XIX_BMC_HV.DE_UI2Sens01_CALID_Index_12, system-signal=UI2Sens01_CALID_Index_12}
        sender-receiver-to-signal-mapping={communication-direction=IN, data-element=Geltungsbereich_E3_1_2_Premium.RP_IF_UI2Sens01_CALID_Index_14_XIX_BMC_HV.DE_UI2Sens01_CALID_Index_14, system-signal=UI2Sens01_CALID_Index_14}
        sender-receiver-to-signal-mapping={communication-direction=IN, data-element=Geltungsbereich_E3_1_2_Premium.RP_IF_UI2Sens01_CALID_Index_13_XIX_BMC_HV.DE_UI2Sens01_CALID_Index_13, system-signal=UI2Sens01_CALID_Index_13}
        sender-receiver-to-signal-mapping={communication-direction=IN, data-element=Geltungsbereich_E3_1_2_Premium.RP_IF_UI2Sens01_CALID_Index_16_XIX_BMC_HV.DE_UI2Sens01_CALID_Index_16, system-signal=UI2Sens01_CALID_Index_16}
        sender-receiver-to-signal-mapping={communication-direction=IN, data-element=Geltungsbereich_E3_1_2_Premium.RP_IF_UI2Sens01_CALID_Index_11_XIX_BMC_HV.DE_UI2Sens01_CALID_Index_11, system-signal=UI2Sens01_CALID_Index_11}
        sender-receiver-to-signal-mapping={communication-direction=IN, data-element=Geltungsbereich_E3_1_2_Premium.RP_IF_UI2Sens01_CVN_Byte_4_XIX_BMC_HV.DE_UI2Sens01_CVN_Byte_4, system-signal=UI2Sens01_CVN_Byte_4}
        sender-receiver-to-signal-mapping={communication-direction=IN, data-element=Geltungsbereich_E3_1_2_Premium.RP_IF_UI2Sens01_CVN_Byte_2_XIX_BMC_HV.DE_UI2Sens01_CVN_Byte_2, system-signal=UI2Sens01_CVN_Byte_2}
        sender-receiver-to-signal-mapping={communication-direction=IN, data-element=Geltungsbereich_E3_1_2_Premium.RP_IF_UI2Sens01_CVN_Byte_1_XIX_BMC_HV.DE_UI2Sens01_CVN_Byte_1, system-signal=UI2Sens01_CVN_Byte_1}
        sender-receiver-to-signal-mapping={communication-direction=IN, data-element=Geltungsbereich_E3_1_2_Premium.RP_IF_UI2Sens01_CALID_Index_15_XIX_BMC_HV.DE_UI2Sens01_CALID_Index_15, system-signal=UI2Sens01_CALID_Index_15}
        sender-receiver-to-signal-mapping={communication-direction=IN, data-element=Geltungsbereich_E3_1_2_Premium.RP_IF_UI2Sens01_CALID_Index_10_XIX_BMC_HV.DE_UI2Sens01_CALID_Index_10, system-signal=UI2Sens01_CALID_Index_10}
        sender-receiver-to-signal-mapping={communication-direction=IN, data-element=Geltungsbereich_E3_1_2_Premium.RP_IF_UI2Sens01_CVN_Byte_3_XIX_BMC_HV.DE_UI2Sens01_CVN_Byte_3, system-signal=UI2Sens01_CVN_Byte_3}
        sender-receiver-to-signal-mapping={communication-direction=IN, data-element=Geltungsbereich_E3_1_2_Premium.RP_IF_UI2Sens02_CALID_Index_16_XIX_BMC_HV.DE_UI2Sens02_CALID_Index_16, system-signal=UI2Sens02_CALID_Index_16}
        sender-receiver-to-signal-mapping={communication-direction=IN, data-element=Geltungsbereich_E3_1_2_Premium.RP_IF_UI2Sens02_CALID_Index_15_XIX_BMC_HV.DE_UI2Sens02_CALID_Index_15, system-signal=UI2Sens02_CALID_Index_15}
        sender-receiver-to-signal-mapping={communication-direction=IN, data-element=Geltungsbereich_E3_1_2_Premium.RP_IF_UI2Sens02_CALID_Index_13_XIX_BMC_HV.DE_UI2Sens02_CALID_Index_13, system-signal=UI2Sens02_CALID_Index_13}
        sender-receiver-to-signal-mapping={communication-direction=IN, data-element=Geltungsbereich_E3_1_2_Premium.RP_IF_UI2Sens02_CALID_Index_14_XIX_BMC_HV.DE_UI2Sens02_CALID_Index_14, system-signal=UI2Sens02_CALID_Index_14}
        sender-receiver-to-signal-mapping={communication-direction=IN, data-element=Geltungsbereich_E3_1_2_Premium.RP_IF_UI2Sens02_CALID_Index_11_XIX_BMC_HV.DE_UI2Sens02_CALID_Index_11, system-signal=UI2Sens02_CALID_Index_11}
        sender-receiver-to-signal-mapping={communication-direction=IN, data-element=Geltungsbereich_E3_1_2_Premium.RP_IF_UI2Sens02_CALID_Index_12_XIX_BMC_HV.DE_UI2Sens02_CALID_Index_12, system-signal=UI2Sens02_CALID_Index_12}
        sender-receiver-to-signal-mapping={communication-direction=IN, data-element=Geltungsbereich_E3_1_2_Premium.RP_IF_UI2Sens02_CVN_Byte_1_XIX_BMC_HV.DE_UI2Sens02_CVN_Byte_1, system-signal=UI2Sens02_CVN_Byte_1}
        sender-receiver-to-signal-mapping={communication-direction=IN, data-element=Geltungsbereich_E3_1_2_Premium.RP_IF_UI2Sens02_CVN_Byte_3_XIX_BMC_HV.DE_UI2Sens02_CVN_Byte_3, system-signal=UI2Sens02_CVN_Byte_3}
        sender-receiver-to-signal-mapping={communication-direction=IN, data-element=Geltungsbereich_E3_1_2_Premium.RP_IF_UI2Sens02_CVN_Byte_2_XIX_BMC_HV.DE_UI2Sens02_CVN_Byte_2, system-signal=UI2Sens02_CVN_Byte_2}
        sender-receiver-to-signal-mapping={communication-direction=IN, data-element=Geltungsbereich_E3_1_2_Premium.RP_IF_UI2Sens02_CVN_Byte_4_XIX_BMC_HV.DE_UI2Sens02_CVN_Byte_4, system-signal=UI2Sens02_CVN_Byte_4}
        sender-receiver-to-signal-mapping={communication-direction=IN, data-element=Geltungsbereich_E3_1_2_Premium.RP_IF_UI2Sens02_CALID_Index_10_XIX_BMC_HV.DE_UI2Sens02_CALID_Index_10, system-signal=UI2Sens02_CALID_Index_10}
        sender-receiver-to-signal-mapping={communication-direction=IN, data-element=Geltungsbereich_E3_1_2_Premium.RP_IF_UI2Sens01_ErrMem_State_XIX_BMC_HV.DE_UI2Sens01_ErrMem_State, system-signal=UI2Sens01_ErrMem_State}
        sender-receiver-to-signal-mapping={communication-direction=IN, data-element=Geltungsbereich_E3_1_2_Premium.RP_IF_UI2Sens02_ErrMem_State_XIX_BMC_HV.DE_UI2Sens02_ErrMem_State, system-signal=UI2Sens02_ErrMem_State}
        sender-receiver-to-signal-mapping={communication-direction=IN, data-element=Geltungsbereich_E3_1_2_Premium.RP_IF_OBD_Abs_Pedal_Pos_XIX_BMC_HV.DE_OBD_Abs_Pedal_Pos, system-signal=OBD_Abs_Pedal_Pos}
        sender-receiver-to-signal-mapping={communication-direction=IN, data-element=Geltungsbereich_E3_1_2_Premium.RP_IF_OBD_Aussen_Temp_gef_XIX_BMC_HV.DE_OBD_Aussen_Temp_gef, system-signal=OBD_Aussen_Temp_gef}
        sender-receiver-to-signal-mapping={communication-direction=IN, data-element=Geltungsbereich_E3_1_2_Premium.RP_IF_OBD_Calc_Load_Val_XIX_BMC_HV.DE_OBD_Calc_Load_Val, system-signal=OBD_Calc_Load_Val}
        sender-receiver-to-signal-mapping={communication-direction=IN, data-element=Geltungsbereich_E3_1_2_Premium.RP_IF_OBD_Sperrung_Kaltstart_Denom_XIX_BMC_HV.DE_OBD_Sperrung_Kaltstart_Denom, system-signal=OBD_Sperrung_Kaltstart_Denom}
        sender-receiver-to-signal-mapping={communication-direction=IN, data-element=Geltungsbereich_E3_1_2_Premium.RP_IF_OBD_ClearMem_Inhibit_XIX_BMC_HV.DE_OBD_ClearMem_Inhibit, system-signal=OBD_ClearMem_Inhibit}
        sender-receiver-to-signal-mapping={communication-direction=IN, data-element=Geltungsbereich_E3_1_2_Premium.RP_IF_OBD_Kaltstart_Denominator_XIX_BMC_HV.DE_OBD_Kaltstart_Denominator, system-signal=OBD_Kaltstart_Denominator}
        sender-receiver-to-signal-mapping={communication-direction=IN, data-element=Geltungsbereich_E3_1_2_Premium.RP_IF_OBD_Eng_Cool_Temp_XIX_BMC_HV.DE_OBD_Eng_Cool_Temp, system-signal=OBD_Eng_Cool_Temp}
        sender-receiver-to-signal-mapping={communication-direction=IN, data-element=Geltungsbereich_E3_1_2_Premium.RP_IF_OBD_Typ_XIX_BMC_HV.DE_OBD_Typ, system-signal=OBD_Typ}
        sender-receiver-to-signal-mapping={communication-direction=IN, data-element=Geltungsbereich_E3_1_2_Premium.RP_IF_OBD_QBit_Aussen_Temp_XIX_BMC_HV.DE_OBD_QBit_Aussen_Temp, system-signal=OBD_QBit_Aussen_Temp}
        sender-receiver-to-signal-mapping={communication-direction=IN, data-element=Geltungsbereich_E3_1_2_Premium.RP_IF_BJB_CVN_Byte_2_XIX_BMC_HV.DE_BJB_CVN_Byte_2, system-signal=BJB_CVN_Byte_2}
        sender-receiver-to-signal-mapping={communication-direction=IN, data-element=Geltungsbereich_E3_1_2_Premium.RP_IF_BJB_CVN_Byte_4_XIX_BMC_HV.DE_BJB_CVN_Byte_4, system-signal=BJB_CVN_Byte_4}
        sender-receiver-to-signal-mapping={communication-direction=IN, data-element=Geltungsbereich_E3_1_2_Premium.RP_IF_BJB_CVN_Byte_3_XIX_BMC_HV.DE_BJB_CVN_Byte_3, system-signal=BJB_CVN_Byte_3}
        sender-receiver-to-signal-mapping={communication-direction=IN, data-element=Geltungsbereich_E3_1_2_Premium.RP_IF_BJB_CVN_Byte_1_XIX_BMC_HV.DE_BJB_CVN_Byte_1, system-signal=BJB_CVN_Byte_1}
        sender-receiver-to-signal-mapping={communication-direction=IN, data-element=Geltungsbereich_E3_1_2_Premium.RP_IF_UI2Sens01_CALID_Index_06_XIX_BMC_HV.DE_UI2Sens01_CALID_Index_06, system-signal=UI2Sens01_CALID_Index_06}
        sender-receiver-to-signal-mapping={communication-direction=IN, data-element=Geltungsbereich_E3_1_2_Premium.RP_IF_UI2Sens01_CALID_Index_03_XIX_BMC_HV.DE_UI2Sens01_CALID_Index_03, system-signal=UI2Sens01_CALID_Index_03}
        sender-receiver-to-signal-mapping={communication-direction=IN, data-element=Geltungsbereich_E3_1_2_Premium.RP_IF_UI2Sens01_CALID_Index_01_XIX_BMC_HV.DE_UI2Sens01_CALID_Index_01, system-signal=UI2Sens01_CALID_Index_01}
        sender-receiver-to-signal-mapping={communication-direction=IN, data-element=Geltungsbereich_E3_1_2_Premium.RP_IF_UI2Sens01_CALID_Index_02_XIX_BMC_HV.DE_UI2Sens01_CALID_Index_02, system-signal=UI2Sens01_CALID_Index_02}
        sender-receiver-to-signal-mapping={communication-direction=IN, data-element=Geltungsbereich_E3_1_2_Premium.RP_IF_UI2Sens01_CALID_Index_08_XIX_BMC_HV.DE_UI2Sens01_CALID_Index_08, system-signal=UI2Sens01_CALID_Index_08}
        sender-receiver-to-signal-mapping={communication-direction=IN, data-element=Geltungsbereich_E3_1_2_Premium.RP_IF_UI2Sens01_CALID_Index_05_XIX_BMC_HV.DE_UI2Sens01_CALID_Index_05, system-signal=UI2Sens01_CALID_Index_05}
        sender-receiver-to-signal-mapping={communication-direction=IN, data-element=Geltungsbereich_E3_1_2_Premium.RP_IF_UI2Sens01_CALID_Index_04_XIX_BMC_HV.DE_UI2Sens01_CALID_Index_04, system-signal=UI2Sens01_CALID_Index_04}
        sender-receiver-to-signal-mapping={communication-direction=IN, data-element=Geltungsbereich_E3_1_2_Premium.RP_IF_UI2Sens01_CALID_Index_07_XIX_BMC_HV.DE_UI2Sens01_CALID_Index_07, system-signal=UI2Sens01_CALID_Index_07}
        sender-receiver-to-signal-mapping={communication-direction=IN, data-element=Geltungsbereich_E3_1_2_Premium.RP_IF_UI2Sens01_CALID_Index_09_XIX_BMC_HV.DE_UI2Sens01_CALID_Index_09, system-signal=UI2Sens01_CALID_Index_09}
        sender-receiver-to-signal-mapping={communication-direction=IN, data-element=Geltungsbereich_E3_1_2_Premium.RP_IF_UI2Sens02_CALID_Index_04_XIX_BMC_HV.DE_UI2Sens02_CALID_Index_04, system-signal=UI2Sens02_CALID_Index_04}
        sender-receiver-to-signal-mapping={communication-direction=IN, data-element=Geltungsbereich_E3_1_2_Premium.RP_IF_UI2Sens02_CALID_Index_01_XIX_BMC_HV.DE_UI2Sens02_CALID_Index_01, system-signal=UI2Sens02_CALID_Index_01}
        sender-receiver-to-signal-mapping={communication-direction=IN, data-element=Geltungsbereich_E3_1_2_Premium.RP_IF_UI2Sens02_CALID_Index_07_XIX_BMC_HV.DE_UI2Sens02_CALID_Index_07, system-signal=UI2Sens02_CALID_Index_07}
        sender-receiver-to-signal-mapping={communication-direction=IN, data-element=Geltungsbereich_E3_1_2_Premium.RP_IF_UI2Sens02_CALID_Index_09_XIX_BMC_HV.DE_UI2Sens02_CALID_Index_09, system-signal=UI2Sens02_CALID_Index_09}
        sender-receiver-to-signal-mapping={communication-direction=IN, data-element=Geltungsbereich_E3_1_2_Premium.RP_IF_UI2Sens02_CALID_Index_03_XIX_BMC_HV.DE_UI2Sens02_CALID_Index_03, system-signal=UI2Sens02_CALID_Index_03}
        sender-receiver-to-signal-mapping={communication-direction=IN, data-element=Geltungsbereich_E3_1_2_Premium.RP_IF_UI2Sens02_CALID_Index_08_XIX_BMC_HV.DE_UI2Sens02_CALID_Index_08, system-signal=UI2Sens02_CALID_Index_08}
        sender-receiver-to-signal-mapping={communication-direction=IN, data-element=Geltungsbereich_E3_1_2_Premium.RP_IF_UI2Sens02_CALID_Index_02_XIX_BMC_HV.DE_UI2Sens02_CALID_Index_02, system-signal=UI2Sens02_CALID_Index_02}
        sender-receiver-to-signal-mapping={communication-direction=IN, data-element=Geltungsbereich_E3_1_2_Premium.RP_IF_UI2Sens02_CALID_Index_05_XIX_BMC_HV.DE_UI2Sens02_CALID_Index_05, system-signal=UI2Sens02_CALID_Index_05}
        sender-receiver-to-signal-mapping={communication-direction=IN, data-element=Geltungsbereich_E3_1_2_Premium.RP_IF_UI2Sens02_CALID_Index_06_XIX_BMC_HV.DE_UI2Sens02_CALID_Index_06, system-signal=UI2Sens02_CALID_Index_06}
        sender-receiver-to-signal-mapping={communication-direction=IN, data-element=Geltungsbereich_E3_1_2_Premium.RP_IF_BJB_CALID_Index_03_XIX_BMC_HV.DE_BJB_CALID_Index_03, system-signal=BJB_CALID_Index_03}
        sender-receiver-to-signal-mapping={communication-direction=IN, data-element=Geltungsbereich_E3_1_2_Premium.RP_IF_BJB_CALID_Index_11_XIX_BMC_HV.DE_BJB_CALID_Index_11, system-signal=BJB_CALID_Index_11}
        sender-receiver-to-signal-mapping={communication-direction=IN, data-element=Geltungsbereich_E3_1_2_Premium.RP_IF_BJB_CALID_Index_05_XIX_BMC_HV.DE_BJB_CALID_Index_05, system-signal=BJB_CALID_Index_05}
        sender-receiver-to-signal-mapping={communication-direction=IN, data-element=Geltungsbereich_E3_1_2_Premium.RP_IF_BJB_CALID_Index_02_XIX_BMC_HV.DE_BJB_CALID_Index_02, system-signal=BJB_CALID_Index_02}
        sender-receiver-to-signal-mapping={communication-direction=IN, data-element=Geltungsbereich_E3_1_2_Premium.RP_IF_BJB_CALID_Index_14_XIX_BMC_HV.DE_BJB_CALID_Index_14, system-signal=BJB_CALID_Index_14}
        sender-receiver-to-signal-mapping={communication-direction=IN, data-element=Geltungsbereich_E3_1_2_Premium.RP_IF_BJB_CALID_Index_12_XIX_BMC_HV.DE_BJB_CALID_Index_12, system-signal=BJB_CALID_Index_12}
        sender-receiver-to-signal-mapping={communication-direction=IN, data-element=Geltungsbereich_E3_1_2_Premium.RP_IF_BJB_CALID_Index_13_XIX_BMC_HV.DE_BJB_CALID_Index_13, system-signal=BJB_CALID_Index_13}
        sender-receiver-to-signal-mapping={communication-direction=IN, data-element=Geltungsbereich_E3_1_2_Premium.RP_IF_BJB_CALID_Index_09_XIX_BMC_HV.DE_BJB_CALID_Index_09, system-signal=BJB_CALID_Index_09}
        sender-receiver-to-signal-mapping={communication-direction=IN, data-element=Geltungsbereich_E3_1_2_Premium.RP_IF_BJB_CALID_Index_01_XIX_BMC_HV.DE_BJB_CALID_Index_01, system-signal=BJB_CALID_Index_01}
        sender-receiver-to-signal-mapping={communication-direction=IN, data-element=Geltungsbereich_E3_1_2_Premium.RP_IF_BJB_CALID_Index_07_XIX_BMC_HV.DE_BJB_CALID_Index_07, system-signal=BJB_CALID_Index_07}
        sender-receiver-to-signal-mapping={communication-direction=IN, data-element=Geltungsbereich_E3_1_2_Premium.RP_IF_BJB_CALID_Index_08_XIX_BMC_HV.DE_BJB_CALID_Index_08, system-signal=BJB_CALID_Index_08}
        sender-receiver-to-signal-mapping={communication-direction=IN, data-element=Geltungsbereich_E3_1_2_Premium.RP_IF_BJB_CVN_VLD_XIX_BMC_HV.DE_BJB_CVN_VLD, system-signal=BJB_CVN_VLD}
        sender-receiver-to-signal-mapping={communication-direction=IN, data-element=Geltungsbereich_E3_1_2_Premium.RP_IF_BJB_CALID_Index_15_XIX_BMC_HV.DE_BJB_CALID_Index_15, system-signal=BJB_CALID_Index_15}
        sender-receiver-to-signal-mapping={communication-direction=IN, data-element=Geltungsbereich_E3_1_2_Premium.RP_IF_BJB_CALID_Index_04_XIX_BMC_HV.DE_BJB_CALID_Index_04, system-signal=BJB_CALID_Index_04}
        sender-receiver-to-signal-mapping={communication-direction=IN, data-element=Geltungsbereich_E3_1_2_Premium.RP_IF_BJB_CALID_Index_10_XIX_BMC_HV.DE_BJB_CALID_Index_10, system-signal=BJB_CALID_Index_10}
        sender-receiver-to-signal-mapping={communication-direction=IN, data-element=Geltungsbereich_E3_1_2_Premium.RP_IF_BJB_CALID_Index_06_XIX_BMC_HV.DE_BJB_CALID_Index_06, system-signal=BJB_CALID_Index_06}
        sender-receiver-to-signal-mapping={communication-direction=IN, data-element=Geltungsbereich_E3_1_2_Premium.RP_IF_BJB_CALID_Index_16_XIX_BMC_HV.DE_BJB_CALID_Index_16, system-signal=BJB_CALID_Index_16}
        sender-receiver-to-signal-mapping={communication-direction=OUT, data-element=Geltungsbereich_E3_1_2_Premium.SP_IF_ISO_ALL_01_Req_Data_XIX_diagnosis_infrastructure_Hybrid_01_XIX_diagnosis_infrastructure_XIX_BMC_HV.DE_ISO_ALL_01_Req_Data, system-signal=ISO_ALL_01_Req_Data}
        sender-receiver-to-signal-mapping={communication-direction=IN, data-element=Geltungsbereich_E3_1_2_Premium.RP_IF_OBD_Engine_RPM_XIX_BMC_HV.DE_OBD_Engine_RPM, system-signal=OBD_Engine_RPM}
        sender-receiver-to-signal-mapping={communication-direction=IN, data-element=Geltungsbereich_E3_1_2_Premium.RP_IF_DCDC_NV_CALID_Index_01_XIX_BMC_HV.DE_DCDC_NV_CALID_Index_01, system-signal=DCDC_NV_CALID_Index_01}
        sender-receiver-to-signal-mapping={communication-direction=IN, data-element=Geltungsbereich_E3_1_2_Premium.RP_IF_DCDC_NV_CVN_VLD_XIX_BMC_HV.DE_DCDC_NV_CVN_VLD, system-signal=DCDC_NV_CVN_VLD}
        sender-receiver-to-signal-mapping={communication-direction=IN, data-element=Geltungsbereich_E3_1_2_Premium.RP_IF_DCDC_NV_CALID_Index_12_XIX_BMC_HV.DE_DCDC_NV_CALID_Index_12, system-signal=DCDC_NV_CALID_Index_12}
        sender-receiver-to-signal-mapping={communication-direction=IN, data-element=Geltungsbereich_E3_1_2_Premium.RP_IF_DCDC_NV_CALID_Index_06_XIX_BMC_HV.DE_DCDC_NV_CALID_Index_06, system-signal=DCDC_NV_CALID_Index_06}
        sender-receiver-to-signal-mapping={communication-direction=IN, data-element=Geltungsbereich_E3_1_2_Premium.RP_IF_DCDC_NV_CALID_Index_13_XIX_BMC_HV.DE_DCDC_NV_CALID_Index_13, system-signal=DCDC_NV_CALID_Index_13}
        sender-receiver-to-signal-mapping={communication-direction=IN, data-element=Geltungsbereich_E3_1_2_Premium.RP_IF_DCDC_NV_CALID_Index_08_XIX_BMC_HV.DE_DCDC_NV_CALID_Index_08, system-signal=DCDC_NV_CALID_Index_08}
        sender-receiver-to-signal-mapping={communication-direction=IN, data-element=Geltungsbereich_E3_1_2_Premium.RP_IF_DCDC_NV_CALID_Index_15_XIX_BMC_HV.DE_DCDC_NV_CALID_Index_15, system-signal=DCDC_NV_CALID_Index_15}
        sender-receiver-to-signal-mapping={communication-direction=IN, data-element=Geltungsbereich_E3_1_2_Premium.RP_IF_DCDC_NV_CALID_Index_16_XIX_BMC_HV.DE_DCDC_NV_CALID_Index_16, system-signal=DCDC_NV_CALID_Index_16}
        sender-receiver-to-signal-mapping={communication-direction=IN, data-element=Geltungsbereich_E3_1_2_Premium.RP_IF_DCDC_NV_CVN_Byte_1_XIX_BMC_HV.DE_DCDC_NV_CVN_Byte_1, system-signal=DCDC_NV_CVN_Byte_1}
        sender-receiver-to-signal-mapping={communication-direction=IN, data-element=Geltungsbereich_E3_1_2_Premium.RP_IF_DCDC_NV_CALID_Index_07_XIX_BMC_HV.DE_DCDC_NV_CALID_Index_07, system-signal=DCDC_NV_CALID_Index_07}
        sender-receiver-to-signal-mapping={communication-direction=IN, data-element=Geltungsbereich_E3_1_2_Premium.RP_IF_DCDC_NV_CALID_Index_05_XIX_BMC_HV.DE_DCDC_NV_CALID_Index_05, system-signal=DCDC_NV_CALID_Index_05}
        sender-receiver-to-signal-mapping={communication-direction=IN, data-element=Geltungsbereich_E3_1_2_Premium.RP_IF_DCDC_NV_CALID_Index_02_XIX_BMC_HV.DE_DCDC_NV_CALID_Index_02, system-signal=DCDC_NV_CALID_Index_02}
        sender-receiver-to-signal-mapping={communication-direction=IN, data-element=Geltungsbereich_E3_1_2_Premium.RP_IF_DCDC_NV_CVN_Byte_3_XIX_BMC_HV.DE_DCDC_NV_CVN_Byte_3, system-signal=DCDC_NV_CVN_Byte_3}
        sender-receiver-to-signal-mapping={communication-direction=IN, data-element=Geltungsbereich_E3_1_2_Premium.RP_IF_DCDC_NV_CALID_Index_10_XIX_BMC_HV.DE_DCDC_NV_CALID_Index_10, system-signal=DCDC_NV_CALID_Index_10}
        sender-receiver-to-signal-mapping={communication-direction=IN, data-element=Geltungsbereich_E3_1_2_Premium.RP_IF_DCDC_NV_CALID_Index_09_XIX_BMC_HV.DE_DCDC_NV_CALID_Index_09, system-signal=DCDC_NV_CALID_Index_09}
        sender-receiver-to-signal-mapping={communication-direction=IN, data-element=Geltungsbereich_E3_1_2_Premium.RP_IF_DCDC_NV_CALID_Index_14_XIX_BMC_HV.DE_DCDC_NV_CALID_Index_14, system-signal=DCDC_NV_CALID_Index_14}
        sender-receiver-to-signal-mapping={communication-direction=IN, data-element=Geltungsbereich_E3_1_2_Premium.RP_IF_DCDC_NV_CVN_Byte_2_XIX_BMC_HV.DE_DCDC_NV_CVN_Byte_2, system-signal=DCDC_NV_CVN_Byte_2}
        sender-receiver-to-signal-mapping={communication-direction=IN, data-element=Geltungsbereich_E3_1_2_Premium.RP_IF_DCDC_NV_CALID_Index_11_XIX_BMC_HV.DE_DCDC_NV_CALID_Index_11, system-signal=DCDC_NV_CALID_Index_11}
        sender-receiver-to-signal-mapping={communication-direction=IN, data-element=Geltungsbereich_E3_1_2_Premium.RP_IF_DCDC_NV_CALID_Index_04_XIX_BMC_HV.DE_DCDC_NV_CALID_Index_04, system-signal=DCDC_NV_CALID_Index_04}
        sender-receiver-to-signal-mapping={communication-direction=IN, data-element=Geltungsbereich_E3_1_2_Premium.RP_IF_DCDC_NV_CALID_Index_03_XIX_BMC_HV.DE_DCDC_NV_CALID_Index_03, system-signal=DCDC_NV_CALID_Index_03}
        sender-receiver-to-signal-mapping={communication-direction=IN, data-element=Geltungsbereich_E3_1_2_Premium.RP_IF_DCDC_NV_CVN_Byte_4_XIX_BMC_HV.DE_DCDC_NV_CVN_Byte_4, system-signal=DCDC_NV_CVN_Byte_4}
        sender-receiver-to-signal-mapping={communication-direction=IN, data-element=Geltungsbereich_E3_1_2_Premium.RP_IF_OBD_Barometric_Pressure_XIX_BMC_HV.DE_OBD_Barometric_Pressure, system-signal=OBD_Barometric_Pressure}
        sender-receiver-to-signal-mapping={communication-direction=IN, data-element=Geltungsbereich_E3_1_2_Premium.RP_IF_OBD_NumDcyMilOnReq_XIX_BMC_HV.DE_OBD_NumDcyMilOnReq, system-signal=OBD_NumDcyMilOnReq}
        sender-receiver-to-signal-mapping={communication-direction=IN, data-element=Geltungsbereich_E3_1_2_Premium.RP_IF_OBDProtocol_req_XIX_BMC_HV.DE_OBDProtocol_req, system-signal=OBDProtocol_req}
        sender-receiver-to-signal-group-mapping={communication-direction=IN, data-element=Geltungsbereich_E3_1_2_Premium.RP_IF_SG_KS_Hybrid_01_Challenge_M_XIX_BMC_HV.DE_SG_KS_Hybrid_01_Challenge_M, signal-group=SG_KS_Hybrid_01_Challenge_M, type-mapping=sender-rec-record-type-mapping=record-element-mappings=[{implementation-record-element=KS_Hybrid_01_ChM_SID, system-signal=KS_Hybrid_01_ChM_SID}, {implementation-record-element=KS_Hybrid_01_ChM_IKACtr, system-signal=KS_Hybrid_01_ChM_IKACtr}, {implementation-record-element=KS_Hybrid_01_ChM, system-signal=KS_Hybrid_01_ChM}]}
        sender-receiver-to-signal-group-mapping={communication-direction=IN, data-element=Geltungsbereich_E3_1_2_Premium.RP_IF_SG_KS_Hybrid_01_Response_M_XIX_BMC_HV.DE_SG_KS_Hybrid_01_Response_M, signal-group=SG_KS_Hybrid_01_Response_M, type-mapping=sender-rec-record-type-mapping=record-element-mappings=[{implementation-record-element=KS_Hybrid_01_ReM_SID, system-signal=KS_Hybrid_01_ReM_SID}, {implementation-record-element=KS_Hybrid_01_ReM_IKACtr, system-signal=KS_Hybrid_01_ReM_IKACtr}, {implementation-record-element=KS_Hybrid_01_ReM, system-signal=KS_Hybrid_01_ReM}]}
        sender-receiver-to-signal-mapping={communication-direction=IN, data-element=Geltungsbereich_E3_1_2_Premium.RP_IF_SOK_Zeit_Hybrid_01_Zeit_XIX_BMC_HV.DE_SOK_Zeit_Hybrid_01_Zeit, system-signal=SOK_Zeit_Hybrid_01_Zeit}
        sender-receiver-to-signal-mapping={communication-direction=OUT, data-element=Geltungsbereich_E3_1_2_Premium.SP_IF_SOK_Zeit_Hybrid_01_Challenge_XIX_BMC_HV.DE_SOK_Zeit_Hybrid_01_Challenge, system-signal=SOK_Zeit_Hybrid_01_Challenge}
        sender-receiver-to-signal-mapping={communication-direction=IN, data-element=Geltungsbereich_E3_1_2_Premium.RP_IF_SOK_ungeschuetzte_Zeit_XIX_BMC_HV.DE_SOK_ungeschuetzte_Zeit, system-signal=SOK_ungeschuetzte_Zeit}
        sender-receiver-to-signal-mapping={communication-direction=OUT, data-element=Geltungsbereich_E3_1_2_Premium.SP_IF_BMC_IstTemperaturMin_Sensor_ID_XIX_BMC_HV.DE_BMC_IstTemperaturMin_Sensor_ID, system-signal=BMC_IstTemperaturMin_Sensor_ID}
        sender-receiver-to-signal-mapping={communication-direction=OUT, data-element=Geltungsbereich_E3_1_2_Premium.SP_IF_BMC_IstZellSpannungMin_Modul_ID_XIX_BMC_HV.DE_BMC_IstZellSpannungMin_Modul_ID, system-signal=BMC_IstZellSpannungMin_Modul_ID}
        sender-receiver-to-signal-mapping={communication-direction=OUT, data-element=Geltungsbereich_E3_1_2_Premium.SP_IF_BMC_IstZellSpannungMax_Modul_ID_XIX_BMC_HV.DE_BMC_IstZellSpannungMax_Modul_ID, system-signal=BMC_IstZellSpannungMax_Modul_ID}
        sender-receiver-to-signal-mapping={communication-direction=OUT, data-element=Geltungsbereich_E3_1_2_Premium.SP_IF_BMC_IstZellSpannungMin_Zell_ID_XIX_BMC_HV.DE_BMC_IstZellSpannungMin_Zell_ID, system-signal=BMC_IstZellSpannungMin_Zell_ID}
        sender-receiver-to-signal-mapping={communication-direction=OUT, data-element=Geltungsbereich_E3_1_2_Premium.SP_IF_BMC_IstZellSpannungMax_Zell_ID_XIX_BMC_HV.DE_BMC_IstZellSpannungMax_Zell_ID, system-signal=BMC_IstZellSpannungMax_Zell_ID}
        sender-receiver-to-signal-mapping={communication-direction=OUT, data-element=Geltungsbereich_E3_1_2_Premium.SP_IF_BMC_CMC_Zellspannung_176_XIX_BMC_HV.DE_BMC_CMC_Zellspannung_176, system-signal=BMC_CMC_Zellspannung_176}
        sender-receiver-to-signal-mapping={communication-direction=OUT, data-element=Geltungsbereich_E3_1_2_Premium.SP_IF_BMC_CMC_Zellspannung_173_XIX_BMC_HV.DE_BMC_CMC_Zellspannung_173, system-signal=BMC_CMC_Zellspannung_173}
        sender-receiver-to-signal-mapping={communication-direction=OUT, data-element=Geltungsbereich_E3_1_2_Premium.SP_IF_BMC_CMC_Zellspannung_032_XIX_BMC_HV.DE_BMC_CMC_Zellspannung_032, system-signal=BMC_CMC_Zellspannung_032}
        sender-receiver-to-signal-mapping={communication-direction=OUT, data-element=Geltungsbereich_E3_1_2_Premium.SP_IF_BMC_CMC_Temperatur_010_XIX_BMC_HV.DE_BMC_CMC_Temperatur_010, system-signal=BMC_CMC_Temperatur_010}
        sender-receiver-to-signal-mapping={communication-direction=OUT, data-element=Geltungsbereich_E3_1_2_Premium.SP_IF_BMC_CMC_Temperatur_044_XIX_BMC_HV.DE_BMC_CMC_Temperatur_044, system-signal=BMC_CMC_Temperatur_044}
        sender-receiver-to-signal-mapping={communication-direction=OUT, data-element=Geltungsbereich_E3_1_2_Premium.SP_IF_BMC_CMC_Temperatur_040_XIX_BMC_HV.DE_BMC_CMC_Temperatur_040, system-signal=BMC_CMC_Temperatur_040}
        sender-receiver-to-signal-mapping={communication-direction=OUT, data-element=Geltungsbereich_E3_1_2_Premium.SP_IF_BMC_CMC_Temperatur_066_XIX_BMC_HV.DE_BMC_CMC_Temperatur_066, system-signal=BMC_CMC_Temperatur_066}
        sender-receiver-to-signal-mapping={communication-direction=OUT, data-element=Geltungsbereich_E3_1_2_Premium.SP_IF_BMC_CMC_Temperatur_034_XIX_BMC_HV.DE_BMC_CMC_Temperatur_034, system-signal=BMC_CMC_Temperatur_034}
        sender-receiver-to-signal-mapping={communication-direction=OUT, data-element=Geltungsbereich_E3_1_2_Premium.SP_IF_BMC_CMC_Temperatur_070_XIX_BMC_HV.DE_BMC_CMC_Temperatur_070, system-signal=BMC_CMC_Temperatur_070}
        sender-receiver-to-signal-mapping={communication-direction=OUT, data-element=Geltungsbereich_E3_1_2_Premium.SP_IF_BMC_CMC_Temperatur_013_XIX_BMC_HV.DE_BMC_CMC_Temperatur_013, system-signal=BMC_CMC_Temperatur_013}
        sender-receiver-to-signal-mapping={communication-direction=OUT, data-element=Geltungsbereich_E3_1_2_Premium.SP_IF_BMC_CMC_Temperatur_033_XIX_BMC_HV.DE_BMC_CMC_Temperatur_033, system-signal=BMC_CMC_Temperatur_033}
        sender-receiver-to-signal-mapping={communication-direction=OUT, data-element=Geltungsbereich_E3_1_2_Premium.SP_IF_BMC_CMC_Temperatur_023_XIX_BMC_HV.DE_BMC_CMC_Temperatur_023, system-signal=BMC_CMC_Temperatur_023}
        sender-receiver-to-signal-mapping={communication-direction=OUT, data-element=Geltungsbereich_E3_1_2_Premium.SP_IF_BMC_CMC_Temperatur_063_XIX_BMC_HV.DE_BMC_CMC_Temperatur_063, system-signal=BMC_CMC_Temperatur_063}
        sender-receiver-to-signal-mapping={communication-direction=OUT, data-element=Geltungsbereich_E3_1_2_Premium.SP_IF_BMC_CMC_Temperatur_056_XIX_BMC_HV.DE_BMC_CMC_Temperatur_056, system-signal=BMC_CMC_Temperatur_056}
        sender-receiver-to-signal-mapping={communication-direction=OUT, data-element=Geltungsbereich_E3_1_2_Premium.SP_IF_BMC_CMC_Temperatur_038_XIX_BMC_HV.DE_BMC_CMC_Temperatur_038, system-signal=BMC_CMC_Temperatur_038}
        sender-receiver-to-signal-mapping={communication-direction=OUT, data-element=Geltungsbereich_E3_1_2_Premium.SP_IF_BMC_CMC_Temperatur_065_XIX_BMC_HV.DE_BMC_CMC_Temperatur_065, system-signal=BMC_CMC_Temperatur_065}
        sender-receiver-to-signal-mapping={communication-direction=OUT, data-element=Geltungsbereich_E3_1_2_Premium.SP_IF_BMC_CMC_Temperatur_022_XIX_BMC_HV.DE_BMC_CMC_Temperatur_022, system-signal=BMC_CMC_Temperatur_022}
        sender-receiver-to-signal-mapping={communication-direction=OUT, data-element=Geltungsbereich_E3_1_2_Premium.SP_IF_BMC_CMC_Temperatur_002_XIX_BMC_HV.DE_BMC_CMC_Temperatur_002, system-signal=BMC_CMC_Temperatur_002}
        sender-receiver-to-signal-mapping={communication-direction=OUT, data-element=Geltungsbereich_E3_1_2_Premium.SP_IF_BMC_CMC_Temperatur_024_XIX_BMC_HV.DE_BMC_CMC_Temperatur_024, system-signal=BMC_CMC_Temperatur_024}
        sender-receiver-to-signal-mapping={communication-direction=OUT, data-element=Geltungsbereich_E3_1_2_Premium.SP_IF_BMC_CMC_Temperatur_031_XIX_BMC_HV.DE_BMC_CMC_Temperatur_031, system-signal=BMC_CMC_Temperatur_031}
        sender-receiver-to-signal-mapping={communication-direction=OUT, data-element=Geltungsbereich_E3_1_2_Premium.SP_IF_BMC_CMC_Temperatur_055_XIX_BMC_HV.DE_BMC_CMC_Temperatur_055, system-signal=BMC_CMC_Temperatur_055}
        sender-receiver-to-signal-mapping={communication-direction=OUT, data-element=Geltungsbereich_E3_1_2_Premium.SP_IF_BMC_CMC_Temperatur_027_XIX_BMC_HV.DE_BMC_CMC_Temperatur_027, system-signal=BMC_CMC_Temperatur_027}
        sender-receiver-to-signal-mapping={communication-direction=OUT, data-element=Geltungsbereich_E3_1_2_Premium.SP_IF_BMC_CMC_Temperatur_011_XIX_BMC_HV.DE_BMC_CMC_Temperatur_011, system-signal=BMC_CMC_Temperatur_011}
        sender-receiver-to-signal-mapping={communication-direction=OUT, data-element=Geltungsbereich_E3_1_2_Premium.SP_IF_BMC_CMC_Temperatur_041_XIX_BMC_HV.DE_BMC_CMC_Temperatur_041, system-signal=BMC_CMC_Temperatur_041}
        sender-receiver-to-signal-mapping={communication-direction=OUT, data-element=Geltungsbereich_E3_1_2_Premium.SP_IF_BMC_CMC_Temperatur_052_XIX_BMC_HV.DE_BMC_CMC_Temperatur_052, system-signal=BMC_CMC_Temperatur_052}
        sender-receiver-to-signal-mapping={communication-direction=OUT, data-element=Geltungsbereich_E3_1_2_Premium.SP_IF_BMC_CMC_Temperatur_014_XIX_BMC_HV.DE_BMC_CMC_Temperatur_014, system-signal=BMC_CMC_Temperatur_014}
        sender-receiver-to-signal-mapping={communication-direction=OUT, data-element=Geltungsbereich_E3_1_2_Premium.SP_IF_BMC_CMC_Temperatur_026_XIX_BMC_HV.DE_BMC_CMC_Temperatur_026, system-signal=BMC_CMC_Temperatur_026}
        sender-receiver-to-signal-mapping={communication-direction=OUT, data-element=Geltungsbereich_E3_1_2_Premium.SP_IF_BMC_CMC_Temperatur_067_XIX_BMC_HV.DE_BMC_CMC_Temperatur_067, system-signal=BMC_CMC_Temperatur_067}
        sender-receiver-to-signal-mapping={communication-direction=OUT, data-element=Geltungsbereich_E3_1_2_Premium.SP_IF_BMC_CMC_Temperatur_037_XIX_BMC_HV.DE_BMC_CMC_Temperatur_037, system-signal=BMC_CMC_Temperatur_037}
        sender-receiver-to-signal-mapping={communication-direction=OUT, data-element=Geltungsbereich_E3_1_2_Premium.SP_IF_BMC_CMC_Temperatur_045_XIX_BMC_HV.DE_BMC_CMC_Temperatur_045, system-signal=BMC_CMC_Temperatur_045}
        sender-receiver-to-signal-mapping={communication-direction=OUT, data-element=Geltungsbereich_E3_1_2_Premium.SP_IF_BMC_CMC_Temperatur_050_XIX_BMC_HV.DE_BMC_CMC_Temperatur_050, system-signal=BMC_CMC_Temperatur_050}
        sender-receiver-to-signal-mapping={communication-direction=OUT, data-element=Geltungsbereich_E3_1_2_Premium.SP_IF_BMC_CMC_Temperatur_064_XIX_BMC_HV.DE_BMC_CMC_Temperatur_064, system-signal=BMC_CMC_Temperatur_064}
        sender-receiver-to-signal-mapping={communication-direction=OUT, data-element=Geltungsbereich_E3_1_2_Premium.SP_IF_BMC_CMC_Temperatur_047_XIX_BMC_HV.DE_BMC_CMC_Temperatur_047, system-signal=BMC_CMC_Temperatur_047}
        sender-receiver-to-signal-mapping={communication-direction=OUT, data-element=Geltungsbereich_E3_1_2_Premium.SP_IF_BMC_CMC_Temperatur_069_XIX_BMC_HV.DE_BMC_CMC_Temperatur_069, system-signal=BMC_CMC_Temperatur_069}
        sender-receiver-to-signal-mapping={communication-direction=OUT, data-element=Geltungsbereich_E3_1_2_Premium.SP_IF_BMC_CMC_Temperatur_071_XIX_BMC_HV.DE_BMC_CMC_Temperatur_071, system-signal=BMC_CMC_Temperatur_071}
        sender-receiver-to-signal-mapping={communication-direction=OUT, data-element=Geltungsbereich_E3_1_2_Premium.SP_IF_BMC_CMC_Temperatur_036_XIX_BMC_HV.DE_BMC_CMC_Temperatur_036, system-signal=BMC_CMC_Temperatur_036}
        sender-receiver-to-signal-mapping={communication-direction=OUT, data-element=Geltungsbereich_E3_1_2_Premium.SP_IF_BMC_CMC_Temperatur_049_XIX_BMC_HV.DE_BMC_CMC_Temperatur_049, system-signal=BMC_CMC_Temperatur_049}
        sender-receiver-to-signal-mapping={communication-direction=OUT, data-element=Geltungsbereich_E3_1_2_Premium.SP_IF_BMC_CMC_Temperatur_021_XIX_BMC_HV.DE_BMC_CMC_Temperatur_021, system-signal=BMC_CMC_Temperatur_021}
        sender-receiver-to-signal-mapping={communication-direction=OUT, data-element=Geltungsbereich_E3_1_2_Premium.SP_IF_BMC_CMC_Temperatur_019_XIX_BMC_HV.DE_BMC_CMC_Temperatur_019, system-signal=BMC_CMC_Temperatur_019}
        sender-receiver-to-signal-mapping={communication-direction=OUT, data-element=Geltungsbereich_E3_1_2_Premium.SP_IF_BMC_CMC_Temperatur_015_XIX_BMC_HV.DE_BMC_CMC_Temperatur_015, system-signal=BMC_CMC_Temperatur_015}
        sender-receiver-to-signal-mapping={communication-direction=OUT, data-element=Geltungsbereich_E3_1_2_Premium.SP_IF_BMC_CMC_Temperatur_030_XIX_BMC_HV.DE_BMC_CMC_Temperatur_030, system-signal=BMC_CMC_Temperatur_030}
        sender-receiver-to-signal-mapping={communication-direction=OUT, data-element=Geltungsbereich_E3_1_2_Premium.SP_IF_BMC_CMC_Temperatur_039_XIX_BMC_HV.DE_BMC_CMC_Temperatur_039, system-signal=BMC_CMC_Temperatur_039}
        sender-receiver-to-signal-mapping={communication-direction=OUT, data-element=Geltungsbereich_E3_1_2_Premium.SP_IF_BMC_CMC_Temperatur_059_XIX_BMC_HV.DE_BMC_CMC_Temperatur_059, system-signal=BMC_CMC_Temperatur_059}
        sender-receiver-to-signal-mapping={communication-direction=OUT, data-element=Geltungsbereich_E3_1_2_Premium.SP_IF_BMC_CMC_Temperatur_006_XIX_BMC_HV.DE_BMC_CMC_Temperatur_006, system-signal=BMC_CMC_Temperatur_006}
        sender-receiver-to-signal-mapping={communication-direction=OUT, data-element=Geltungsbereich_E3_1_2_Premium.SP_IF_BMC_CMC_Temperatur_001_XIX_BMC_HV.DE_BMC_CMC_Temperatur_001, system-signal=BMC_CMC_Temperatur_001}
        sender-receiver-to-signal-mapping={communication-direction=OUT, data-element=Geltungsbereich_E3_1_2_Premium.SP_IF_BMC_CMC_Temperatur_062_XIX_BMC_HV.DE_BMC_CMC_Temperatur_062, system-signal=BMC_CMC_Temperatur_062}
        sender-receiver-to-signal-mapping={communication-direction=OUT, data-element=Geltungsbereich_E3_1_2_Premium.SP_IF_BMC_CMC_Temperatur_008_XIX_BMC_HV.DE_BMC_CMC_Temperatur_008, system-signal=BMC_CMC_Temperatur_008}
        sender-receiver-to-signal-mapping={communication-direction=OUT, data-element=Geltungsbereich_E3_1_2_Premium.SP_IF_BMC_CMC_Temperatur_009_XIX_BMC_HV.DE_BMC_CMC_Temperatur_009, system-signal=BMC_CMC_Temperatur_009}
        sender-receiver-to-signal-mapping={communication-direction=OUT, data-element=Geltungsbereich_E3_1_2_Premium.SP_IF_BMC_CMC_Temperatur_068_XIX_BMC_HV.DE_BMC_CMC_Temperatur_068, system-signal=BMC_CMC_Temperatur_068}
        sender-receiver-to-signal-mapping={communication-direction=OUT, data-element=Geltungsbereich_E3_1_2_Premium.SP_IF_BMC_CMC_Temperatur_007_XIX_BMC_HV.DE_BMC_CMC_Temperatur_007, system-signal=BMC_CMC_Temperatur_007}
        sender-receiver-to-signal-mapping={communication-direction=OUT, data-element=Geltungsbereich_E3_1_2_Premium.SP_IF_BMC_CMC_Temperatur_012_XIX_BMC_HV.DE_BMC_CMC_Temperatur_012, system-signal=BMC_CMC_Temperatur_012}
        sender-receiver-to-signal-mapping={communication-direction=OUT, data-element=Geltungsbereich_E3_1_2_Premium.SP_IF_BMC_CMC_Temperatur_051_XIX_BMC_HV.DE_BMC_CMC_Temperatur_051, system-signal=BMC_CMC_Temperatur_051}
        sender-receiver-to-signal-mapping={communication-direction=OUT, data-element=Geltungsbereich_E3_1_2_Premium.SP_IF_BMC_CMC_Temperatur_048_XIX_BMC_HV.DE_BMC_CMC_Temperatur_048, system-signal=BMC_CMC_Temperatur_048}
        sender-receiver-to-signal-mapping={communication-direction=OUT, data-element=Geltungsbereich_E3_1_2_Premium.SP_IF_BMC_CMC_Temperatur_046_XIX_BMC_HV.DE_BMC_CMC_Temperatur_046, system-signal=BMC_CMC_Temperatur_046}
        sender-receiver-to-signal-mapping={communication-direction=OUT, data-element=Geltungsbereich_E3_1_2_Premium.SP_IF_BMC_CMC_Temperatur_072_XIX_BMC_HV.DE_BMC_CMC_Temperatur_072, system-signal=BMC_CMC_Temperatur_072}
        sender-receiver-to-signal-mapping={communication-direction=OUT, data-element=Geltungsbereich_E3_1_2_Premium.SP_IF_BMC_CMC_Temperatur_017_XIX_BMC_HV.DE_BMC_CMC_Temperatur_017, system-signal=BMC_CMC_Temperatur_017}
        sender-receiver-to-signal-mapping={communication-direction=OUT, data-element=Geltungsbereich_E3_1_2_Premium.SP_IF_BMC_CMC_Temperatur_060_XIX_BMC_HV.DE_BMC_CMC_Temperatur_060, system-signal=BMC_CMC_Temperatur_060}
        sender-receiver-to-signal-mapping={communication-direction=OUT, data-element=Geltungsbereich_E3_1_2_Premium.SP_IF_BMC_CMC_Temperatur_003_XIX_BMC_HV.DE_BMC_CMC_Temperatur_003, system-signal=BMC_CMC_Temperatur_003}
        sender-receiver-to-signal-mapping={communication-direction=OUT, data-element=Geltungsbereich_E3_1_2_Premium.SP_IF_BMC_CMC_Temperatur_057_XIX_BMC_HV.DE_BMC_CMC_Temperatur_057, system-signal=BMC_CMC_Temperatur_057}
        sender-receiver-to-signal-mapping={communication-direction=OUT, data-element=Geltungsbereich_E3_1_2_Premium.SP_IF_BMC_CMC_Temperatur_016_XIX_BMC_HV.DE_BMC_CMC_Temperatur_016, system-signal=BMC_CMC_Temperatur_016}
        sender-receiver-to-signal-mapping={communication-direction=OUT, data-element=Geltungsbereich_E3_1_2_Premium.SP_IF_BMC_CMC_Temperatur_005_XIX_BMC_HV.DE_BMC_CMC_Temperatur_005, system-signal=BMC_CMC_Temperatur_005}
        sender-receiver-to-signal-mapping={communication-direction=OUT, data-element=Geltungsbereich_E3_1_2_Premium.SP_IF_BMC_CMC_Temperatur_061_XIX_BMC_HV.DE_BMC_CMC_Temperatur_061, system-signal=BMC_CMC_Temperatur_061}
        sender-receiver-to-signal-mapping={communication-direction=OUT, data-element=Geltungsbereich_E3_1_2_Premium.SP_IF_BMC_CMC_Temperatur_054_XIX_BMC_HV.DE_BMC_CMC_Temperatur_054, system-signal=BMC_CMC_Temperatur_054}
        sender-receiver-to-signal-mapping={communication-direction=OUT, data-element=Geltungsbereich_E3_1_2_Premium.SP_IF_BMC_CMC_Temperatur_004_XIX_BMC_HV.DE_BMC_CMC_Temperatur_004, system-signal=BMC_CMC_Temperatur_004}
        sender-receiver-to-signal-mapping={communication-direction=OUT, data-element=Geltungsbereich_E3_1_2_Premium.SP_IF_BMC_CMC_Temperatur_032_XIX_BMC_HV.DE_BMC_CMC_Temperatur_032, system-signal=BMC_CMC_Temperatur_032}
        sender-receiver-to-signal-mapping={communication-direction=OUT, data-element=Geltungsbereich_E3_1_2_Premium.SP_IF_BMC_CMC_Temperatur_058_XIX_BMC_HV.DE_BMC_CMC_Temperatur_058, system-signal=BMC_CMC_Temperatur_058}
        sender-receiver-to-signal-mapping={communication-direction=OUT, data-element=Geltungsbereich_E3_1_2_Premium.SP_IF_BMC_CMC_Temperatur_029_XIX_BMC_HV.DE_BMC_CMC_Temperatur_029, system-signal=BMC_CMC_Temperatur_029}
        sender-receiver-to-signal-mapping={communication-direction=OUT, data-element=Geltungsbereich_E3_1_2_Premium.SP_IF_BMC_CMC_Temperatur_025_XIX_BMC_HV.DE_BMC_CMC_Temperatur_025, system-signal=BMC_CMC_Temperatur_025}
        sender-receiver-to-signal-mapping={communication-direction=OUT, data-element=Geltungsbereich_E3_1_2_Premium.SP_IF_BMC_CMC_Temperatur_042_XIX_BMC_HV.DE_BMC_CMC_Temperatur_042, system-signal=BMC_CMC_Temperatur_042}
        sender-receiver-to-signal-mapping={communication-direction=OUT, data-element=Geltungsbereich_E3_1_2_Premium.SP_IF_BMC_CMC_Temperatur_028_XIX_BMC_HV.DE_BMC_CMC_Temperatur_028, system-signal=BMC_CMC_Temperatur_028}
        sender-receiver-to-signal-mapping={communication-direction=OUT, data-element=Geltungsbereich_E3_1_2_Premium.SP_IF_BMC_CMC_Temperatur_018_XIX_BMC_HV.DE_BMC_CMC_Temperatur_018, system-signal=BMC_CMC_Temperatur_018}
        sender-receiver-to-signal-mapping={communication-direction=OUT, data-element=Geltungsbereich_E3_1_2_Premium.SP_IF_BMC_CMC_Temperatur_053_XIX_BMC_HV.DE_BMC_CMC_Temperatur_053, system-signal=BMC_CMC_Temperatur_053}
        sender-receiver-to-signal-mapping={communication-direction=OUT, data-element=Geltungsbereich_E3_1_2_Premium.SP_IF_BMC_CMC_Temperatur_035_XIX_BMC_HV.DE_BMC_CMC_Temperatur_035, system-signal=BMC_CMC_Temperatur_035}
        sender-receiver-to-signal-mapping={communication-direction=OUT, data-element=Geltungsbereich_E3_1_2_Premium.SP_IF_BMC_CMC_Temperatur_043_XIX_BMC_HV.DE_BMC_CMC_Temperatur_043, system-signal=BMC_CMC_Temperatur_043}
        sender-receiver-to-signal-mapping={communication-direction=OUT, data-element=Geltungsbereich_E3_1_2_Premium.SP_IF_BMC_CMC_Temperatur_020_XIX_BMC_HV.DE_BMC_CMC_Temperatur_020, system-signal=BMC_CMC_Temperatur_020}
        sender-receiver-to-signal-mapping={communication-direction=OUT, data-element=Geltungsbereich_E3_1_2_Premium.SP_IF_BMC_CMC_Zellspannung_025_XIX_BMC_HV.DE_BMC_CMC_Zellspannung_025, system-signal=BMC_CMC_Zellspannung_025}
        sender-receiver-to-signal-mapping={communication-direction=OUT, data-element=Geltungsbereich_E3_1_2_Premium.SP_IF_BMC_CMC_Zellspannung_146_XIX_BMC_HV.DE_BMC_CMC_Zellspannung_146, system-signal=BMC_CMC_Zellspannung_146}
        sender-receiver-to-signal-mapping={communication-direction=OUT, data-element=Geltungsbereich_E3_1_2_Premium.SP_IF_BMC_CMC_Zellspannung_059_XIX_BMC_HV.DE_BMC_CMC_Zellspannung_059, system-signal=BMC_CMC_Zellspannung_059}
        sender-receiver-to-signal-mapping={communication-direction=OUT, data-element=Geltungsbereich_E3_1_2_Premium.SP_IF_BMC_CMC_Zellspannung_073_XIX_BMC_HV.DE_BMC_CMC_Zellspannung_073, system-signal=BMC_CMC_Zellspannung_073}
        sender-receiver-to-signal-mapping={communication-direction=OUT, data-element=Geltungsbereich_E3_1_2_Premium.SP_IF_BMC_CMC_Zellspannung_191_XIX_BMC_HV.DE_BMC_CMC_Zellspannung_191, system-signal=BMC_CMC_Zellspannung_191}
        sender-receiver-to-signal-mapping={communication-direction=OUT, data-element=Geltungsbereich_E3_1_2_Premium.SP_IF_BMC_CMC_Zellspannung_120_XIX_BMC_HV.DE_BMC_CMC_Zellspannung_120, system-signal=BMC_CMC_Zellspannung_120}
        sender-receiver-to-signal-mapping={communication-direction=OUT, data-element=Geltungsbereich_E3_1_2_Premium.SP_IF_BMC_CMC_Zellspannung_045_XIX_BMC_HV.DE_BMC_CMC_Zellspannung_045, system-signal=BMC_CMC_Zellspannung_045}
        sender-receiver-to-signal-mapping={communication-direction=OUT, data-element=Geltungsbereich_E3_1_2_Premium.SP_IF_BMC_CMC_Zellspannung_015_XIX_BMC_HV.DE_BMC_CMC_Zellspannung_015, system-signal=BMC_CMC_Zellspannung_015}
        sender-receiver-to-signal-mapping={communication-direction=OUT, data-element=Geltungsbereich_E3_1_2_Premium.SP_IF_BMC_CMC_Zellspannung_043_XIX_BMC_HV.DE_BMC_CMC_Zellspannung_043, system-signal=BMC_CMC_Zellspannung_043}
        sender-receiver-to-signal-mapping={communication-direction=OUT, data-element=Geltungsbereich_E3_1_2_Premium.SP_IF_BMC_CMC_Zellspannung_140_XIX_BMC_HV.DE_BMC_CMC_Zellspannung_140, system-signal=BMC_CMC_Zellspannung_140}
        sender-receiver-to-signal-mapping={communication-direction=OUT, data-element=Geltungsbereich_E3_1_2_Premium.SP_IF_BMC_CMC_Zellspannung_101_XIX_BMC_HV.DE_BMC_CMC_Zellspannung_101, system-signal=BMC_CMC_Zellspannung_101}
        sender-receiver-to-signal-mapping={communication-direction=OUT, data-element=Geltungsbereich_E3_1_2_Premium.SP_IF_BMC_CMC_Zellspannung_075_XIX_BMC_HV.DE_BMC_CMC_Zellspannung_075, system-signal=BMC_CMC_Zellspannung_075}
        sender-receiver-to-signal-mapping={communication-direction=OUT, data-element=Geltungsbereich_E3_1_2_Premium.SP_IF_BMC_CMC_Zellspannung_181_XIX_BMC_HV.DE_BMC_CMC_Zellspannung_181, system-signal=BMC_CMC_Zellspannung_181}
        sender-receiver-to-signal-mapping={communication-direction=OUT, data-element=Geltungsbereich_E3_1_2_Premium.SP_IF_BMC_CMC_Zellspannung_110_XIX_BMC_HV.DE_BMC_CMC_Zellspannung_110, system-signal=BMC_CMC_Zellspannung_110}
        sender-receiver-to-signal-mapping={communication-direction=OUT, data-element=Geltungsbereich_E3_1_2_Premium.SP_IF_BMC_CMC_Zellspannung_018_XIX_BMC_HV.DE_BMC_CMC_Zellspannung_018, system-signal=BMC_CMC_Zellspannung_018}
        sender-receiver-to-signal-mapping={communication-direction=OUT, data-element=Geltungsbereich_E3_1_2_Premium.SP_IF_BMC_CMC_Zellspannung_088_XIX_BMC_HV.DE_BMC_CMC_Zellspannung_088, system-signal=BMC_CMC_Zellspannung_088}
        sender-receiver-to-signal-mapping={communication-direction=OUT, data-element=Geltungsbereich_E3_1_2_Premium.SP_IF_BMC_CMC_Zellspannung_111_XIX_BMC_HV.DE_BMC_CMC_Zellspannung_111, system-signal=BMC_CMC_Zellspannung_111}
        sender-receiver-to-signal-mapping={communication-direction=OUT, data-element=Geltungsbereich_E3_1_2_Premium.SP_IF_BMC_CMC_Zellspannung_158_XIX_BMC_HV.DE_BMC_CMC_Zellspannung_158, system-signal=BMC_CMC_Zellspannung_158}
        sender-receiver-to-signal-mapping={communication-direction=OUT, data-element=Geltungsbereich_E3_1_2_Premium.SP_IF_BMC_CMC_Zellspannung_113_XIX_BMC_HV.DE_BMC_CMC_Zellspannung_113, system-signal=BMC_CMC_Zellspannung_113}
        sender-receiver-to-signal-mapping={communication-direction=OUT, data-element=Geltungsbereich_E3_1_2_Premium.SP_IF_BMC_CMC_Zellspannung_152_XIX_BMC_HV.DE_BMC_CMC_Zellspannung_152, system-signal=BMC_CMC_Zellspannung_152}
        sender-receiver-to-signal-mapping={communication-direction=OUT, data-element=Geltungsbereich_E3_1_2_Premium.SP_IF_BMC_CMC_Zellspannung_019_XIX_BMC_HV.DE_BMC_CMC_Zellspannung_019, system-signal=BMC_CMC_Zellspannung_019}
        sender-receiver-to-signal-mapping={communication-direction=OUT, data-element=Geltungsbereich_E3_1_2_Premium.SP_IF_BMC_CMC_Zellspannung_013_XIX_BMC_HV.DE_BMC_CMC_Zellspannung_013, system-signal=BMC_CMC_Zellspannung_013}
        sender-receiver-to-signal-mapping={communication-direction=OUT, data-element=Geltungsbereich_E3_1_2_Premium.SP_IF_BMC_CMC_Zellspannung_123_XIX_BMC_HV.DE_BMC_CMC_Zellspannung_123, system-signal=BMC_CMC_Zellspannung_123}
        sender-receiver-to-signal-mapping={communication-direction=OUT, data-element=Geltungsbereich_E3_1_2_Premium.SP_IF_BMC_CMC_Zellspannung_069_XIX_BMC_HV.DE_BMC_CMC_Zellspannung_069, system-signal=BMC_CMC_Zellspannung_069}
        sender-receiver-to-signal-mapping={communication-direction=OUT, data-element=Geltungsbereich_E3_1_2_Premium.SP_IF_BMC_CMC_Zellspannung_023_XIX_BMC_HV.DE_BMC_CMC_Zellspannung_023, system-signal=BMC_CMC_Zellspannung_023}
        sender-receiver-to-signal-mapping={communication-direction=OUT, data-element=Geltungsbereich_E3_1_2_Premium.SP_IF_BMC_CMC_Zellspannung_129_XIX_BMC_HV.DE_BMC_CMC_Zellspannung_129, system-signal=BMC_CMC_Zellspannung_129}
        sender-receiver-to-signal-mapping={communication-direction=OUT, data-element=Geltungsbereich_E3_1_2_Premium.SP_IF_BMC_CMC_Zellspannung_042_XIX_BMC_HV.DE_BMC_CMC_Zellspannung_042, system-signal=BMC_CMC_Zellspannung_042}
        sender-receiver-to-signal-mapping={communication-direction=OUT, data-element=Geltungsbereich_E3_1_2_Premium.SP_IF_BMC_CMC_Zellspannung_137_XIX_BMC_HV.DE_BMC_CMC_Zellspannung_137, system-signal=BMC_CMC_Zellspannung_137}
        sender-receiver-to-signal-mapping={communication-direction=OUT, data-element=Geltungsbereich_E3_1_2_Premium.SP_IF_BMC_CMC_Zellspannung_150_XIX_BMC_HV.DE_BMC_CMC_Zellspannung_150, system-signal=BMC_CMC_Zellspannung_150}
        sender-receiver-to-signal-mapping={communication-direction=OUT, data-element=Geltungsbereich_E3_1_2_Premium.SP_IF_BMC_CMC_Zellspannung_031_XIX_BMC_HV.DE_BMC_CMC_Zellspannung_031, system-signal=BMC_CMC_Zellspannung_031}
        sender-receiver-to-signal-mapping={communication-direction=OUT, data-element=Geltungsbereich_E3_1_2_Premium.SP_IF_BMC_CMC_Zellspannung_057_XIX_BMC_HV.DE_BMC_CMC_Zellspannung_057, system-signal=BMC_CMC_Zellspannung_057}
        sender-receiver-to-signal-mapping={communication-direction=OUT, data-element=Geltungsbereich_E3_1_2_Premium.SP_IF_BMC_CMC_Zellspannung_178_XIX_BMC_HV.DE_BMC_CMC_Zellspannung_178, system-signal=BMC_CMC_Zellspannung_178}
        sender-receiver-to-signal-mapping={communication-direction=OUT, data-element=Geltungsbereich_E3_1_2_Premium.SP_IF_BMC_CMC_Zellspannung_090_XIX_BMC_HV.DE_BMC_CMC_Zellspannung_090, system-signal=BMC_CMC_Zellspannung_090}
        sender-receiver-to-signal-mapping={communication-direction=OUT, data-element=Geltungsbereich_E3_1_2_Premium.SP_IF_BMC_CMC_Zellspannung_080_XIX_BMC_HV.DE_BMC_CMC_Zellspannung_080, system-signal=BMC_CMC_Zellspannung_080}
        sender-receiver-to-signal-mapping={communication-direction=OUT, data-element=Geltungsbereich_E3_1_2_Premium.SP_IF_BMC_CMC_Zellspannung_054_XIX_BMC_HV.DE_BMC_CMC_Zellspannung_054, system-signal=BMC_CMC_Zellspannung_054}
        sender-receiver-to-signal-mapping={communication-direction=OUT, data-element=Geltungsbereich_E3_1_2_Premium.SP_IF_BMC_CMC_Zellspannung_067_XIX_BMC_HV.DE_BMC_CMC_Zellspannung_067, system-signal=BMC_CMC_Zellspannung_067}
        sender-receiver-to-signal-mapping={communication-direction=OUT, data-element=Geltungsbereich_E3_1_2_Premium.SP_IF_BMC_CMC_Zellspannung_076_XIX_BMC_HV.DE_BMC_CMC_Zellspannung_076, system-signal=BMC_CMC_Zellspannung_076}
        sender-receiver-to-signal-mapping={communication-direction=OUT, data-element=Geltungsbereich_E3_1_2_Premium.SP_IF_BMC_CMC_Zellspannung_189_XIX_BMC_HV.DE_BMC_CMC_Zellspannung_189, system-signal=BMC_CMC_Zellspannung_189}
        sender-receiver-to-signal-mapping={communication-direction=OUT, data-element=Geltungsbereich_E3_1_2_Premium.SP_IF_BMC_CMC_Zellspannung_131_XIX_BMC_HV.DE_BMC_CMC_Zellspannung_131, system-signal=BMC_CMC_Zellspannung_131}
        sender-receiver-to-signal-mapping={communication-direction=OUT, data-element=Geltungsbereich_E3_1_2_Premium.SP_IF_BMC_CMC_Zellspannung_115_XIX_BMC_HV.DE_BMC_CMC_Zellspannung_115, system-signal=BMC_CMC_Zellspannung_115}
        sender-receiver-to-signal-mapping={communication-direction=OUT, data-element=Geltungsbereich_E3_1_2_Premium.SP_IF_BMC_CMC_Zellspannung_005_XIX_BMC_HV.DE_BMC_CMC_Zellspannung_005, system-signal=BMC_CMC_Zellspannung_005}
        sender-receiver-to-signal-mapping={communication-direction=OUT, data-element=Geltungsbereich_E3_1_2_Premium.SP_IF_BMC_CMC_Zellspannung_098_XIX_BMC_HV.DE_BMC_CMC_Zellspannung_098, system-signal=BMC_CMC_Zellspannung_098}
        sender-receiver-to-signal-mapping={communication-direction=OUT, data-element=Geltungsbereich_E3_1_2_Premium.SP_IF_BMC_CMC_Zellspannung_133_XIX_BMC_HV.DE_BMC_CMC_Zellspannung_133, system-signal=BMC_CMC_Zellspannung_133}
        sender-receiver-to-signal-mapping={communication-direction=OUT, data-element=Geltungsbereich_E3_1_2_Premium.SP_IF_BMC_CMC_Zellspannung_077_XIX_BMC_HV.DE_BMC_CMC_Zellspannung_077, system-signal=BMC_CMC_Zellspannung_077}
        sender-receiver-to-signal-mapping={communication-direction=OUT, data-element=Geltungsbereich_E3_1_2_Premium.SP_IF_BMC_CMC_Zellspannung_089_XIX_BMC_HV.DE_BMC_CMC_Zellspannung_089, system-signal=BMC_CMC_Zellspannung_089}
        sender-receiver-to-signal-mapping={communication-direction=OUT, data-element=Geltungsbereich_E3_1_2_Premium.SP_IF_BMC_CMC_Zellspannung_091_XIX_BMC_HV.DE_BMC_CMC_Zellspannung_091, system-signal=BMC_CMC_Zellspannung_091}
        sender-receiver-to-signal-mapping={communication-direction=OUT, data-element=Geltungsbereich_E3_1_2_Premium.SP_IF_BMC_CMC_Zellspannung_180_XIX_BMC_HV.DE_BMC_CMC_Zellspannung_180, system-signal=BMC_CMC_Zellspannung_180}
        sender-receiver-to-signal-mapping={communication-direction=OUT, data-element=Geltungsbereich_E3_1_2_Premium.SP_IF_BMC_CMC_Zellspannung_065_XIX_BMC_HV.DE_BMC_CMC_Zellspannung_065, system-signal=BMC_CMC_Zellspannung_065}
        sender-receiver-to-signal-mapping={communication-direction=OUT, data-element=Geltungsbereich_E3_1_2_Premium.SP_IF_BMC_CMC_Zellspannung_119_XIX_BMC_HV.DE_BMC_CMC_Zellspannung_119, system-signal=BMC_CMC_Zellspannung_119}
        sender-receiver-to-signal-mapping={communication-direction=OUT, data-element=Geltungsbereich_E3_1_2_Premium.SP_IF_BMC_CMC_Zellspannung_004_XIX_BMC_HV.DE_BMC_CMC_Zellspannung_004, system-signal=BMC_CMC_Zellspannung_004}
        sender-receiver-to-signal-mapping={communication-direction=OUT, data-element=Geltungsbereich_E3_1_2_Premium.SP_IF_BMC_CMC_Zellspannung_100_XIX_BMC_HV.DE_BMC_CMC_Zellspannung_100, system-signal=BMC_CMC_Zellspannung_100}
        sender-receiver-to-signal-mapping={communication-direction=OUT, data-element=Geltungsbereich_E3_1_2_Premium.SP_IF_BMC_CMC_Zellspannung_162_XIX_BMC_HV.DE_BMC_CMC_Zellspannung_162, system-signal=BMC_CMC_Zellspannung_162}
        sender-receiver-to-signal-mapping={communication-direction=OUT, data-element=Geltungsbereich_E3_1_2_Premium.SP_IF_BMC_CMC_Zellspannung_093_XIX_BMC_HV.DE_BMC_CMC_Zellspannung_093, system-signal=BMC_CMC_Zellspannung_093}
        sender-receiver-to-signal-mapping={communication-direction=OUT, data-element=Geltungsbereich_E3_1_2_Premium.SP_IF_BMC_CMC_Zellspannung_185_XIX_BMC_HV.DE_BMC_CMC_Zellspannung_185, system-signal=BMC_CMC_Zellspannung_185}
        sender-receiver-to-signal-mapping={communication-direction=OUT, data-element=Geltungsbereich_E3_1_2_Premium.SP_IF_BMC_CMC_Zellspannung_055_XIX_BMC_HV.DE_BMC_CMC_Zellspannung_055, system-signal=BMC_CMC_Zellspannung_055}
        sender-receiver-to-signal-mapping={communication-direction=OUT, data-element=Geltungsbereich_E3_1_2_Premium.SP_IF_BMC_CMC_Zellspannung_169_XIX_BMC_HV.DE_BMC_CMC_Zellspannung_169, system-signal=BMC_CMC_Zellspannung_169}
        sender-receiver-to-signal-mapping={communication-direction=OUT, data-element=Geltungsbereich_E3_1_2_Premium.SP_IF_BMC_CMC_Zellspannung_053_XIX_BMC_HV.DE_BMC_CMC_Zellspannung_053, system-signal=BMC_CMC_Zellspannung_053}
        sender-receiver-to-signal-mapping={communication-direction=OUT, data-element=Geltungsbereich_E3_1_2_Premium.SP_IF_BMC_CMC_Zellspannung_118_XIX_BMC_HV.DE_BMC_CMC_Zellspannung_118, system-signal=BMC_CMC_Zellspannung_118}
        sender-receiver-to-signal-mapping={communication-direction=OUT, data-element=Geltungsbereich_E3_1_2_Premium.SP_IF_BMC_CMC_Zellspannung_034_XIX_BMC_HV.DE_BMC_CMC_Zellspannung_034, system-signal=BMC_CMC_Zellspannung_034}
        sender-receiver-to-signal-mapping={communication-direction=OUT, data-element=Geltungsbereich_E3_1_2_Premium.SP_IF_BMC_CMC_Zellspannung_190_XIX_BMC_HV.DE_BMC_CMC_Zellspannung_190, system-signal=BMC_CMC_Zellspannung_190}
        sender-receiver-to-signal-mapping={communication-direction=OUT, data-element=Geltungsbereich_E3_1_2_Premium.SP_IF_BMC_CMC_Zellspannung_006_XIX_BMC_HV.DE_BMC_CMC_Zellspannung_006, system-signal=BMC_CMC_Zellspannung_006}
        sender-receiver-to-signal-mapping={communication-direction=OUT, data-element=Geltungsbereich_E3_1_2_Premium.SP_IF_BMC_CMC_Zellspannung_041_XIX_BMC_HV.DE_BMC_CMC_Zellspannung_041, system-signal=BMC_CMC_Zellspannung_041}
        sender-receiver-to-signal-mapping={communication-direction=OUT, data-element=Geltungsbereich_E3_1_2_Premium.SP_IF_BMC_CMC_Zellspannung_014_XIX_BMC_HV.DE_BMC_CMC_Zellspannung_014, system-signal=BMC_CMC_Zellspannung_014}
        sender-receiver-to-signal-mapping={communication-direction=OUT, data-element=Geltungsbereich_E3_1_2_Premium.SP_IF_BMC_CMC_Zellspannung_108_XIX_BMC_HV.DE_BMC_CMC_Zellspannung_108, system-signal=BMC_CMC_Zellspannung_108}
        sender-receiver-to-signal-mapping={communication-direction=OUT, data-element=Geltungsbereich_E3_1_2_Premium.SP_IF_BMC_CMC_Zellspannung_008_XIX_BMC_HV.DE_BMC_CMC_Zellspannung_008, system-signal=BMC_CMC_Zellspannung_008}
        sender-receiver-to-signal-mapping={communication-direction=OUT, data-element=Geltungsbereich_E3_1_2_Premium.SP_IF_BMC_CMC_Zellspannung_051_XIX_BMC_HV.DE_BMC_CMC_Zellspannung_051, system-signal=BMC_CMC_Zellspannung_051}
        sender-receiver-to-signal-mapping={communication-direction=OUT, data-element=Geltungsbereich_E3_1_2_Premium.SP_IF_BMC_CMC_Zellspannung_177_XIX_BMC_HV.DE_BMC_CMC_Zellspannung_177, system-signal=BMC_CMC_Zellspannung_177}
        sender-receiver-to-signal-mapping={communication-direction=OUT, data-element=Geltungsbereich_E3_1_2_Premium.SP_IF_BMC_CMC_Zellspannung_037_XIX_BMC_HV.DE_BMC_CMC_Zellspannung_037, system-signal=BMC_CMC_Zellspannung_037}
        sender-receiver-to-signal-mapping={communication-direction=OUT, data-element=Geltungsbereich_E3_1_2_Premium.SP_IF_BMC_CMC_Zellspannung_052_XIX_BMC_HV.DE_BMC_CMC_Zellspannung_052, system-signal=BMC_CMC_Zellspannung_052}
        sender-receiver-to-signal-mapping={communication-direction=OUT, data-element=Geltungsbereich_E3_1_2_Premium.SP_IF_BMC_CMC_Zellspannung_064_XIX_BMC_HV.DE_BMC_CMC_Zellspannung_064, system-signal=BMC_CMC_Zellspannung_064}
        sender-receiver-to-signal-mapping={communication-direction=OUT, data-element=Geltungsbereich_E3_1_2_Premium.SP_IF_BMC_CMC_Zellspannung_105_XIX_BMC_HV.DE_BMC_CMC_Zellspannung_105, system-signal=BMC_CMC_Zellspannung_105}
        sender-receiver-to-signal-mapping={communication-direction=OUT, data-element=Geltungsbereich_E3_1_2_Premium.SP_IF_BMC_CMC_Zellspannung_151_XIX_BMC_HV.DE_BMC_CMC_Zellspannung_151, system-signal=BMC_CMC_Zellspannung_151}
        sender-receiver-to-signal-mapping={communication-direction=OUT, data-element=Geltungsbereich_E3_1_2_Premium.SP_IF_BMC_CMC_Zellspannung_103_XIX_BMC_HV.DE_BMC_CMC_Zellspannung_103, system-signal=BMC_CMC_Zellspannung_103}
        sender-receiver-to-signal-mapping={communication-direction=OUT, data-element=Geltungsbereich_E3_1_2_Premium.SP_IF_BMC_CMC_Zellspannung_082_XIX_BMC_HV.DE_BMC_CMC_Zellspannung_082, system-signal=BMC_CMC_Zellspannung_082}
        sender-receiver-to-signal-mapping={communication-direction=OUT, data-element=Geltungsbereich_E3_1_2_Premium.SP_IF_BMC_CMC_Zellspannung_063_XIX_BMC_HV.DE_BMC_CMC_Zellspannung_063, system-signal=BMC_CMC_Zellspannung_063}
        sender-receiver-to-signal-mapping={communication-direction=OUT, data-element=Geltungsbereich_E3_1_2_Premium.SP_IF_BMC_CMC_Zellspannung_047_XIX_BMC_HV.DE_BMC_CMC_Zellspannung_047, system-signal=BMC_CMC_Zellspannung_047}
        sender-receiver-to-signal-mapping={communication-direction=OUT, data-element=Geltungsbereich_E3_1_2_Premium.SP_IF_BMC_CMC_Zellspannung_085_XIX_BMC_HV.DE_BMC_CMC_Zellspannung_085, system-signal=BMC_CMC_Zellspannung_085}
        sender-receiver-to-signal-mapping={communication-direction=OUT, data-element=Geltungsbereich_E3_1_2_Premium.SP_IF_BMC_CMC_Zellspannung_083_XIX_BMC_HV.DE_BMC_CMC_Zellspannung_083, system-signal=BMC_CMC_Zellspannung_083}
        sender-receiver-to-signal-mapping={communication-direction=OUT, data-element=Geltungsbereich_E3_1_2_Premium.SP_IF_BMC_CMC_Zellspannung_130_XIX_BMC_HV.DE_BMC_CMC_Zellspannung_130, system-signal=BMC_CMC_Zellspannung_130}
        sender-receiver-to-signal-mapping={communication-direction=OUT, data-element=Geltungsbereich_E3_1_2_Premium.SP_IF_BMC_CMC_Zellspannung_141_XIX_BMC_HV.DE_BMC_CMC_Zellspannung_141, system-signal=BMC_CMC_Zellspannung_141}
        sender-receiver-to-signal-mapping={communication-direction=OUT, data-element=Geltungsbereich_E3_1_2_Premium.SP_IF_BMC_CMC_Zellspannung_033_XIX_BMC_HV.DE_BMC_CMC_Zellspannung_033, system-signal=BMC_CMC_Zellspannung_033}
        sender-receiver-to-signal-mapping={communication-direction=OUT, data-element=Geltungsbereich_E3_1_2_Premium.SP_IF_BMC_CMC_Zellspannung_001_XIX_BMC_HV.DE_BMC_CMC_Zellspannung_001, system-signal=BMC_CMC_Zellspannung_001}
        sender-receiver-to-signal-mapping={communication-direction=OUT, data-element=Geltungsbereich_E3_1_2_Premium.SP_IF_BMC_CMC_Zellspannung_170_XIX_BMC_HV.DE_BMC_CMC_Zellspannung_170, system-signal=BMC_CMC_Zellspannung_170}
        sender-receiver-to-signal-mapping={communication-direction=OUT, data-element=Geltungsbereich_E3_1_2_Premium.SP_IF_BMC_CMC_Zellspannung_097_XIX_BMC_HV.DE_BMC_CMC_Zellspannung_097, system-signal=BMC_CMC_Zellspannung_097}
        sender-receiver-to-signal-mapping={communication-direction=OUT, data-element=Geltungsbereich_E3_1_2_Premium.SP_IF_BMC_CMC_Zellspannung_040_XIX_BMC_HV.DE_BMC_CMC_Zellspannung_040, system-signal=BMC_CMC_Zellspannung_040}
        sender-receiver-to-signal-mapping={communication-direction=OUT, data-element=Geltungsbereich_E3_1_2_Premium.SP_IF_BMC_CMC_Zellspannung_038_XIX_BMC_HV.DE_BMC_CMC_Zellspannung_038, system-signal=BMC_CMC_Zellspannung_038}
        sender-receiver-to-signal-mapping={communication-direction=OUT, data-element=Geltungsbereich_E3_1_2_Premium.SP_IF_BMC_CMC_Zellspannung_095_XIX_BMC_HV.DE_BMC_CMC_Zellspannung_095, system-signal=BMC_CMC_Zellspannung_095}
        sender-receiver-to-signal-mapping={communication-direction=OUT, data-element=Geltungsbereich_E3_1_2_Premium.SP_IF_BMC_CMC_Zellspannung_136_XIX_BMC_HV.DE_BMC_CMC_Zellspannung_136, system-signal=BMC_CMC_Zellspannung_136}
        sender-receiver-to-signal-mapping={communication-direction=OUT, data-element=Geltungsbereich_E3_1_2_Premium.SP_IF_BMC_CMC_Zellspannung_192_XIX_BMC_HV.DE_BMC_CMC_Zellspannung_192, system-signal=BMC_CMC_Zellspannung_192}
        sender-receiver-to-signal-mapping={communication-direction=OUT, data-element=Geltungsbereich_E3_1_2_Premium.SP_IF_BMC_CMC_Zellspannung_024_XIX_BMC_HV.DE_BMC_CMC_Zellspannung_024, system-signal=BMC_CMC_Zellspannung_024}
        sender-receiver-to-signal-mapping={communication-direction=OUT, data-element=Geltungsbereich_E3_1_2_Premium.SP_IF_BMC_CMC_Zellspannung_046_XIX_BMC_HV.DE_BMC_CMC_Zellspannung_046, system-signal=BMC_CMC_Zellspannung_046}
        sender-receiver-to-signal-mapping={communication-direction=OUT, data-element=Geltungsbereich_E3_1_2_Premium.SP_IF_BMC_CMC_Zellspannung_010_XIX_BMC_HV.DE_BMC_CMC_Zellspannung_010, system-signal=BMC_CMC_Zellspannung_010}
        sender-receiver-to-signal-mapping={communication-direction=OUT, data-element=Geltungsbereich_E3_1_2_Premium.SP_IF_BMC_CMC_Zellspannung_153_XIX_BMC_HV.DE_BMC_CMC_Zellspannung_153, system-signal=BMC_CMC_Zellspannung_153}
        sender-receiver-to-signal-mapping={communication-direction=OUT, data-element=Geltungsbereich_E3_1_2_Premium.SP_IF_BMC_CMC_Zellspannung_104_XIX_BMC_HV.DE_BMC_CMC_Zellspannung_104, system-signal=BMC_CMC_Zellspannung_104}
        sender-receiver-to-signal-mapping={communication-direction=OUT, data-element=Geltungsbereich_E3_1_2_Premium.SP_IF_BMC_CMC_Zellspannung_086_XIX_BMC_HV.DE_BMC_CMC_Zellspannung_086, system-signal=BMC_CMC_Zellspannung_086}
        sender-receiver-to-signal-mapping={communication-direction=OUT, data-element=Geltungsbereich_E3_1_2_Premium.SP_IF_BMC_CMC_Zellspannung_112_XIX_BMC_HV.DE_BMC_CMC_Zellspannung_112, system-signal=BMC_CMC_Zellspannung_112}
        sender-receiver-to-signal-mapping={communication-direction=OUT, data-element=Geltungsbereich_E3_1_2_Premium.SP_IF_BMC_CMC_Zellspannung_011_XIX_BMC_HV.DE_BMC_CMC_Zellspannung_011, system-signal=BMC_CMC_Zellspannung_011}
        sender-receiver-to-signal-mapping={communication-direction=OUT, data-element=Geltungsbereich_E3_1_2_Premium.SP_IF_BMC_CMC_Zellspannung_156_XIX_BMC_HV.DE_BMC_CMC_Zellspannung_156, system-signal=BMC_CMC_Zellspannung_156}
        sender-receiver-to-signal-mapping={communication-direction=OUT, data-element=Geltungsbereich_E3_1_2_Premium.SP_IF_BMC_CMC_Zellspannung_188_XIX_BMC_HV.DE_BMC_CMC_Zellspannung_188, system-signal=BMC_CMC_Zellspannung_188}
        sender-receiver-to-signal-mapping={communication-direction=OUT, data-element=Geltungsbereich_E3_1_2_Premium.SP_IF_BMC_CMC_Zellspannung_016_XIX_BMC_HV.DE_BMC_CMC_Zellspannung_016, system-signal=BMC_CMC_Zellspannung_016}
        sender-receiver-to-signal-mapping={communication-direction=OUT, data-element=Geltungsbereich_E3_1_2_Premium.SP_IF_BMC_CMC_Zellspannung_145_XIX_BMC_HV.DE_BMC_CMC_Zellspannung_145, system-signal=BMC_CMC_Zellspannung_145}
        sender-receiver-to-signal-mapping={communication-direction=OUT, data-element=Geltungsbereich_E3_1_2_Premium.SP_IF_BMC_CMC_Zellspannung_048_XIX_BMC_HV.DE_BMC_CMC_Zellspannung_048, system-signal=BMC_CMC_Zellspannung_048}
        sender-receiver-to-signal-mapping={communication-direction=OUT, data-element=Geltungsbereich_E3_1_2_Premium.SP_IF_BMC_CMC_Zellspannung_068_XIX_BMC_HV.DE_BMC_CMC_Zellspannung_068, system-signal=BMC_CMC_Zellspannung_068}
        sender-receiver-to-signal-mapping={communication-direction=OUT, data-element=Geltungsbereich_E3_1_2_Premium.SP_IF_BMC_CMC_Zellspannung_066_XIX_BMC_HV.DE_BMC_CMC_Zellspannung_066, system-signal=BMC_CMC_Zellspannung_066}
        sender-receiver-to-signal-mapping={communication-direction=OUT, data-element=Geltungsbereich_E3_1_2_Premium.SP_IF_BMC_CMC_Zellspannung_035_XIX_BMC_HV.DE_BMC_CMC_Zellspannung_035, system-signal=BMC_CMC_Zellspannung_035}
        sender-receiver-to-signal-mapping={communication-direction=OUT, data-element=Geltungsbereich_E3_1_2_Premium.SP_IF_BMC_CMC_Zellspannung_128_XIX_BMC_HV.DE_BMC_CMC_Zellspannung_128, system-signal=BMC_CMC_Zellspannung_128}
        sender-receiver-to-signal-mapping={communication-direction=OUT, data-element=Geltungsbereich_E3_1_2_Premium.SP_IF_BMC_CMC_Zellspannung_081_XIX_BMC_HV.DE_BMC_CMC_Zellspannung_081, system-signal=BMC_CMC_Zellspannung_081}
        sender-receiver-to-signal-mapping={communication-direction=OUT, data-element=Geltungsbereich_E3_1_2_Premium.SP_IF_BMC_CMC_Zellspannung_142_XIX_BMC_HV.DE_BMC_CMC_Zellspannung_142, system-signal=BMC_CMC_Zellspannung_142}
        sender-receiver-to-signal-mapping={communication-direction=OUT, data-element=Geltungsbereich_E3_1_2_Premium.SP_IF_BMC_CMC_Zellspannung_061_XIX_BMC_HV.DE_BMC_CMC_Zellspannung_061, system-signal=BMC_CMC_Zellspannung_061}
        sender-receiver-to-signal-mapping={communication-direction=OUT, data-element=Geltungsbereich_E3_1_2_Premium.SP_IF_BMC_CMC_Zellspannung_017_XIX_BMC_HV.DE_BMC_CMC_Zellspannung_017, system-signal=BMC_CMC_Zellspannung_017}
        sender-receiver-to-signal-mapping={communication-direction=OUT, data-element=Geltungsbereich_E3_1_2_Premium.SP_IF_BMC_CMC_Zellspannung_079_XIX_BMC_HV.DE_BMC_CMC_Zellspannung_079, system-signal=BMC_CMC_Zellspannung_079}
        sender-receiver-to-signal-mapping={communication-direction=OUT, data-element=Geltungsbereich_E3_1_2_Premium.SP_IF_BMC_CMC_Zellspannung_135_XIX_BMC_HV.DE_BMC_CMC_Zellspannung_135, system-signal=BMC_CMC_Zellspannung_135}
        sender-receiver-to-signal-mapping={communication-direction=OUT, data-element=Geltungsbereich_E3_1_2_Premium.SP_IF_BMC_CMC_Zellspannung_124_XIX_BMC_HV.DE_BMC_CMC_Zellspannung_124, system-signal=BMC_CMC_Zellspannung_124}
        sender-receiver-to-signal-mapping={communication-direction=OUT, data-element=Geltungsbereich_E3_1_2_Premium.SP_IF_BMC_CMC_Zellspannung_144_XIX_BMC_HV.DE_BMC_CMC_Zellspannung_144, system-signal=BMC_CMC_Zellspannung_144}
        sender-receiver-to-signal-mapping={communication-direction=OUT, data-element=Geltungsbereich_E3_1_2_Premium.SP_IF_BMC_CMC_Zellspannung_029_XIX_BMC_HV.DE_BMC_CMC_Zellspannung_029, system-signal=BMC_CMC_Zellspannung_029}
        sender-receiver-to-signal-mapping={communication-direction=OUT, data-element=Geltungsbereich_E3_1_2_Premium.SP_IF_BMC_CMC_Zellspannung_154_XIX_BMC_HV.DE_BMC_CMC_Zellspannung_154, system-signal=BMC_CMC_Zellspannung_154}
        sender-receiver-to-signal-mapping={communication-direction=OUT, data-element=Geltungsbereich_E3_1_2_Premium.SP_IF_BMC_CMC_Zellspannung_062_XIX_BMC_HV.DE_BMC_CMC_Zellspannung_062, system-signal=BMC_CMC_Zellspannung_062}
        sender-receiver-to-signal-mapping={communication-direction=OUT, data-element=Geltungsbereich_E3_1_2_Premium.SP_IF_BMC_CMC_Zellspannung_127_XIX_BMC_HV.DE_BMC_CMC_Zellspannung_127, system-signal=BMC_CMC_Zellspannung_127}
        sender-receiver-to-signal-mapping={communication-direction=OUT, data-element=Geltungsbereich_E3_1_2_Premium.SP_IF_BMC_CMC_Zellspannung_009_XIX_BMC_HV.DE_BMC_CMC_Zellspannung_009, system-signal=BMC_CMC_Zellspannung_009}
        sender-receiver-to-signal-mapping={communication-direction=OUT, data-element=Geltungsbereich_E3_1_2_Premium.SP_IF_BMC_CMC_Zellspannung_171_XIX_BMC_HV.DE_BMC_CMC_Zellspannung_171, system-signal=BMC_CMC_Zellspannung_171}
        sender-receiver-to-signal-mapping={communication-direction=OUT, data-element=Geltungsbereich_E3_1_2_Premium.SP_IF_BMC_CMC_Zellspannung_132_XIX_BMC_HV.DE_BMC_CMC_Zellspannung_132, system-signal=BMC_CMC_Zellspannung_132}
        sender-receiver-to-signal-mapping={communication-direction=OUT, data-element=Geltungsbereich_E3_1_2_Premium.SP_IF_BMC_CMC_Zellspannung_139_XIX_BMC_HV.DE_BMC_CMC_Zellspannung_139, system-signal=BMC_CMC_Zellspannung_139}
        sender-receiver-to-signal-mapping={communication-direction=OUT, data-element=Geltungsbereich_E3_1_2_Premium.SP_IF_BMC_CMC_Zellspannung_028_XIX_BMC_HV.DE_BMC_CMC_Zellspannung_028, system-signal=BMC_CMC_Zellspannung_028}
        sender-receiver-to-signal-mapping={communication-direction=OUT, data-element=Geltungsbereich_E3_1_2_Premium.SP_IF_BMC_CMC_Zellspannung_157_XIX_BMC_HV.DE_BMC_CMC_Zellspannung_157, system-signal=BMC_CMC_Zellspannung_157}
        sender-receiver-to-signal-mapping={communication-direction=OUT, data-element=Geltungsbereich_E3_1_2_Premium.SP_IF_BMC_CMC_Zellspannung_020_XIX_BMC_HV.DE_BMC_CMC_Zellspannung_020, system-signal=BMC_CMC_Zellspannung_020}
        sender-receiver-to-signal-mapping={communication-direction=OUT, data-element=Geltungsbereich_E3_1_2_Premium.SP_IF_BMC_CMC_Zellspannung_148_XIX_BMC_HV.DE_BMC_CMC_Zellspannung_148, system-signal=BMC_CMC_Zellspannung_148}
        sender-receiver-to-signal-mapping={communication-direction=OUT, data-element=Geltungsbereich_E3_1_2_Premium.SP_IF_BMC_CMC_Zellspannung_027_XIX_BMC_HV.DE_BMC_CMC_Zellspannung_027, system-signal=BMC_CMC_Zellspannung_027}
        sender-receiver-to-signal-mapping={communication-direction=OUT, data-element=Geltungsbereich_E3_1_2_Premium.SP_IF_BMC_CMC_Zellspannung_056_XIX_BMC_HV.DE_BMC_CMC_Zellspannung_056, system-signal=BMC_CMC_Zellspannung_056}
        sender-receiver-to-signal-mapping={communication-direction=OUT, data-element=Geltungsbereich_E3_1_2_Premium.SP_IF_BMC_CMC_Zellspannung_050_XIX_BMC_HV.DE_BMC_CMC_Zellspannung_050, system-signal=BMC_CMC_Zellspannung_050}
        sender-receiver-to-signal-mapping={communication-direction=OUT, data-element=Geltungsbereich_E3_1_2_Premium.SP_IF_BMC_CMC_Zellspannung_174_XIX_BMC_HV.DE_BMC_CMC_Zellspannung_174, system-signal=BMC_CMC_Zellspannung_174}
        sender-receiver-to-signal-mapping={communication-direction=OUT, data-element=Geltungsbereich_E3_1_2_Premium.SP_IF_BMC_CMC_Zellspannung_138_XIX_BMC_HV.DE_BMC_CMC_Zellspannung_138, system-signal=BMC_CMC_Zellspannung_138}
        sender-receiver-to-signal-mapping={communication-direction=OUT, data-element=Geltungsbereich_E3_1_2_Premium.SP_IF_BMC_CMC_Zellspannung_122_XIX_BMC_HV.DE_BMC_CMC_Zellspannung_122, system-signal=BMC_CMC_Zellspannung_122}
        sender-receiver-to-signal-mapping={communication-direction=OUT, data-element=Geltungsbereich_E3_1_2_Premium.SP_IF_BMC_CMC_Zellspannung_044_XIX_BMC_HV.DE_BMC_CMC_Zellspannung_044, system-signal=BMC_CMC_Zellspannung_044}
        sender-receiver-to-signal-mapping={communication-direction=OUT, data-element=Geltungsbereich_E3_1_2_Premium.SP_IF_BMC_CMC_Zellspannung_147_XIX_BMC_HV.DE_BMC_CMC_Zellspannung_147, system-signal=BMC_CMC_Zellspannung_147}
        sender-receiver-to-signal-mapping={communication-direction=OUT, data-element=Geltungsbereich_E3_1_2_Premium.SP_IF_BMC_CMC_Zellspannung_179_XIX_BMC_HV.DE_BMC_CMC_Zellspannung_179, system-signal=BMC_CMC_Zellspannung_179}
        sender-receiver-to-signal-mapping={communication-direction=OUT, data-element=Geltungsbereich_E3_1_2_Premium.SP_IF_BMC_CMC_Zellspannung_155_XIX_BMC_HV.DE_BMC_CMC_Zellspannung_155, system-signal=BMC_CMC_Zellspannung_155}
        sender-receiver-to-signal-mapping={communication-direction=OUT, data-element=Geltungsbereich_E3_1_2_Premium.SP_IF_BMC_CMC_Zellspannung_107_XIX_BMC_HV.DE_BMC_CMC_Zellspannung_107, system-signal=BMC_CMC_Zellspannung_107}
        sender-receiver-to-signal-mapping={communication-direction=OUT, data-element=Geltungsbereich_E3_1_2_Premium.SP_IF_BMC_CMC_Zellspannung_007_XIX_BMC_HV.DE_BMC_CMC_Zellspannung_007, system-signal=BMC_CMC_Zellspannung_007}
        sender-receiver-to-signal-mapping={communication-direction=OUT, data-element=Geltungsbereich_E3_1_2_Premium.SP_IF_BMC_CMC_Zellspannung_109_XIX_BMC_HV.DE_BMC_CMC_Zellspannung_109, system-signal=BMC_CMC_Zellspannung_109}
        sender-receiver-to-signal-mapping={communication-direction=OUT, data-element=Geltungsbereich_E3_1_2_Premium.SP_IF_BMC_CMC_Zellspannung_175_XIX_BMC_HV.DE_BMC_CMC_Zellspannung_175, system-signal=BMC_CMC_Zellspannung_175}
        sender-receiver-to-signal-mapping={communication-direction=OUT, data-element=Geltungsbereich_E3_1_2_Premium.SP_IF_BMC_CMC_Zellspannung_078_XIX_BMC_HV.DE_BMC_CMC_Zellspannung_078, system-signal=BMC_CMC_Zellspannung_078}
        sender-receiver-to-signal-mapping={communication-direction=OUT, data-element=Geltungsbereich_E3_1_2_Premium.SP_IF_BMC_CMC_Zellspannung_163_XIX_BMC_HV.DE_BMC_CMC_Zellspannung_163, system-signal=BMC_CMC_Zellspannung_163}
        sender-receiver-to-signal-mapping={communication-direction=OUT, data-element=Geltungsbereich_E3_1_2_Premium.SP_IF_BMC_CMC_Zellspannung_060_XIX_BMC_HV.DE_BMC_CMC_Zellspannung_060, system-signal=BMC_CMC_Zellspannung_060}
        sender-receiver-to-signal-mapping={communication-direction=OUT, data-element=Geltungsbereich_E3_1_2_Premium.SP_IF_BMC_CMC_Zellspannung_072_XIX_BMC_HV.DE_BMC_CMC_Zellspannung_072, system-signal=BMC_CMC_Zellspannung_072}
        sender-receiver-to-signal-mapping={communication-direction=OUT, data-element=Geltungsbereich_E3_1_2_Premium.SP_IF_BMC_CMC_Zellspannung_094_XIX_BMC_HV.DE_BMC_CMC_Zellspannung_094, system-signal=BMC_CMC_Zellspannung_094}
        sender-receiver-to-signal-mapping={communication-direction=OUT, data-element=Geltungsbereich_E3_1_2_Premium.SP_IF_BMC_CMC_Zellspannung_183_XIX_BMC_HV.DE_BMC_CMC_Zellspannung_183, system-signal=BMC_CMC_Zellspannung_183}
        sender-receiver-to-signal-mapping={communication-direction=OUT, data-element=Geltungsbereich_E3_1_2_Premium.SP_IF_BMC_CMC_Zellspannung_036_XIX_BMC_HV.DE_BMC_CMC_Zellspannung_036, system-signal=BMC_CMC_Zellspannung_036}
        sender-receiver-to-signal-mapping={communication-direction=OUT, data-element=Geltungsbereich_E3_1_2_Premium.SP_IF_BMC_CMC_Zellspannung_021_XIX_BMC_HV.DE_BMC_CMC_Zellspannung_021, system-signal=BMC_CMC_Zellspannung_021}
        sender-receiver-to-signal-mapping={communication-direction=OUT, data-element=Geltungsbereich_E3_1_2_Premium.SP_IF_BMC_CMC_Zellspannung_149_XIX_BMC_HV.DE_BMC_CMC_Zellspannung_149, system-signal=BMC_CMC_Zellspannung_149}
        sender-receiver-to-signal-mapping={communication-direction=OUT, data-element=Geltungsbereich_E3_1_2_Premium.SP_IF_BMC_CMC_Zellspannung_167_XIX_BMC_HV.DE_BMC_CMC_Zellspannung_167, system-signal=BMC_CMC_Zellspannung_167}
        sender-receiver-to-signal-mapping={communication-direction=OUT, data-element=Geltungsbereich_E3_1_2_Premium.SP_IF_BMC_CMC_Zellspannung_012_XIX_BMC_HV.DE_BMC_CMC_Zellspannung_012, system-signal=BMC_CMC_Zellspannung_012}
        sender-receiver-to-signal-mapping={communication-direction=OUT, data-element=Geltungsbereich_E3_1_2_Premium.SP_IF_BMC_CMC_Zellspannung_058_XIX_BMC_HV.DE_BMC_CMC_Zellspannung_058, system-signal=BMC_CMC_Zellspannung_058}
        sender-receiver-to-signal-mapping={communication-direction=OUT, data-element=Geltungsbereich_E3_1_2_Premium.SP_IF_BMC_CMC_Zellspannung_092_XIX_BMC_HV.DE_BMC_CMC_Zellspannung_092, system-signal=BMC_CMC_Zellspannung_092}
        sender-receiver-to-signal-mapping={communication-direction=OUT, data-element=Geltungsbereich_E3_1_2_Premium.SP_IF_BMC_CMC_Zellspannung_071_XIX_BMC_HV.DE_BMC_CMC_Zellspannung_071, system-signal=BMC_CMC_Zellspannung_071}
        sender-receiver-to-signal-mapping={communication-direction=OUT, data-element=Geltungsbereich_E3_1_2_Premium.SP_IF_BMC_CMC_Zellspannung_168_XIX_BMC_HV.DE_BMC_CMC_Zellspannung_168, system-signal=BMC_CMC_Zellspannung_168}
        sender-receiver-to-signal-mapping={communication-direction=OUT, data-element=Geltungsbereich_E3_1_2_Premium.SP_IF_BMC_CMC_Zellspannung_164_XIX_BMC_HV.DE_BMC_CMC_Zellspannung_164, system-signal=BMC_CMC_Zellspannung_164}
        sender-receiver-to-signal-mapping={communication-direction=OUT, data-element=Geltungsbereich_E3_1_2_Premium.SP_IF_BMC_CMC_Zellspannung_002_XIX_BMC_HV.DE_BMC_CMC_Zellspannung_002, system-signal=BMC_CMC_Zellspannung_002}
        sender-receiver-to-signal-mapping={communication-direction=OUT, data-element=Geltungsbereich_E3_1_2_Premium.SP_IF_BMC_CMC_Zellspannung_165_XIX_BMC_HV.DE_BMC_CMC_Zellspannung_165, system-signal=BMC_CMC_Zellspannung_165}
        sender-receiver-to-signal-mapping={communication-direction=OUT, data-element=Geltungsbereich_E3_1_2_Premium.SP_IF_BMC_CMC_Zellspannung_049_XIX_BMC_HV.DE_BMC_CMC_Zellspannung_049, system-signal=BMC_CMC_Zellspannung_049}
        sender-receiver-to-signal-mapping={communication-direction=OUT, data-element=Geltungsbereich_E3_1_2_Premium.SP_IF_BMC_CMC_Zellspannung_084_XIX_BMC_HV.DE_BMC_CMC_Zellspannung_084, system-signal=BMC_CMC_Zellspannung_084}
        sender-receiver-to-signal-mapping={communication-direction=OUT, data-element=Geltungsbereich_E3_1_2_Premium.SP_IF_BMC_CMC_Zellspannung_184_XIX_BMC_HV.DE_BMC_CMC_Zellspannung_184, system-signal=BMC_CMC_Zellspannung_184}
        sender-receiver-to-signal-mapping={communication-direction=OUT, data-element=Geltungsbereich_E3_1_2_Premium.SP_IF_BMC_CMC_Zellspannung_039_XIX_BMC_HV.DE_BMC_CMC_Zellspannung_039, system-signal=BMC_CMC_Zellspannung_039}
        sender-receiver-to-signal-mapping={communication-direction=OUT, data-element=Geltungsbereich_E3_1_2_Premium.SP_IF_BMC_CMC_Zellspannung_022_XIX_BMC_HV.DE_BMC_CMC_Zellspannung_022, system-signal=BMC_CMC_Zellspannung_022}
        sender-receiver-to-signal-mapping={communication-direction=OUT, data-element=Geltungsbereich_E3_1_2_Premium.SP_IF_BMC_CMC_Zellspannung_166_XIX_BMC_HV.DE_BMC_CMC_Zellspannung_166, system-signal=BMC_CMC_Zellspannung_166}
        sender-receiver-to-signal-mapping={communication-direction=OUT, data-element=Geltungsbereich_E3_1_2_Premium.SP_IF_BMC_CMC_Zellspannung_102_XIX_BMC_HV.DE_BMC_CMC_Zellspannung_102, system-signal=BMC_CMC_Zellspannung_102}
        sender-receiver-to-signal-mapping={communication-direction=OUT, data-element=Geltungsbereich_E3_1_2_Premium.SP_IF_BMC_CMC_Zellspannung_026_XIX_BMC_HV.DE_BMC_CMC_Zellspannung_026, system-signal=BMC_CMC_Zellspannung_026}
        sender-receiver-to-signal-mapping={communication-direction=OUT, data-element=Geltungsbereich_E3_1_2_Premium.SP_IF_BMC_CMC_Zellspannung_125_XIX_BMC_HV.DE_BMC_CMC_Zellspannung_125, system-signal=BMC_CMC_Zellspannung_125}
        sender-receiver-to-signal-mapping={communication-direction=OUT, data-element=Geltungsbereich_E3_1_2_Premium.SP_IF_BMC_CMC_Zellspannung_160_XIX_BMC_HV.DE_BMC_CMC_Zellspannung_160, system-signal=BMC_CMC_Zellspannung_160}
        sender-receiver-to-signal-mapping={communication-direction=OUT, data-element=Geltungsbereich_E3_1_2_Premium.SP_IF_BMC_CMC_Zellspannung_121_XIX_BMC_HV.DE_BMC_CMC_Zellspannung_121, system-signal=BMC_CMC_Zellspannung_121}
        sender-receiver-to-signal-mapping={communication-direction=OUT, data-element=Geltungsbereich_E3_1_2_Premium.SP_IF_BMC_CMC_Zellspannung_106_XIX_BMC_HV.DE_BMC_CMC_Zellspannung_106, system-signal=BMC_CMC_Zellspannung_106}
        sender-receiver-to-signal-mapping={communication-direction=OUT, data-element=Geltungsbereich_E3_1_2_Premium.SP_IF_BMC_CMC_Zellspannung_116_XIX_BMC_HV.DE_BMC_CMC_Zellspannung_116, system-signal=BMC_CMC_Zellspannung_116}
        sender-receiver-to-signal-mapping={communication-direction=OUT, data-element=Geltungsbereich_E3_1_2_Premium.SP_IF_BMC_CMC_Zellspannung_030_XIX_BMC_HV.DE_BMC_CMC_Zellspannung_030, system-signal=BMC_CMC_Zellspannung_030}
        sender-receiver-to-signal-mapping={communication-direction=OUT, data-element=Geltungsbereich_E3_1_2_Premium.SP_IF_BMC_CMC_Zellspannung_186_XIX_BMC_HV.DE_BMC_CMC_Zellspannung_186, system-signal=BMC_CMC_Zellspannung_186}
        sender-receiver-to-signal-mapping={communication-direction=OUT, data-element=Geltungsbereich_E3_1_2_Premium.SP_IF_BMC_CMC_Zellspannung_187_XIX_BMC_HV.DE_BMC_CMC_Zellspannung_187, system-signal=BMC_CMC_Zellspannung_187}
        sender-receiver-to-signal-mapping={communication-direction=OUT, data-element=Geltungsbereich_E3_1_2_Premium.SP_IF_BMC_CMC_Zellspannung_126_XIX_BMC_HV.DE_BMC_CMC_Zellspannung_126, system-signal=BMC_CMC_Zellspannung_126}
        sender-receiver-to-signal-mapping={communication-direction=OUT, data-element=Geltungsbereich_E3_1_2_Premium.SP_IF_BMC_CMC_Zellspannung_117_XIX_BMC_HV.DE_BMC_CMC_Zellspannung_117, system-signal=BMC_CMC_Zellspannung_117}
        sender-receiver-to-signal-mapping={communication-direction=OUT, data-element=Geltungsbereich_E3_1_2_Premium.SP_IF_BMC_CMC_Zellspannung_159_XIX_BMC_HV.DE_BMC_CMC_Zellspannung_159, system-signal=BMC_CMC_Zellspannung_159}
        sender-receiver-to-signal-mapping={communication-direction=OUT, data-element=Geltungsbereich_E3_1_2_Premium.SP_IF_BMC_CMC_Zellspannung_003_XIX_BMC_HV.DE_BMC_CMC_Zellspannung_003, system-signal=BMC_CMC_Zellspannung_003}
        sender-receiver-to-signal-mapping={communication-direction=OUT, data-element=Geltungsbereich_E3_1_2_Premium.SP_IF_BMC_CMC_Zellspannung_099_XIX_BMC_HV.DE_BMC_CMC_Zellspannung_099, system-signal=BMC_CMC_Zellspannung_099}
        sender-receiver-to-signal-mapping={communication-direction=OUT, data-element=Geltungsbereich_E3_1_2_Premium.SP_IF_BMC_CMC_Zellspannung_182_XIX_BMC_HV.DE_BMC_CMC_Zellspannung_182, system-signal=BMC_CMC_Zellspannung_182}
        sender-receiver-to-signal-mapping={communication-direction=OUT, data-element=Geltungsbereich_E3_1_2_Premium.SP_IF_BMC_CMC_Zellspannung_087_XIX_BMC_HV.DE_BMC_CMC_Zellspannung_087, system-signal=BMC_CMC_Zellspannung_087}
        sender-receiver-to-signal-mapping={communication-direction=OUT, data-element=Geltungsbereich_E3_1_2_Premium.SP_IF_BMC_CMC_Zellspannung_074_XIX_BMC_HV.DE_BMC_CMC_Zellspannung_074, system-signal=BMC_CMC_Zellspannung_074}
        sender-receiver-to-signal-mapping={communication-direction=OUT, data-element=Geltungsbereich_E3_1_2_Premium.SP_IF_BMC_CMC_Zellspannung_096_XIX_BMC_HV.DE_BMC_CMC_Zellspannung_096, system-signal=BMC_CMC_Zellspannung_096}
        sender-receiver-to-signal-mapping={communication-direction=OUT, data-element=Geltungsbereich_E3_1_2_Premium.SP_IF_BMC_CMC_Zellspannung_070_XIX_BMC_HV.DE_BMC_CMC_Zellspannung_070, system-signal=BMC_CMC_Zellspannung_070}
        sender-receiver-to-signal-mapping={communication-direction=OUT, data-element=Geltungsbereich_E3_1_2_Premium.SP_IF_BMC_CMC_Zellspannung_143_XIX_BMC_HV.DE_BMC_CMC_Zellspannung_143, system-signal=BMC_CMC_Zellspannung_143}
        sender-receiver-to-signal-mapping={communication-direction=OUT, data-element=Geltungsbereich_E3_1_2_Premium.SP_IF_BMC_CMC_Zellspannung_161_XIX_BMC_HV.DE_BMC_CMC_Zellspannung_161, system-signal=BMC_CMC_Zellspannung_161}
        sender-receiver-to-signal-mapping={communication-direction=OUT, data-element=Geltungsbereich_E3_1_2_Premium.SP_IF_BMC_CMC_Zellspannung_134_XIX_BMC_HV.DE_BMC_CMC_Zellspannung_134, system-signal=BMC_CMC_Zellspannung_134}
        sender-receiver-to-signal-mapping={communication-direction=OUT, data-element=Geltungsbereich_E3_1_2_Premium.SP_IF_BMC_CMC_Zellspannung_114_XIX_BMC_HV.DE_BMC_CMC_Zellspannung_114, system-signal=BMC_CMC_Zellspannung_114}
        sender-receiver-to-signal-mapping={communication-direction=OUT, data-element=Geltungsbereich_E3_1_2_Premium.SP_IF_BMC_CMC_Zellspannung_172_XIX_BMC_HV.DE_BMC_CMC_Zellspannung_172, system-signal=BMC_CMC_Zellspannung_172}
        sender-receiver-to-signal-mapping={communication-direction=OUT, data-element=Geltungsbereich_E3_1_2_Premium.SP_IF_BMC_IstTemperaturMax_Modul_ID_XIX_BMC_HV.DE_BMC_IstTemperaturMax_Modul_ID, system-signal=BMC_IstTemperaturMax_Modul_ID}
        sender-receiver-to-signal-mapping={communication-direction=OUT, data-element=Geltungsbereich_E3_1_2_Premium.SP_IF_BMC_IstTemperaturMin_Modul_ID_XIX_BMC_HV.DE_BMC_IstTemperaturMin_Modul_ID, system-signal=BMC_IstTemperaturMin_Modul_ID}
        sender-receiver-to-signal-mapping={communication-direction=OUT, data-element=Geltungsbereich_E3_1_2_Premium.SP_IF_BMC_IstTemperaturMax_Sensor_ID_XIX_BMC_HV.DE_BMC_IstTemperaturMax_Sensor_ID, system-signal=BMC_IstTemperaturMax_Sensor_ID}
        sender-receiver-to-signal-mapping={communication-direction=OUT, data-element=Geltungsbereich_E3_1_2_Premium.SP_IF_BMC_Temperatur_hoechste_XIX_BMC_HV.DE_BMC_Temperatur_hoechste, system-signal=BMC_Temperatur_hoechste}
        sender-receiver-to-signal-mapping={communication-direction=OUT, data-element=Geltungsbereich_E3_1_2_Premium.SP_IF_BMC_Temperatur_niedrigste_XIX_BMC_HV.DE_BMC_Temperatur_niedrigste, system-signal=BMC_Temperatur_niedrigste}
        sender-receiver-to-signal-mapping={communication-direction=OUT, data-element=Geltungsbereich_E3_1_2_Premium.SP_IF_BMC_CMC_Zellspannung_{01..05}_Messzeit_XIX_BMC_HV.DE_BMC_CMC_Zellspannung_{01..05}_Messzeit, system-signal=BMC_CMC_Zellspannung_{01..05}_Messzeit}
        sender-receiver-to-signal-mapping={communication-direction=OUT, data-element=Geltungsbereich_E3_1_2_Premium.SP_IF_BMC_CMC_Temperatur_01_Messzeit_XIX_BMC_HV.DE_BMC_CMC_Temperatur_01_Messzeit, system-signal=BMC_CMC_Temperatur_01_Messzeit}
        sender-receiver-to-signal-mapping={communication-direction=OUT, data-element=Geltungsbereich_E3_1_2_Premium.SP_IF_BMC_CMC_Temperatur_02_Messzeit_XIX_BMC_HV.DE_BMC_CMC_Temperatur_02_Messzeit, system-signal=BMC_CMC_Temperatur_02_Messzeit}
        sender-receiver-to-signal-mapping={communication-direction=OUT, data-element=Geltungsbereich_E3_1_2_Premium.SP_IF_BMC_CMC_Temperatur_{073..075}_XIX_BMC_HV.DE_BMC_CMC_Temperatur_{073..075}, system-signal=BMC_CMC_Temperatur_{073..075}}
        sender-receiver-to-signal-mapping={communication-direction=OUT, data-element=Geltungsbereich_E3_1_2_Premium.SP_IF_BMC_CMC_Temperatur_078_XIX_BMC_HV.DE_BMC_CMC_Temperatur_078, system-signal=BMC_CMC_Temperatur_078}
        sender-receiver-to-signal-mapping={communication-direction=OUT, data-element=Geltungsbereich_E3_1_2_Premium.SP_IF_BMC_CMC_Temperatur_076_XIX_BMC_HV.DE_BMC_CMC_Temperatur_076, system-signal=BMC_CMC_Temperatur_076}
        sender-receiver-to-signal-mapping={communication-direction=OUT, data-element=Geltungsbereich_E3_1_2_Premium.SP_IF_BMC_CMC_Temperatur_077_XIX_BMC_HV.DE_BMC_CMC_Temperatur_077, system-signal=BMC_CMC_Temperatur_077}
        sender-receiver-to-signal-mapping={communication-direction=OUT, data-element=Geltungsbereich_E3_1_2_Premium.SP_IF_BMC_CMC_Temperatur_{079..082}_XIX_BMC_HV.DE_BMC_CMC_Temperatur_{079..082}, system-signal=BMC_CMC_Temperatur_{079..082}}
        sender-receiver-to-signal-mapping={communication-direction=OUT, data-element=Geltungsbereich_E3_1_2_Premium.SP_IF_BMC_CMC_Temperatur_{085..088}_XIX_BMC_HV.DE_BMC_CMC_Temperatur_{085..088}, system-signal=BMC_CMC_Temperatur_{085..088}}
        sender-receiver-to-signal-mapping={communication-direction=OUT, data-element=Geltungsbereich_E3_1_2_Premium.SP_IF_BMC_CMC_Temperatur_084_XIX_BMC_HV.DE_BMC_CMC_Temperatur_084, system-signal=BMC_CMC_Temperatur_084}
        sender-receiver-to-signal-mapping={communication-direction=OUT, data-element=Geltungsbereich_E3_1_2_Premium.SP_IF_BMC_CMC_Temperatur_083_XIX_BMC_HV.DE_BMC_CMC_Temperatur_083, system-signal=BMC_CMC_Temperatur_083}
        sender-receiver-to-signal-mapping={communication-direction=OUT, data-element=Geltungsbereich_E3_1_2_Premium.SP_IF_BMC_CMC_Temperatur_090_XIX_BMC_HV.DE_BMC_CMC_Temperatur_090, system-signal=BMC_CMC_Temperatur_090}
        sender-receiver-to-signal-mapping={communication-direction=OUT, data-element=Geltungsbereich_E3_1_2_Premium.SP_IF_BMC_CMC_Temperatur_092_XIX_BMC_HV.DE_BMC_CMC_Temperatur_092, system-signal=BMC_CMC_Temperatur_092}
        sender-receiver-to-signal-mapping={communication-direction=OUT, data-element=Geltungsbereich_E3_1_2_Premium.SP_IF_BMC_CMC_Temperatur_091_XIX_BMC_HV.DE_BMC_CMC_Temperatur_091, system-signal=BMC_CMC_Temperatur_091}
        sender-receiver-to-signal-mapping={communication-direction=OUT, data-element=Geltungsbereich_E3_1_2_Premium.SP_IF_BMC_CMC_Temperatur_093_XIX_BMC_HV.DE_BMC_CMC_Temperatur_093, system-signal=BMC_CMC_Temperatur_093}
        sender-receiver-to-signal-mapping={communication-direction=OUT, data-element=Geltungsbereich_E3_1_2_Premium.SP_IF_BMC_CMC_Temperatur_089_XIX_BMC_HV.DE_BMC_CMC_Temperatur_089, system-signal=BMC_CMC_Temperatur_089}
        sender-receiver-to-signal-mapping={communication-direction=OUT, data-element=Geltungsbereich_E3_1_2_Premium.SP_IF_BMC_CMC_Temperatur_{094..096}_XIX_BMC_HV.DE_BMC_CMC_Temperatur_{094..096}, system-signal=BMC_CMC_Temperatur_{094..096}}
        sender-receiver-to-signal-mapping={communication-direction=OUT, data-element=Geltungsbereich_E3_1_2_Premium.SP_IF_BMC_CMC_Temperatur_03_Messzeit_XIX_BMC_HV.DE_BMC_CMC_Temperatur_03_Messzeit, system-signal=BMC_CMC_Temperatur_03_Messzeit}
        sender-receiver-to-signal-mapping={communication-direction=IN, data-element=Geltungsbereich_E3_1_2_Premium.RP_IF_VIN_15_XIX_BMC_HV.DE_VIN_15, system-signal=VIN_15}
        sender-receiver-to-signal-mapping={communication-direction=IN, data-element=Geltungsbereich_E3_1_2_Premium.RP_IF_VIN_16_XIX_BMC_HV.DE_VIN_16, system-signal=VIN_16}
        sender-receiver-to-signal-mapping={communication-direction=IN, data-element=Geltungsbereich_E3_1_2_Premium.RP_IF_VIN_9_XIX_BMC_HV.DE_VIN_9, system-signal=VIN_9}
        sender-receiver-to-signal-mapping={communication-direction=IN, data-element=Geltungsbereich_E3_1_2_Premium.RP_IF_VIN_12_XIX_BMC_HV.DE_VIN_12, system-signal=VIN_12}
        sender-receiver-to-signal-mapping={communication-direction=IN, data-element=Geltungsbereich_E3_1_2_Premium.RP_IF_VIN_8_XIX_BMC_HV.DE_VIN_8, system-signal=VIN_8}
        sender-receiver-to-signal-mapping={communication-direction=IN, data-element=Geltungsbereich_E3_1_2_Premium.RP_IF_VIN_6_XIX_BMC_HV.DE_VIN_6, system-signal=VIN_6}
        sender-receiver-to-signal-mapping={communication-direction=IN, data-element=Geltungsbereich_E3_1_2_Premium.RP_IF_VIN_13_XIX_BMC_HV.DE_VIN_13, system-signal=VIN_13}
        sender-receiver-to-signal-mapping={communication-direction=IN, data-element=Geltungsbereich_E3_1_2_Premium.RP_IF_VIN_14_XIX_BMC_HV.DE_VIN_14, system-signal=VIN_14}
        sender-receiver-to-signal-mapping={communication-direction=IN, data-element=Geltungsbereich_E3_1_2_Premium.RP_IF_VIN_2_XIX_BMC_HV.DE_VIN_2, system-signal=VIN_2}
        sender-receiver-to-signal-mapping={communication-direction=IN, data-element=Geltungsbereich_E3_1_2_Premium.RP_IF_VIN_7_XIX_BMC_HV.DE_VIN_7, system-signal=VIN_7}
        sender-receiver-to-signal-mapping={communication-direction=IN, data-element=Geltungsbereich_E3_1_2_Premium.RP_IF_VIN_17_XIX_BMC_HV.DE_VIN_17, system-signal=VIN_17}
        sender-receiver-to-signal-mapping={communication-direction=IN, data-element=Geltungsbereich_E3_1_2_Premium.RP_IF_VIN_11_XIX_BMC_HV.DE_VIN_11, system-signal=VIN_11}
        sender-receiver-to-signal-mapping={communication-direction=IN, data-element=Geltungsbereich_E3_1_2_Premium.RP_IF_VIN_10_XIX_BMC_HV.DE_VIN_10, system-signal=VIN_10}
        sender-receiver-to-signal-mapping={communication-direction=IN, data-element=Geltungsbereich_E3_1_2_Premium.RP_IF_VIN_4_XIX_BMC_HV.DE_VIN_4, system-signal=VIN_4}
        sender-receiver-to-signal-mapping={communication-direction=IN, data-element=Geltungsbereich_E3_1_2_Premium.RP_IF_VIN_5_XIX_BMC_HV.DE_VIN_5, system-signal=VIN_5}
        sender-receiver-to-signal-mapping={communication-direction=IN, data-element=Geltungsbereich_E3_1_2_Premium.RP_IF_VIN_3_XIX_BMC_HV.DE_VIN_3, system-signal=VIN_3}
        sender-receiver-to-signal-mapping={communication-direction=IN, data-element=Geltungsbereich_E3_1_2_Premium.RP_IF_VIN_1_XIX_BMC_HV.DE_VIN_1, system-signal=VIN_1}
        sender-receiver-to-signal-mapping={communication-direction=IN, data-element=Geltungsbereich_E3_1_2_Premium.RP_IF_ORU_Status_XIX_BMC_HV.DE_ORU_Status, system-signal=ORU_Status}
        sender-receiver-to-signal-mapping={communication-direction=IN, data-element=Geltungsbereich_E3_1_2_Premium.RP_IF_DCDC_NV_Komponentenfehler_63_XIX_BMC_HV.DE_DCDC_NV_Komponentenfehler_63, system-signal=DCDC_NV_Komponentenfehler_63}
        sender-receiver-to-signal-mapping={communication-direction=IN, data-element=Geltungsbereich_E3_1_2_Premium.RP_IF_DCDC_NV_Komponentenfehler_VLD_XIX_BMC_HV.DE_DCDC_NV_Komponentenfehler_VLD, system-signal=DCDC_NV_Komponentenfehler_VLD}
        sender-receiver-to-signal-mapping={communication-direction=IN, data-element=Geltungsbereich_E3_1_2_Premium.RP_IF_DCDC_NV_Komponentenfehler_3_1_XIX_BMC_HV.DE_DCDC_NV_Komponentenfehler_3_1, system-signal=DCDC_NV_Komponentenfehler_3_1}
        sender-receiver-to-signal-mapping={communication-direction=IN, data-element=Geltungsbereich_E3_1_2_Premium.RP_IF_DCDC_NV_Komponentenfehler_3_3_XIX_BMC_HV.DE_DCDC_NV_Komponentenfehler_3_3, system-signal=DCDC_NV_Komponentenfehler_3_3}
        sender-receiver-to-signal-mapping={communication-direction=IN, data-element=Geltungsbereich_E3_1_2_Premium.RP_IF_DCDC_NV_Komponentenfehler_11_XIX_BMC_HV.DE_DCDC_NV_Komponentenfehler_11, system-signal=DCDC_NV_Komponentenfehler_11}
        sender-receiver-to-signal-mapping={communication-direction=IN, data-element=Geltungsbereich_E3_1_2_Premium.RP_IF_DCDC_NV_Komponentenfehler_34_XIX_BMC_HV.DE_DCDC_NV_Komponentenfehler_34, system-signal=DCDC_NV_Komponentenfehler_34}
        sender-receiver-to-signal-mapping={communication-direction=IN, data-element=Geltungsbereich_E3_1_2_Premium.RP_IF_DCDC_NV_Komponentenfehler_51_XIX_BMC_HV.DE_DCDC_NV_Komponentenfehler_51, system-signal=DCDC_NV_Komponentenfehler_51}
        sender-receiver-to-signal-mapping={communication-direction=IN, data-element=Geltungsbereich_E3_1_2_Premium.RP_IF_DCDC_NV_Komponentenfehler_41_XIX_BMC_HV.DE_DCDC_NV_Komponentenfehler_41, system-signal=DCDC_NV_Komponentenfehler_41}
        sender-receiver-to-signal-mapping={communication-direction=IN, data-element=Geltungsbereich_E3_1_2_Premium.RP_IF_DCDC_NV_Komponentenfehler_3_15_XIX_BMC_HV.DE_DCDC_NV_Komponentenfehler_3_15, system-signal=DCDC_NV_Komponentenfehler_3_15}
        sender-receiver-to-signal-mapping={communication-direction=IN, data-element=Geltungsbereich_E3_1_2_Premium.RP_IF_DCDC_NV_Komponentenfehler_03_XIX_BMC_HV.DE_DCDC_NV_Komponentenfehler_03, system-signal=DCDC_NV_Komponentenfehler_03}
        sender-receiver-to-signal-mapping={communication-direction=IN, data-element=Geltungsbereich_E3_1_2_Premium.RP_IF_DCDC_NV_Komponentenfehler_02_XIX_BMC_HV.DE_DCDC_NV_Komponentenfehler_02, system-signal=DCDC_NV_Komponentenfehler_02}
        sender-receiver-to-signal-mapping={communication-direction=IN, data-element=Geltungsbereich_E3_1_2_Premium.RP_IF_DCDC_NV_Komponentenfehler_12_XIX_BMC_HV.DE_DCDC_NV_Komponentenfehler_12, system-signal=DCDC_NV_Komponentenfehler_12}
        sender-receiver-to-signal-mapping={communication-direction=IN, data-element=Geltungsbereich_E3_1_2_Premium.RP_IF_DCDC_NV_Komponentenfehler_21_XIX_BMC_HV.DE_DCDC_NV_Komponentenfehler_21, system-signal=DCDC_NV_Komponentenfehler_21}
        sender-receiver-to-signal-mapping={communication-direction=IN, data-element=Geltungsbereich_E3_1_2_Premium.RP_IF_DCDC_NV_Komponentenfehler_60_XIX_BMC_HV.DE_DCDC_NV_Komponentenfehler_60, system-signal=DCDC_NV_Komponentenfehler_60}
        sender-receiver-to-signal-mapping={communication-direction=IN, data-element=Geltungsbereich_E3_1_2_Premium.RP_IF_DCDC_NV_Komponentenfehler_75_XIX_BMC_HV.DE_DCDC_NV_Komponentenfehler_75, system-signal=DCDC_NV_Komponentenfehler_75}
        sender-receiver-to-signal-mapping={communication-direction=IN, data-element=Geltungsbereich_E3_1_2_Premium.RP_IF_DCDC_NV_Komponentenfehler_40_XIX_BMC_HV.DE_DCDC_NV_Komponentenfehler_40, system-signal=DCDC_NV_Komponentenfehler_40}
        sender-receiver-to-signal-mapping={communication-direction=IN, data-element=Geltungsbereich_E3_1_2_Premium.RP_IF_DCDC_NV_Komponentenfehler_53_XIX_BMC_HV.DE_DCDC_NV_Komponentenfehler_53, system-signal=DCDC_NV_Komponentenfehler_53}
        sender-receiver-to-signal-mapping={communication-direction=IN, data-element=Geltungsbereich_E3_1_2_Premium.RP_IF_DCDC_NV_Komponentenfehler_36_XIX_BMC_HV.DE_DCDC_NV_Komponentenfehler_36, system-signal=DCDC_NV_Komponentenfehler_36}
        sender-receiver-to-signal-mapping={communication-direction=IN, data-element=Geltungsbereich_E3_1_2_Premium.RP_IF_DCDC_NV_Komponentenfehler_45_XIX_BMC_HV.DE_DCDC_NV_Komponentenfehler_45, system-signal=DCDC_NV_Komponentenfehler_45}
        sender-receiver-to-signal-mapping={communication-direction=IN, data-element=Geltungsbereich_E3_1_2_Premium.RP_IF_DCDC_NV_Komponentenfehler_77_XIX_BMC_HV.DE_DCDC_NV_Komponentenfehler_77, system-signal=DCDC_NV_Komponentenfehler_77}
        sender-receiver-to-signal-mapping={communication-direction=IN, data-element=Geltungsbereich_E3_1_2_Premium.RP_IF_DCDC_NV_Komponentenfehler_27_XIX_BMC_HV.DE_DCDC_NV_Komponentenfehler_27, system-signal=DCDC_NV_Komponentenfehler_27}
        sender-receiver-to-signal-mapping={communication-direction=IN, data-element=Geltungsbereich_E3_1_2_Premium.RP_IF_DCDC_NV_Komponentenfehler_31_XIX_BMC_HV.DE_DCDC_NV_Komponentenfehler_31, system-signal=DCDC_NV_Komponentenfehler_31}
        sender-receiver-to-signal-mapping={communication-direction=IN, data-element=Geltungsbereich_E3_1_2_Premium.RP_IF_DCDC_NV_Komponentenfehler_28_XIX_BMC_HV.DE_DCDC_NV_Komponentenfehler_28, system-signal=DCDC_NV_Komponentenfehler_28}
        sender-receiver-to-signal-mapping={communication-direction=IN, data-element=Geltungsbereich_E3_1_2_Premium.RP_IF_DCDC_NV_Komponentenfehler_07_XIX_BMC_HV.DE_DCDC_NV_Komponentenfehler_07, system-signal=DCDC_NV_Komponentenfehler_07}
        sender-receiver-to-signal-mapping={communication-direction=IN, data-element=Geltungsbereich_E3_1_2_Premium.RP_IF_DCDC_NV_Komponentenfehler_42_XIX_BMC_HV.DE_DCDC_NV_Komponentenfehler_42, system-signal=DCDC_NV_Komponentenfehler_42}
        sender-receiver-to-signal-mapping={communication-direction=IN, data-element=Geltungsbereich_E3_1_2_Premium.RP_IF_DCDC_NV_Komponentenfehler_52_XIX_BMC_HV.DE_DCDC_NV_Komponentenfehler_52, system-signal=DCDC_NV_Komponentenfehler_52}
        sender-receiver-to-signal-mapping={communication-direction=IN, data-element=Geltungsbereich_E3_1_2_Premium.RP_IF_DCDC_NV_Komponentenfehler_50_XIX_BMC_HV.DE_DCDC_NV_Komponentenfehler_50, system-signal=DCDC_NV_Komponentenfehler_50}
        sender-receiver-to-signal-mapping={communication-direction=IN, data-element=Geltungsbereich_E3_1_2_Premium.RP_IF_DCDC_NV_Komponentenfehler_62_XIX_BMC_HV.DE_DCDC_NV_Komponentenfehler_62, system-signal=DCDC_NV_Komponentenfehler_62}
        sender-receiver-to-signal-mapping={communication-direction=IN, data-element=Geltungsbereich_E3_1_2_Premium.RP_IF_DCDC_NV_Komponentenfehler_3_12_XIX_BMC_HV.DE_DCDC_NV_Komponentenfehler_3_12, system-signal=DCDC_NV_Komponentenfehler_3_12}
        sender-receiver-to-signal-mapping={communication-direction=IN, data-element=Geltungsbereich_E3_1_2_Premium.RP_IF_DCDC_NV_Komponentenfehler_74_XIX_BMC_HV.DE_DCDC_NV_Komponentenfehler_74, system-signal=DCDC_NV_Komponentenfehler_74}
        sender-receiver-to-signal-mapping={communication-direction=IN, data-element=Geltungsbereich_E3_1_2_Premium.RP_IF_DCDC_NV_Komponentenfehler_67_XIX_BMC_HV.DE_DCDC_NV_Komponentenfehler_67, system-signal=DCDC_NV_Komponentenfehler_67}
        sender-receiver-to-signal-mapping={communication-direction=IN, data-element=Geltungsbereich_E3_1_2_Premium.RP_IF_DCDC_NV_Komponentenfehler_76_XIX_BMC_HV.DE_DCDC_NV_Komponentenfehler_76, system-signal=DCDC_NV_Komponentenfehler_76}
        sender-receiver-to-signal-mapping={communication-direction=IN, data-element=Geltungsbereich_E3_1_2_Premium.RP_IF_DCDC_NV_Komponentenfehler_3_8_XIX_BMC_HV.DE_DCDC_NV_Komponentenfehler_3_8, system-signal=DCDC_NV_Komponentenfehler_3_8}
        sender-receiver-to-signal-mapping={communication-direction=IN, data-element=Geltungsbereich_E3_1_2_Premium.RP_IF_DCDC_NV_Komponentenfehler_69_XIX_BMC_HV.DE_DCDC_NV_Komponentenfehler_69, system-signal=DCDC_NV_Komponentenfehler_69}
        sender-receiver-to-signal-mapping={communication-direction=IN, data-element=Geltungsbereich_E3_1_2_Premium.RP_IF_DCDC_NV_Komponentenfehler_46_XIX_BMC_HV.DE_DCDC_NV_Komponentenfehler_46, system-signal=DCDC_NV_Komponentenfehler_46}
        sender-receiver-to-signal-mapping={communication-direction=IN, data-element=Geltungsbereich_E3_1_2_Premium.RP_IF_DCDC_NV_Komponentenfehler_71_XIX_BMC_HV.DE_DCDC_NV_Komponentenfehler_71, system-signal=DCDC_NV_Komponentenfehler_71}
        sender-receiver-to-signal-mapping={communication-direction=IN, data-element=Geltungsbereich_E3_1_2_Premium.RP_IF_DCDC_NV_Komponentenfehler_20_XIX_BMC_HV.DE_DCDC_NV_Komponentenfehler_20, system-signal=DCDC_NV_Komponentenfehler_20}
        sender-receiver-to-signal-mapping={communication-direction=IN, data-element=Geltungsbereich_E3_1_2_Premium.RP_IF_DCDC_NV_Komponentenfehler_35_XIX_BMC_HV.DE_DCDC_NV_Komponentenfehler_35, system-signal=DCDC_NV_Komponentenfehler_35}
        sender-receiver-to-signal-mapping={communication-direction=IN, data-element=Geltungsbereich_E3_1_2_Premium.RP_IF_DCDC_NV_Komponentenfehler_08_XIX_BMC_HV.DE_DCDC_NV_Komponentenfehler_08, system-signal=DCDC_NV_Komponentenfehler_08}
        sender-receiver-to-signal-mapping={communication-direction=IN, data-element=Geltungsbereich_E3_1_2_Premium.RP_IF_DCDC_NV_Komponentenfehler_16_XIX_BMC_HV.DE_DCDC_NV_Komponentenfehler_16, system-signal=DCDC_NV_Komponentenfehler_16}
        sender-receiver-to-signal-mapping={communication-direction=IN, data-element=Geltungsbereich_E3_1_2_Premium.RP_IF_DCDC_NV_Komponentenfehler_3_9_XIX_BMC_HV.DE_DCDC_NV_Komponentenfehler_3_9, system-signal=DCDC_NV_Komponentenfehler_3_9}
        sender-receiver-to-signal-mapping={communication-direction=IN, data-element=Geltungsbereich_E3_1_2_Premium.RP_IF_DCDC_NV_Komponentenfehler_06_XIX_BMC_HV.DE_DCDC_NV_Komponentenfehler_06, system-signal=DCDC_NV_Komponentenfehler_06}
        sender-receiver-to-signal-mapping={communication-direction=IN, data-element=Geltungsbereich_E3_1_2_Premium.RP_IF_DCDC_NV_Komponentenfehler_80_XIX_BMC_HV.DE_DCDC_NV_Komponentenfehler_80, system-signal=DCDC_NV_Komponentenfehler_80}
        sender-receiver-to-signal-mapping={communication-direction=IN, data-element=Geltungsbereich_E3_1_2_Premium.RP_IF_DCDC_NV_Komponentenfehler_24_XIX_BMC_HV.DE_DCDC_NV_Komponentenfehler_24, system-signal=DCDC_NV_Komponentenfehler_24}
        sender-receiver-to-signal-mapping={communication-direction=IN, data-element=Geltungsbereich_E3_1_2_Premium.RP_IF_DCDC_NV_Komponentenfehler_56_XIX_BMC_HV.DE_DCDC_NV_Komponentenfehler_56, system-signal=DCDC_NV_Komponentenfehler_56}
        sender-receiver-to-signal-mapping={communication-direction=IN, data-element=Geltungsbereich_E3_1_2_Premium.RP_IF_DCDC_NV_Komponentenfehler_64_XIX_BMC_HV.DE_DCDC_NV_Komponentenfehler_64, system-signal=DCDC_NV_Komponentenfehler_64}
        sender-receiver-to-signal-mapping={communication-direction=IN, data-element=Geltungsbereich_E3_1_2_Premium.RP_IF_DCDC_NV_Komponentenfehler_22_XIX_BMC_HV.DE_DCDC_NV_Komponentenfehler_22, system-signal=DCDC_NV_Komponentenfehler_22}
        sender-receiver-to-signal-mapping={communication-direction=IN, data-element=Geltungsbereich_E3_1_2_Premium.RP_IF_DCDC_NV_Komponentenfehler_33_XIX_BMC_HV.DE_DCDC_NV_Komponentenfehler_33, system-signal=DCDC_NV_Komponentenfehler_33}
        sender-receiver-to-signal-mapping={communication-direction=IN, data-element=Geltungsbereich_E3_1_2_Premium.RP_IF_DCDC_NV_Komponentenfehler_3_13_XIX_BMC_HV.DE_DCDC_NV_Komponentenfehler_3_13, system-signal=DCDC_NV_Komponentenfehler_3_13}
        sender-receiver-to-signal-mapping={communication-direction=IN, data-element=Geltungsbereich_E3_1_2_Premium.RP_IF_DCDC_NV_Komponentenfehler_3_5_XIX_BMC_HV.DE_DCDC_NV_Komponentenfehler_3_5, system-signal=DCDC_NV_Komponentenfehler_3_5}
        sender-receiver-to-signal-mapping={communication-direction=IN, data-element=Geltungsbereich_E3_1_2_Premium.RP_IF_DCDC_NV_Komponentenfehler_49_XIX_BMC_HV.DE_DCDC_NV_Komponentenfehler_49, system-signal=DCDC_NV_Komponentenfehler_49}
        sender-receiver-to-signal-mapping={communication-direction=IN, data-element=Geltungsbereich_E3_1_2_Premium.RP_IF_DCDC_NV_Komponentenfehler_3_4_XIX_BMC_HV.DE_DCDC_NV_Komponentenfehler_3_4, system-signal=DCDC_NV_Komponentenfehler_3_4}
        sender-receiver-to-signal-mapping={communication-direction=IN, data-element=Geltungsbereich_E3_1_2_Premium.RP_IF_DCDC_NV_Komponentenfehler_3_11_XIX_BMC_HV.DE_DCDC_NV_Komponentenfehler_3_11, system-signal=DCDC_NV_Komponentenfehler_3_11}
        sender-receiver-to-signal-mapping={communication-direction=IN, data-element=Geltungsbereich_E3_1_2_Premium.RP_IF_DCDC_NV_Komponentenfehler_70_XIX_BMC_HV.DE_DCDC_NV_Komponentenfehler_70, system-signal=DCDC_NV_Komponentenfehler_70}
        sender-receiver-to-signal-mapping={communication-direction=IN, data-element=Geltungsbereich_E3_1_2_Premium.RP_IF_DCDC_NV_Komponentenfehler_73_XIX_BMC_HV.DE_DCDC_NV_Komponentenfehler_73, system-signal=DCDC_NV_Komponentenfehler_73}
        sender-receiver-to-signal-mapping={communication-direction=IN, data-element=Geltungsbereich_E3_1_2_Premium.RP_IF_DCDC_NV_Komponentenfehler_57_XIX_BMC_HV.DE_DCDC_NV_Komponentenfehler_57, system-signal=DCDC_NV_Komponentenfehler_57}
        sender-receiver-to-signal-mapping={communication-direction=IN, data-element=Geltungsbereich_E3_1_2_Premium.RP_IF_DCDC_NV_Komponentenfehler_78_XIX_BMC_HV.DE_DCDC_NV_Komponentenfehler_78, system-signal=DCDC_NV_Komponentenfehler_78}
        sender-receiver-to-signal-mapping={communication-direction=IN, data-element=Geltungsbereich_E3_1_2_Premium.RP_IF_DCDC_NV_Komponentenfehler_68_XIX_BMC_HV.DE_DCDC_NV_Komponentenfehler_68, system-signal=DCDC_NV_Komponentenfehler_68}
        sender-receiver-to-signal-mapping={communication-direction=IN, data-element=Geltungsbereich_E3_1_2_Premium.RP_IF_DCDC_NV_Komponentenfehler_66_XIX_BMC_HV.DE_DCDC_NV_Komponentenfehler_66, system-signal=DCDC_NV_Komponentenfehler_66}
        sender-receiver-to-signal-mapping={communication-direction=IN, data-element=Geltungsbereich_E3_1_2_Premium.RP_IF_DCDC_NV_Komponentenfehler_44_XIX_BMC_HV.DE_DCDC_NV_Komponentenfehler_44, system-signal=DCDC_NV_Komponentenfehler_44}
        sender-receiver-to-signal-mapping={communication-direction=IN, data-element=Geltungsbereich_E3_1_2_Premium.RP_IF_DCDC_NV_Komponentenfehler_19_XIX_BMC_HV.DE_DCDC_NV_Komponentenfehler_19, system-signal=DCDC_NV_Komponentenfehler_19}
        sender-receiver-to-signal-mapping={communication-direction=IN, data-element=Geltungsbereich_E3_1_2_Premium.RP_IF_DCDC_NV_Komponentenfehler_55_XIX_BMC_HV.DE_DCDC_NV_Komponentenfehler_55, system-signal=DCDC_NV_Komponentenfehler_55}
        sender-receiver-to-signal-mapping={communication-direction=IN, data-element=Geltungsbereich_E3_1_2_Premium.RP_IF_DCDC_NV_Komponentenfehler_04_XIX_BMC_HV.DE_DCDC_NV_Komponentenfehler_04, system-signal=DCDC_NV_Komponentenfehler_04}
        sender-receiver-to-signal-mapping={communication-direction=IN, data-element=Geltungsbereich_E3_1_2_Premium.RP_IF_DCDC_NV_Komponentenfehler_54_XIX_BMC_HV.DE_DCDC_NV_Komponentenfehler_54, system-signal=DCDC_NV_Komponentenfehler_54}
        sender-receiver-to-signal-mapping={communication-direction=IN, data-element=Geltungsbereich_E3_1_2_Premium.RP_IF_DCDC_NV_Komponentenfehler_10_XIX_BMC_HV.DE_DCDC_NV_Komponentenfehler_10, system-signal=DCDC_NV_Komponentenfehler_10}
        sender-receiver-to-signal-mapping={communication-direction=IN, data-element=Geltungsbereich_E3_1_2_Premium.RP_IF_DCDC_NV_Komponentenfehler_25_XIX_BMC_HV.DE_DCDC_NV_Komponentenfehler_25, system-signal=DCDC_NV_Komponentenfehler_25}
        sender-receiver-to-signal-mapping={communication-direction=IN, data-element=Geltungsbereich_E3_1_2_Premium.RP_IF_DCDC_NV_Komponentenfehler_18_XIX_BMC_HV.DE_DCDC_NV_Komponentenfehler_18, system-signal=DCDC_NV_Komponentenfehler_18}
        sender-receiver-to-signal-mapping={communication-direction=IN, data-element=Geltungsbereich_E3_1_2_Premium.RP_IF_DCDC_NV_Komponentenfehler_3_10_XIX_BMC_HV.DE_DCDC_NV_Komponentenfehler_3_10, system-signal=DCDC_NV_Komponentenfehler_3_10}
        sender-receiver-to-signal-mapping={communication-direction=IN, data-element=Geltungsbereich_E3_1_2_Premium.RP_IF_DCDC_NV_Komponentenfehler_14_XIX_BMC_HV.DE_DCDC_NV_Komponentenfehler_14, system-signal=DCDC_NV_Komponentenfehler_14}
        sender-receiver-to-signal-mapping={communication-direction=IN, data-element=Geltungsbereich_E3_1_2_Premium.RP_IF_DCDC_NV_Komponentenfehler_3_6_XIX_BMC_HV.DE_DCDC_NV_Komponentenfehler_3_6, system-signal=DCDC_NV_Komponentenfehler_3_6}
        sender-receiver-to-signal-mapping={communication-direction=IN, data-element=Geltungsbereich_E3_1_2_Premium.RP_IF_DCDC_NV_Komponentenfehler_47_XIX_BMC_HV.DE_DCDC_NV_Komponentenfehler_47, system-signal=DCDC_NV_Komponentenfehler_47}
        sender-receiver-to-signal-mapping={communication-direction=IN, data-element=Geltungsbereich_E3_1_2_Premium.RP_IF_DCDC_NV_Komponentenfehler_39_XIX_BMC_HV.DE_DCDC_NV_Komponentenfehler_39, system-signal=DCDC_NV_Komponentenfehler_39}
        sender-receiver-to-signal-mapping={communication-direction=IN, data-element=Geltungsbereich_E3_1_2_Premium.RP_IF_DCDC_NV_Komponentenfehler_3_14_XIX_BMC_HV.DE_DCDC_NV_Komponentenfehler_3_14, system-signal=DCDC_NV_Komponentenfehler_3_14}
        sender-receiver-to-signal-mapping={communication-direction=IN, data-element=Geltungsbereich_E3_1_2_Premium.RP_IF_DCDC_NV_Komponentenfehler_37_XIX_BMC_HV.DE_DCDC_NV_Komponentenfehler_37, system-signal=DCDC_NV_Komponentenfehler_37}
        sender-receiver-to-signal-mapping={communication-direction=IN, data-element=Geltungsbereich_E3_1_2_Premium.RP_IF_DCDC_NV_Komponentenfehler_3_2_XIX_BMC_HV.DE_DCDC_NV_Komponentenfehler_3_2, system-signal=DCDC_NV_Komponentenfehler_3_2}
        sender-receiver-to-signal-mapping={communication-direction=IN, data-element=Geltungsbereich_E3_1_2_Premium.RP_IF_DCDC_NV_Komponentenfehler_58_XIX_BMC_HV.DE_DCDC_NV_Komponentenfehler_58, system-signal=DCDC_NV_Komponentenfehler_58}
        sender-receiver-to-signal-mapping={communication-direction=IN, data-element=Geltungsbereich_E3_1_2_Premium.RP_IF_DCDC_NV_Komponentenfehler_3_7_XIX_BMC_HV.DE_DCDC_NV_Komponentenfehler_3_7, system-signal=DCDC_NV_Komponentenfehler_3_7}
        sender-receiver-to-signal-mapping={communication-direction=IN, data-element=Geltungsbereich_E3_1_2_Premium.RP_IF_DCDC_NV_Komponentenfehler_61_XIX_BMC_HV.DE_DCDC_NV_Komponentenfehler_61, system-signal=DCDC_NV_Komponentenfehler_61}
        sender-receiver-to-signal-mapping={communication-direction=IN, data-element=Geltungsbereich_E3_1_2_Premium.RP_IF_DCDC_NV_Komponentenfehler_72_XIX_BMC_HV.DE_DCDC_NV_Komponentenfehler_72, system-signal=DCDC_NV_Komponentenfehler_72}
        sender-receiver-to-signal-mapping={communication-direction=IN, data-element=Geltungsbereich_E3_1_2_Premium.RP_IF_DCDC_NV_Komponentenfehler_43_XIX_BMC_HV.DE_DCDC_NV_Komponentenfehler_43, system-signal=DCDC_NV_Komponentenfehler_43}
        sender-receiver-to-signal-mapping={communication-direction=IN, data-element=Geltungsbereich_E3_1_2_Premium.RP_IF_DCDC_NV_Komponentenfehler_65_XIX_BMC_HV.DE_DCDC_NV_Komponentenfehler_65, system-signal=DCDC_NV_Komponentenfehler_65}
        sender-receiver-to-signal-mapping={communication-direction=IN, data-element=Geltungsbereich_E3_1_2_Premium.RP_IF_DCDC_NV_Komponentenfehler_17_XIX_BMC_HV.DE_DCDC_NV_Komponentenfehler_17, system-signal=DCDC_NV_Komponentenfehler_17}
        sender-receiver-to-signal-mapping={communication-direction=IN, data-element=Geltungsbereich_E3_1_2_Premium.RP_IF_DCDC_NV_Komponentenfehler_01_XIX_BMC_HV.DE_DCDC_NV_Komponentenfehler_01, system-signal=DCDC_NV_Komponentenfehler_01}
        sender-receiver-to-signal-mapping={communication-direction=IN, data-element=Geltungsbereich_E3_1_2_Premium.RP_IF_DCDC_NV_Komponentenfehler_30_XIX_BMC_HV.DE_DCDC_NV_Komponentenfehler_30, system-signal=DCDC_NV_Komponentenfehler_30}
        sender-receiver-to-signal-mapping={communication-direction=IN, data-element=Geltungsbereich_E3_1_2_Premium.RP_IF_DCDC_NV_Komponentenfehler_09_XIX_BMC_HV.DE_DCDC_NV_Komponentenfehler_09, system-signal=DCDC_NV_Komponentenfehler_09}
        sender-receiver-to-signal-mapping={communication-direction=IN, data-element=Geltungsbereich_E3_1_2_Premium.RP_IF_DCDC_NV_Komponentenfehler_3_16_XIX_BMC_HV.DE_DCDC_NV_Komponentenfehler_3_16, system-signal=DCDC_NV_Komponentenfehler_3_16}
        sender-receiver-to-signal-mapping={communication-direction=IN, data-element=Geltungsbereich_E3_1_2_Premium.RP_IF_DCDC_NV_Komponentenfehler_59_XIX_BMC_HV.DE_DCDC_NV_Komponentenfehler_59, system-signal=DCDC_NV_Komponentenfehler_59}
        sender-receiver-to-signal-mapping={communication-direction=IN, data-element=Geltungsbereich_E3_1_2_Premium.RP_IF_DCDC_NV_Komponentenfehler_13_XIX_BMC_HV.DE_DCDC_NV_Komponentenfehler_13, system-signal=DCDC_NV_Komponentenfehler_13}
        sender-receiver-to-signal-mapping={communication-direction=IN, data-element=Geltungsbereich_E3_1_2_Premium.RP_IF_DCDC_NV_Komponentenfehler_38_XIX_BMC_HV.DE_DCDC_NV_Komponentenfehler_38, system-signal=DCDC_NV_Komponentenfehler_38}
        sender-receiver-to-signal-mapping={communication-direction=IN, data-element=Geltungsbereich_E3_1_2_Premium.RP_IF_DCDC_NV_Komponentenfehler_48_XIX_BMC_HV.DE_DCDC_NV_Komponentenfehler_48, system-signal=DCDC_NV_Komponentenfehler_48}
        sender-receiver-to-signal-mapping={communication-direction=IN, data-element=Geltungsbereich_E3_1_2_Premium.RP_IF_DCDC_NV_Komponentenfehler_05_XIX_BMC_HV.DE_DCDC_NV_Komponentenfehler_05, system-signal=DCDC_NV_Komponentenfehler_05}
        sender-receiver-to-signal-mapping={communication-direction=IN, data-element=Geltungsbereich_E3_1_2_Premium.RP_IF_DCDC_NV_Komponentenfehler_15_XIX_BMC_HV.DE_DCDC_NV_Komponentenfehler_15, system-signal=DCDC_NV_Komponentenfehler_15}
        sender-receiver-to-signal-mapping={communication-direction=IN, data-element=Geltungsbereich_E3_1_2_Premium.RP_IF_DCDC_NV_Komponentenfehler_79_XIX_BMC_HV.DE_DCDC_NV_Komponentenfehler_79, system-signal=DCDC_NV_Komponentenfehler_79}
        sender-receiver-to-signal-mapping={communication-direction=IN, data-element=Geltungsbereich_E3_1_2_Premium.RP_IF_DCDC_NV_Komponentenfehler_32_XIX_BMC_HV.DE_DCDC_NV_Komponentenfehler_32, system-signal=DCDC_NV_Komponentenfehler_32}
        sender-receiver-to-signal-mapping={communication-direction=IN, data-element=Geltungsbereich_E3_1_2_Premium.RP_IF_DCDC_NV_Komponentenfehler_29_XIX_BMC_HV.DE_DCDC_NV_Komponentenfehler_29, system-signal=DCDC_NV_Komponentenfehler_29}
        sender-receiver-to-signal-mapping={communication-direction=IN, data-element=Geltungsbereich_E3_1_2_Premium.RP_IF_DCDC_NV_Komponentenfehler_23_XIX_BMC_HV.DE_DCDC_NV_Komponentenfehler_23, system-signal=DCDC_NV_Komponentenfehler_23}
        sender-receiver-to-signal-mapping={communication-direction=IN, data-element=Geltungsbereich_E3_1_2_Premium.RP_IF_DCDC_NV_Komponentenfehler_26_XIX_BMC_HV.DE_DCDC_NV_Komponentenfehler_26, system-signal=DCDC_NV_Komponentenfehler_26}
        sender-receiver-to-signal-mapping={data-element=AB_Deaktivierung_HV.AB_Deaktivierung_HV, system-signal=AB_Deaktivierung_HV}
        sender-receiver-to-signal-group-mapping={data-element=SG_KS_Hybrid_01_Challenge_K.SG_KS_Hybrid_01_Challenge_K, signal-group=SG_KS_Hybrid_01_Challenge_K, type-mapping=sender-rec-record-type-mapping=record-element-mappings=[{application-record-element=KS_Hybrid_01_ChK, system-signal=KS_Hybrid_01_ChK}, {application-record-element=KS_Hybrid_01_ChK_IKACtr, system-signal=KS_Hybrid_01_ChK_IKACtr}, {application-record-element=KS_Hybrid_01_ChK_SID, system-signal=KS_Hybrid_01_ChK_SID}]}
        sender-receiver-to-signal-group-mapping={data-element=SG_KS_Hybrid_01_ReqFrame.SG_KS_Hybrid_01_ReqFrame, signal-group=SG_KS_Hybrid_01_ReqFrame, type-mapping=sender-rec-record-type-mapping=record-element-mappings=[{application-record-element=KS_Hybrid_01_Req_ErrCtr, system-signal=KS_Hybrid_01_Req_ErrCtr}, {application-record-element=KS_Hybrid_01_Req_IKA_Retry, system-signal=KS_Hybrid_01_Req_IKA_Retry}, {application-record-element=KS_Hybrid_01_Req_Prio, system-signal=KS_Hybrid_01_Req_Prio}, {application-record-element=KS_Hybrid_01_Req_SID, system-signal=KS_Hybrid_01_Req_SID}, {application-record-element=KS_Hybrid_01_Req_SWMaj, system-signal=KS_Hybrid_01_Req_SWMaj}, {application-record-element=KS_Hybrid_01_Req_SWMin, system-signal=KS_Hybrid_01_Req_SWMin}, {application-record-element=KS_Hybrid_01_Req_SWPat, system-signal=KS_Hybrid_01_Req_SWPat}, {application-record-element=KS_Hybrid_01_Req_VKMS_Err, system-signal=KS_Hybrid_01_Req_VKMS_Err}]}
        sender-receiver-to-signal-group-mapping={data-element=SG_KS_Hybrid_01_Response_K.SG_KS_Hybrid_01_Response_K, signal-group=SG_KS_Hybrid_01_Response_K, type-mapping=sender-rec-record-type-mapping=record-element-mappings=[{application-record-element=KS_Hybrid_01_ReK, system-signal=KS_Hybrid_01_ReK}, {application-record-element=KS_Hybrid_01_ReK_IKACtr, system-signal=KS_Hybrid_01_ReK_IKACtr}, {application-record-element=KS_Hybrid_01_ReK_SID, system-signal=KS_Hybrid_01_ReK_SID}]}
        sender-receiver-to-signal-group-mapping={data-element=SG_BJB_10.SG_BJB_10, signal-group=SG_BJB_10, type-mapping=sender-rec-record-type-mapping=record-element-mappings=[{application-record-element=BJB_10_BZ, system-signal=BJB_10_BZ}, {application-record-element=BJB_10_CRC, system-signal=BJB_10_CRC}, {application-record-element=BJB_Lebensdauer_Trennelemente, system-signal=BJB_Lebensdauer_Trennelemente}, {application-record-element=BJB_Sperrung_Unterspannung, system-signal=BJB_Sperrung_Unterspannung}, {application-record-element=BJB_Status_HV_Spannungssensorik, system-signal=BJB_Status_HV_Spannungssensorik}, {application-record-element=BJB_Status_Trennelemente, system-signal=BJB_Status_Trennelemente}, {application-record-element=SignalVoid_BJB_10_0, system-signal=SignalVoid_BJB_10_0}, {application-record-element=SignalVoid_BJB_10_1, system-signal=SignalVoid_BJB_10_1}, {application-record-element=SignalVoid_BJB_10_2, system-signal=SignalVoid_BJB_10_2}, {application-record-element=SignalVoid_BJB_10_3, system-signal=SignalVoid_BJB_10_3}]}
        sender-receiver-to-signal-group-mapping={data-element=SG_BJB_13.SG_BJB_11, signal-group=SG_BJB_11, type-mapping=sender-rec-record-type-mapping=record-element-mappings=[{application-record-element=BJB_11_BZ, system-signal=BJB_11_BZ}, {application-record-element=BJB_11_CRC, system-signal=BJB_11_CRC}, {application-record-element=BJB_Sperrung_Ueberspannung, system-signal=BJB_Sperrung_Ueberspannung}, {application-record-element=BJB_Ueberspannungszaehler_CMC01, system-signal=BJB_Ueberspannungszaehler_CMC01}, {application-record-element=BJB_Ueberspannungszaehler_CMC02, system-signal=BJB_Ueberspannungszaehler_CMC02}, {application-record-element=BJB_Uebertemperaturzaehler_CMC01, system-signal=BJB_Uebertemperaturzaehler_CMC01}, {application-record-element=BJB_Uebertemperaturzaehler_CMC02, system-signal=BJB_Uebertemperaturzaehler_CMC02}]}
        sender-receiver-to-signal-group-mapping={data-element=SG_BJB_15.SG_BJB_12, signal-group=SG_BJB_12, type-mapping=sender-rec-record-type-mapping=record-element-mappings=[{application-record-element=BJB_12_BZ, system-signal=BJB_12_BZ}, {application-record-element=BJB_12_CRC, system-signal=BJB_12_CRC}, {application-record-element=BJB_Sperrung_Uebertemperatur, system-signal=BJB_Sperrung_Uebertemperatur}, {application-record-element=BJB_Ueberspannungszaehler_CMC03, system-signal=BJB_Ueberspannungszaehler_CMC03}, {application-record-element=BJB_Ueberspannungszaehler_CMC04, system-signal=BJB_Ueberspannungszaehler_CMC04}, {application-record-element=BJB_Uebertemperaturzaehler_CMC03, system-signal=BJB_Uebertemperaturzaehler_CMC03}, {application-record-element=BJB_Uebertemperaturzaehler_CMC04, system-signal=BJB_Uebertemperaturzaehler_CMC04}]}
        sender-receiver-to-signal-group-mapping={data-element=SG_BJB_16.SG_BJB_13, signal-group=SG_BJB_13, type-mapping=sender-rec-record-type-mapping=record-element-mappings=[{application-record-element=BJB_13_BZ, system-signal=BJB_13_BZ}, {application-record-element=BJB_13_CRC, system-signal=BJB_13_CRC}, {application-record-element=BJB_Unterspannungszaehler_CMC01, system-signal=BJB_Unterspannungszaehler_CMC01}, {application-record-element=BJB_Unterspannungszaehler_CMC02, system-signal=BJB_Unterspannungszaehler_CMC02}, {application-record-element=BJB_Unterspannungszaehler_CMC03, system-signal=BJB_Unterspannungszaehler_CMC03}, {application-record-element=BJB_Unterspannungszaehler_CMC04, system-signal=BJB_Unterspannungszaehler_CMC04}, {application-record-element=SignalVoid_BJB_13_0, system-signal=SignalVoid_BJB_13_0}, {application-record-element=SignalVoid_BJB_13_1, system-signal=SignalVoid_BJB_13_1}]}
        sender-receiver-to-signal-group-mapping={data-element=SG_BMC_HV_5.SG_BMC_HV_04, signal-group=SG_BMC_HV_04, type-mapping=sender-rec-record-type-mapping=record-element-mappings=[{application-record-element=BMC_Dev_Freigabe, system-signal=BMC_Dev_Freigabe}, {application-record-element=BMC_Flash_Freigabe, system-signal=BMC_Flash_Freigabe}, {application-record-element=BMC_HV_04_BZ, system-signal=BMC_HV_04_BZ}, {application-record-element=BMC_HV_04_CRC, system-signal=BMC_HV_04_CRC}, {application-record-element=BMC_Iso_Mode_Anf, system-signal=BMC_Iso_Mode_Anf}, {application-record-element=BMC_UI1_Spannung1_Schalt_Anf, system-signal=BMC_UI1_Spannung1_Schalt_Anf}, {application-record-element=BMC_UI1_Spannung2_Schalt_Anf, system-signal=BMC_UI1_Spannung2_Schalt_Anf}, {application-record-element=BMC_UI2_Spannung1_Schalt_Anf, system-signal=BMC_UI2_Spannung1_Schalt_Anf}, {application-record-element=BMC_UI2_Spannung2_Schalt_Anf, system-signal=BMC_UI2_Spannung2_Schalt_Anf}, {application-record-element=SignalVoid_BMC_HV_04_0, system-signal=SignalVoid_BMC_HV_04_0}, {application-record-element=SignalVoid_BMC_HV_04_1, system-signal=SignalVoid_BMC_HV_04_1}, {application-record-element=SignalVoid_BMC_HV_04_2, system-signal=SignalVoid_BMC_HV_04_2}, {application-record-element=SignalVoid_BMC_HV_04_3, system-signal=SignalVoid_BMC_HV_04_3}, {application-record-element=SignalVoid_BMC_HV_04_4, system-signal=SignalVoid_BMC_HV_04_4}, {application-record-element=SignalVoid_BMC_HV_04_5, system-signal=SignalVoid_BMC_HV_04_5}]}
        sender-receiver-to-signal-group-mapping={data-element=SG_BMC_HV_17.SG_BMC_HV_10, signal-group=SG_BMC_HV_10, type-mapping=sender-rec-record-type-mapping=record-element-mappings=[{application-record-element=BMC_Datenuebernahme_Anf, system-signal=BMC_Datenuebernahme_Anf}, {application-record-element=BMC_HV_10_BZ, system-signal=BMC_HV_10_BZ}, {application-record-element=BMC_HV_10_CRC, system-signal=BMC_HV_10_CRC}, {application-record-element=BMC_Lebensdauer_Trennelemente, system-signal=BMC_Lebensdauer_Trennelemente}, {application-record-element=BMC_Sperrung_Unterspannung, system-signal=BMC_Sperrung_Unterspannung}, {application-record-element=BMC_Status_HV_Spannungssensorik, system-signal=BMC_Status_HV_Spannungssensorik}, {application-record-element=BMC_Status_Trennelemente, system-signal=BMC_Status_Trennelemente}, {application-record-element=SignalVoid_BMC_HV_10_0, system-signal=SignalVoid_BMC_HV_10_0}, {application-record-element=SignalVoid_BMC_HV_10_1, system-signal=SignalVoid_BMC_HV_10_1}, {application-record-element=SignalVoid_BMC_HV_10_2, system-signal=SignalVoid_BMC_HV_10_2}, {application-record-element=SignalVoid_BMC_HV_10_3, system-signal=SignalVoid_BMC_HV_10_3}]}
        sender-receiver-to-signal-group-mapping={data-element=SG_BMC_HV_19.SG_BMC_HV_11, signal-group=SG_BMC_HV_11, type-mapping=sender-rec-record-type-mapping=record-element-mappings=[{application-record-element=BMC_HV_11_BZ, system-signal=BMC_HV_11_BZ}, {application-record-element=BMC_HV_11_CRC, system-signal=BMC_HV_11_CRC}, {application-record-element=BMC_Sperrung_Ueberspannung, system-signal=BMC_Sperrung_Ueberspannung}, {application-record-element=BMC_Ueberspannungszaehler_CMC01, system-signal=BMC_Ueberspannungszaehler_CMC01}, {application-record-element=BMC_Ueberspannungszaehler_CMC02, system-signal=BMC_Ueberspannungszaehler_CMC02}, {application-record-element=BMC_Uebertemperaturzaehler_CMC01, system-signal=BMC_Uebertemperaturzaehler_CMC01}, {application-record-element=BMC_Uebertemperaturzaehler_CMC02, system-signal=BMC_Uebertemperaturzaehler_CMC02}]}
        sender-receiver-to-signal-group-mapping={data-element=SG_BMC_HV_20.SG_BMC_HV_12, signal-group=SG_BMC_HV_12, type-mapping=sender-rec-record-type-mapping=record-element-mappings=[{application-record-element=BMC_HV_12_BZ, system-signal=BMC_HV_12_BZ}, {application-record-element=BMC_HV_12_CRC, system-signal=BMC_HV_12_CRC}, {application-record-element=BMC_Sperrung_Uebertemperatur, system-signal=BMC_Sperrung_Uebertemperatur}, {application-record-element=BMC_Ueberspannungszaehler_CMC03, system-signal=BMC_Ueberspannungszaehler_CMC03}, {application-record-element=BMC_Ueberspannungszaehler_CMC04, system-signal=BMC_Ueberspannungszaehler_CMC04}, {application-record-element=BMC_Uebertemperaturzaehler_CMC03, system-signal=BMC_Uebertemperaturzaehler_CMC03}, {application-record-element=BMC_Uebertemperaturzaehler_CMC04, system-signal=BMC_Uebertemperaturzaehler_CMC04}]}
        sender-receiver-to-signal-group-mapping={data-element=SG_BMC_HV_21.SG_BMC_HV_13, signal-group=SG_BMC_HV_13, type-mapping=sender-rec-record-type-mapping=record-element-mappings=[{application-record-element=BMC_HV_13_BZ, system-signal=BMC_HV_13_BZ}, {application-record-element=BMC_HV_13_CRC, system-signal=BMC_HV_13_CRC}, {application-record-element=BMC_Unterspannungszaehler_CMC01, system-signal=BMC_Unterspannungszaehler_CMC01}, {application-record-element=BMC_Unterspannungszaehler_CMC02, system-signal=BMC_Unterspannungszaehler_CMC02}, {application-record-element=BMC_Unterspannungszaehler_CMC03, system-signal=BMC_Unterspannungszaehler_CMC03}, {application-record-element=BMC_Unterspannungszaehler_CMC04, system-signal=BMC_Unterspannungszaehler_CMC04}, {application-record-element=SignalVoid_BMC_HV_13_0, system-signal=SignalVoid_BMC_HV_13_0}, {application-record-element=SignalVoid_BMC_HV_13_1, system-signal=SignalVoid_BMC_HV_13_1}]}
        sender-receiver-to-signal-mapping={data-element=Vishnu_Test_100Bytes_PDU_NewSignal5_2a9e79b5a4a81ebd.Vishnu_Test_100Bytes_PDU_NewSignal5_2a9e79b5a4a81ebd, system-signal=Vishnu_Test_100Bytes_PDU_NewSignal5_2a9e79b5a4a81ebd}
        sender-receiver-to-signal-mapping={data-element=DTC_Test_PDU_Set_Signal_e68158b3301efab7.DTC_Test_PDU_Set_Signal_e68158b3301efab7, system-signal=DTC_Test_PDU_Set_Signal_e68158b3301efab7}
      pnc-mapping pnc-group=BMC_HV_XIX_PNC_01_CarWakeUp_Tx, pnc-identifier=8, wakeup-frame=[NMH_Hybrid_01_XIX_BMC_CAN01, NM_AWC_XIX_HCP5_CANFD01, NM_Gateway_XIX_HCP5_CANFD01, NM_HVZB_XIX_HCP5_CANFD01, NM_Hybrid_01_XIX_HCP5_CANFD01, NM_SACID_1_XIX_HCP5_CANFD01, NM_SACID_2_XIX_HCP5_CANFD01]:
        ident PNC_01_CarWakeUp
      pnc-mapping pnc-group=BMC_HV_XIX_PNC_02_Basefunction_Powertrain_Rx, pnc-identifier=9, wakeup-frame=NM_Gateway_XIX_HCP5_CANFD01:
        ident PNC_02_Basefunction_Powertrain
      pnc-mapping pnc-identifier=10, wakeup-frame=NM_Gateway_XIX_HCP5_CANFD01:
        ident PNC_03_Basefunction_Chassis
      pnc-mapping pnc-identifier=11, wakeup-frame=NM_Gateway_XIX_HCP5_CANFD01:
        ident PNC_04_Basefunction_DrivingAssistance
      pnc-mapping pnc-identifier=12, wakeup-frame=NM_Gateway_XIX_HCP5_CANFD01:
        ident PNC_05_Basefunction_Infotainment
      pnc-mapping pnc-group=BMC_HV_XIX_PNC_06_Basefunction_ComfortLight_Rx, pnc-identifier=13, wakeup-frame=NM_Gateway_XIX_HCP5_CANFD01:
        ident PNC_06_Basefunction_ComfortLight
      pnc-mapping pnc-group=BMC_HV_XIX_PNC_07_Basefunction_CrossSection_Rx, pnc-identifier=14, wakeup-frame=NM_Gateway_XIX_HCP5_CANFD01:
        ident PNC_07_Basefunction_CrossSection
      pnc-mapping pnc-identifier=15, wakeup-frame=NM_Gateway_XIX_HCP5_CANFD01:
        ident PNC_08_Basefunction_Connectivity
      pnc-mapping pnc-group=BMC_HV_XIX_PNC_10_Powertrain_Rx, pnc-identifier=17, wakeup-frame=NM_Gateway_XIX_HCP5_CANFD01:
        ident PNC_10_Powertrain
      pnc-mapping pnc-group=BMC_HV_XIX_PNC_11_Chassis_Rx, pnc-identifier=18, wakeup-frame=NM_Gateway_XIX_HCP5_CANFD01:
        ident PNC_11_Chassis
      pnc-mapping pnc-identifier=19, wakeup-frame=NM_Gateway_XIX_HCP5_CANFD01:
        ident PNC_12_GearSelector
      pnc-mapping pnc-group=BMC_HV_XIX_PNC_13_Airbag_Rx, pnc-identifier=20, wakeup-frame=NM_Gateway_XIX_HCP5_CANFD01:
        ident PNC_13_Airbag
      pnc-mapping pnc-identifier=21, wakeup-frame=NM_Gateway_XIX_HCP5_CANFD01:
        ident PNC_14_InfotainmentExtensions
      pnc-mapping pnc-identifier=22, wakeup-frame=NM_Gateway_XIX_HCP5_CANFD01:
        ident PNC_15_InstrumentclusterDisplay
      pnc-mapping pnc-identifier=23, wakeup-frame=NM_Gateway_XIX_HCP5_CANFD01:
        ident PNC_16_InfotainmentDisplay
      pnc-mapping pnc-identifier=24, wakeup-frame=NM_Gateway_XIX_HCP5_CANFD01:
        ident PNC_17_Audio
      pnc-mapping pnc-identifier=25, wakeup-frame=NM_Gateway_XIX_HCP5_CANFD01:
        ident PNC_18_VirtualSideMirrors
      pnc-mapping pnc-identifier=26, wakeup-frame=NM_Gateway_XIX_HCP5_CANFD01:
        ident PNC_19_Doors_Hatches
      pnc-mapping pnc-identifier=27, wakeup-frame=NM_Gateway_XIX_HCP5_CANFD01:
        ident PNC_20_OptionalComfort
      pnc-mapping pnc-identifier=28, wakeup-frame=NM_Gateway_XIX_HCP5_CANFD01:
        ident PNC_21_AirSuspension
      pnc-mapping pnc-identifier=29, wakeup-frame=NM_Gateway_XIX_HCP5_CANFD01:
        ident PNC_22_ExteriorLights
      pnc-mapping pnc-identifier=30, wakeup-frame=NM_Gateway_XIX_HCP5_CANFD01:
        ident PNC_23_Climate
      pnc-mapping pnc-group=BMC_HV_XIX_PNC_24_ThermoManagement_Rx, pnc-identifier=31, wakeup-frame=NM_Gateway_XIX_HCP5_CANFD01:
        ident PNC_24_ThermoManagement
      pnc-mapping pnc-identifier=32, wakeup-frame=NM_Gateway_XIX_HCP5_CANFD01:
        ident PNC_25_AccessSystemSensors
      pnc-mapping pnc-group=[BMC_HV_XIX_PNC_26_HighVoltage_Charging_Rx, BMC_HV_XIX_PNC_26_HighVoltage_Charging_Tx], pnc-identifier=33, wakeup-frame=NM_Gateway_XIX_HCP5_CANFD01:
        ident PNC_26_HighVoltage_Charging
      pnc-mapping pnc-group=BMC_HV_XIX_PNC_27_Timemaster_Timer_Rx, pnc-identifier=34, wakeup-frame=NM_Gateway_XIX_HCP5_CANFD01:
        ident PNC_27_Timemaster_Timer
      pnc-mapping pnc-identifier=35, wakeup-frame=NM_Gateway_XIX_HCP5_CANFD01:
        ident PNC_28_OnboardTester_DataCollector
      pnc-mapping pnc-identifier=36, wakeup-frame=NM_Gateway_XIX_HCP5_CANFD01:
        ident PNC_29_SteeringColumnLock
      pnc-mapping pnc-group=[BMC_HV_XIX_PNC_30_EnergyManagement_Rx, BMC_HV_XIX_PNC_30_EnergyManagement_Tx], pnc-identifier=37, wakeup-frame=NM_Gateway_XIX_HCP5_CANFD01:
        ident PNC_30_EnergyManagement
      pnc-mapping pnc-identifier=38, wakeup-frame=NM_Gateway_XIX_HCP5_CANFD01:
        ident PNC_31_MultifunctionalSteeringWheel
      pnc-mapping pnc-identifier=39, wakeup-frame=NM_Gateway_XIX_HCP5_CANFD01:
        ident PNC_32_OnlineAccess
      pnc-mapping pnc-identifier=40, wakeup-frame=NM_Gateway_XIX_HCP5_CANFD01:
        ident PNC_33_ExternalWirelessCommunication
      pnc-mapping pnc-identifier=41, wakeup-frame=NM_Gateway_XIX_HCP5_CANFD01:
        ident PNC_34_GPS_Lokalization
      pnc-mapping pnc-identifier=42, wakeup-frame=NM_Gateway_XIX_HCP5_CANFD01:
        ident PNC_35_ExteriorSound
      pnc-mapping pnc-identifier=43, wakeup-frame=NM_Gateway_XIX_HCP5_CANFD01:
        ident PNC_36_Preheater
      pnc-mapping pnc-identifier=44, wakeup-frame=NM_Gateway_XIX_HCP5_CANFD01:
        ident PNC_37_HighVoltage_WirelessChargingStation
      pnc-mapping pnc-group=[BMC_HV_XIX_PNC_40_Diagnosis_Energy_Rx, BMC_HV_XIX_PNC_40_Diagnosis_Energy_Tx], pnc-identifier=47, wakeup-frame=NM_Gateway_XIX_HCP5_CANFD01:
        ident PNC_40_Diagnosis_Energy
      pnc-mapping pnc-identifier=48, wakeup-frame=NM_Gateway_XIX_HCP5_CANFD01:
        ident PNC_41_Diagnosis_Powertrain
      pnc-mapping pnc-identifier=49, wakeup-frame=NM_Gateway_XIX_HCP5_CANFD01:
        ident PNC_42_Diagnosis_FlexRay
      pnc-mapping pnc-identifier=50, wakeup-frame=NM_Gateway_XIX_HCP5_CANFD01:
        ident PNC_43_Diagnosis_DrivingAssistance
      pnc-mapping pnc-identifier=51, wakeup-frame=NM_Gateway_XIX_HCP5_CANFD01:
        ident PNC_44_Diagnosis_Infotainment
      pnc-mapping pnc-identifier=52, wakeup-frame=NM_Gateway_XIX_HCP5_CANFD01:
        ident PNC_45_Diagnosis_Comfort
      pnc-mapping pnc-identifier=53, wakeup-frame=NM_Gateway_XIX_HCP5_CANFD01:
        ident PNC_46_Diagnosis_Light
      pnc-mapping pnc-identifier=54, wakeup-frame=NM_Gateway_XIX_HCP5_CANFD01:
        ident PNC_47_Diagnosis_ComfortLINs
      pnc-mapping pnc-identifier=55, wakeup-frame=NM_Gateway_XIX_HCP5_CANFD01:
        ident PNC_48_Diagnosis_ClimateTmeLINs
      pnc-mapping pnc-identifier=60, wakeup-frame=NM_Gateway_XIX_HCP5_CANFD01:
        ident PNC_53_Lock_Unlock
      pnc-mapping pnc-identifier=62, wakeup-frame=NM_Gateway_XIX_HCP5_CANFD01:
        ident PNC_55_Dimming
      pnc-mapping pnc-identifier=63, wakeup-frame=NM_Gateway_XIX_HCP5_CANFD01:
        ident PNC_56_Charging_Status
      sw-mappings:
        15 x swc to ecu mapping, all with ecu-instance=BMC_HV:
          MAPPING_Infrastructure_Hybrid_01_XIX_network_infrastructure_XIX_BMC_HV: component=Geltungsbereich_E3_1_2_Premium.Infrastructure_Hybrid_01_XIX_network_infrastructure_XIX_BMC_HV
          MAPPING_HochvoltBatterieManagement_XIX_SoC_XIX_BMC_HV: component=Geltungsbereich_E3_1_2_Premium.HochvoltBatterieManagement_XIX_SoC_XIX_BMC_HV
          MAPPING_diagnosis_infrastructure_Hybrid_01_XIX_diagnosis_infrastructure_XIX_BMC_HV: component=Geltungsbereich_E3_1_2_Premium.diagnosis_infrastructure_Hybrid_01_XIX_diagnosis_infrastructure_XIX_BMC_HV
          MAPPING_KS_BMC_HV_XIX_KSGen3_XIX_BMC_HV: component=Geltungsbereich_E3_1_2_Premium.KS_BMC_HV_XIX_KSGen3_XIX_BMC_HV
          MAPPING_BMC_HV_Netzsteuerung_XIX_NV_SD_XIX_BMC_HV: component=Geltungsbereich_E3_1_2_Premium.BMC_HV_Netzsteuerung_XIX_NV_SD_XIX_BMC_HV
          MAPPING_SOK_Participant_BMC_HV_XIX_SOK_XIX_BMC_HV: component=Geltungsbereich_E3_1_2_Premium.SOK_Participant_BMC_HV_XIX_SOK_XIX_BMC_HV
          MAPPING_BMC_Berechnung_SOC_XIX_SoC_XIX_BMC_HV: component=Geltungsbereich_E3_1_2_Premium.BMC_Berechnung_SOC_XIX_SoC_XIX_BMC_HV
          MAPPING_BMC_HVS_Slave_XIX_SoC_XIX_BMC_HV: component=Geltungsbereich_E3_1_2_Premium.BMC_HVS_Slave_XIX_SoC_XIX_BMC_HV
          MAPPING_HV_Batterie_RTM_XIX_RTM_XIX_BMC_HV: component=Geltungsbereich_E3_1_2_Premium.HV_Batterie_RTM_XIX_RTM_XIX_BMC_HV
          MAPPING_VKMS_Participant_BMC_HV_XIX_VKMS_XIX_BMC_HV: component=Geltungsbereich_E3_1_2_Premium.VKMS_Participant_BMC_HV_XIX_VKMS_XIX_BMC_HV
          MAPPING_OTA_Infrastructure_Hybrid_01_XIX_ORU6_XIX_BMC_HV: component=Geltungsbereich_E3_1_2_Premium.OTA_Infrastructure_Hybrid_01_XIX_ORU6_XIX_BMC_HV
          MAPPING_ORU_Infrastructure_Hybrid_01_XIX_ORU6_XIX_BMC_HV: component=Geltungsbereich_E3_1_2_Premium.ORU_Infrastructure_Hybrid_01_XIX_ORU6_XIX_BMC_HV
          MAPPING_DaapServer_BMC_HV_XIX_GDC_DAAP_XIX_BMC_HV: component=Geltungsbereich_E3_1_2_Premium.DaapServer_BMC_HV_XIX_GDC_DAAP_XIX_BMC_HV
          MAPPING_HVB_Fehlerausgabe_SecondaryOBDECU_XIX_SoC_XIX_BMC_HV: component=Geltungsbereich_E3_1_2_Premium.HVB_Fehlerausgabe_SecondaryOBDECU_XIX_SoC_XIX_BMC_HV
          MAPPING_BMC_SafetyDataStorage_XIX_SoC_XIX_BMC_HV: component=Geltungsbereich_E3_1_2_Premium.BMC_SafetyDataStorage_XIX_SoC_XIX_BMC_HV
    root-software-compositions:
      root sw composition prototype Geltungsbereich_E3_1_2_Premium: software-composition=Geltungsbereich_E3_1_2_Premium
