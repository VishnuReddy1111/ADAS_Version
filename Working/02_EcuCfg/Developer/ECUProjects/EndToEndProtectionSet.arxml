AUTOSAR XML (schema 00044)
package /EndToEndProtections
  end to end protection set E2E_ProtectionSet
