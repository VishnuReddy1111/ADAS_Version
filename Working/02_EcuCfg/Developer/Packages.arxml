AUTOSAR XML (schema 00044)
package /DataTypes/DataConstrs
  range Signal_MyECU_SecOC_Tx1: raw 0..255
  range Signal_MyECU_SecOC_Tx2: raw 0..255
  range Signal_MyECU_SecOC_Rx2: raw 0..255
