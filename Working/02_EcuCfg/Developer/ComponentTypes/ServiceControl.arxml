AUTOSAR XML (schema 00044)
package /ComponentTypes
  application sw component type ServiceControl
    behavior ServiceControl_InternalBehavior: data-type-mapping=BswMMappingSet
      init event ServiceControl_InitEvent: start-on-event=ServiceControl_Init
      timing event TMT_ServiceControl_Main: start-on-event=ServiceControl_Main, period=0.05
      runnable ServiceControl_Init
      runnable ServiceControl_Main
  swc implementation ServiceControl_Implementation: behavior=ServiceControl_InternalBehavior
