AUTOSAR XML (schema 00044)
package /ComponentTypes
  composition sw component type BMC_Berechnung_SOC_XIX_SoC_XIX_BMC_HV
    provide port SP_IF_Anzeige_SOC_XIX_BMC_Berechnung_SOC_XIX_SoC_XIX_BMC_HV: nonqueued-sender-com-spec=DE_Anzeige_SOC, provided-interface=IF_Anzeige_SOC
