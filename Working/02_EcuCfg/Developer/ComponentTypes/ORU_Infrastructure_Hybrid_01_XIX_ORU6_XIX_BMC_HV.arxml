AUTOSAR XML (schema 00044)
package /ComponentTypes
  composition sw component type ORU_Infrastructure_Hybrid_01_XIX_ORU6_XIX_BMC_HV
    require port RP_IF_ORU_Status_XIX_ORU_Infrastructure_Hybrid_01_XIX_ORU6_XIX_BMC_HV: nonqueued-receiver-com-spec=DE_ORU_Status, required-interface=IF_ORU_Status
