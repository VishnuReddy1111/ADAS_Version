[part 2 of 5: packages /BaseType to /Semantics]
AUTOSAR XML (schema 00048)
package /BaseType
  1525 x base type, all with category=FIXED_LENGTH:
    BT_Airbag_10_CRC: base-type-size=1, base-type-encoding=NONE
    BT_BMC_CMC_Zellspannung_053: base-type-size=1, base-type-encoding=NONE
    BT_BMC_CMC_Temperatur_027: base-type-size=1, base-type-encoding=NONE
    BT_BMC_CMC_Temperatur_057: base-type-size=1, base-type-encoding=NONE
    BT_Anzeige_SOC: base-type-size=1, base-type-encoding=NONE
    BT_BMC_CMC_Zellspannung_054: base-type-size=1, base-type-encoding=NONE
    BT_BMC_CMC_Zellspannung_024: base-type-size=1, base-type-encoding=NONE
    BT_BMC_CMC_Zellspannung_055: base-type-size=1, base-type-encoding=NONE
    BT_BMC_CMC_Temperatur_028: base-type-size=1, base-type-encoding=NONE
    BT_BMC_CMC_Temperatur_058: base-type-size=1, base-type-encoding=NONE
    BT_BMC_CMC_Zellspannung_056: base-type-size=1, base-type-encoding=NONE
    BT_BEM_Batt_Ab: base-type-size=1, base-type-encoding=NONE
    BT_AB_Abschaltanf_SIH_BF: base-type-size=1, base-type-encoding=NONE
    BT_BMC_CMC_Temperatur_059: base-type-size=1, base-type-encoding=NONE
    BT_BMC_CMC_Zellspannung_057: base-type-size=1, base-type-encoding=NONE
    BT_BMC_CMC_Temperatur_029: base-type-size=1, base-type-encoding=NONE
    BT_BMC_CMC_Zellspannung_025: base-type-size=1, base-type-encoding=NONE
    BT_BMC_CMC_Zellspannung_058: base-type-size=1, base-type-encoding=NONE
    BT_BMC_CMC_Temperatur_060: base-type-size=1, base-type-encoding=NONE
    BT_BMC_Bidi_GenutzteEnergie: base-type-size=1, base-type-encoding=NONE
    BT_BMC_CMC_Temperatur_02_Messzeit: base-type-size=1, base-type-encoding=NONE
    BT_BEM_Generatordiagnose: base-type-size=1, base-type-encoding=NONE
    BT_BMC_CMC_Temperatur_061: base-type-size=1, base-type-encoding=NONE
    BT_BMC_CMC_Zellspannung_026: base-type-size=1, base-type-encoding=NONE
    BT_BMC_CMC_Zellspannung_059: base-type-size=1, base-type-encoding=NONE
    BT_BMC_CMC_Temperatur_030: base-type-size=1, base-type-encoding=NONE
    BT_BMC_CMC_Zellspannung_027: base-type-size=1, base-type-encoding=NONE
    BT_BMC_CMC_Zellspannung_05_Messzeit: base-type-size=1, base-type-encoding=NONE
    BT_BMC_CMC_Temperatur_062: base-type-size=1, base-type-encoding=NONE
    BT_BMC_CMC_Temperatur_031: base-type-size=1, base-type-encoding=NONE
    BT_BEM_HL_Regelung_Status: base-type-size=1, base-type-encoding=NONE
    BT_BMC_CMC_Zellspannung_060: base-type-size=1, base-type-encoding=NONE
    BT_BMC_CMC_Temperatur_063: base-type-size=1, base-type-encoding=NONE
    BT_BMC_CMC_Zellspannung_028: base-type-size=1, base-type-encoding=NONE
    BT_AB_Anzeige_Fussg: base-type-size=1, base-type-encoding=NONE
    BT_BMC_CMC_Temperatur_032: base-type-size=1, base-type-encoding=NONE
    BT_BMC_CMC_Zellspannung_061: base-type-size=1, base-type-encoding=NONE
    BT_BMC_Bidi_Max_SoC: base-type-size=1, base-type-encoding=NONE
    BT_BMC_CMC_Temperatur_064: base-type-size=1, base-type-encoding=NONE
    BT_BJB_10_BZ: base-type-size=1, base-type-encoding=NONE
    BT_BMC_CMC_Zellspannung_062: base-type-size=1, base-type-encoding=NONE
    BT_BMC_CMC_Zellspannung_029: base-type-size=1, base-type-encoding=NONE
    BT_BMC_CMC_Temperatur_065: base-type-size=1, base-type-encoding=NONE
    BT_BMC_CMC_Temperatur_033: base-type-size=1, base-type-encoding=NONE
    BT_AB_Belegung_VB: base-type-size=1, base-type-encoding=NONE
    BT_BMC_CMC_Temperatur_066: base-type-size=1, base-type-encoding=NONE
    BT_BEM_Red_Innengeblaese: base-type-size=1, base-type-encoding=NONE
    BT_BMC_CMC_Zellspannung_063: base-type-size=1, base-type-encoding=NONE
    BT_BMC_CMC_Zellspannung_02_Messzeit: base-type-size=1, base-type-encoding=NONE
    BT_BMC_CMC_Temperatur_034: base-type-size=1, base-type-encoding=NONE
    BT_BMC_Bidi_Min_SoC: base-type-size=1, base-type-encoding=NONE
    BT_BMC_CMC_Zellspannung_064: base-type-size=1, base-type-encoding=NONE
    BT_BMC_CMC_Temperatur_067: base-type-size=1, base-type-encoding=NONE
    BT_BMC_CMC_Zellspannung_030: base-type-size=1, base-type-encoding=NONE
    BT_BMC_CMC_Temperatur_035: base-type-size=1, base-type-encoding=NONE
    BT_AB_Belegung_VF: base-type-size=1, base-type-encoding=NONE
    BT_BMC_CMC_Zellspannung_065: base-type-size=1, base-type-encoding=NONE
    BT_BEM_STH_Einschaltverbot: base-type-size=1, base-type-encoding=NONE
    BT_BMC_CMC_Temperatur_068: base-type-size=1, base-type-encoding=NONE
    BT_BMC_CMC_Zellspannung_031: base-type-size=1, base-type-encoding=NONE
    BT_BMC_CMC_Temperatur_036: base-type-size=1, base-type-encoding=NONE
    BT_BMC_CMC_Zellspannung_066: base-type-size=1, base-type-encoding=NONE
    BT_BMC_Bidi_Veto_Energie: base-type-size=1, base-type-encoding=NONE
    BT_BMC_CMC_Temperatur_012: base-type-size=1, base-type-encoding=NONE
    BT_BMC_CMC_Temperatur_069: base-type-size=1, base-type-encoding=NONE
    BT_BJB_10_CRC: base-type-size=1, base-type-encoding=NONE
    BT_BMC_CMC_Temperatur_037: base-type-size=1, base-type-encoding=NONE
    BT_BMC_CMC_Zellspannung_032: base-type-size=1, base-type-encoding=NONE
    BT_BMC_CMC_Zellspannung_067: base-type-size=1, base-type-encoding=NONE
    BT_BMC_CMC_Temperatur_070: base-type-size=1, base-type-encoding=NONE
    BT_BEM_STH_Zielzeit: base-type-size=1, base-type-encoding=NONE
    BT_AB_Belegung_VF_ext: base-type-size=1, base-type-encoding=NONE
    BT_BMC_Bidi_Veto_Temp: base-type-size=1, base-type-encoding=NONE
    BT_BMC_CMC_Zellspannung_068: base-type-size=1, base-type-encoding=NONE
    BT_BMC_CMC_Temperatur_071: base-type-size=1, base-type-encoding=NONE
    BT_BMC_CMC_Temperatur_038: base-type-size=1, base-type-encoding=NONE
    BT_BMC_CMC_Zellspannung_033: base-type-size=1, base-type-encoding=NONE
    BT_BMC_CMC_Zellspannung_069: base-type-size=1, base-type-encoding=NONE
    BT_BJB_11_BZ: base-type-size=1, base-type-encoding=NONE
    BT_BMC_CMC_Zellspannung_116: base-type-size=1, base-type-encoding=NONE
    BT_BMC_CMC_Temperatur_072: base-type-size=1, base-type-encoding=NONE
    BT_AB_Belegung_VF_ext_aktiv: base-type-size=1, base-type-encoding=NONE
    BT_BMC_CMC_Zellspannung_034: base-type-size=1, base-type-encoding=NONE
    BT_BMC_CMC_Temperatur_039: base-type-size=1, base-type-encoding=NONE
    BT_BMC_CMC_Zellspannung_070: base-type-size=1, base-type-encoding=NONE
    BT_BMC_CMC_Zellspannung_180: base-type-size=1, base-type-encoding=NONE
    BT_BMC_CMC_Temperatur_001: base-type-size=1, base-type-encoding=NONE
    BT_BMC_CMC_Temperatur_073: base-type-size=1, base-type-encoding=NONE
    BT_BMC_CMC_Temperatur_013: base-type-size=1, base-type-encoding=NONE
    BT_BMC_CMC_Zellspannung_035: base-type-size=1, base-type-encoding=NONE
    BT_BMC_CMC_Zellspannung_071: base-type-size=1, base-type-encoding=NONE
    BT_BMC_CMC_Temperatur_074: base-type-size=1, base-type-encoding=NONE
    BT_BMC_CMC_Temperatur_03_Messzeit: base-type-size=1, base-type-encoding=NONE
    BT_BJB_11_CRC: base-type-size=1, base-type-encoding=NONE
    BT_AB_Crash_Int: base-type-size=1, base-type-encoding=NONE
    BT_BMC_CMC_Temperatur_075: base-type-size=1, base-type-encoding=NONE
    BT_BMC_CMC_Temperatur_002: base-type-size=1, base-type-encoding=NONE
    BT_BMC_CMC_Zellspannung_072: base-type-size=1, base-type-encoding=NONE
    BT_BMC_CMC_Temperatur_014: base-type-size=1, base-type-encoding=NONE
    BT_BMC_CMC_Temperatur_076: base-type-size=1, base-type-encoding=NONE
    BT_BJB_12_BZ: base-type-size=1, base-type-encoding=NONE
    BT_BMC_CMC_Zellspannung_073: base-type-size=1, base-type-encoding=NONE
    BT_BMC_CMC_Zellspannung_117: base-type-size=1, base-type-encoding=NONE
    BT_AB_Deaktivierung_HV: base-type-size=1, base-type-encoding=NONE
    BT_BMC_CMC_Zellspannung_181: base-type-size=1, base-type-encoding=NONE
    BT_BMC_CMC_Temperatur_077: base-type-size=1, base-type-encoding=NONE
    BT_BMC_CMC_Zellspannung_074: base-type-size=1, base-type-encoding=NONE
    BT_BMC_CMC_Zellspannung_118: base-type-size=1, base-type-encoding=NONE
    BT_BMC_CMC_Temperatur_003: base-type-size=1, base-type-encoding=NONE
    BT_BMC_CMC_Temperatur_015: base-type-size=1, base-type-encoding=NONE
    BT_BMC_CMC_Temperatur_040: base-type-size=1, base-type-encoding=NONE
    BT_BMC_CMC_Temperatur_078: base-type-size=1, base-type-encoding=NONE
    BT_BMC_CMC_Zellspannung_075: base-type-size=1, base-type-encoding=NONE
    BT_BJB_12_CRC: base-type-size=1, base-type-encoding=NONE
    BT_BMC_CMC_Zellspannung_119: base-type-size=1, base-type-encoding=NONE
    BT_AB_DeltaV_X_eCall: base-type-size=1, base-type-encoding=NONE
    BT_BMC_CMC_Temperatur_041: base-type-size=1, base-type-encoding=NONE
    BT_BMC_CMC_Temperatur_079: base-type-size=1, base-type-encoding=NONE
    BT_BMC_CMC_Zellspannung_076: base-type-size=1, base-type-encoding=NONE
    BT_BMC_CMC_Temperatur_004: base-type-size=1, base-type-encoding=NONE
    BT_BMC_CMC_Zellspannung_120: base-type-size=1, base-type-encoding=NONE
    BT_BMC_CMC_Zellspannung_182: base-type-size=1, base-type-encoding=NONE
    BT_BMC_CMC_Temperatur_016: base-type-size=1, base-type-encoding=NONE
    BT_BMC_CMC_Temperatur_080: base-type-size=1, base-type-encoding=NONE
    BT_BMC_CMC_Temperatur_042: base-type-size=1, base-type-encoding=NONE
    BT_BMC_CMC_Zellspannung_077: base-type-size=1, base-type-encoding=NONE
    BT_BMC_CMC_Zellspannung_121: base-type-size=1, base-type-encoding=NONE
    BT_BMC_CMC_Temperatur_081: base-type-size=1, base-type-encoding=NONE
    BT_BJB_13_BZ: base-type-size=1, base-type-encoding=NONE
    BT_BMC_CMC_Temperatur_043: base-type-size=1, base-type-encoding=NONE
    BT_BMC_CMC_Zellspannung_078: base-type-size=1, base-type-encoding=NONE
    BT_AB_DeltaV_Y_eCall: base-type-size=1, base-type-encoding=NONE
    BT_BMC_CMC_Zellspannung_122: base-type-size=1, base-type-encoding=NONE
    BT_BMC_CMC_Temperatur_005: base-type-size=1, base-type-encoding=NONE
    BT_BMC_CMC_Zellspannung_183: base-type-size=1, base-type-encoding=NONE
    BT_BMC_CMC_Temperatur_044: base-type-size=1, base-type-encoding=NONE
    BT_BJB_CALID_Index_01: base-type-size=1, base-type-encoding=NONE
    BT_BMC_CMC_Temperatur_082: base-type-size=1, base-type-encoding=NONE
    BT_BMC_CMC_Zellspannung_079: base-type-size=1, base-type-encoding=NONE
    BT_BMC_CMC_Zellspannung_123: base-type-size=1, base-type-encoding=NONE
    BT_BMC_CMC_Zellspannung_036: base-type-size=1, base-type-encoding=NONE
    BT_BMC_CMC_Temperatur_017: base-type-size=1, base-type-encoding=NONE
    BT_BMC_CMC_Temperatur_045: base-type-size=1, base-type-encoding=NONE
    BT_BJB_13_CRC: base-type-size=1, base-type-encoding=NONE
    BT_BMC_CMC_Temperatur_083: base-type-size=1, base-type-encoding=NONE
    BT_BMC_CMC_Zellspannung_080: base-type-size=1, base-type-encoding=NONE
    BT_BMC_CMC_Zellspannung_124: base-type-size=1, base-type-encoding=NONE
    BT_AB_Gurtwarn_VB: base-type-size=1, base-type-encoding=NONE
    BT_BMC_CMC_Temperatur_006: base-type-size=1, base-type-encoding=NONE
    BT_AB_EDR_Trigger: base-type-size=1, base-type-encoding=NONE
    BT_BMC_CMC_Zellspannung_037: base-type-size=1, base-type-encoding=NONE
    BT_BMC_CMC_Temperatur_084: base-type-size=1, base-type-encoding=NONE
    BT_BMC_CMC_Zellspannung_081: base-type-size=1, base-type-encoding=NONE
    BT_BMC_CMC_Zellspannung_184: base-type-size=1, base-type-encoding=NONE
    BT_BMC_CMC_Temperatur_046: base-type-size=1, base-type-encoding=NONE
    BT_BMC_CMC_Zellspannung_125: base-type-size=1, base-type-encoding=NONE
    BT_BMC_CMC_Temperatur_018: base-type-size=1, base-type-encoding=NONE
    BT_BMC_CMC_Temperatur_085: base-type-size=1, base-type-encoding=NONE
    BT_BMC_CMC_Zellspannung_038: base-type-size=1, base-type-encoding=NONE
    BT_BMC_CMC_Zellspannung_082: base-type-size=1, base-type-encoding=NONE
    BT_BMC_CMC_Zellspannung_126: base-type-size=1, base-type-encoding=NONE
    BT_BJB_CVN_Byte_1: base-type-size=1, base-type-encoding=NONE
    BT_BMC_CMC_Temperatur_007: base-type-size=1, base-type-encoding=NONE
    BT_BMC_CMC_Temperatur_086: base-type-size=1, base-type-encoding=NONE
    BT_BMC_CMC_Temperatur_047: base-type-size=1, base-type-encoding=NONE
    BT_BMC_CMC_Zellspannung_188: base-type-size=1, base-type-encoding=NONE
    BT_AB_Erh_Auf_VB: base-type-size=1, base-type-encoding=NONE
    BT_BMC_CMC_Zellspannung_185: base-type-size=1, base-type-encoding=NONE
    BT_BMC_CMC_Zellspannung_083: base-type-size=1, base-type-encoding=NONE
    BT_BMC_CMC_Zellspannung_127: base-type-size=1, base-type-encoding=NONE
    BT_BMC_CMC_Zellspannung_039: base-type-size=1, base-type-encoding=NONE
    BT_BJB_CALID_Index_02: base-type-size=1, base-type-encoding=NONE
    BT_AB_Gurtwarn_VF: base-type-size=1, base-type-encoding=NONE
    BT_BMC_CMC_Temperatur_019: base-type-size=1, base-type-encoding=NONE
    BT_BMC_CMC_Temperatur_048: base-type-size=1, base-type-encoding=NONE
    BT_BMC_CMC_Temperatur_087: base-type-size=1, base-type-encoding=NONE
    BT_BMC_CMC_Zellspannung_084: base-type-size=1, base-type-encoding=NONE
    BT_BMC_CMC_Zellspannung_128: base-type-size=1, base-type-encoding=NONE
    BT_BMC_CMC_Zellspannung_03_Messzeit: base-type-size=1, base-type-encoding=NONE
    BT_BMC_CMC_Temperatur_088: base-type-size=1, base-type-encoding=NONE
    BT_AB_Front_Crash: base-type-size=1, base-type-encoding=NONE
    BT_BMC_CMC_Zellspannung_085: base-type-size=1, base-type-encoding=NONE
    BT_BMC_CMC_Zellspannung_189: base-type-size=1, base-type-encoding=NONE
    BT_BMC_CMC_Temperatur_049: base-type-size=1, base-type-encoding=NONE
    BT_BJB_CALID_Index_03: base-type-size=1, base-type-encoding=NONE
    BT_BMC_CMC_Zellspannung_129: base-type-size=1, base-type-encoding=NONE
    BT_AB_Heck_Crash: base-type-size=1, base-type-encoding=NONE
    BT_BMC_CMC_Temperatur_008: base-type-size=1, base-type-encoding=NONE
    BT_BMC_CMC_Zellspannung_186: base-type-size=1, base-type-encoding=NONE
    BT_BMC_CMC_Zellspannung_040: base-type-size=1, base-type-encoding=NONE
    BT_BJB_CVN_Byte_2: base-type-size=1, base-type-encoding=NONE
    BT_BMC_CMC_Temperatur_01_Messzeit: base-type-size=1, base-type-encoding=NONE
    BT_BMC_CMC_Zellspannung_086: base-type-size=1, base-type-encoding=NONE
    BT_BMC_CMC_Temperatur_089: base-type-size=1, base-type-encoding=NONE
    BT_BMC_CMC_Temperatur_050: base-type-size=1, base-type-encoding=NONE
    BT_BMC_CMC_Zellspannung_130: base-type-size=1, base-type-encoding=NONE
    BT_AB_Lampe: base-type-size=1, base-type-encoding=NONE
    BT_BMC_CMC_Zellspannung_041: base-type-size=1, base-type-encoding=NONE
    BT_BJB_CVN_Byte_3: base-type-size=1, base-type-encoding=NONE
    BT_BJB_CALID_Index_04: base-type-size=1, base-type-encoding=NONE
    BT_BMC_CMC_Temperatur_090: base-type-size=1, base-type-encoding=NONE
    BT_AB_Gurtschloss_BF: base-type-size=1, base-type-encoding=NONE
    BT_BMC_CMC_Zellspannung_087: base-type-size=1, base-type-encoding=NONE
    BT_BMC_CMC_Zellspannung_131: base-type-size=1, base-type-encoding=NONE
    BT_BMC_CMC_Zellspannung_190: base-type-size=1, base-type-encoding=NONE
    BT_BMC_CMC_Temperatur_051: base-type-size=1, base-type-encoding=NONE
    BT_BJB_CVN_Byte_4: base-type-size=1, base-type-encoding=NONE
    BT_BMC_CMC_Temperatur_020: base-type-size=1, base-type-encoding=NONE
    BT_BMC_CMC_Temperatur_009: base-type-size=1, base-type-encoding=NONE
    BT_BMC_CMC_Zellspannung_187: base-type-size=1, base-type-encoding=NONE
    BT_BMC_CMC_Temperatur_091: base-type-size=1, base-type-encoding=NONE
    BT_BJB_CALID_Index_05: base-type-size=1, base-type-encoding=NONE
    BT_AB_PSS_SollZustand: base-type-size=1, base-type-encoding=NONE
    BT_BMC_CMC_Zellspannung_042: base-type-size=1, base-type-encoding=NONE
    BT_BMC_CMC_Zellspannung_132: base-type-size=1, base-type-encoding=NONE
    BT_BMC_CMC_Zellspannung_088: base-type-size=1, base-type-encoding=NONE
    BT_BMC_CMC_Temperatur_092: base-type-size=1, base-type-encoding=NONE
    BT_BJB_CVN_VLD: base-type-size=1, base-type-encoding=NONE
    BT_BMC_CMC_Zellspannung_133: base-type-size=1, base-type-encoding=NONE
    BT_BMC_CMC_Zellspannung_089: base-type-size=1, base-type-encoding=NONE
    BT_BMC_CMC_Zellspannung_043: base-type-size=1, base-type-encoding=NONE
    BT_BJB_CALID_Index_06: base-type-size=1, base-type-encoding=NONE
    BT_AB_Gurtschloss_FA: base-type-size=1, base-type-encoding=NONE
    BT_AB_Rollover_Crash: base-type-size=1, base-type-encoding=NONE
    BT_BMC_CMC_Temperatur_093: base-type-size=1, base-type-encoding=NONE
    BT_BMC_CMC_Temperatur_010: base-type-size=1, base-type-encoding=NONE
    BT_BJB_ErrMem_State: base-type-size=1, base-type-encoding=NONE
    BT_BMC_CMC_Zellspannung_090: base-type-size=1, base-type-encoding=NONE
    BT_BMC_CMC_Zellspannung_134: base-type-size=1, base-type-encoding=NONE
    BT_BMC_CMC_Zellspannung_191: base-type-size=1, base-type-encoding=NONE
    BT_BMC_CMC_Temperatur_021: base-type-size=1, base-type-encoding=NONE
    BT_BMC_EnergieVorhalt: base-type-size=1, base-type-encoding=NONE
    BT_BMC_CMC_Zellspannung_044: base-type-size=1, base-type-encoding=NONE
    BT_BMC_CMC_Temperatur_094: base-type-size=1, base-type-encoding=NONE
    BT_BJB_CALID_Index_07: base-type-size=1, base-type-encoding=NONE
    BT_AB_SB_Crash: base-type-size=1, base-type-encoding=NONE
    BT_BJB_Lebensdauer_Trennelemente: base-type-size=1, base-type-encoding=NONE
    BT_BMC_CMC_Zellspannung_091: base-type-size=1, base-type-encoding=NONE
    BT_BMC_CMC_Zellspannung_135: base-type-size=1, base-type-encoding=NONE
    BT_AB_Gurtschloss_FA_ext: base-type-size=1, base-type-encoding=NONE
    BT_BMC_CMC_Temperatur_095: base-type-size=1, base-type-encoding=NONE
    BT_BMC_CMC_Zellspannung_045: base-type-size=1, base-type-encoding=NONE
    BT_BMC_HV_12_CRC: base-type-size=1, base-type-encoding=NONE
    BT_BJB_Sperrung_Ueberspannung: base-type-size=1, base-type-encoding=NONE
    BT_BMC_CMC_Temperatur_011: base-type-size=1, base-type-encoding=NONE
    BT_BJB_CALID_Index_08: base-type-size=1, base-type-encoding=NONE
    BT_AB_SBR_hinten_verbau: base-type-size=1, base-type-encoding=NONE
    BT_BMC_CMC_Zellspannung_092: base-type-size=1, base-type-encoding=NONE
    BT_BMC_CMC_Zellspannung_192: base-type-size=1, base-type-encoding=NONE
    BT_BMC_CMC_Zellspannung_136: base-type-size=1, base-type-encoding=NONE
    BT_BMC_CMC_Temperatur_022: base-type-size=1, base-type-encoding=NONE
    BT_BMC_ExtLadeleistung: base-type-size=1, base-type-encoding=NONE
    BT_BMC_CMC_Temperatur_096: base-type-size=1, base-type-encoding=NONE
    BT_BJB_Sperrung_Uebertemperatur: base-type-size=1, base-type-encoding=NONE
    BT_BMC_CMC_Zellspannung_046: base-type-size=1, base-type-encoding=NONE
    BT_BMC_HV_13_BZ: base-type-size=1, base-type-encoding=NONE
    BT_BMC_CMC_Zellspannung_093: base-type-size=1, base-type-encoding=NONE
    BT_BMC_CMC_Zellspannung_137: base-type-size=1, base-type-encoding=NONE
    BT_AB_SF_Crash: base-type-size=1, base-type-encoding=NONE
    BT_AB_Gurtschloss_FA_ext_aktiv: base-type-size=1, base-type-encoding=NONE
    BT_BJB_CALID_Index_09: base-type-size=1, base-type-encoding=NONE
    BT_BMC_CMC_Zellspannung_001: base-type-size=1, base-type-encoding=NONE
    BT_BMC_CMC_Zellspannung_094: base-type-size=1, base-type-encoding=NONE
    BT_BJB_Sperrung_Unterspannung: base-type-size=1, base-type-encoding=NONE
    BT_BMC_CMC_Zellspannung_138: base-type-size=1, base-type-encoding=NONE
    BT_BMC_Datenuebernahme_Anf: base-type-size=1, base-type-encoding=NONE
    BT_BMC_CMC_Zellspannung_047: base-type-size=1, base-type-encoding=NONE
    BT_BMC_IWU_Status: base-type-size=1, base-type-encoding=NONE
    BT_BMC_CMC_Temperatur_023: base-type-size=1, base-type-encoding=NONE
    BT_BMC_Fehler_Leistungsred: base-type-size=1, base-type-encoding=NONE
    BT_BMC_CMC_Zellspannung_002: base-type-size=1, base-type-encoding=NONE
    BT_BMC_HV_13_CRC: base-type-size=1, base-type-encoding=NONE
    BT_BMC_CMC_Zellspannung_095: base-type-size=1, base-type-encoding=NONE
    BT_BJB_Status_HV_Spannungssensorik: base-type-size=1, base-type-encoding=NONE
    BT_BMC_CMC_Zellspannung_139: base-type-size=1, base-type-encoding=NONE
    BT_BJB_CALID_Index_10: base-type-size=1, base-type-encoding=NONE
    BT_AB_Sitzpos_Sens_BF: base-type-size=1, base-type-encoding=NONE
    BT_BMC_CMC_Zellspannung_003: base-type-size=1, base-type-encoding=NONE
    BT_BMC_CMC_Zellspannung_096: base-type-size=1, base-type-encoding=NONE
    BT_BMC_CMC_Zellspannung_048: base-type-size=1, base-type-encoding=NONE
    BT_BMC_IWU_Wert_neg: base-type-size=1, base-type-encoding=NONE
    BT_AB_Gurtschloss_Reihe2_BF: base-type-size=1, base-type-encoding=NONE
    BT_BJB_Status_Trennelemente: base-type-size=1, base-type-encoding=NONE
    BT_BMC_CMC_Zellspannung_004: base-type-size=1, base-type-encoding=NONE
    BT_BMC_CMC_Zellspannung_140: base-type-size=1, base-type-encoding=NONE
    BT_BJB_CALID_Index_11: base-type-size=1, base-type-encoding=NONE
    BT_AB_Sitzpos_Sens_FA: base-type-size=1, base-type-encoding=NONE
    BT_BMC_Dauer_Entladeleistung: base-type-size=1, base-type-encoding=NONE
    BT_BMC_CMC_Temperatur_024: base-type-size=1, base-type-encoding=NONE
    BT_BJB_Ueberspannungszaehler_CMC01: base-type-size=1, base-type-encoding=NONE
    BT_BMC_Fehler_Warnung: base-type-size=1, base-type-encoding=NONE
    BT_BMC_CMC_Zellspannung_049: base-type-size=1, base-type-encoding=NONE
    BT_BMC_CMC_Zellspannung_141: base-type-size=1, base-type-encoding=NONE
    BT_BMC_HVK_EoHVL_Status: base-type-size=1, base-type-encoding=NONE
    BT_BMC_CMC_Zellspannung_005: base-type-size=1, base-type-encoding=NONE
    BT_BJB_Ueberspannungszaehler_CMC02: base-type-size=1, base-type-encoding=NONE
    BT_BMC_CMC_Zellspannung_097: base-type-size=1, base-type-encoding=NONE
    BT_AB_Stellgliedtest: base-type-size=1, base-type-encoding=NONE
    BT_BJB_CALID_Index_12: base-type-size=1, base-type-encoding=NONE
    BT_BMC_IWU_Wert_pos: base-type-size=1, base-type-encoding=NONE
    BT_AB_Gurtschloss_Reihe2_FA: base-type-size=1, base-type-encoding=NONE
    BT_BMC_CMC_Zellspannung_142: base-type-size=1, base-type-encoding=NONE
    BT_BMC_CMC_Zellspannung_04_Messzeit: base-type-size=1, base-type-encoding=NONE
    BT_BMC_CMC_Zellspannung_006: base-type-size=1, base-type-encoding=NONE
    BT_BMC_Dauer_Entladeleistung_02: base-type-size=1, base-type-encoding=NONE
    BT_BMC_CMC_Zellspannung_098: base-type-size=1, base-type-encoding=NONE
    BT_BMC_CMC_Temperatur_025: base-type-size=1, base-type-encoding=NONE
    BT_BMC_Konditionierung_Anf: base-type-size=1, base-type-encoding=NONE
    BT_BMC_CMC_Zellspannung_143: base-type-size=1, base-type-encoding=NONE
    BT_BJB_Ueberspannungszaehler_CMC03: base-type-size=1, base-type-encoding=NONE
    BT_AB_Systemfehler: base-type-size=1, base-type-encoding=NONE
    BT_BJB_CALID_Index_13: base-type-size=1, base-type-encoding=NONE
    BT_BMC_CMC_Zellspannung_007: base-type-size=1, base-type-encoding=NONE
    BT_BMC_CMC_Zellspannung_050: base-type-size=1, base-type-encoding=NONE
    BT_BMC_HVK_Fehler_HVIL: base-type-size=1, base-type-encoding=NONE
    BT_BMC_Flash_Freigabe: base-type-size=1, base-type-encoding=NONE
    BT_BMC_CMC_Zellspannung_099: base-type-size=1, base-type-encoding=NONE
    BT_BMC_CMC_Zellspannung_144: base-type-size=1, base-type-encoding=NONE
    BT_BJB_Ueberspannungszaehler_CMC04: base-type-size=1, base-type-encoding=NONE
    BT_BMC_CMC_Zellspannung_008: base-type-size=1, base-type-encoding=NONE
    BT_AB_Versorgungsspannung: base-type-size=1, base-type-encoding=NONE
    BT_BMC_KundenWarnung: base-type-size=1, base-type-encoding=NONE
    BT_BMC_CMC_Zellspannung_100: base-type-size=1, base-type-encoding=NONE
    BT_BJB_CALID_Index_14: base-type-size=1, base-type-encoding=NONE
    BT_AB_Gurtschloss_Reihe2_MI: base-type-size=1, base-type-encoding=NONE
    BT_BMC_CMC_Zellspannung_051: base-type-size=1, base-type-encoding=NONE
    BT_BMC_CMC_Zellspannung_009: base-type-size=1, base-type-encoding=NONE
    BT_BMC_CMC_Zellspannung_145: base-type-size=1, base-type-encoding=NONE
    BT_BMC_Dauer_Ladeleistung: base-type-size=1, base-type-encoding=NONE
    BT_BMC_Leerlaufspannung: base-type-size=1, base-type-encoding=NONE
    BT_BMC_CMC_Zellspannung_101: base-type-size=1, base-type-encoding=NONE
    BT_BMC_HVK_Fehler_Intern: base-type-size=1, base-type-encoding=NONE
    BT_BMC_Lebensdauer_Trennelemente: base-type-size=1, base-type-encoding=NONE
    BT_BMC_HV_01_BZ: base-type-size=1, base-type-encoding=NONE
    BT_BMC_CMC_Temperatur_026: base-type-size=1, base-type-encoding=NONE
    BT_BJB_CALID_Index_15: base-type-size=1, base-type-encoding=NONE
    BT_AB_VRU_Crash: base-type-size=1, base-type-encoding=NONE
    BT_BMC_CMC_Zellspannung_146: base-type-size=1, base-type-encoding=NONE
    BT_BMC_CMC_Zellspannung_052: base-type-size=1, base-type-encoding=NONE
    BT_BMC_CMC_Zellspannung_010: base-type-size=1, base-type-encoding=NONE
    BT_BMC_Max_Entladeleistung: base-type-size=1, base-type-encoding=NONE
    BT_AB_Gurtschloss_Reihe3_BF: base-type-size=1, base-type-encoding=NONE
    BT_BMC_CMC_Zellspannung_102: base-type-size=1, base-type-encoding=NONE
    BT_BMC_CMC_Zellspannung_147: base-type-size=1, base-type-encoding=NONE
    BT_BMC_NutzbareKapazitaet: base-type-size=1, base-type-encoding=NONE
    BT_Airbag_10_BZ: base-type-size=1, base-type-encoding=NONE
    BT_BJB_CALID_Index_16: base-type-size=1, base-type-encoding=NONE
    BT_BMC_Max_Entladeleistung_02: base-type-size=1, base-type-encoding=NONE
    BT_BMC_CMC_Zellspannung_011: base-type-size=1, base-type-encoding=NONE
    BT_BMC_Dauer_Ladeleistung_02: base-type-size=1, base-type-encoding=NONE
    BT_BMC_HVK_Fehler_SD: base-type-size=1, base-type-encoding=NONE
    BT_BMC_CMC_Zellspannung_148: base-type-size=1, base-type-encoding=NONE
    BT_BMC_CMC_Zellspannung_103: base-type-size=1, base-type-encoding=NONE
    BT_BMC_HV_01_CRC: base-type-size=1, base-type-encoding=NONE
    BT_BMC_CMC_Zellspannung_012: base-type-size=1, base-type-encoding=NONE
    BT_BMC_Pack_SN_03: base-type-size=1, base-type-encoding=NONE
    BT_BMC_Pack_SN_19: base-type-size=1, base-type-encoding=NONE
    BT_BMC_NutzbarerSOC: base-type-size=1, base-type-encoding=NONE
    BT_BMC_CMC_Zellspannung_149: base-type-size=1, base-type-encoding=NONE
    BT_BMC_Max_Entladestrom: base-type-size=1, base-type-encoding=NONE
    BT_BMC_CMC_Zellspannung_104: base-type-size=1, base-type-encoding=NONE
    BT_BMC_RtmWarnZelleZustand: base-type-size=1, base-type-encoding=NONE
    BT_AB_Gurtschloss_Reihe3_FA: base-type-size=1, base-type-encoding=NONE
    BT_BMC_CMC_Zellspannung_013: base-type-size=1, base-type-encoding=NONE
    BT_BMC_DC_Laden: base-type-size=1, base-type-encoding=NONE
    BT_BMC_CMC_Zellspannung_105: base-type-size=1, base-type-encoding=NONE
    BT_BMC_Max_Entladestrom_02: base-type-size=1, base-type-encoding=NONE
    BT_BMC_Iso_Mode_Anf: base-type-size=1, base-type-encoding=NONE
    BT_BMC_Strom_Messzeit: base-type-size=1, base-type-encoding=NONE
    BT_BMC_CMC_Zellspannung_014: base-type-size=1, base-type-encoding=NONE
    BT_BMC_Pack_SN_01: base-type-size=1, base-type-encoding=NONE
    BT_BMC_CMC_Zellspannung_150: base-type-size=1, base-type-encoding=NONE
    BT_BMC_Pack_SN_20: base-type-size=1, base-type-encoding=NONE
    BT_BMC_RuecklaufTemperatur: base-type-size=1, base-type-encoding=NONE
    BT_BMC_HV_02_BZ: base-type-size=1, base-type-encoding=NONE
    BT_BMC_Max_Ladeleistung: base-type-size=1, base-type-encoding=NONE
    BT_BMC_CMC_Zellspannung_106: base-type-size=1, base-type-encoding=NONE
    BT_BMC_Pack_SN_04: base-type-size=1, base-type-encoding=NONE
    BT_AB_Gurtschloss_Reihe3_MI: base-type-size=1, base-type-encoding=NONE
    BT_BMC_TechnischerSOC: base-type-size=1, base-type-encoding=NONE
    BT_BMC_CMC_Zellspannung_015: base-type-size=1, base-type-encoding=NONE
    BT_BMC_CMC_Zellspannung_151: base-type-size=1, base-type-encoding=NONE
    BT_BMC_Pack_SN_02: base-type-size=1, base-type-encoding=NONE
    BT_BMC_Max_Ladeleistung_02: base-type-size=1, base-type-encoding=NONE
    BT_BMC_Spannung: base-type-size=1, base-type-encoding=NONE
    BT_BMC_Dev_Freigabe: base-type-size=1, base-type-encoding=NONE
    BT_BMC_Pack_SN_21: base-type-size=1, base-type-encoding=NONE
    BT_BMC_CMC_Zellspannung_107: base-type-size=1, base-type-encoding=NONE
    BT_BMC_CMC_Zellspannung_152: base-type-size=1, base-type-encoding=NONE
    BT_BMC_CMC_Zellspannung_016: base-type-size=1, base-type-encoding=NONE
    BT_BMC_Max_Ladestrom: base-type-size=1, base-type-encoding=NONE
    BT_BMC_IstTemperaturMax_Modul_ID: base-type-size=1, base-type-encoding=NONE
    BT_BMC_HV_02_CRC: base-type-size=1, base-type-encoding=NONE
    BT_BMC_Temperatur: base-type-size=1, base-type-encoding=NONE
    BT_BMC_Uebertemperaturzaehler_CMC04: base-type-size=1, base-type-encoding=NONE
    BT_BMC_CMC_Zellspannung_108: base-type-size=1, base-type-encoding=NONE
    BT_BMC_Pack_SN_05: base-type-size=1, base-type-encoding=NONE
    BT_BMC_CMC_Zellspannung_153: base-type-size=1, base-type-encoding=NONE
    BT_BMC_CMC_Zellspannung_017: base-type-size=1, base-type-encoding=NONE
    BT_AB_Gurtschloss_Reihe4_BF: base-type-size=1, base-type-encoding=NONE
    BT_BMC_Pack_SN_22: base-type-size=1, base-type-encoding=NONE
    BT_BMC_Spannung_DC_Ladesaeule: base-type-size=1, base-type-encoding=NONE
    BT_BMC_Max_Ladestrom_02: base-type-size=1, base-type-encoding=NONE
    BT_BMC_Energie_Entladen: base-type-size=1, base-type-encoding=NONE
    BT_BMC_CMC_Zellspannung_109: base-type-size=1, base-type-encoding=NONE
    BT_BMC_CMC_Zellspannung_154: base-type-size=1, base-type-encoding=NONE
    BT_BMC_CMC_Zellspannung_018: base-type-size=1, base-type-encoding=NONE
    BT_BMC_Temperatur_hoechste: base-type-size=1, base-type-encoding=NONE
    BT_BMC_UI1_Spannung1_Schalt_Anf: base-type-size=1, base-type-encoding=NONE
    BT_BMC_Pack_SN_23: base-type-size=1, base-type-encoding=NONE
    BT_BMC_Spannung_Messzeit: base-type-size=1, base-type-encoding=NONE
    BT_BMC_CMC_Zellspannung_110: base-type-size=1, base-type-encoding=NONE
    BT_BMC_Max_Spannung: base-type-size=1, base-type-encoding=NONE
    BT_BMC_IstTemperaturMax_Sensor_ID: base-type-size=1, base-type-encoding=NONE
    BT_BMC_CMC_Zellspannung_019: base-type-size=1, base-type-encoding=NONE
    BT_BMC_CMC_Zellspannung_155: base-type-size=1, base-type-encoding=NONE
    BT_BMC_Pack_SN_06: base-type-size=1, base-type-encoding=NONE
    BT_BMC_Temperatur_niedrigste: base-type-size=1, base-type-encoding=NONE
    BT_BMC_HV_04_BZ: base-type-size=1, base-type-encoding=NONE
    BT_BMC_CMC_Zellspannung_111: base-type-size=1, base-type-encoding=NONE
    BT_BMC_Pack_SN_24: base-type-size=1, base-type-encoding=NONE
    BT_BMC_MaxEnergieinhalt: base-type-size=1, base-type-encoding=NONE
    BT_BMC_Spannung_ZwischenKreis: base-type-size=1, base-type-encoding=NONE
    BT_BMC_CMC_Zellspannung_01_Messzeit: base-type-size=1, base-type-encoding=NONE
    BT_BMC_UI1_Spannung2_Schalt_Anf: base-type-size=1, base-type-encoding=NONE
    BT_BMC_CMC_Zellspannung_156: base-type-size=1, base-type-encoding=NONE
    BT_AB_Gurtschloss_Reihe4_FA: base-type-size=1, base-type-encoding=NONE
    BT_BMC_Min_Spannung: base-type-size=1, base-type-encoding=NONE
    BT_BMC_ThermAuslastung: base-type-size=1, base-type-encoding=NONE
    BT_BMC_CMC_Zellspannung_112: base-type-size=1, base-type-encoding=NONE
    BT_BMC_Energie_Laden: base-type-size=1, base-type-encoding=NONE
    BT_BMC_IstTemperaturMin_Modul_ID: base-type-size=1, base-type-encoding=NONE
    BT_BMC_Pack_SN_25: base-type-size=1, base-type-encoding=NONE
    BT_BMC_CMC_Zellspannung_020: base-type-size=1, base-type-encoding=NONE
    BT_BMC_CMC_Zellspannung_157: base-type-size=1, base-type-encoding=NONE
    BT_BMC_Spannung_ZwischenKreis_2: base-type-size=1, base-type-encoding=NONE
    BT_BMC_UI2_Spannung1_Schalt_Anf: base-type-size=1, base-type-encoding=NONE
    BT_BMC_HV_04_CRC: base-type-size=1, base-type-encoding=NONE
    BT_BMC_CMC_Zellspannung_113: base-type-size=1, base-type-encoding=NONE
    BT_BMC_MinDyn_Entladespannung: base-type-size=1, base-type-encoding=NONE
    BT_BMC_CMC_Zellspannung_021: base-type-size=1, base-type-encoding=NONE
    BT_BMC_ThermSpreizung: base-type-size=1, base-type-encoding=NONE
    BT_BMC_CMC_Zellspannung_158: base-type-size=1, base-type-encoding=NONE
    BT_BMC_Pack_SN_07: base-type-size=1, base-type-encoding=NONE
    BT_BMC_Pack_SN_26: base-type-size=1, base-type-encoding=NONE
    BT_BMC_Sperrung_Ueberspannung: base-type-size=1, base-type-encoding=NONE
    BT_AB_Gurtschloss_Reihe4_MI: base-type-size=1, base-type-encoding=NONE
    BT_BMC_CMC_Zellspannung_114: base-type-size=1, base-type-encoding=NONE
    BT_BMC_UI2_Spannung2_Schalt_Anf: base-type-size=1, base-type-encoding=NONE
    BT_BMC_MinDyn_Ladespannung: base-type-size=1, base-type-encoding=NONE
    BT_BMC_CMC_Zellspannung_022: base-type-size=1, base-type-encoding=NONE
    BT_BMC_CMC_Zellspannung_159: base-type-size=1, base-type-encoding=NONE
    BT_BMC_Energie_Sockel_SoC: base-type-size=1, base-type-encoding=NONE
    BT_BMC_IstTemperaturMin_Sensor_ID: base-type-size=1, base-type-encoding=NONE
    BT_BMC_CMC_Zellspannung_115: base-type-size=1, base-type-encoding=NONE
    BT_BMC_UBE_Indik_last_update_km: base-type-size=1, base-type-encoding=NONE
    BT_BMC_CMC_Zellspannung_023: base-type-size=1, base-type-encoding=NONE
    BT_BMC_MMTR_Status: base-type-size=1, base-type-encoding=NONE
    BT_BMC_PCM_VTD_Freeze_Req: base-type-size=1, base-type-encoding=NONE
    BT_BMC_Unterboden_Warnung: base-type-size=1, base-type-encoding=NONE
    BT_BMC_HV_10_BZ: base-type-size=1, base-type-encoding=NONE
    BT_BMC_Sperrung_Uebertemperatur: base-type-size=1, base-type-encoding=NONE
    BT_BMC_CMC_Zellspannung_160: base-type-size=1, base-type-encoding=NONE
    BT_BMC_Pack_SN_08: base-type-size=1, base-type-encoding=NONE
    BT_BMC_Modus: base-type-size=1, base-type-encoding=NONE
    BT_BMC_UBE_Indikator: base-type-size=1, base-type-encoding=NONE
    BT_AB_Gurtwarn_Reihe2_BF: base-type-size=1, base-type-encoding=NONE
    BT_BMC_CMC_Zellspannung_161: base-type-size=1, base-type-encoding=NONE
    BT_BMC_PCM_VTD_LifeTimeReset_Req: base-type-size=1, base-type-encoding=NONE
    BT_BMC_Unterspannungszaehler_CMC01: base-type-size=1, base-type-encoding=NONE
    BT_BMC_Energieinhalt: base-type-size=1, base-type-encoding=NONE
    BT_BMC_Sperrung_Unterspannung: base-type-size=1, base-type-encoding=NONE
    BT_BMC_IstZellspannungMax: base-type-size=1, base-type-encoding=NONE
    BT_BMC_Unterspannungszaehler_CMC03: base-type-size=1, base-type-encoding=NONE
    BT_BMC_CMC_Zellspannung_162: base-type-size=1, base-type-encoding=NONE
    BT_DCDC_NV_CALID_Index_10: base-type-size=1, base-type-encoding=NONE
    BT_BMC_HV_10_CRC: base-type-size=1, base-type-encoding=NONE
    BT_BMC_Ueberspannungszaehler_CMC01: base-type-size=1, base-type-encoding=NONE
    BT_BMC_PCM_VTD_LifeTimeReset_Resp: base-type-size=1, base-type-encoding=NONE
    BT_BMC_Status_DCLS: base-type-size=1, base-type-encoding=NONE
    BT_BMC_Pack_SN_09: base-type-size=1, base-type-encoding=NONE
    BT_BMC_Unterspannungszaehler_CMC04: base-type-size=1, base-type-encoding=NONE
    BT_BMC_Unterspannungszaehler_CMC02: base-type-size=1, base-type-encoding=NONE
    BT_BMC_CMC_Zellspannung_163: base-type-size=1, base-type-encoding=NONE
    BT_DCDC_NV_CALID_Index_11: base-type-size=1, base-type-encoding=NONE
    BT_AB_Gurtwarn_Reihe2_FA: base-type-size=1, base-type-encoding=NONE
    BT_BMC_Ueberspannungszaehler_CMC02: base-type-size=1, base-type-encoding=NONE
    BT_BMC_Verbauinfo_ACSchuetz: base-type-size=1, base-type-encoding=NONE
    BT_BMC_CMC_Zellspannung_164: base-type-size=1, base-type-encoding=NONE
    BT_BMC_PCM_VTD_RecentReset_Req: base-type-size=1, base-type-encoding=NONE
    BT_BMC_Status_HV_Spannungssensorik: base-type-size=1, base-type-encoding=NONE
    BT_BMC_IstZellSpannungMax_Modul_ID: base-type-size=1, base-type-encoding=NONE
    BT_DCDC_NV_Komponentenfehler_21: base-type-size=1, base-type-encoding=NONE
    BT_DCDC_NV_CALID_Index_12: base-type-size=1, base-type-encoding=NONE
    BT_DCDC_NV_Komponentenfehler_37: base-type-size=1, base-type-encoding=NONE
    BT_BMC_HV_11_BZ: base-type-size=1, base-type-encoding=NONE
    BT_BMC_Verbauinfo_Bank: base-type-size=1, base-type-encoding=NONE
    BT_BMC_Ueberspannungszaehler_CMC03: base-type-size=1, base-type-encoding=NONE
    BT_BMC_Pack_SN_10: base-type-size=1, base-type-encoding=NONE
    BT_DCDC_NV_CALID_Index_13: base-type-size=1, base-type-encoding=NONE
    BT_BMC_Status_Spgfreiheit: base-type-size=1, base-type-encoding=NONE
    BT_BMC_PerfInd_Entladen: base-type-size=1, base-type-encoding=NONE
    BT_BMC_CMC_Zellspannung_165: base-type-size=1, base-type-encoding=NONE
    BT_BMC_Verbrauch: base-type-size=1, base-type-encoding=NONE
    BT_AB_Gurtwarn_Reihe2_MI: base-type-size=1, base-type-encoding=NONE
    BT_DCDC_NV_Komponentenfehler_38: base-type-size=1, base-type-encoding=NONE
    BT_DCDC_NV_CALID_Index_14: base-type-size=1, base-type-encoding=NONE
    BT_BMC_IstZellSpannungMax_Zell_ID: base-type-size=1, base-type-encoding=NONE
    BT_BMC_CMC_Zellspannung_166: base-type-size=1, base-type-encoding=NONE
    BT_BMC_Verbrauch_Ueberlauf: base-type-size=1, base-type-encoding=NONE
    BT_DCDC_NV_Komponentenfehler_22: base-type-size=1, base-type-encoding=NONE
    BT_BMC_Ueberspannungszaehler_CMC04: base-type-size=1, base-type-encoding=NONE
    BT_DCDC_NV_Komponentenfehler_39: base-type-size=1, base-type-encoding=NONE
    BT_BMC_Status_Trennelemente: base-type-size=1, base-type-encoding=NONE
    BT_BMC_PerfInd_Laden: base-type-size=1, base-type-encoding=NONE
    BT_DCDC_NV_CALID_Index_15: base-type-size=1, base-type-encoding=NONE
    BT_BMC_CMC_Zellspannung_167: base-type-size=1, base-type-encoding=NONE
    BT_BMC_HV_11_CRC: base-type-size=1, base-type-encoding=NONE
    BT_BMC_Pack_SN_11: base-type-size=1, base-type-encoding=NONE
    BT_BMC_VerlustEnergie: base-type-size=1, base-type-encoding=NONE
    BT_BMC_Uebertemperaturzaehler_CMC01: base-type-size=1, base-type-encoding=NONE
    BT_BMC_CMC_Zellspannung_168: base-type-size=1, base-type-encoding=NONE
    BT_BMC_Strom: base-type-size=1, base-type-encoding=NONE
    BT_DCDC_NV_Komponentenfehler_3_1: base-type-size=1, base-type-encoding=NONE
    BT_BMC_PredLeistung_StuetzungNV: base-type-size=1, base-type-encoding=NONE
    BT_BMC_IstZellspannungMin: base-type-size=1, base-type-encoding=NONE
    BT_DCDC_NV_CALID_Index_16: base-type-size=1, base-type-encoding=NONE
    BT_AB_Gurtwarn_Reihe3_BF: base-type-size=1, base-type-encoding=NONE
    BT_BMC_Vorlade_Zielspannung: base-type-size=1, base-type-encoding=NONE
    BT_BMC_CMC_Zellspannung_169: base-type-size=1, base-type-encoding=NONE
    BT_BMC_Uebertemperaturzaehler_CMC02: base-type-size=1, base-type-encoding=NONE
    BT_DCDC_NV_Komponentenfehler_23: base-type-size=1, base-type-encoding=NONE
    BT_BMC_Strom_02: base-type-size=1, base-type-encoding=NONE
    BT_BMC_VorlaufTemperatur: base-type-size=1, base-type-encoding=NONE
    BT_DCDC_NV_CVN_Byte_1: base-type-size=1, base-type-encoding=NONE
    BT_BMC_Range_Indikator: base-type-size=1, base-type-encoding=NONE
    BT_BMC_HV_12_BZ: base-type-size=1, base-type-encoding=NONE
    BT_DCDC_NV_Komponentenfehler_3_10: base-type-size=1, base-type-encoding=NONE
    BT_BMC_Pack_SN_12: base-type-size=1, base-type-encoding=NONE
    BT_BMC_CMC_Zellspannung_170: base-type-size=1, base-type-encoding=NONE
    BT_BMC_ZellTemp_virtuell_max: base-type-size=1, base-type-encoding=NONE
    BT_DCDC_NV_CVN_Byte_2: base-type-size=1, base-type-encoding=NONE
    BT_BMC_Uebertemperaturzaehler_CMC03: base-type-size=1, base-type-encoding=NONE
    BT_BMC_IstZellSpannungMin_Modul_ID: base-type-size=1, base-type-encoding=NONE
    BT_AB_Gurtwarn_Reihe3_FA: base-type-size=1, base-type-encoding=NONE
    BT_BMC_Rekuperation: base-type-size=1, base-type-encoding=NONE
    BT_DCDC_NV_Komponentenfehler_3_11: base-type-size=1, base-type-encoding=NONE
    BT_BMC_ZellTemp_virtuell_min: base-type-size=1, base-type-encoding=NONE
    BT_BMC_CMC_Zellspannung_171: base-type-size=1, base-type-encoding=NONE
    BT_DCDC_NV_CVN_Byte_3: base-type-size=1, base-type-encoding=NONE
    BT_DCDC_NV_Komponentenfehler_3_14: base-type-size=1, base-type-encoding=NONE
    BT_DCDC_NV_Komponentenfehler_24: base-type-size=1, base-type-encoding=NONE
    BT_BMC_CMC_Zellspannung_172: base-type-size=1, base-type-encoding=NONE
    BT_DCDC_NV_CVN_Byte_4: base-type-size=1, base-type-encoding=NONE
    BT_BMC_Rekuperation_Ueberlauf: base-type-size=1, base-type-encoding=NONE
    BT_DCDC_NV_Komponentenfehler_3_12: base-type-size=1, base-type-encoding=NONE
    BT_DCDC_NV_Komponentenfehler_3_15: base-type-size=1, base-type-encoding=NONE
    BT_CHA_CurProf: base-type-size=1, base-type-encoding=NONE
    BT_BMC_Pack_SN_13: base-type-size=1, base-type-encoding=NONE
    BT_HV_Heizer_Status: base-type-size=1, base-type-encoding=NONE
    BT_BMC_IstZellSpannungMin_Zell_ID: base-type-size=1, base-type-encoding=NONE
    BT_DS_Hybrid_01_TestFailedChanged: base-type-size=1, base-type-encoding=NONE
    BT_BMC_CMC_Zellspannung_173: base-type-size=1, base-type-encoding=NONE
    BT_DCDC_NV_Komponentenfehler_3_16: base-type-size=1, base-type-encoding=NONE
    BT_AB_Gurtwarn_Reihe3_MI: base-type-size=1, base-type-encoding=NONE
    BT_CHA_FlgEndOfList: base-type-size=1, base-type-encoding=NONE
    BT_DCDC_NV_CVN_VLD: base-type-size=1, base-type-encoding=NONE
    BT_DCDC_NV_Komponentenfehler_3_13: base-type-size=1, base-type-encoding=NONE
    BT_DCDC_NV_Komponentenfehler_25: base-type-size=1, base-type-encoding=NONE
    BT_BMC_RtmWarnBattUnautorisiert: base-type-size=1, base-type-encoding=NONE
    BT_HVEM_Abschaltstufe: base-type-size=1, base-type-encoding=NONE
    BT_HVK_03_CRC: base-type-size=1, base-type-encoding=NONE
    BT_DCDC_NV_Komponentenfehler_3_2: base-type-size=1, base-type-encoding=NONE
    BT_CHA_FlgGlbFallBkIdc: base-type-size=1, base-type-encoding=NONE
    BT_BMC_CMC_Zellspannung_174: base-type-size=1, base-type-encoding=NONE
    BT_DCDC_NV_Komponentenfehler_01: base-type-size=1, base-type-encoding=NONE
    BT_BMC_Pack_SN_14: base-type-size=1, base-type-encoding=NONE
    BT_BMC_RtmWarnPackKommunikation: base-type-size=1, base-type-encoding=NONE
    BT_DCDC_NV_Komponentenfehler_3_3: base-type-size=1, base-type-encoding=NONE
    BT_CHA_ProfChanged: base-type-size=1, base-type-encoding=NONE
    BT_DS_Hybrid_01_WIRChanged: base-type-size=1, base-type-encoding=NONE
    BT_DCDC_NV_Komponentenfehler_02: base-type-size=1, base-type-encoding=NONE
    BT_BMC_CMC_Zellspannung_175: base-type-size=1, base-type-encoding=NONE
    BT_HVK_AIAD_Sollmodus: base-type-size=1, base-type-encoding=NONE
    BT_HVEM_AIAD_Energieinhalt: base-type-size=1, base-type-encoding=NONE
    BT_DCDC_NV_Komponentenfehler_26: base-type-size=1, base-type-encoding=NONE
    BT_CHA_ReqPrgAcc: base-type-size=1, base-type-encoding=NONE
    BT_DCDC_NV_Komponentenfehler_03: base-type-size=1, base-type-encoding=NONE
    BT_BMC_CMC_Zellspannung_176: base-type-size=1, base-type-encoding=NONE
    BT_DCDC_NV_Komponentenfehler_3_4: base-type-size=1, base-type-encoding=NONE
    BT_HVK_Istmodus_Anf: base-type-size=1, base-type-encoding=NONE
    BT_BMC_RtmWarnPackUeberladen: base-type-size=1, base-type-encoding=NONE
    BT_HVLM_Ladevorgang_Anf: base-type-size=1, base-type-encoding=NONE
    BT_HVEM_AIAD_Leistungsvorgabe: base-type-size=1, base-type-encoding=NONE
    BT_HVLM_Aktive_Ladeart: base-type-size=1, base-type-encoding=NONE
    BT_BMC_Pack_SN_15: base-type-size=1, base-type-encoding=NONE
    BT_DCDC_NV_Komponentenfehler_04: base-type-size=1, base-type-encoding=NONE
    BT_HVK_AktiveEntladung_Anf: base-type-size=1, base-type-encoding=NONE
    BT_BMC_CMC_Zellspannung_177: base-type-size=1, base-type-encoding=NONE
    BT_CHA_ReqPrgAcvChassis: base-type-size=1, base-type-encoding=NONE
    BT_DCDC_NV_Komponentenfehler_3_5: base-type-size=1, base-type-encoding=NONE
    BT_DW_Kilometerstand: base-type-size=1, base-type-encoding=NONE
    BT_BMC_RtmWarnSocHoch: base-type-size=1, base-type-encoding=NONE
    BT_HVEM_AIAD_RekuVerbot: base-type-size=1, base-type-encoding=NONE
    BT_HVLM_Max_Strom_Netz_L1: base-type-size=1, base-type-encoding=NONE
    BT_DCDC_NV_Komponentenfehler_27: base-type-size=1, base-type-encoding=NONE
    BT_BMC_CMC_Zellspannung_178: base-type-size=1, base-type-encoding=NONE
    BT_DCDC_NV_Komponentenfehler_3_6: base-type-size=1, base-type-encoding=NONE
    BT_CHA_ReqPrgAcvStg: base-type-size=1, base-type-encoding=NONE
    BT_HVK_BMC_Sollmodus: base-type-size=1, base-type-encoding=NONE
    BT_DCDC_NV_Komponentenfehler_05: base-type-size=1, base-type-encoding=NONE
    BT_HVK_Vorladung_aktiv: base-type-size=1, base-type-encoding=NONE
    BT_BMC_RtmWarnSocNiedrig: base-type-size=1, base-type-encoding=NONE
    BT_DCDC_NV_Komponentenfehler_3_7: base-type-size=1, base-type-encoding=NONE
    BT_CHA_ReqPrgBms: base-type-size=1, base-type-encoding=NONE
    BT_HVLM_ALF_AktiverLadeniveauwunsch: base-type-size=1, base-type-encoding=NONE
    BT_BMC_Pack_SN_16: base-type-size=1, base-type-encoding=NONE
    BT_HVLM_Max_Strom_Netz_L2: base-type-size=1, base-type-encoding=NONE
    BT_HVEM_BMC_CHA_Wunschleistung: base-type-size=1, base-type-encoding=NONE
    BT_BMC_CMC_Zellspannung_179: base-type-size=1, base-type-encoding=NONE
    BT_DCDC_NV_Komponentenfehler_06: base-type-size=1, base-type-encoding=NONE
    BT_HVK_BMC_Spannung_Anf: base-type-size=1, base-type-encoding=NONE
    BT_DCDC_NV_Komponentenfehler_3_8: base-type-size=1, base-type-encoding=NONE
    BT_CHA_ReqPrgCMM: base-type-size=1, base-type-encoding=NONE
    BT_EKK_HVK_EoHVL_Status: base-type-size=1, base-type-encoding=NONE
    BT_HVLM_Max_Strom_Netz_L3: base-type-size=1, base-type-encoding=NONE
    BT_DCDC_NV_Komponentenfehler_07: base-type-size=1, base-type-encoding=NONE
    BT_BMC_RtmWarnSocSprung: base-type-size=1, base-type-encoding=NONE
    BT_HVEM_BMC_CHA_Wunschleistung_02: base-type-size=1, base-type-encoding=NONE
    BT_CHA_ReqPrgDC: base-type-size=1, base-type-encoding=NONE
    BT_HVLE_AnzahlVerwendeterPhasen: base-type-size=1, base-type-encoding=NONE
    BT_DCDC_NV_Komponentenfehler_28: base-type-size=1, base-type-encoding=NONE
    BT_HVK_DCDC_Sollmodus: base-type-size=1, base-type-encoding=NONE
    BT_DCDC_NV_Komponentenfehler_3_9: base-type-size=1, base-type-encoding=NONE
    BT_HVLM_Pulsierstufe: base-type-size=1, base-type-encoding=NONE
    BT_DCDC_NV_Komponentenfehler_08: base-type-size=1, base-type-encoding=NONE
    BT_HVLM_MaxSpannung_OBG_HV: base-type-size=1, base-type-encoding=NONE
    BT_BMC_RtmWarnTZelleDiff: base-type-size=1, base-type-encoding=NONE
    BT_HVLM_ALF_Ladestatus_Niveau: base-type-size=1, base-type-encoding=NONE
    BT_CHA_ReqPrgDispSetup: base-type-size=1, base-type-encoding=NONE
    BT_BMC_Pack_SN_17: base-type-size=1, base-type-encoding=NONE
    BT_DCDC_NV_Komponentenfehler_40: base-type-size=1, base-type-encoding=NONE
    BT_HVLM_S2SchliessenAnf_A: base-type-size=1, base-type-encoding=NONE
    BT_HVEM_ETM_Max_Entladeleistung: base-type-size=1, base-type-encoding=NONE
    BT_HVK_eKAT_Sollmodus: base-type-size=1, base-type-encoding=NONE
    BT_EKK_HVK_Fehler_intern: base-type-size=1, base-type-encoding=NONE
    BT_DCDC_NV_Komponentenfehler_09: base-type-size=1, base-type-encoding=NONE
    BT_HVLM_S2SchliessenAnf_B: base-type-size=1, base-type-encoding=NONE
    BT_DCDC_NV_Komponentenfehler_41: base-type-size=1, base-type-encoding=NONE
    BT_CHA_ReqPrgDt: base-type-size=1, base-type-encoding=NONE
    BT_HVLE_AsymmetrischLadenMoeglich: base-type-size=1, base-type-encoding=NONE
    BT_HVLM_OBG_SollModus: base-type-size=1, base-type-encoding=NONE
    BT_DCDC_NV_Komponentenfehler_29: base-type-size=1, base-type-encoding=NONE
    BT_BMC_RtmWarnTZelleMax: base-type-size=1, base-type-encoding=NONE
    BT_HVEM_ETM_Max_Entladeleistung_02: base-type-size=1, base-type-encoding=NONE
    BT_HVK_EKK_Sollmodus: base-type-size=1, base-type-encoding=NONE
    BT_DCDC_NV_Komponentenfehler_10: base-type-size=1, base-type-encoding=NONE
    BT_HVLM_Schluessel_Anfrage: base-type-size=1, base-type-encoding=NONE
    BT_DCDC_NV_Komponentenfehler_42: base-type-size=1, base-type-encoding=NONE
    BT_CHA_ReqPrgDynTqCtrl: base-type-size=1, base-type-encoding=NONE
    BT_HVLM_ALF_PosAnforderung: base-type-size=1, base-type-encoding=NONE
    BT_BMC_RtmWarnTZelleMin: base-type-size=1, base-type-encoding=NONE
    BT_BMC_Pack_SN_18: base-type-size=1, base-type-encoding=NONE
    BT_EKK_HVK_Status_Spgfreiheit: base-type-size=1, base-type-encoding=NONE
    BT_DCDC_NV_Komponentenfehler_11: base-type-size=1, base-type-encoding=NONE
    BT_HVEM_ETM_Max_Ladeleistung: base-type-size=1, base-type-encoding=NONE
    BT_DCDC_NV_Komponentenfehler_43: base-type-size=1, base-type-encoding=NONE
    BT_HVLM_PrkCtl_StAlyReq: base-type-size=1, base-type-encoding=NONE
    BT_CHA_ReqPrgEps: base-type-size=1, base-type-encoding=NONE
    BT_HVK_ETM_Freigabe: base-type-size=1, base-type-encoding=NONE
    BT_HVLE_Derating_Temperatur: base-type-size=1, base-type-encoding=NONE
    BT_HVLM_SF4OeffnenAnf_A: base-type-size=1, base-type-encoding=NONE
    BT_DCDC_NV_Komponentenfehler_30: base-type-size=1, base-type-encoding=NONE
    BT_BMC_RtmWarnUeberstrom: base-type-size=1, base-type-encoding=NONE
    BT_DCDC_NV_Komponentenfehler_12: base-type-size=1, base-type-encoding=NONE
    BT_CHA_ReqPrgEsc: base-type-size=1, base-type-encoding=NONE
    BT_HVLM_SF4OeffnenAnf_B: base-type-size=1, base-type-encoding=NONE
    BT_HVLM_PrkCtl_StPrkLockReq: base-type-size=1, base-type-encoding=NONE
    BT_DCDC_NV_Komponentenfehler_44: base-type-size=1, base-type-encoding=NONE
    BT_HVLM_ALF_PosLadeart: base-type-size=1, base-type-encoding=NONE
    BT_HVK_Gesamtst_Spgfreiheit: base-type-size=1, base-type-encoding=NONE
    BT_HVEM_ETM_Max_Ladeleistung_02: base-type-size=1, base-type-encoding=NONE
    BT_ELF_GeplEndeLadevorgangJahr: base-type-size=1, base-type-encoding=NONE
    BT_DCDC_NV_Komponentenfehler_13: base-type-size=1, base-type-encoding=NONE
    BT_HVLM_SpannungsModusDc_Anf: base-type-size=1, base-type-encoding=NONE
    BT_CHA_ReqPrgExtrLight: base-type-size=1, base-type-encoding=NONE
    BT_DCDC_NV_Komponentenfehler_45: base-type-size=1, base-type-encoding=NONE
    BT_BMC_RtmWarnUPackMax: base-type-size=1, base-type-encoding=NONE
    BT_KST_Ausstiegswunsch_Status: base-type-size=1, base-type-encoding=NONE
    BT_DCDC_NV_Komponentenfehler_31: base-type-size=1, base-type-encoding=NONE
    BT_DCDC_NV_Komponentenfehler_14: base-type-size=1, base-type-encoding=NONE
    BT_MKB_ScndCllsnMtgtn_StReq: base-type-size=1, base-type-encoding=NONE
    BT_HVEM_ETM_Max_Leistung_Verteiler: base-type-size=1, base-type-encoding=NONE
    BT_HVK_HV_Netz_Warnungen: base-type-size=1, base-type-encoding=NONE
    BT_HVLM_Start_Pulserkennung: base-type-size=1, base-type-encoding=NONE
    BT_HVLE_Energiemenge_Laden: base-type-size=1, base-type-encoding=NONE
    BT_CHA_ReqPrgExtrSound: base-type-size=1, base-type-encoding=NONE
    BT_DCDC_NV_Komponentenfehler_46: base-type-size=1, base-type-encoding=NONE
    BT_BMC_RtmWarnUPackMin: base-type-size=1, base-type-encoding=NONE
    BT_HVLM_ALF_PosStatus: base-type-size=1, base-type-encoding=NONE
    BT_HVLM_Stecker_Notentriegeln_Anf_A: base-type-size=1, base-type-encoding=NONE
    BT_CHA_ReqPrgHdc: base-type-size=1, base-type-encoding=NONE
    BT_ELF_GeplEndeLadevorgangMinute: base-type-size=1, base-type-encoding=NONE
    BT_DCDC_NV_Komponentenfehler_47: base-type-size=1, base-type-encoding=NONE
    BT_DCDC_NV_Komponentenfehler_15: base-type-size=1, base-type-encoding=NONE
    BT_MM_PropulsionSystemActive: base-type-size=1, base-type-encoding=NONE
    BT_HVK_HV_Netz_Zustand: base-type-size=1, base-type-encoding=NONE
    BT_HVEM_IstLeistung_HVVerbraucher: base-type-size=1, base-type-encoding=NONE
    BT_KST_aut_Abschaltung_Zuendung: base-type-size=1, base-type-encoding=NONE
    BT_DCDC_NV_Komponentenfehler_32: base-type-size=1, base-type-encoding=NONE
    BT_CHA_ReqPrgHdUpDisp: base-type-size=1, base-type-encoding=NONE
    BT_BMC_RtmWarnUZelleMax: base-type-size=1, base-type-encoding=NONE
    BT_DCDC_NV_Komponentenfehler_48: base-type-size=1, base-type-encoding=NONE
    BT_DCDC_NV_Komponentenfehler_16: base-type-size=1, base-type-encoding=NONE
    BT_HVLM_Stecker_Notentriegeln_Anf_B: base-type-size=1, base-type-encoding=NONE
    BT_HVLE_I_istAC_Netz_L1: base-type-size=1, base-type-encoding=NONE
    BT_NM_aktiv_AutomotiveEdge_1: base-type-size=1, base-type-encoding=NONE
    BT_HVEM_IstStrom_HVVerbraucher: base-type-size=1, base-type-encoding=NONE
    BT_CHA_ReqPrgHsp: base-type-size=1, base-type-encoding=NONE
    BT_HVLM_BCAM_Aktiv: base-type-size=1, base-type-encoding=NONE
    BT_HVK_HVHL_Sollmodus: base-type-size=1, base-type-encoding=NONE
    BT_DCDC_NV_Komponentenfehler_17: base-type-size=1, base-type-encoding=NONE
    BT_HVLM_Stecker_Notentriegeln_Anf_C: base-type-size=1, base-type-encoding=NONE
    BT_BMC_RtmWarnUZelleMin: base-type-size=1, base-type-encoding=NONE
    BT_DCDC_NV_Komponentenfehler_49: base-type-size=1, base-type-encoding=NONE
    BT_ELF_GeplEndeLadevorgangMonat: base-type-size=1, base-type-encoding=NONE
    BT_DCDC_NV_Komponentenfehler_18: base-type-size=1, base-type-encoding=NONE
    BT_CHA_ReqPrgIntrLight: base-type-size=1, base-type-encoding=NONE
    BT_KST_BulbCheckReq: base-type-size=1, base-type-encoding=NONE
    BT_HVEM_Leistungsvorhalt_Entladen: base-type-size=1, base-type-encoding=NONE
    BT_HVLM_Stecker_VerEntriegelnAnf_A: base-type-size=1, base-type-encoding=NONE
    BT_HVK_HVHW_Sollmodus: base-type-size=1, base-type-encoding=NONE
    BT_NM_aktiv_AutomotiveEdge_2: base-type-size=1, base-type-encoding=NONE
    BT_DCDC_NV_Komponentenfehler_50: base-type-size=1, base-type-encoding=NONE
    BT_HVLE_I_istAC_Netz_L2: base-type-size=1, base-type-encoding=NONE
    BT_DCDC_NV_Komponentenfehler_33: base-type-size=1, base-type-encoding=NONE
    BT_DCDC_NV_Komponentenfehler_19: base-type-size=1, base-type-encoding=NONE
    BT_HVLM_Stecker_VerEntriegelnAnf_B: base-type-size=1, base-type-encoding=NONE
    BT_CHA_ReqPrgIntrSound: base-type-size=1, base-type-encoding=NONE
    BT_DCDC_NV_Komponentenfehler_51: base-type-size=1, base-type-encoding=NONE
    BT_NM_aktiv_Batteriekonditionierung: base-type-size=1, base-type-encoding=NONE
    BT_HVK_HVLM_Sollmodus: base-type-size=1, base-type-encoding=NONE
    BT_NM_aktiv_AutomotiveEdge_3: base-type-size=1, base-type-encoding=NONE
    BT_HVEM_Leistungsvorhalt_Laden: base-type-size=1, base-type-encoding=NONE
    BT_HVLM_Stecker_VerEntriegelnAnf_C: base-type-size=1, base-type-encoding=NONE
    BT_HVLM_BidiLadeModus: base-type-size=1, base-type-encoding=NONE
    BT_CHA_ReqPrgKl: base-type-size=1, base-type-encoding=NONE
    BT_ELF_GeplEndeLadevorgangStatus: base-type-size=1, base-type-encoding=NONE
    BT_DCDC_NV_Komponentenfehler_52: base-type-size=1, base-type-encoding=NONE
    BT_DCDC_NV_Komponentenfehler_20: base-type-size=1, base-type-encoding=NONE
    BT_CHA_ReqPrgLC: base-type-size=1, base-type-encoding=NONE
    BT_HVK_Iso_Messung_Start: base-type-size=1, base-type-encoding=NONE
    BT_HVLE_I_istAC_Netz_L3: base-type-size=1, base-type-encoding=NONE
    BT_KST_ComfortReadyStatus: base-type-size=1, base-type-encoding=NONE
    BT_NM_aktiv_AutomotiveEdge_4: base-type-size=1, base-type-encoding=NONE
    BT_NM_aktiv_Bedienung_an_Ladedose_1: base-type-size=1, base-type-encoding=NONE
    BT_DCDC_NV_Komponentenfehler_53: base-type-size=1, base-type-encoding=NONE
    BT_DCDC_NV_Komponentenfehler_34: base-type-size=1, base-type-encoding=NONE
    BT_HVLM_Steckerstatus: base-type-size=1, base-type-encoding=NONE
    BT_HVEM_MMTR_State: base-type-size=1, base-type-encoding=NONE
    BT_CHA_ReqPrgPreCrash: base-type-size=1, base-type-encoding=NONE
    BT_NM_Gateway_NM_aktiv_Tmin: base-type-size=1, base-type-encoding=NONE
    BT_HVLM_CP_Fehlerzustand_A: base-type-size=1, base-type-encoding=NONE
    BT_ELF_GeplEndeLadevorgangStunde: base-type-size=1, base-type-encoding=NONE
    BT_HVLM_VA_Sollmodus: base-type-size=1, base-type-encoding=NONE
    BT_NM_Gateway_NM_State: base-type-size=1, base-type-encoding=NONE
    BT_NM_aktiv_Bedienung_an_Ladedose_2: base-type-size=1, base-type-encoding=NONE
    BT_NM_Ladegeraet_FCAB: base-type-size=1, base-type-encoding=ISO-8859-1
    BT_DCDC_NV_Komponentenfehler_54: base-type-size=1, base-type-encoding=NONE
    BT_NM_aktiv_AutomotiveEdge_5: base-type-size=1, base-type-encoding=NONE
    BT_CHA_ReqPrgRcp: base-type-size=1, base-type-encoding=NONE
    BT_HVEM_Nachlad_Status: base-type-size=1, base-type-encoding=NONE
    BT_HVLE_Ist_Wirkungsgrad: base-type-size=1, base-type-encoding=NONE
    BT_HVLM_VALeistungFzg: base-type-size=1, base-type-encoding=NONE
    BT_NM_Gateway_SNI_10: base-type-size=1, base-type-encoding=NONE
    BT_KST_Deaktivierungs_Trigger: base-type-size=1, base-type-encoding=NONE
    BT_DCDC_NV_Komponentenfehler_35: base-type-size=1, base-type-encoding=NONE
    BT_CHA_ReqPrgRwb: base-type-size=1, base-type-encoding=NONE
    BT_DCDC_NV_Komponentenfehler_55: base-type-size=1, base-type-encoding=NONE
    BT_NM_aktiv_Call: base-type-size=1, base-type-encoding=NONE
    BT_NM_aktiv_Backend_KomGW: base-type-size=1, base-type-encoding=NONE
    BT_HVLM_CP_Fehlerzustand_B: base-type-size=1, base-type-encoding=NONE
    BT_HVEM_Nachladen_Anf: base-type-size=1, base-type-encoding=NONE
    BT_NM_Ladegeraet_NM_aktiv_Diag: base-type-size=1, base-type-encoding=NONE
    BT_HVLM_VASpannungFzg: base-type-size=1, base-type-encoding=NONE
    BT_NM_Gateway_UDS_CC: base-type-size=1, base-type-encoding=NONE
    BT_ELF_GeplEndeLadevorgangTag: base-type-size=1, base-type-encoding=NONE
    BT_CHA_ReqPrgTqVect: base-type-size=1, base-type-encoding=NONE
    BT_DCDC_NV_Komponentenfehler_56: base-type-size=1, base-type-encoding=NONE
    BT_NM_aktiv_ConnectVerbund_UseCase1: base-type-size=1, base-type-encoding=NONE
    BT_HVLM_VAStromFzg: base-type-size=1, base-type-encoding=NONE
    BT_HVEM_StCpbDrv: base-type-size=1, base-type-encoding=NONE
    BT_NM_Ladegeraet_NM_aktiv_KL15: base-type-size=1, base-type-encoding=NONE
    BT_NM_Gateway_Wakeup_V12: base-type-size=1, base-type-encoding=NONE
    BT_CHA_ReqPrgVLim: base-type-size=1, base-type-encoding=NONE
    BT_KST_Fahrerhinweis_1: base-type-size=1, base-type-encoding=NONE
    BT_DCDC_NV_Komponentenfehler_57: base-type-size=1, base-type-encoding=NONE
    BT_HVLE_IstSpannung_HV: base-type-size=1, base-type-encoding=NONE
    BT_DCDC_NV_Komponentenfehler_36: base-type-size=1, base-type-encoding=NONE
    BT_NVEM_Bordnetz_Information: base-type-size=1, base-type-encoding=NONE
    BT_HVLM_CP_KommProtokoll_A: base-type-size=1, base-type-encoding=NONE
    BT_NM_aktiv_ConnectVerbund_UseCase2: base-type-size=1, base-type-encoding=NONE
    BT_HVLM_WakeUpZaehlerResetAnf: base-type-size=1, base-type-encoding=NONE
    BT_NM_HVZB_CBV_AWB: base-type-size=1, base-type-encoding=NONE
    BT_CHA_ReqPrgWarnBrk: base-type-size=1, base-type-encoding=NONE
    BT_DCDC_NV_Komponentenfehler_58: base-type-size=1, base-type-encoding=NONE
    BT_NM_Ladegeraet_NM_aktiv_Tmin: base-type-size=1, base-type-encoding=NONE
    BT_HVEM_StCpbElAcy: base-type-size=1, base-type-encoding=NONE
    BT_HCP1_Indc_StChk: base-type-size=1, base-type-encoding=NONE
    BT_NVEM_Bordnetzdiagnose: base-type-size=1, base-type-encoding=NONE
    BT_HVLM_WLAN_Aktivieren: base-type-size=1, base-type-encoding=NONE
    BT_NM_HVZB_CBV_CRI: base-type-size=1, base-type-encoding=NONE
    BT_NM_aktiv_ConnectVerbund_UseCase3: base-type-size=1, base-type-encoding=NONE
    BT_DCDC_NV_Komponentenfehler_59: base-type-size=1, base-type-encoding=NONE
    BT_KST_Fahrerhinweis_2: base-type-size=1, base-type-encoding=NONE
    BT_NM_Ladegeraet_NM_State: base-type-size=1, base-type-encoding=NONE
    BT_HVLE_Netzfrequenz_EVU: base-type-size=1, base-type-encoding=NONE
    BT_CHA_StCurProfDft: base-type-size=1, base-type-encoding=NONE
    BT_HVLM_WLAN_Verbinden: base-type-size=1, base-type-encoding=NONE
    BT_NVEM_DC_iSoll_NV: base-type-size=1, base-type-encoding=NONE
    BT_HVEM_STK_Leistung_verfuegbar: base-type-size=1, base-type-encoding=NONE
    BT_NM_HVZB_FCAB: base-type-size=1, base-type-encoding=ISO-8859-1
    BT_OBD_Calc_Load_Val: base-type-size=1, base-type-encoding=NONE
    BT_HVLM_CP_KommProtokoll_B: base-type-size=1, base-type-encoding=NONE
    BT_DCDC_NV_Komponentenfehler_60: base-type-size=1, base-type-encoding=NONE
    BT_NM_aktiv_ConnectVerbund_UseCase4: base-type-size=1, base-type-encoding=NONE
    BT_ClampControl_01_BZ: base-type-size=1, base-type-encoding=NONE
    BT_NM_Ladegeraet_SNI_10: base-type-size=1, base-type-encoding=NONE
    BT_HVLM_ZustandLadeablauf: base-type-size=1, base-type-encoding=NONE
    BT_NM_HVZB_NM_aktiv_Diag: base-type-size=1, base-type-encoding=NONE
    BT_HVEM_StLimElAcy: base-type-size=1, base-type-encoding=NONE
    BT_NVEM_DC_uMin_NV: base-type-size=1, base-type-encoding=NONE
    BT_DCDC_NV_Komponentenfehler_61: base-type-size=1, base-type-encoding=NONE
    BT_ClampControl_01_CRC: base-type-size=1, base-type-encoding=NONE
    BT_HCP1_Indc_StFail: base-type-size=1, base-type-encoding=NONE
    BT_KST_Fahrerhinweis_3: base-type-size=1, base-type-encoding=NONE
    BT_NM_aktiv_ConnectVerbund_UseCase5: base-type-size=1, base-type-encoding=NONE
    BT_HVLE_Netzmodus: base-type-size=1, base-type-encoding=NONE
    BT_Hybrid_01_Abschaltstufe: base-type-size=1, base-type-encoding=NONE
    BT_DCDC_NV_Komponentenfehler_62: base-type-size=1, base-type-encoding=NONE
    BT_NM_HVZB_NM_aktiv_KL15: base-type-size=1, base-type-encoding=NONE
    BT_CMM_FlgCHAFctDC: base-type-size=1, base-type-encoding=NONE
    BT_NM_Ladegeraet_UDS_CC: base-type-size=1, base-type-encoding=NONE
    BT_NVEM_DC_uSoll_NV: base-type-size=1, base-type-encoding=NONE
    BT_HVEM_SystemMinLeistungsgrenze: base-type-size=1, base-type-encoding=NONE
    BT_NM_aktiv_ConnectVerbund_UseCase6: base-type-size=1, base-type-encoding=NONE
    BT_OBD_ClearMem_Inhibit: base-type-size=1, base-type-encoding=NONE
    BT_DCDC_NV_Komponentenfehler_63: base-type-size=1, base-type-encoding=NONE
    BT_Hybrid_01_Indc_StChk: base-type-size=1, base-type-encoding=NONE
    BT_NM_HVZB_NM_aktiv_Tmin: base-type-size=1, base-type-encoding=NONE
    BT_CMM_FlgCHAFctLC: base-type-size=1, base-type-encoding=NONE
    BT_HVLM_CP_MaxStrom_A: base-type-size=1, base-type-encoding=NONE
    BT_NM_Ladegeraet_Wakeup_V12: base-type-size=1, base-type-encoding=NONE
    BT_HV_Bordnetz_aktiv: base-type-size=1, base-type-encoding=NONE
    BT_HVEM_TME_Energie_Vorgabe: base-type-size=1, base-type-encoding=NONE
    BT_HVLE_OBG_AC_maxSpannung: base-type-size=1, base-type-encoding=NONE
    BT_NVEM_Freigabe_OTA: base-type-size=1, base-type-encoding=NONE
    BT_NM_HVZB_NM_State: base-type-size=1, base-type-encoding=NONE
    BT_Hybrid_01_Indc_StFail: base-type-size=1, base-type-encoding=NONE
    BT_NM_aktiv_E3_SW_Plattform_1: base-type-size=1, base-type-encoding=NONE
    BT_DCDC_NV_Komponentenfehler_64: base-type-size=1, base-type-encoding=NONE
    BT_KST_Fahrerhinweis_4: base-type-size=1, base-type-encoding=NONE
    BT_CMM_FlgGlbFallBkIdc: base-type-size=1, base-type-encoding=NONE
    BT_NM_SACID_1_CBV_AWB: base-type-size=1, base-type-encoding=NONE
    BT_NM_HVZB_SNI_10: base-type-size=1, base-type-encoding=NONE
    BT_Hybrid_01_KD_Fehler: base-type-size=1, base-type-encoding=NONE
    BT_OBD_Driving_Cycle: base-type-size=1, base-type-encoding=NONE
    BT_NVEM_Last_Anf: base-type-size=1, base-type-encoding=NONE
    BT_DCDC_NV_Komponentenfehler_65: base-type-size=1, base-type-encoding=NONE
    BT_HVEM_TME_Leistung_Vorgabe: base-type-size=1, base-type-encoding=NONE
    BT_DC_Fehler_extern: base-type-size=1, base-type-encoding=NONE
    BT_HVLM_CP_MaxStrom_B: base-type-size=1, base-type-encoding=NONE
    BT_NM_HVZB_UDS_CC: base-type-size=1, base-type-encoding=NONE
    BT_NM_aktiv_E3_SW_Plattform_2: base-type-size=1, base-type-encoding=NONE
    BT_Hybrid_01_KompSchutz: base-type-size=1, base-type-encoding=NONE
    BT_HVLE_OBG_AC_maxStrom: base-type-size=1, base-type-encoding=NONE
    BT_NM_SACID_1_CBV_CRI: base-type-size=1, base-type-encoding=NONE
    BT_HV_Bordnetz_Fehler: base-type-size=1, base-type-encoding=NONE
    BT_DCDC_NV_Komponentenfehler_66: base-type-size=1, base-type-encoding=NONE
    BT_NVEM_MV_DC_iSoll_NV: base-type-size=1, base-type-encoding=NONE
    BT_DC_Fehler_intern: base-type-size=1, base-type-encoding=NONE
    BT_KST_Fahrerhinweis_5: base-type-size=1, base-type-encoding=NONE
    BT_HVEM_TME_MSF_aktiv: base-type-size=1, base-type-encoding=NONE
    BT_Hybrid_01_Nachlauftyp: base-type-size=1, base-type-encoding=NONE
    BT_NM_aktiv_E3_SW_Plattform_3: base-type-size=1, base-type-encoding=NONE
    BT_DCDC_NV_Komponentenfehler_67: base-type-size=1, base-type-encoding=NONE
    BT_OBD_Eng_Cool_Temp: base-type-size=1, base-type-encoding=NONE
    BT_NM_HVZB_Wakeup_V12: base-type-size=1, base-type-encoding=NONE
    BT_NM_SACID_1_FCAB: base-type-size=1, base-type-encoding=ISO-8859-1
    BT_DC_IstLeistung_HV: base-type-size=1, base-type-encoding=NONE
    BT_NVEM_MV_DC_uMinLV: base-type-size=1, base-type-encoding=NONE
    BT_HVLM_CP_State_A: base-type-size=1, base-type-encoding=NONE
    BT_HVEM_TME_Sollstatus: base-type-size=1, base-type-encoding=NONE
    BT_DCDC_NV_Komponentenfehler_68: base-type-size=1, base-type-encoding=NONE
    BT_NM_Hybrid_01_CAB_V12: base-type-size=1, base-type-encoding=ISO-8859-1
    BT_DC_IstModus_02: base-type-size=1, base-type-encoding=NONE
    BT_Hybrid_01_OBD_Lampe_Anf: base-type-size=1, base-type-encoding=NONE
    BT_NM_aktiv_E3_SW_Plattform_4: base-type-size=1, base-type-encoding=NONE
    BT_HVLE_OBG_ACDC_IstLeistung: base-type-size=1, base-type-encoding=NONE
    BT_OBDProtocol_Hybrid_01: base-type-size=1, base-type-encoding=NONE
    BT_KST_Fahrerhinweis_6: base-type-size=1, base-type-encoding=NONE
    BT_NM_SACID_1_NM_aktiv_Diag: base-type-size=1, base-type-encoding=NONE
    BT_NVEM_MV_DC_uSollLV: base-type-size=1, base-type-encoding=NONE
    BT_NM_Hybrid_01_CBV_AWB: base-type-size=1, base-type-encoding=NONE
    BT_Hybrid_01_SNI_10: base-type-size=1, base-type-encoding=NONE
    BT_HVHL_HVK_EoHVL_Status: base-type-size=1, base-type-encoding=NONE
    BT_DCDC_NV_Komponentenfehler_69: base-type-size=1, base-type-encoding=NONE
    BT_OBD_Engine_RPM: base-type-size=1, base-type-encoding=NONE
    BT_NM_aktiv_E3_SW_Plattform_5: base-type-size=1, base-type-encoding=NONE
    BT_DC_Vorladung_Status: base-type-size=1, base-type-encoding=NONE
    BT_NM_Hybrid_01_CBV_CRI: base-type-size=1, base-type-encoding=NONE
    BT_Hybrid_01_Transport_Mode: base-type-size=1, base-type-encoding=NONE
    BT_HVLM_CP_State_B: base-type-size=1, base-type-encoding=NONE
    BT_NM_SACID_1_NM_aktiv_KL15: base-type-size=1, base-type-encoding=NONE
    BT_DCDC_NV_Komponentenfehler_70: base-type-size=1, base-type-encoding=NONE
    BT_HVHL_HVK_Fehler_intern: base-type-size=1, base-type-encoding=NONE
    BT_NVEM_NV_BAT_ZellStatus_Index_Anf: base-type-size=1, base-type-encoding=NONE
    BT_NM_Hybrid_01_FCAB: base-type-size=1, base-type-encoding=ISO-8859-1
    BT_DCDC_HVK_EoHVL_Status: base-type-size=1, base-type-encoding=NONE
    BT_NM_aktiv_Erw_HV_Ladefunktion: base-type-size=1, base-type-encoding=NONE
    BT_IMMO_ClampPermStatus: base-type-size=1, base-type-encoding=NONE
    BT_OBDProtocol_req: base-type-size=1, base-type-encoding=NONE
    BT_HVLE_OBG_ACDC_MaxLeistung: base-type-size=1, base-type-encoding=NONE
    BT_KST_KL_15: base-type-size=1, base-type-encoding=NONE
    BT_DCDC_NV_Komponentenfehler_71: base-type-size=1, base-type-encoding=NONE
    BT_NM_SACID_1_NM_aktiv_Tmin: base-type-size=1, base-type-encoding=NONE
    BT_OBD_Kaltstart_Denominator: base-type-size=1, base-type-encoding=NONE
    BT_DCDC_HVK_Fehler_AE: base-type-size=1, base-type-encoding=NONE
    BT_IMMO_Display: base-type-size=1, base-type-encoding=NONE
    BT_NVEM_NV_BAT_ZellStatus_Typ_Anf: base-type-size=1, base-type-encoding=NONE
    BT_NM_Hybrid_01_FCIB: base-type-size=1, base-type-encoding=ISO-8859-1
    BT_DCDC_NV_Komponentenfehler_72: base-type-size=1, base-type-encoding=NONE
    BT_HVLM_DC_Aufstartmodus: base-type-size=1, base-type-encoding=NONE
    BT_HVHL_HVK_Status_Spgfreiheit: base-type-size=1, base-type-encoding=NONE
    BT_NM_SACID_1_NM_State: base-type-size=1, base-type-encoding=NONE
    BT_DCDC_HVK_Fehler_SD: base-type-size=1, base-type-encoding=NONE
    BT_NM_aktiv_Gefahreninfo: base-type-size=1, base-type-encoding=NONE
    BT_NM_Hybrid_01_Lokalaktiv: base-type-size=1, base-type-encoding=NONE
    BT_DCDC_NV_Komponentenfehler_73: base-type-size=1, base-type-encoding=NONE
    BT_NVEM_Verbraucher_Information: base-type-size=1, base-type-encoding=NONE
    BT_ISO_ALL_01_Req_Data: base-type-size=1, base-type-encoding=NONE
    BT_HVLE_OBG_DC_IstStrom: base-type-size=1, base-type-encoding=NONE
    BT_KST_Kl_50_Startanforderung: base-type-size=1, base-type-encoding=NONE
    BT_DCDC_NV_CALID_Index_01: base-type-size=1, base-type-encoding=NONE
    BT_HVK_03_BZ: base-type-size=1, base-type-encoding=NONE
    BT_NM_Hybrid_01_NM_aktiv_Diag: base-type-size=1, base-type-encoding=NONE
    BT_NM_SACID_1_SNI_10: base-type-size=1, base-type-encoding=NONE
    BT_NM_aktiv_HV_Laden: base-type-size=1, base-type-encoding=NONE
    BT_OBG_01_BZ: base-type-size=1, base-type-encoding=NONE
    BT_KL_Verdampfertemperatur: base-type-size=1, base-type-encoding=NONE
    BT_OBD_Abs_Pedal_Pos: base-type-size=1, base-type-encoding=NONE
    BT_DCDC_NV_Komponentenfehler_74: base-type-size=1, base-type-encoding=NONE
    BT_OBD_MIL: base-type-size=1, base-type-encoding=NONE
    BT_NM_Hybrid_01_NM_aktiv_KL15: base-type-size=1, base-type-encoding=NONE
    BT_DCDC_NV_CALID_Index_02: base-type-size=1, base-type-encoding=NONE
    BT_KN_Hybrid_01_BusKnockOut: base-type-size=1, base-type-encoding=NONE
    BT_HVLM_DC_SollStrom: base-type-size=1, base-type-encoding=NONE
    BT_NM_aktiv_HVEM: base-type-size=1, base-type-encoding=NONE
    BT_HVLE_OBG_DC_MaxStrom: base-type-size=1, base-type-encoding=NONE
    BT_DCDC_NV_Komponentenfehler_75: base-type-size=1, base-type-encoding=NONE
    BT_OruControlStateD: base-type-size=1, base-type-encoding=NONE
    BT_NM_Hybrid_01_NM_aktiv_KondAnf: base-type-size=1, base-type-encoding=NONE
    BT_OBD_Aussen_Temp_gef: base-type-size=1, base-type-encoding=NONE
    BT_NM_SACID_1_UDS_CC: base-type-size=1, base-type-encoding=NONE
    BT_KN_Hybrid_01_BusKnockOutTimer: base-type-size=1, base-type-encoding=NONE
    BT_DCDC_NV_CALID_Index_03: base-type-size=1, base-type-encoding=NONE
    BT_DCDC_NV_Komponentenfehler_76: base-type-size=1, base-type-encoding=NONE
    BT_OnlineRemoteUpdateControlA: base-type-size=1, base-type-encoding=NONE
    BT_NM_aktiv_HVK: base-type-size=1, base-type-encoding=NONE
    BT_KST_Kl_S: base-type-size=1, base-type-encoding=NONE
    BT_OBD_Minimum_Trip: base-type-size=1, base-type-encoding=NONE
    BT_KN_Hybrid_01_DiagPfad_V12: base-type-size=1, base-type-encoding=NONE
    BT_OruHostUpdateA: base-type-size=1, base-type-encoding=NONE
    BT_DCDC_NV_CALID_Index_04: base-type-size=1, base-type-encoding=NONE
    BT_NM_Hybrid_01_NM_aktiv_Tmin: base-type-size=1, base-type-encoding=NONE
    BT_NM_SACID_1_Wakeup_V12: base-type-size=1, base-type-encoding=NONE
    BT_OBD_Barometric_Pressure: base-type-size=1, base-type-encoding=NONE
    BT_DCDC_NV_Komponentenfehler_77: base-type-size=1, base-type-encoding=NONE
    BT_HVLM_GAFrequenz: base-type-size=1, base-type-encoding=NONE
    BT_DCDC_NV_CALID_Index_05: base-type-size=1, base-type-encoding=NONE
    BT_NM_aktiv_HVLM: base-type-size=1, base-type-encoding=NONE
    BT_NM_Hybrid_01_NM_State: base-type-size=1, base-type-encoding=NONE
    BT_HVLE_OBG_Fehlerstatus: base-type-size=1, base-type-encoding=NONE
    BT_KN_Hybrid_01_ECUKnockOut: base-type-size=1, base-type-encoding=NONE
    BT_DCDC_NV_Komponentenfehler_78: base-type-size=1, base-type-encoding=NONE
    BT_OruHostUpdateD: base-type-size=1, base-type-encoding=NONE
    BT_NM_SACID_2_CBV_AWB: base-type-size=1, base-type-encoding=NONE
    BT_OnlineRemoteUpdateControlD: base-type-size=1, base-type-encoding=NONE
    BT_NM_Hybrid_01_SNI_10: base-type-size=1, base-type-encoding=NONE
    BT_DCDC_NV_CALID_Index_06: base-type-size=1, base-type-encoding=NONE
    BT_KST_Kl_X: base-type-size=1, base-type-encoding=NONE
    BT_SI_T_Mode: base-type-size=1, base-type-encoding=NONE
    BT_OBD_Normed_Trip: base-type-size=1, base-type-encoding=NONE
    BT_KN_Hybrid_01_ECUKnockOutTimer: base-type-size=1, base-type-encoding=NONE
    BT_NM_aktiv_Key_Authentifiz_SMS: base-type-size=1, base-type-encoding=NONE
    BT_NM_Hybrid_01_Subsystemaktiv: base-type-size=1, base-type-encoding=NONE
    BT_DCDC_NV_Komponentenfehler_79: base-type-size=1, base-type-encoding=NONE
    BT_NM_SACID_2_CBV_CRI: base-type-size=1, base-type-encoding=NONE
    BT_OruIntegrityCheckActiveA: base-type-size=1, base-type-encoding=NONE
    BT_DCDC_NV_CALID_Index_07: base-type-size=1, base-type-encoding=NONE
    BT_HVLM_GASpulenstrom: base-type-size=1, base-type-encoding=NONE
    BT_SI_T_Schutz: base-type-size=1, base-type-encoding=NONE
    BT_Kompressor_Status: base-type-size=1, base-type-encoding=NONE
    BT_HVLE_OBG_Fehlerstrom: base-type-size=1, base-type-encoding=NONE
    BT_DCDC_NV_Komponentenfehler_80: base-type-size=1, base-type-encoding=NONE
    BT_NM_Hybrid_01_UDS_CC: base-type-size=1, base-type-encoding=NONE
    BT_NM_aktiv_Konditionierung_Track: base-type-size=1, base-type-encoding=NONE
    BT_OnlineRemoteUpdateControlOldA: base-type-size=1, base-type-encoding=NONE
    BT_NM_SACID_2_FCAB: base-type-size=1, base-type-encoding=ISO-8859-1
    BT_KST_Sonderzustand_Anforderung: base-type-size=1, base-type-encoding=NONE
    BT_OBD_Normed_Trip_Wout_Fu_Cdn: base-type-size=1, base-type-encoding=NONE
    BT_DCDC_NV_CALID_Index_08: base-type-size=1, base-type-encoding=NONE
    BT_DCDC_NV_Komponentenfehler_VLD: base-type-size=1, base-type-encoding=NONE
    BT_SignalVoid: base-type-size=1, base-type-encoding=NONE
    BT_OruIntegrityCheckActiveD: base-type-size=1, base-type-encoding=NONE
    BT_KS_Hybrid_01_ChK: base-type-size=8, base-type-encoding=ISO-8859-1
    BT_NM_aktiv_Konditionierungsbedarf: base-type-size=1, base-type-encoding=NONE
    BT_NM_Hybrid_01_Wakeup_V12: base-type-size=1, base-type-encoding=NONE
    BT_HVLM_Grundladen_Anf: base-type-size=1, base-type-encoding=NONE
    BT_DCDC_NV_CALID_Index_09: base-type-size=1, base-type-encoding=NONE
    BT_DEV_Hybrid_01_Req_00_FD_Data: base-type-size=8, base-type-encoding=ISO-8859-1
    BT_NM_SACID_2_NM_aktiv_Diag: base-type-size=1, base-type-encoding=NONE
    BT_KS_Hybrid_01_ChK_IKACtr: base-type-size=1, base-type-encoding=NONE
    BT_NM_Ladegeraet_CBV_AWB: base-type-size=1, base-type-encoding=NONE
    BT_HVLE_OBG_IstModus: base-type-size=1, base-type-encoding=NONE
    BT_OnlineRemoteUpdateControlOldD: base-type-size=1, base-type-encoding=NONE
    BT_OruReleasePartitionSwitchA: base-type-size=1, base-type-encoding=NONE
    BT_SOK_ungeschuetzte_Zeit: base-type-size=8, base-type-encoding=ISO-8859-1
    BT_NM_aktiv_Ladestecker_erkannt_1: base-type-size=1, base-type-encoding=NONE
    BT_KST_Sonderzustand_Status: base-type-size=1, base-type-encoding=NONE
    BT_DEV_Hybrid_01_Resp_FF_FD_Data: base-type-size=8, base-type-encoding=ISO-8859-1
    BT_NM_Ladegeraet_CBV_CRI: base-type-size=1, base-type-encoding=NONE
    BT_NM_SACID_2_NM_aktiv_KL15: base-type-size=1, base-type-encoding=NONE
    BT_KS_Hybrid_01_ChK_SID: base-type-size=1, base-type-encoding=NONE
    BT_TME_EKK_Istmodus: base-type-size=1, base-type-encoding=NONE
    BT_OruReleasePartitionSwitchD: base-type-size=1, base-type-encoding=NONE
    BT_NM_aktiv_Ladestecker_erkannt_2: base-type-size=1, base-type-encoding=NONE
    BT_OBD_NumDcyMilOnReq: base-type-size=1, base-type-encoding=NONE
    BT_SOK_Zeit_Hybrid_01_Challenge: base-type-size=8, base-type-encoding=ISO-8859-1
    BT_KS_Hybrid_01_ChM: base-type-size=8, base-type-encoding=ISO-8859-1
    BT_TME_eKMV_Istmodus: base-type-size=1, base-type-encoding=NONE
    BT_HVLE_OBG_Typ_verbaut: base-type-size=1, base-type-encoding=NONE
    BT_NM_SACID_2_NM_aktiv_Tmin: base-type-size=1, base-type-encoding=NONE
    BT_DGN_Verlernzaehler: base-type-size=1, base-type-encoding=NONE
    BT_HVLM_Intensitaet_Lk1: base-type-size=1, base-type-encoding=NONE
    BT_TME_Temp_nach_HVH_Heizk1_1: base-type-size=1, base-type-encoding=NONE
    BT_OruVehicleLockRequestA: base-type-size=1, base-type-encoding=NONE
    BT_KST_StPtAcvReq: base-type-size=1, base-type-encoding=NONE
    BT_KS_Hybrid_01_ChM_IKACtr: base-type-size=1, base-type-encoding=NONE
    BT_ORU_AgLgtSdsl: base-type-size=1, base-type-encoding=NONE
    BT_NM_aktiv_Ladezustand: base-type-size=1, base-type-encoding=NONE
    BT_SOK_Zeit_Hybrid_01_Zeit: base-type-size=8, base-type-encoding=ISO-8859-1
    BT_TME_eKMV_Spannung: base-type-size=1, base-type-encoding=NONE
    BT_DS_Hybrid_01_ConfDTCChanged: base-type-size=1, base-type-encoding=NONE
    BT_TME_Temp_nach_HVH_Heizk1_2: base-type-size=1, base-type-encoding=NONE
    BT_KS_Hybrid_01_ChM_SID: base-type-size=1, base-type-encoding=NONE
    BT_NM_SACID_2_NM_State: base-type-size=1, base-type-encoding=NONE
    BT_OBD_QBit_Aussen_Temp: base-type-size=1, base-type-encoding=NONE
    BT_TME_eKMV_Strom: base-type-size=1, base-type-encoding=NONE
    BT_NM_aktiv_MVEM_Fremdladung: base-type-size=1, base-type-encoding=NONE
    BT_OruVehicleLockRequestD: base-type-size=1, base-type-encoding=NONE
    BT_Thermo_Verbrauch_BTL: base-type-size=1, base-type-encoding=NONE
    BT_DS_Hybrid_01_DiagAdr: base-type-size=1, base-type-encoding=NONE
    BT_HVLE_OBG_Warnzustand: base-type-size=1, base-type-encoding=NONE
    BT_KS_Hybrid_01_ReK: base-type-size=8, base-type-encoding=ISO-8859-1
    BT_HVLM_Intensitaet_Lk2: base-type-size=1, base-type-encoding=NONE
    BT_TME_Temp_nach_HVH_Heizk2_1: base-type-size=1, base-type-encoding=NONE
    BT_NM_SACID_2_SNI_10: base-type-size=1, base-type-encoding=NONE
    BT_TME_ELM1_IstVolumenstrom: base-type-size=1, base-type-encoding=NONE
    BT_ORU_Control_A_01_BZ: base-type-size=1, base-type-encoding=NONE
    BT_DS_Hybrid_01_IdentValid: base-type-size=1, base-type-encoding=NONE
    BT_KST_StPtDeacReq: base-type-size=1, base-type-encoding=NONE
    BT_OTAMC_D_01_BZ: base-type-size=1, base-type-encoding=NONE
    BT_NM_aktiv_MVEM_Pos_RSG: base-type-size=1, base-type-encoding=NONE
    BT_Thermo_Verbrauch_BTL_Ueberlauf: base-type-size=1, base-type-encoding=NONE
    BT_KS_Hybrid_01_ReK_IKACtr: base-type-size=1, base-type-encoding=NONE
    BT_TME_Temp_nach_HVH_Heizk2_2: base-type-size=1, base-type-encoding=NONE
    BT_TME_ELM2_IstVolumenstrom: base-type-size=1, base-type-encoding=NONE
    BT_OBD_Sperrung_IUMPR: base-type-size=1, base-type-encoding=NONE
    BT_DS_Hybrid_01_Lokalaktiv: base-type-size=1, base-type-encoding=NONE
    BT_NM_SACID_2_UDS_CC: base-type-size=1, base-type-encoding=NONE
    BT_HVLE_PE_Monitor: base-type-size=1, base-type-encoding=NONE
    BT_OTAMC_D_01_CRC: base-type-size=1, base-type-encoding=NONE
    BT_NM_aktiv_NVEM: base-type-size=1, base-type-encoding=NONE
    BT_TME_ELM3_IstVolumenstrom: base-type-size=1, base-type-encoding=NONE
    BT_TME_Temp_nach_HVH_Heizk3_1: base-type-size=1, base-type-encoding=NONE
    BT_KS_Hybrid_01_ReK_SID: base-type-size=1, base-type-encoding=NONE
    BT_HVLM_Intensitaet_Lk3: base-type-size=1, base-type-encoding=NONE
    BT_ORU_Control_A_01_CRC: base-type-size=1, base-type-encoding=NONE
    BT_DS_Hybrid_01_MemSel10Changed: base-type-size=1, base-type-encoding=NONE
    BT_NM_SACID_2_Wakeup_V12: base-type-size=1, base-type-encoding=NONE
    BT_Thermo_Verbrauch_Innen: base-type-size=1, base-type-encoding=NONE
    BT_KST_Txt_Panikabschaltung: base-type-size=1, base-type-encoding=NONE
    BT_KS_Hybrid_01_ReM: base-type-size=8, base-type-encoding=ISO-8859-1
    BT_TME_Temp_nach_HVH_Heizk3_2: base-type-size=1, base-type-encoding=NONE
    BT_OTP_01_BZ: base-type-size=1, base-type-encoding=NONE
    BT_NM_aktiv_NVEM2: base-type-size=1, base-type-encoding=NONE
    BT_TME_ETV_IstVolumenstrom: base-type-size=1, base-type-encoding=NONE
    BT_OBD_Sperrung_Kaltstart_Denom: base-type-size=1, base-type-encoding=NONE
    BT_DS_Hybrid_01_MemSelChanged: base-type-size=1, base-type-encoding=NONE
    BT_KS_Hybrid_01_ReM_IKACtr: base-type-size=1, base-type-encoding=NONE
    BT_TME_Temp_nach_HVH_Heizk4_1: base-type-size=1, base-type-encoding=NONE
    BT_NVEM3_Absch_SCR: base-type-size=1, base-type-encoding=NONE
    BT_Thermo_Verbrauch_Innen_Ueberlauf: base-type-size=1, base-type-encoding=NONE
    BT_TME_Heizanforderung_Innenraum: base-type-size=1, base-type-encoding=NONE
    BT_HVLM_LadedosenSuchlicht: base-type-size=1, base-type-encoding=NONE
    BT_HVLE_U_istAC_Netz_L1: base-type-size=1, base-type-encoding=NONE
    BT_ORU_Control_D_01_BZ: base-type-size=1, base-type-encoding=NONE
    BT_OTP_01_CRC: base-type-size=1, base-type-encoding=NONE
    BT_DS_Hybrid_01_StMemChanged: base-type-size=1, base-type-encoding=NONE
    BT_KS_Hybrid_01_ReM_SID: base-type-size=1, base-type-encoding=NONE
    BT_NM_aktiv_OnlineRemoteUpdate: base-type-size=1, base-type-encoding=NONE
    BT_KST_Warn_P1_ZAT_def: base-type-size=1, base-type-encoding=NONE
    BT_TME_HT_Kuehlmittel_Sensor: base-type-size=1, base-type-encoding=NONE
    BT_NVEM_12_BZ: base-type-size=1, base-type-encoding=NONE
    BT_TME_Temp_nach_HVH_Heizk4_2: base-type-size=1, base-type-encoding=NONE
    BT_TME_Anforderung_Heizkreispumpe: base-type-size=1, base-type-encoding=NONE
    BT_OBD_Typ: base-type-size=1, base-type-encoding=NONE
    BT_DS_Hybrid_01_Subsystemaktiv: base-type-size=1, base-type-encoding=NONE
    BT_TME_HV_Anf: base-type-size=1, base-type-encoding=NONE
    BT_NM_aktiv_Remote_Repair: base-type-size=1, base-type-encoding=NONE
    BT_KS_Hybrid_01_Req_ErrCtr: base-type-size=1, base-type-encoding=NONE
    BT_TME_Temp_nach_Verdampfer_Front: base-type-size=1, base-type-encoding=NONE
    BT_OTP_Aussen_Temp_FStatus: base-type-size=1, base-type-encoding=NONE
    BT_HVLM_Ladeklappe_VerEntriegeAnf_1: base-type-size=1, base-type-encoding=NONE
    BT_TME_Antriebszustand_Anf: base-type-size=1, base-type-encoding=NONE
    BT_NVEM_12_CRC: base-type-size=1, base-type-encoding=NONE
    BT_ORU_Control_D_01_CRC: base-type-size=1, base-type-encoding=NONE
    BT_TME_HV_IstLeistung: base-type-size=1, base-type-encoding=NONE
    BT_HVLE_U_istAC_Netz_L2: base-type-size=1, base-type-encoding=NONE
    BT_KS_Hybrid_01_Req_IKA_Retry: base-type-size=1, base-type-encoding=NONE
    BT_TME_Therm_IstLeistung_HVBatterie: base-type-size=1, base-type-encoding=NONE
    BT_UI1_KompFehlerModus2_09: base-type-size=1, base-type-encoding=NONE
    BT_NM_aktiv_Remote_Unlock_Lock: base-type-size=1, base-type-encoding=NONE
    BT_KST_Warn_P2_ZAT_def: base-type-size=1, base-type-encoding=NONE
    BT_OTP_Aussen_Temp_gef: base-type-size=1, base-type-encoding=NONE
    BT_TME_Batt_Kond_status: base-type-size=1, base-type-encoding=NONE
    BT_NVEM_Abschaltstufe: base-type-size=1, base-type-encoding=NONE
    BT_KS_Hybrid_01_Req_Prio: base-type-size=1, base-type-encoding=NONE
    BT_TME_Verbrauch_gesamt: base-type-size=1, base-type-encoding=NONE
    BT_TME_HV_IstLeistung_BTL: base-type-size=1, base-type-encoding=NONE
    BT_NM_aktiv_RemoteDiensteGW: base-type-size=1, base-type-encoding=NONE
    BT_OTP_Aussen_Temp_OBD: base-type-size=1, base-type-encoding=NONE
    BT_OBD_Warm_Up_Cycle: base-type-size=1, base-type-encoding=NONE
    BT_KS_Hybrid_01_Req_SID: base-type-size=1, base-type-encoding=NONE
    BT_UI1_KompFehlerModus2_10: base-type-size=1, base-type-encoding=NONE
    BT_TME_Verbrauch_gesamt_Ueberlauf: base-type-size=1, base-type-encoding=NONE
    BT_HVLE_U_istAC_Netz_L3: base-type-size=1, base-type-encoding=NONE
    BT_HVLM_Ladeklappe_VerEntriegeAnf_2: base-type-size=1, base-type-encoding=NONE
    BT_TME_HV_IstLeistung_EKK: base-type-size=1, base-type-encoding=NONE
    BT_TME_Batt_Kond_Verf: base-type-size=1, base-type-encoding=NONE
    BT_UI2_KompFehlerModus2_15: base-type-size=1, base-type-encoding=NONE
    BT_ORU_Status: base-type-size=1, base-type-encoding=NONE
    BT_KST_WFS_Fahrfreigabe_Anforderung: base-type-size=1, base-type-encoding=NONE
    BT_NM_aktiv_RemoteStart: base-type-size=1, base-type-encoding=NONE
    BT_KS_Hybrid_01_Req_SWMaj: base-type-size=1, base-type-encoding=NONE
    BT_UI1_KompFehlerModus2_11: base-type-size=1, base-type-encoding=NONE
    BT_OTP_Aussen_Temp_ungef: base-type-size=1, base-type-encoding=NONE
    BT_TME_HV_IstLeistung_HVHL: base-type-size=1, base-type-encoding=NONE
    BT_TME_Vorwarn_Komp_ein: base-type-size=1, base-type-encoding=NONE
    BT_UI1_KompFehlerModus2_12: base-type-size=1, base-type-encoding=NONE
    BT_TME_DCDC_HV_Status_Kuehlung: base-type-size=1, base-type-encoding=NONE
    BT_UI2_KompFehlerModus2_16: base-type-size=1, base-type-encoding=NONE
    BT_HVLM_13_BZ: base-type-size=1, base-type-encoding=NONE
    BT_PCM_BMC_VTD_Freeze_Req: base-type-size=1, base-type-encoding=NONE
    BT_TME_HV_IstLeistung_HVHW: base-type-size=1, base-type-encoding=NONE
    BT_KS_Hybrid_01_Req_SWMin: base-type-size=1, base-type-encoding=NONE
    BT_NM_aktiv_RemoteVehicleTracking: base-type-size=1, base-type-encoding=NONE
    BT_TME_ZR_Anforderung: base-type-size=1, base-type-encoding=NONE
    BT_UI1_KompFehlerModus2_13: base-type-size=1, base-type-encoding=NONE
    BT_HVLM_Ladeklappe_VerEntriegeAnf_3: base-type-size=1, base-type-encoding=NONE
    BT_UI2_Spannung2_Schalt_Status: base-type-size=1, base-type-encoding=NONE
    BT_OruControlReleaseA: base-type-size=1, base-type-encoding=NONE
    BT_TME_HV_IstLeistung_Komfort: base-type-size=1, base-type-encoding=NONE
    BT_TME_EKK_HVK_Fehler_AE: base-type-size=1, base-type-encoding=NONE
    BT_KS_Hybrid_01_Req_SWPat: base-type-size=1, base-type-encoding=NONE
    BT_UI2_KompFehlerModus2_17: base-type-size=1, base-type-encoding=NONE
    BT_UH_Jahr: base-type-size=1, base-type-encoding=NONE
    BT_UI1_KompFehlerModus2_14: base-type-size=1, base-type-encoding=NONE
    BT_NM_aktiv_RequestWirelessCharging: base-type-size=1, base-type-encoding=NONE
    BT_KST_ZAT_betaetigt: base-type-size=1, base-type-encoding=NONE
    BT_PCM_BMC_VTD_LifeTimeReset_Req: base-type-size=1, base-type-encoding=NONE
    BT_KS_Hybrid_01_Req_VKMS_Err: base-type-size=1, base-type-encoding=NONE
    BT_UH_Minute: base-type-size=1, base-type-encoding=NONE
    BT_TME_HVEM_Abschaltleistung: base-type-size=1, base-type-encoding=NONE
    BT_HVLM_13_CRC: base-type-size=1, base-type-encoding=NONE
    BT_UI2_KompFehlerModus2_18: base-type-size=1, base-type-encoding=NONE
    BT_UI1_KompFehlerModus2_15: base-type-size=1, base-type-encoding=NONE
    BT_UI2Sens01_ErrMem_State: base-type-size=1, base-type-encoding=NONE
    BT_NM_aktiv_SmartCharging_Aktiv: base-type-size=1, base-type-encoding=NONE
    BT_KST_Anf_Klemmenfreigabe_ELV: base-type-size=1, base-type-encoding=NONE
    BT_UH_Monat: base-type-size=1, base-type-encoding=NONE
    BT_OruControlReleaseD: base-type-size=1, base-type-encoding=NONE
    BT_UI2_Spannung3: base-type-size=1, base-type-encoding=NONE
    BT_PCM_BMC_VTD_LifeTimeReset_Resp: base-type-size=1, base-type-encoding=NONE
    BT_HVLM_Laden_ISO_Messung_Anf: base-type-size=1, base-type-encoding=NONE
    BT_TME_HVEM_HV_Anf: base-type-size=1, base-type-encoding=NONE
    BT_UI1_KompFehlerModus2_16: base-type-size=1, base-type-encoding=NONE
    BT_KST_Ausparken_Betrieb: base-type-size=1, base-type-encoding=NONE
    BT_LR_StDiagPrcd: base-type-size=1, base-type-encoding=NONE
    BT_UI2_KompFehlerModus2_19: base-type-size=1, base-type-encoding=NONE
    BT_UI2Sens02_CALID_Index_01: base-type-size=1, base-type-encoding=NONE
    BT_TME_HVEM_Minleistung: base-type-size=1, base-type-encoding=NONE
    BT_NM_aktiv_SubbusSteuerung_BMC_HV: base-type-size=1, base-type-encoding=NONE
    BT_PCM_BMC_VTD_RecentReset_Req: base-type-size=1, base-type-encoding=NONE
    BT_UH_Sekunde: base-type-size=1, base-type-encoding=NONE
    BT_UI1_KompFehlerModus2_17: base-type-size=1, base-type-encoding=NONE
    BT_HVLM_14_BZ: base-type-size=1, base-type-encoding=NONE
    BT_UI2_KompFehlerModus2_20: base-type-size=1, base-type-encoding=NONE
    BT_TME_HVEM_Rekuleistung: base-type-size=1, base-type-encoding=NONE
    BT_OruControlStateA: base-type-size=1, base-type-encoding=NONE
    BT_UI2_Spannung4: base-type-size=1, base-type-encoding=NONE
    BT_UI1_KompFehlerModus2_18: base-type-size=1, base-type-encoding=NONE
    BT_UH_Stunde: base-type-size=1, base-type-encoding=NONE
    BT_HVLM_Ladenaktiv_Standzyklus: base-type-size=1, base-type-encoding=NONE
    BT_NM_aktiv_SubbusSteuerung_HCP5: base-type-size=1, base-type-encoding=NONE
    BT_PLC_StCpbPrkLockUnit: base-type-size=1, base-type-encoding=NONE
    BT_UI2Sens02_CALID_Index_02: base-type-size=1, base-type-encoding=NONE
    BT_UI2Sens02_CALID_Index_16: base-type-size=1, base-type-encoding=NONE
    BT_LVB_Ladegeschw: base-type-size=1, base-type-encoding=NONE
    BT_TME_HVEM_Vorhaltleistung: base-type-size=1, base-type-encoding=NONE
    BT_UI1_KompFehlerModus2_19: base-type-size=1, base-type-encoding=NONE
    BT_UH_Tag: base-type-size=1, base-type-encoding=NONE
    BT_UI2_KompFehlerModus2_21: base-type-size=1, base-type-encoding=NONE
    BT_UI2Sens02_CVN_Byte_1: base-type-size=1, base-type-encoding=NONE
    BT_PTCfgSrv_PwrPtSysMax: base-type-size=1, base-type-encoding=NONE
    BT_UI2Sens02_CALID_Index_03: base-type-size=1, base-type-encoding=NONE
    BT_UI1_Iso_Neg: base-type-size=1, base-type-encoding=NONE
    BT_NM_aktiv_Timer_abgelaufen: base-type-size=1, base-type-encoding=NONE
    BT_HVLM_14_CRC: base-type-size=1, base-type-encoding=NONE
    BT_UI2Sens02_CVN_Byte_2: base-type-size=1, base-type-encoding=NONE
    BT_TME_HVEM_Wunschleistung: base-type-size=1, base-type-encoding=NONE
    BT_HVLM_Ladeniveau_Anf: base-type-size=1, base-type-encoding=NONE
    BT_UI2_Spannung5: base-type-size=1, base-type-encoding=NONE
    BT_UI1_KompFehlerModus2_20: base-type-size=1, base-type-encoding=NONE
    BT_UI2_KompFehlerModus2_22: base-type-size=1, base-type-encoding=NONE
    BT_UI1_Iso_Pos: base-type-size=1, base-type-encoding=NONE
    BT_ZM_Standzeit: base-type-size=1, base-type-encoding=NONE
    BT_UI2Sens02_CALID_Index_04: base-type-size=1, base-type-encoding=NONE
    BT_LVB_Ladegeschw_VZ: base-type-size=1, base-type-encoding=NONE
    BT_UI2Sens02_CVN_Byte_3: base-type-size=1, base-type-encoding=NONE
    BT_PTERM_MdElEgyMng: base-type-size=1, base-type-encoding=NONE
    BT_NM_aktiv_VehicleStatReport_Main: base-type-size=1, base-type-encoding=NONE
    BT_TME_HVHL_Istmodus: base-type-size=1, base-type-encoding=NONE
    BT_UI1_KompFehlerModus2_21: base-type-size=1, base-type-encoding=NONE
    BT_UI2Sens02_CVN_Byte_4: base-type-size=1, base-type-encoding=NONE
    BT_UI1_Iso_Status: base-type-size=1, base-type-encoding=NONE
    BT_TME_HVHL_NTC_Warnung: base-type-size=1, base-type-encoding=NONE
    BT_UI2Sens02_CALID_Index_05: base-type-size=1, base-type-encoding=NONE
    BT_UI2_KompFehlerModus2_23: base-type-size=1, base-type-encoding=NONE
    BT_PTOVeh_FlgTqWhlPos: base-type-size=1, base-type-encoding=NONE
    BT_UI1_KompFehlerModus2_22: base-type-size=1, base-type-encoding=NONE
    BT_NM_aktiv_WarnblinkerInfo: base-type-size=1, base-type-encoding=NONE
    BT_UI1_KL30_Spannung: base-type-size=1, base-type-encoding=NONE
    BT_TME_HVHL_Verbauinfo: base-type-size=1, base-type-encoding=NONE
    BT_UI1_KompFehlerModus2_23: base-type-size=1, base-type-encoding=NONE
    BT_LVB_LadegeschwEinheit: base-type-size=1, base-type-encoding=NONE
    BT_UI2_Spannung6: base-type-size=1, base-type-encoding=NONE
    BT_HVLM_Ladeszenario: base-type-size=1, base-type-encoding=NONE
    BT_UI2Sens02_CVN_VLD: base-type-size=1, base-type-encoding=NONE
    BT_UI2Sens02_CALID_Index_06: base-type-size=1, base-type-encoding=NONE
    BT_SI_Diagnose_Aktiv: base-type-size=1, base-type-encoding=NONE
    BT_UI2_KompFehlerModus2_24: base-type-size=1, base-type-encoding=NONE
    BT_NM_AWC_CBV_AWB: base-type-size=1, base-type-encoding=NONE
    BT_UI1_KompFehlerModus2_01: base-type-size=1, base-type-encoding=NONE
    BT_TME_HVHL_verfuegbar: base-type-size=1, base-type-encoding=NONE
    BT_UI1_KompFehlerModus2_24: base-type-size=1, base-type-encoding=NONE
    BT_UI2Sens02_ErrMem_State: base-type-size=1, base-type-encoding=NONE
    BT_UI1_KompFehlerModus2_02: base-type-size=1, base-type-encoding=NONE
    BT_SI_NWDF: base-type-size=1, base-type-encoding=NONE
    BT_UI2_KompFehlerModus2_25: base-type-size=1, base-type-encoding=NONE
    BT_NM_AWC_CBV_CRI: base-type-size=1, base-type-encoding=NONE
    BT_UI2Sens02_CALID_Index_07: base-type-size=1, base-type-encoding=NONE
    BT_TME_HVHW_Ansteuerung_Soll: base-type-size=1, base-type-encoding=NONE
    BT_UI2_Status: base-type-size=1, base-type-encoding=NONE
    BT_UISensorIso_01_BZ: base-type-size=1, base-type-encoding=NONE
    BT_UI1_KompFehlerModus2_25: base-type-size=1, base-type-encoding=NONE
    BT_UI1_KompFehlerModus2_03: base-type-size=1, base-type-encoding=NONE
    BT_LVB_Restladezeit: base-type-size=1, base-type-encoding=NONE
    BT_TME_HVHW_HVK_EoHVL_Status: base-type-size=1, base-type-encoding=NONE
    BT_UI2_KompFehlerModus2_26: base-type-size=1, base-type-encoding=NONE
    BT_SI_NWDF_30: base-type-size=1, base-type-encoding=NONE
    BT_UI2Sens02_CALID_Index_08: base-type-size=1, base-type-encoding=NONE
    BT_UI1_KompFehlerModus2_26: base-type-size=1, base-type-encoding=NONE
    BT_UISensorIso_01_CRC: base-type-size=1, base-type-encoding=NONE
    BT_NM_AWC_FCAB: base-type-size=1, base-type-encoding=ISO-8859-1
    BT_TME_HVHW_HVK_Fehler_AE: base-type-size=1, base-type-encoding=NONE
    BT_UI1_KompFehlerModus2_04: base-type-size=1, base-type-encoding=NONE
    BT_UI1_KompFehlerModus4_01: base-type-size=1, base-type-encoding=NONE
    BT_UISensorIso_02_BZ: base-type-size=1, base-type-encoding=NONE
    BT_UI2_KompFehlerModus4_01: base-type-size=1, base-type-encoding=NONE
    BT_UI2_Strom: base-type-size=1, base-type-encoding=NONE
    BT_UI2Sens02_CALID_Index_09: base-type-size=1, base-type-encoding=NONE
    BT_TME_HVHW_HVK_Fehler_HVIL: base-type-size=1, base-type-encoding=NONE
    BT_SI_NWDF_gueltig: base-type-size=1, base-type-encoding=NONE
    BT_NM_AWC_NM_aktiv_Diag: base-type-size=1, base-type-encoding=NONE
    BT_UI1_KompFehlerModus2_05: base-type-size=1, base-type-encoding=NONE
    BT_UI1_KompFehlerModus4_02: base-type-size=1, base-type-encoding=NONE
    BT_LVB_StatusLadegeschw: base-type-size=1, base-type-encoding=NONE
    BT_TME_HVHW_HVK_Fehler_intern: base-type-size=1, base-type-encoding=NONE
    BT_UISensorIso_02_CRC: base-type-size=1, base-type-encoding=NONE
    BT_UI1_KompFehlerModus2_06: base-type-size=1, base-type-encoding=NONE
    BT_UI2Sens02_CALID_Index_10: base-type-size=1, base-type-encoding=NONE
    BT_SI_P_Mode: base-type-size=1, base-type-encoding=NONE
    BT_NM_AWC_NM_aktiv_KL15: base-type-size=1, base-type-encoding=NONE
    BT_UI2_KompFehlerModus4_02: base-type-size=1, base-type-encoding=NONE
    BT_UISensorPyro_01_BZ: base-type-size=1, base-type-encoding=NONE
    BT_UI1_KompFehlerModus2_07: base-type-size=1, base-type-encoding=NONE
    BT_UI1_KompFehlerModus4_03: base-type-size=1, base-type-encoding=NONE
    BT_UI2_Stromintegral_Entladen: base-type-size=1, base-type-encoding=NONE
    BT_UI2Sens02_CALID_Index_11: base-type-size=1, base-type-encoding=NONE
    BT_TME_HVHW_HVK_IstModus: base-type-size=1, base-type-encoding=NONE
    BT_NM_AWC_NM_aktiv_Tmin: base-type-size=1, base-type-encoding=NONE
    BT_SI_P_Mode_gueltig: base-type-size=1, base-type-encoding=NONE
    BT_UI2_KompFehlerModus4_03: base-type-size=1, base-type-encoding=NONE
    BT_LVB_StatusRestladezeit: base-type-size=1, base-type-encoding=NONE
    BT_UISensorPyro_01_CRC: base-type-size=1, base-type-encoding=NONE
    BT_UI1_KompFehlerModus2_08: base-type-size=1, base-type-encoding=NONE
    BT_UI1_KompFehlerModus4_04: base-type-size=1, base-type-encoding=NONE
    BT_TME_HVHW_HVK_Status_Spgfreiheit: base-type-size=1, base-type-encoding=NONE
    BT_UISensorPyro_02_BZ: base-type-size=1, base-type-encoding=NONE
    BT_NM_AWC_NM_State: base-type-size=1, base-type-encoding=NONE
    BT_SI_QRS_Mode: base-type-size=1, base-type-encoding=NONE
    BT_UI2_KompFehlerModus4_04: base-type-size=1, base-type-encoding=NONE
    BT_UI2Sens02_CALID_Index_12: base-type-size=1, base-type-encoding=NONE
    BT_UI1_KompFehlerModus4_05: base-type-size=1, base-type-encoding=NONE
    BT_UI2_Stromintegral_Laden: base-type-size=1, base-type-encoding=NONE
    BT_TME_HVHW_SollModus: base-type-size=1, base-type-encoding=NONE
    BT_UISensorPyro_02_CRC: base-type-size=1, base-type-encoding=NONE
    BT_MKB_ScndCllsnMtgtn_StAbo: base-type-size=1, base-type-encoding=NONE
    BT_TME_HVHW_Verbauinfo: base-type-size=1, base-type-encoding=NONE
    BT_UI1_KompFehlerModus4_06: base-type-size=1, base-type-encoding=NONE
    BT_UI2Sens02_CALID_Index_13: base-type-size=1, base-type-encoding=NONE
    BT_UI2_KompFehlerModus4_05: base-type-size=1, base-type-encoding=NONE
    BT_NM_AWC_SNI_10: base-type-size=1, base-type-encoding=NONE
    BT_UISensorPyro_03_BZ: base-type-size=1, base-type-encoding=NONE
    BT_TME_IPB_Status_Kuehlung: base-type-size=1, base-type-encoding=NONE
    BT_UI1_KompFehlerModus4_07: base-type-size=1, base-type-encoding=NONE
    BT_UI2_KompFehlerModus4_06: base-type-size=1, base-type-encoding=NONE
    BT_UI2Sens02_CALID_Index_14: base-type-size=1, base-type-encoding=NONE
    BT_UISensorPyro_03_CRC: base-type-size=1, base-type-encoding=NONE
    BT_NM_AWC_UDS_CC: base-type-size=1, base-type-encoding=NONE
    BT_UI2_Temperatur_1: base-type-size=1, base-type-encoding=NONE
    BT_UI1_KompFehlerModus4_08: base-type-size=1, base-type-encoding=NONE
    BT_TME_Klima_Heizleistung_reduziert: base-type-size=1, base-type-encoding=NONE
    BT_VDSO_05_BZ: base-type-size=1, base-type-encoding=NONE
    BT_UI2Sens02_CALID_Index_15: base-type-size=1, base-type-encoding=NONE
    BT_UI2_KompFehlerModus4_07: base-type-size=1, base-type-encoding=NONE
    BT_NM_AWC_Wakeup_V12: base-type-size=1, base-type-encoding=NONE
    BT_UI1_KompFehlerModus4_09: base-type-size=1, base-type-encoding=NONE
    BT_TME_Klima_Red_Heizleistung_HVHL: base-type-size=1, base-type-encoding=NONE
    BT_VDSO_05_CRC: base-type-size=1, base-type-encoding=NONE
    BT_UI2_KompFehlerModus4_08: base-type-size=1, base-type-encoding=NONE
    BT_UI2_Temperatur_2: base-type-size=1, base-type-encoding=NONE
    BT_UI1_KompFehlerModus4_10: base-type-size=1, base-type-encoding=NONE
    BT_TME_Klimaanforderung: base-type-size=1, base-type-encoding=NONE
    BT_NM_Dummy01_CAB: base-type-size=1, base-type-encoding=ISO-8859-1
    BT_VDSO_BasTi200_NumClc_05: base-type-size=1, base-type-encoding=NONE
    BT_UI2_KompFehlerModus4_09: base-type-size=1, base-type-encoding=NONE
    BT_UI1_KompFehlerModus4_11: base-type-size=1, base-type-encoding=NONE
    BT_TME_Kompressorlastmoment: base-type-size=1, base-type-encoding=NONE
    BT_NM_Dummy01_CBV_AWB: base-type-size=1, base-type-encoding=NONE
    BT_UI2_KompFehlerModus4_10: base-type-size=1, base-type-encoding=NONE
    BT_VDSO_Vx3d: base-type-size=1, base-type-encoding=NONE
    BT_UI1_KompFehlerModus4_12: base-type-size=1, base-type-encoding=NONE
    BT_TME_Kuehlerjalousie_Ausfall: base-type-size=1, base-type-encoding=NONE
    BT_UI2Sens01_CALID_Index_01: base-type-size=1, base-type-encoding=NONE
    BT_UI2_KompFehlerModus4_11: base-type-size=1, base-type-encoding=NONE
    BT_VDSO_Vx3dDisp: base-type-size=1, base-type-encoding=NONE
    BT_NM_Dummy01_CBV_CRI: base-type-size=1, base-type-encoding=NONE
    BT_UI1_KompFehlerModus4_13: base-type-size=1, base-type-encoding=NONE
    BT_VDSO_Vx3dKmph: base-type-size=1, base-type-encoding=NONE
    BT_TME_Kuehlerluefter_Totalausfall: base-type-size=1, base-type-encoding=NONE
    BT_NM_Dummy01_NM_State: base-type-size=1, base-type-encoding=NONE
    BT_UI2_KompFehlerModus4_12: base-type-size=1, base-type-encoding=NONE
    BT_UI1_KompFehlerModus4_14: base-type-size=1, base-type-encoding=NONE
    BT_UI2Sens01_CALID_Index_02: base-type-size=1, base-type-encoding=NONE
    BT_VehicleProtectedEnvironment_D: base-type-size=1, base-type-encoding=NONE
    BT_TME_LED_STK: base-type-size=1, base-type-encoding=NONE
    BT_NM_Gateway_CBV_AWB: base-type-size=1, base-type-encoding=NONE
    BT_UI2_KompFehlerModus4_13: base-type-size=1, base-type-encoding=NONE
    BT_UI1_KompFehlerModus4_15: base-type-size=1, base-type-encoding=NONE
    BT_VIN_1: base-type-size=1, base-type-encoding=NONE
    BT_TME_LED_STK_Timer: base-type-size=1, base-type-encoding=NONE
    BT_NM_Gateway_CBV_CRI: base-type-size=1, base-type-encoding=NONE
    BT_UI2_KompFehlerModus4_14: base-type-size=1, base-type-encoding=NONE
    BT_UI1_KompFehlerModus4_16: base-type-size=1, base-type-encoding=NONE
    BT_TME_Min_Fahrdrehzahl: base-type-size=1, base-type-encoding=NONE
    BT_UI2Sens01_CALID_Index_03: base-type-size=1, base-type-encoding=NONE
    BT_NM_Gateway_FCAB: base-type-size=1, base-type-encoding=ISO-8859-1
    BT_VIN_10: base-type-size=1, base-type-encoding=NONE
    BT_UI1_Spannung1: base-type-size=1, base-type-encoding=NONE
    BT_UI2_KompFehlerModus4_15: base-type-size=1, base-type-encoding=NONE
    BT_TME_Min_Leerlaufdrehzahl: base-type-size=1, base-type-encoding=NONE
    BT_VIN_11: base-type-size=1, base-type-encoding=NONE
    BT_NM_Gateway_NM_aktiv_CABaktiv: base-type-size=1, base-type-encoding=NONE
    BT_UI2_KompFehlerModus4_16: base-type-size=1, base-type-encoding=NONE
    BT_UI1_Spannung1_Schalt_Status: base-type-size=1, base-type-encoding=NONE
    BT_TME_MSF_Stufe: base-type-size=1, base-type-encoding=NONE
    BT_VIN_12: base-type-size=1, base-type-encoding=NONE
    BT_NM_Gateway_NM_aktiv_Diag: base-type-size=1, base-type-encoding=NONE
    BT_UI2Sens01_CALID_Index_04: base-type-size=1, base-type-encoding=NONE
    BT_UI1_Spannung2: base-type-size=1, base-type-encoding=NONE
    BT_UI2_Pyro_Status: base-type-size=1, base-type-encoding=NONE
    BT_VIN_13: base-type-size=1, base-type-encoding=NONE
    BT_TME_MVEM_MinLeistung: base-type-size=1, base-type-encoding=NONE
    BT_NM_Gateway_NM_aktiv_KL15: base-type-size=1, base-type-encoding=NONE
    BT_UI1_Spannung2_Schalt_Status: base-type-size=1, base-type-encoding=NONE
    BT_VIN_14: base-type-size=1, base-type-encoding=NONE
    BT_TME_MVEM_Wunschleistung: base-type-size=1, base-type-encoding=NONE
    BT_UI2_Spannung1: base-type-size=1, base-type-encoding=NONE
    BT_UI1_Spannung3: base-type-size=1, base-type-encoding=NONE
    BT_UI2Sens01_CALID_Index_05: base-type-size=1, base-type-encoding=NONE
    BT_TME_MVH_L_Istmodus: base-type-size=1, base-type-encoding=NONE
    BT_UI2_Spannung1_Schalt_Status: base-type-size=1, base-type-encoding=NONE
    BT_UI1_Spannung4: base-type-size=1, base-type-encoding=NONE
    BT_VIN_15: base-type-size=1, base-type-encoding=NONE
    BT_TME_MVH_L_Spannung: base-type-size=1, base-type-encoding=NONE
    BT_VIN_16: base-type-size=1, base-type-encoding=NONE
    BT_UI2_Spannung2: base-type-size=1, base-type-encoding=NONE
    BT_UI1_Spannung5: base-type-size=1, base-type-encoding=NONE
    BT_TME_MVH_L_Strom: base-type-size=1, base-type-encoding=NONE
    BT_UI2Sens01_CALID_Index_06: base-type-size=1, base-type-encoding=NONE
    BT_VIN_17: base-type-size=1, base-type-encoding=NONE
    BT_UI1_Spannung6: base-type-size=1, base-type-encoding=NONE
    BT_TME_MVH_L_Verbauinfo: base-type-size=1, base-type-encoding=NONE
    BT_VIN_2: base-type-size=1, base-type-encoding=NONE
    BT_UI1_Status: base-type-size=1, base-type-encoding=NONE
    BT_TME_Notbelueftung_Aktivierung: base-type-size=1, base-type-encoding=NONE
    BT_VIN_3: base-type-size=1, base-type-encoding=NONE
    BT_UI2Sens01_CALID_Index_07: base-type-size=1, base-type-encoding=NONE
    BT_UI1_Strom: base-type-size=1, base-type-encoding=NONE
    BT_TME_NT_Kreis_Status: base-type-size=1, base-type-encoding=NONE
    BT_UI1_Stromintegral_Entladen: base-type-size=1, base-type-encoding=NONE
    BT_VIN_4: base-type-size=1, base-type-encoding=NONE
    BT_TME_NT_Kuehlmittel_Sensor_02: base-type-size=1, base-type-encoding=NONE
    BT_VIN_5: base-type-size=1, base-type-encoding=NONE
    BT_UI1_Stromintegral_Laden: base-type-size=1, base-type-encoding=NONE
    BT_TME_OBD_Lampe_Anf: base-type-size=1, base-type-encoding=NONE
    BT_UI2Sens01_CALID_Index_08: base-type-size=1, base-type-encoding=NONE
    BT_VIN_6: base-type-size=1, base-type-encoding=NONE
    BT_TME_PTC_Leistung_Ist: base-type-size=1, base-type-encoding=NONE
    BT_UI1_Temperatur_1: base-type-size=1, base-type-encoding=NONE
    BT_VIN_7: base-type-size=1, base-type-encoding=NONE
    BT_TME_PTC_stufig_Status: base-type-size=1, base-type-encoding=NONE
    BT_VIN_8: base-type-size=1, base-type-encoding=NONE
    BT_UI1_Temperatur_2: base-type-size=1, base-type-encoding=NONE
    BT_TME_PTC_Verbauinfo: base-type-size=1, base-type-encoding=NONE
    BT_UI2Sens01_CALID_Index_09: base-type-size=1, base-type-encoding=NONE
    BT_TME_Temp_KM_vor_LE: base-type-size=1, base-type-encoding=NONE
    BT_UI2Sens01_CALID_Index_10: base-type-size=1, base-type-encoding=NONE
    BT_VIN_9: base-type-size=1, base-type-encoding=NONE
    BT_UI2_HW_Crashleitung_Status: base-type-size=1, base-type-encoding=NONE
    BT_TME_Temp_nach_Heizregister: base-type-size=1, base-type-encoding=NONE
    BT_UI2_KL30_Spannung: base-type-size=1, base-type-encoding=NONE
    BT_Waermepumpe_Status: base-type-size=1, base-type-encoding=NONE
    BT_UI2_KompFehlerModus2_01: base-type-size=1, base-type-encoding=NONE
    BT_WFS_02_BZ: base-type-size=1, base-type-encoding=NONE
    BT_TME_Temp_nach_Heizung_Front: base-type-size=1, base-type-encoding=NONE
    BT_UI2_KompFehlerModus2_02: base-type-size=1, base-type-encoding=NONE
    BT_WFS_02_CRC: base-type-size=1, base-type-encoding=NONE
    BT_UI2Sens01_CALID_Index_11: base-type-size=1, base-type-encoding=NONE
    BT_UI2_KompFehlerModus2_03: base-type-size=1, base-type-encoding=NONE
    BT_WFS_Betrieb_Lesespule: base-type-size=1, base-type-encoding=NONE
    BT_UI2_KompFehlerModus2_04: base-type-size=1, base-type-encoding=NONE
    BT_WFS_ELV_authorisiert: base-type-size=1, base-type-encoding=NONE
    BT_UI2_KompFehlerModus2_05: base-type-size=1, base-type-encoding=NONE
    BT_WFS_Fahrerhinweise: base-type-size=1, base-type-encoding=NONE
    BT_UI2Sens01_CALID_Index_12: base-type-size=1, base-type-encoding=NONE
    BT_UI2_KompFehlerModus2_06: base-type-size=1, base-type-encoding=NONE
    BT_WFS_ID_Geb_autorisiert: base-type-size=1, base-type-encoding=NONE
    BT_UI2_KompFehlerModus2_07: base-type-size=1, base-type-encoding=NONE
    BT_WFS_ID_Geb_autorisiert_in_Kl15: base-type-size=1, base-type-encoding=NONE
    BT_UI2Sens01_CALID_Index_13: base-type-size=1, base-type-encoding=NONE
    BT_UI2_KompFehlerModus2_08: base-type-size=1, base-type-encoding=NONE
    BT_WFS_ID_Geb_steckt: base-type-size=1, base-type-encoding=NONE
    BT_UI2_KompFehlerModus2_09: base-type-size=1, base-type-encoding=NONE
    BT_WFS_Klemmenfreigabe: base-type-size=1, base-type-encoding=NONE
    BT_UI2_KompFehlerModus2_10: base-type-size=1, base-type-encoding=NONE
    BT_WFS_LF_Aktiv: base-type-size=1, base-type-encoding=NONE
    BT_UI2Sens01_CALID_Index_14: base-type-size=1, base-type-encoding=NONE
    BT_WFS_LZ_02: base-type-size=1, base-type-encoding=NONE
    BT_UI2_KompFehlerModus2_11: base-type-size=1, base-type-encoding=NONE
    BT_WFS_Parken_Status: base-type-size=1, base-type-encoding=NONE
    BT_UI2_KompFehlerModus2_12: base-type-size=1, base-type-encoding=NONE
    BT_UI2_KompFehlerModus2_13: base-type-size=1, base-type-encoding=NONE
    BT_UI2Sens01_CALID_Index_15: base-type-size=1, base-type-encoding=NONE
    BT_WFS_Safe: base-type-size=1, base-type-encoding=NONE
    BT_UI2_KompFehlerModus2_14: base-type-size=1, base-type-encoding=NONE
    BT_WFS_Schluessel_Fahrberecht: base-type-size=1, base-type-encoding=NONE
    BT_WFS_Schluessel_Ist: base-type-size=1, base-type-encoding=NONE
    BT_UI2Sens01_CALID_Index_16: base-type-size=1, base-type-encoding=NONE
    BT_WFS_Schluessel_Soll: base-type-size=1, base-type-encoding=NONE
    BT_ZM_Fahrzeugabstellzeit: base-type-size=1, base-type-encoding=NONE
    BT_UI2Sens01_CVN_Byte_1: base-type-size=1, base-type-encoding=NONE
    BT_UI2Sens01_CVN_Byte_2: base-type-size=1, base-type-encoding=NONE
    BT_ZM_Fahrzeugabstellzeit_HiRes: base-type-size=1, base-type-encoding=NONE
    BT_ZM_Fahrzeugabstellzeit_Status: base-type-size=1, base-type-encoding=NONE
    BT_ZM_HV_Auszeit: base-type-size=1, base-type-encoding=NONE
    BT_ZM_HV_Auszeit_HiRes: base-type-size=1, base-type-encoding=NONE
    BT_UI2Sens01_CVN_Byte_3: base-type-size=1, base-type-encoding=NONE
    BT_ZM_HV_Auszeit_Status: base-type-size=1, base-type-encoding=NONE
    BT_UI2Sens01_CVN_Byte_4: base-type-size=1, base-type-encoding=NONE
    BT_UI2Sens01_CVN_VLD: base-type-size=1, base-type-encoding=NONE
    BT_BJB_Uebertemperaturzaehler_CMC01: base-type-size=1, base-type-encoding=NONE
    BT_BMC_CMC_Temperatur_052: base-type-size=1, base-type-encoding=NONE
    BT_BJB_Uebertemperaturzaehler_CMC02: base-type-size=1, base-type-encoding=NONE
    BT_BMC_CMC_Temperatur_053: base-type-size=1, base-type-encoding=NONE
    BT_BMC_CMC_Temperatur_054: base-type-size=1, base-type-encoding=NONE
    BT_BJB_Uebertemperaturzaehler_CMC03: base-type-size=1, base-type-encoding=NONE
    BT_BMC_CMC_Temperatur_055: base-type-size=1, base-type-encoding=NONE
    BT_BMC_CMC_Temperatur_056: base-type-size=1, base-type-encoding=NONE
    BT_BJB_Uebertemperaturzaehler_CMC04: base-type-size=1, base-type-encoding=NONE
    BT_BJB_Unterspannungszaehler_CMC{01..04}: base-type-size=1, base-type-encoding=NONE
    BT_BMC_Abschaltankuendigung: base-type-size=1, base-type-encoding=NONE
    BT_BMC_AC_Laden: base-type-size=1, base-type-encoding=NONE
    BT_BMC_Bank_Notlauf_erlaubt: base-type-size=1, base-type-encoding=NONE
    BT_BMC_Bank_parallel_erlaubt: base-type-size=1, base-type-encoding=NONE
    BT_BMC_Bank_seriell_erlaubt: base-type-size=1, base-type-encoding=NONE
    BT_BMC_Bankstatus: base-type-size=1, base-type-encoding=NONE
    BT_BMC_Bidi_Energie_Absolut: base-type-size=1, base-type-encoding=NONE
    BT_BMC_Bidi_Freigabe: base-type-size=1, base-type-encoding=NONE
package /Semantics
  compu method CM_BJB_CALID_Index_02: 0=Cx0_Init (CM_BJB_CALID_Index_02_Cx0_Init)
  compu method CM_DCDC_NV_Komponentenfehler_34: 0=Cx0_TstNotComplThisOpCycle_Init (CM_DCDC_NV_Komponentenfehler_34_Cx0_TstNotComplThisOpCycle_Init), 1=Cx1_TstComplThisOpCycle_Pass (CM_DCDC_NV_Komponentenfehler_34_Cx1_TstComplThisOpCycle_Pass), 2=Cx2_TstCmplThisCycle_Pass_TimeElapse (CM_DCDC_NV_Komponentenfehler_34_Cx2_TstCmplThisCycle_Pass_TimeElapse), 3=Cx3_TstComplThisOpCycle_FAIL (CM_DCDC_NV_Komponentenfehler_34_Cx3_TstComplThisOpCycle_FAIL)
  compu method CM_DGN_Verlernzaehler: phys=raw for raw 0..254, 255=Cxff_ungueltiger_Zaehlerstand_oder_kein_gueltiger_Fahrzyklus (CM_DGN_Verlernzaehler_Cxff_ungueltiger_Zaehlerstand_oder_kein_gueltiger_Fahrzyklus) (ungültiger Zählerstand oder kein gültiger Fahrzyklus)
  compu method CM_BJB_CALID_Index_03: 0=Cx0_Init (CM_BJB_CALID_Index_03_Cx0_Init)
  compu method CM_DCDC_NV_Komponentenfehler_35: 0=Cx0_TstNotComplThisOpCycle_Init (CM_DCDC_NV_Komponentenfehler_35_Cx0_TstNotComplThisOpCycle_Init), 1=Cx1_TstComplThisOpCycle_Pass (CM_DCDC_NV_Komponentenfehler_35_Cx1_TstComplThisOpCycle_Pass), 2=Cx2_TstCmplThisCycle_Pass_TimeElapse (CM_DCDC_NV_Komponentenfehler_35_Cx2_TstCmplThisCycle_Pass_TimeElapse), 3=Cx3_TstComplThisOpCycle_FAIL (CM_DCDC_NV_Komponentenfehler_35_Cx3_TstComplThisOpCycle_FAIL)
  compu method CM_DS_Hybrid_01_ConfDTCChanged: phys=raw for raw 0..1
  compu method CM_BJB_CALID_Index_04: 0=Cx0_Init (CM_BJB_CALID_Index_04_Cx0_Init)
  compu method CM_BJB_CALID_Index_05: 0=Cx0_Init (CM_BJB_CALID_Index_05_Cx0_Init)
  compu method CM_DCDC_NV_Komponentenfehler_36: 0=Cx0_TstNotComplThisOpCycle_Init (CM_DCDC_NV_Komponentenfehler_36_Cx0_TstNotComplThisOpCycle_Init), 1=Cx1_TstComplThisOpCycle_Pass (CM_DCDC_NV_Komponentenfehler_36_Cx1_TstComplThisOpCycle_Pass), 2=Cx2_TstCmplThisCycle_Pass_TimeElapse (CM_DCDC_NV_Komponentenfehler_36_Cx2_TstCmplThisCycle_Pass_TimeElapse), 3=Cx3_TstComplThisOpCycle_FAIL (CM_DCDC_NV_Komponentenfehler_36_Cx3_TstComplThisOpCycle_FAIL)
  compu method CM_DS_Hybrid_01_DiagAdr: phys=raw for raw 0..65535
  compu method CM_BJB_CALID_Index_06: 0=Cx0_Init (CM_BJB_CALID_Index_06_Cx0_Init)
  compu method CM_BJB_CALID_Index_07: 0=Cx0_Init (CM_BJB_CALID_Index_07_Cx0_Init)
  compu method CM_DCDC_NV_Komponentenfehler_37: 0=Cx0_TstNotComplThisOpCycle_Init (CM_DCDC_NV_Komponentenfehler_37_Cx0_TstNotComplThisOpCycle_Init), 1=Cx1_TstComplThisOpCycle_Pass (CM_DCDC_NV_Komponentenfehler_37_Cx1_TstComplThisOpCycle_Pass), 2=Cx2_TstCmplThisCycle_Pass_TimeElapse (CM_DCDC_NV_Komponentenfehler_37_Cx2_TstCmplThisCycle_Pass_TimeElapse), 3=Cx3_TstComplThisOpCycle_FAIL (CM_DCDC_NV_Komponentenfehler_37_Cx3_TstComplThisOpCycle_FAIL)
  compu method CM_DS_Hybrid_01_IdentValid: 0=Cx0_Ungueltig (CM_DS_Hybrid_01_IdentValid_Cx0_Ungueltig), 1=Cx1_Gueltig (CM_DS_Hybrid_01_IdentValid_Cx1_Gueltig)
  compu method CM_BJB_CALID_Index_08: 0=Cx0_Init (CM_BJB_CALID_Index_08_Cx0_Init)
  compu method CM_BJB_CALID_Index_09: 0=Cx0_Init (CM_BJB_CALID_Index_09_Cx0_Init)
  compu method CM_DCDC_NV_Komponentenfehler_38: 0=Cx0_TstNotComplThisOpCycle_Init (CM_DCDC_NV_Komponentenfehler_38_Cx0_TstNotComplThisOpCycle_Init), 1=Cx1_TstComplThisOpCycle_Pass (CM_DCDC_NV_Komponentenfehler_38_Cx1_TstComplThisOpCycle_Pass), 2=Cx2_TstCmplThisCycle_Pass_TimeElapse (CM_DCDC_NV_Komponentenfehler_38_Cx2_TstCmplThisCycle_Pass_TimeElapse), 3=Cx3_TstComplThisOpCycle_FAIL (CM_DCDC_NV_Komponentenfehler_38_Cx3_TstComplThisOpCycle_FAIL)
  compu method CM_DS_Hybrid_01_Lokalaktiv: 0=Cx0_war_nicht_lokal_aktiv (CM_DS_Hybrid_01_Lokalaktiv_Cx0_war_nicht_lokal_aktiv), 1=Cx1_war_lokal_aktiv (CM_DS_Hybrid_01_Lokalaktiv_Cx1_war_lokal_aktiv)
  compu method CM_BJB_CALID_Index_10: 0=Cx0_Init (CM_BJB_CALID_Index_10_Cx0_Init)
  compu method CM_BJB_CALID_Index_11: 0=Cx0_Init (CM_BJB_CALID_Index_11_Cx0_Init)
  compu method CM_DCDC_NV_Komponentenfehler_39: 0=Cx0_TstNotComplThisOpCycle_Init (CM_DCDC_NV_Komponentenfehler_39_Cx0_TstNotComplThisOpCycle_Init), 1=Cx1_TstComplThisOpCycle_Pass (CM_DCDC_NV_Komponentenfehler_39_Cx1_TstComplThisOpCycle_Pass), 2=Cx2_TstCmplThisCycle_Pass_TimeElapse (CM_DCDC_NV_Komponentenfehler_39_Cx2_TstCmplThisCycle_Pass_TimeElapse), 3=Cx3_TstComplThisOpCycle_FAIL (CM_DCDC_NV_Komponentenfehler_39_Cx3_TstComplThisOpCycle_FAIL)
  compu method CM_DS_Hybrid_01_MemSel10Changed: phys=raw for raw 0..1
  compu method CM_BJB_CALID_Index_{12..14}: 0=Cx0_Init (CM_BJB_CALID_Index_{12..14}_Cx0_Init)
  compu method CM_DS_Hybrid_01_MemSelChanged: phys=raw for raw 0..1
  compu method CM_DCDC_NV_Komponentenfehler_3_1: 0=Cx0_TNCTOC (CM_DCDC_NV_Komponentenfehler_3_1_Cx0_TNCTOC), 1=Cx1_TP_TC (CM_DCDC_NV_Komponentenfehler_3_1_Cx1_TP_TC), 2=Cx2_TP_TC_WCMTL (CM_DCDC_NV_Komponentenfehler_3_1_Cx2_TP_TC_WCMTL), 3=Cx3_TF_TC_Error_1 (CM_DCDC_NV_Komponentenfehler_3_1_Cx3_TF_TC_Error_1), 4=Cx4_TF_TC_Error_2 (CM_DCDC_NV_Komponentenfehler_3_1_Cx4_TF_TC_Error_2), 5=Cx5_TF_TC_Error_3 (CM_DCDC_NV_Komponentenfehler_3_1_Cx5_TF_TC_Error_3), 6=Cx6_TF_TC_Error_4 (CM_DCDC_NV_Komponentenfehler_3_1_Cx6_TF_TC_Error_4), 7=Cx7_TF_TC_Error_5 (CM_DCDC_NV_Komponentenfehler_3_1_Cx7_TF_TC_Error_5)
  compu method CM_BJB_CALID_Index_15: 0=Cx0_Init (CM_BJB_CALID_Index_15_Cx0_Init)
  compu method CM_BJB_CALID_Index_16: 0=Cx0_Init (CM_BJB_CALID_Index_16_Cx0_Init)
  compu method CM_BJB_CVN_Byte_1: phys=raw for raw 0..255
  compu method CM_DCDC_NV_Komponentenfehler_3_10: 0=Cx0_TNCTOC (CM_DCDC_NV_Komponentenfehler_3_10_Cx0_TNCTOC), 1=Cx1_TP_TC (CM_DCDC_NV_Komponentenfehler_3_10_Cx1_TP_TC), 2=Cx2_TP_TC_WCMTL (CM_DCDC_NV_Komponentenfehler_3_10_Cx2_TP_TC_WCMTL), 3=Cx3_TF_TC_Error_1 (CM_DCDC_NV_Komponentenfehler_3_10_Cx3_TF_TC_Error_1), 4=Cx4_TF_TC_Error_2 (CM_DCDC_NV_Komponentenfehler_3_10_Cx4_TF_TC_Error_2), 5=Cx5_TF_TC_Error_3 (CM_DCDC_NV_Komponentenfehler_3_10_Cx5_TF_TC_Error_3), 6=Cx6_TF_TC_Error_4 (CM_DCDC_NV_Komponentenfehler_3_10_Cx6_TF_TC_Error_4), 7=Cx7_TF_TC_Error_5 (CM_DCDC_NV_Komponentenfehler_3_10_Cx7_TF_TC_Error_5)
  compu method CM_DS_Hybrid_01_StMemChanged: phys=raw for raw 0..1
  compu method CM_BJB_CVN_Byte_2: phys=raw for raw 0..255
  compu method CM_DCDC_NV_Komponentenfehler_3_11: 0=Cx0_TNCTOC (CM_DCDC_NV_Komponentenfehler_3_11_Cx0_TNCTOC), 1=Cx1_TP_TC (CM_DCDC_NV_Komponentenfehler_3_11_Cx1_TP_TC), 2=Cx2_TP_TC_WCMTL (CM_DCDC_NV_Komponentenfehler_3_11_Cx2_TP_TC_WCMTL), 3=Cx3_TF_TC_Error_1 (CM_DCDC_NV_Komponentenfehler_3_11_Cx3_TF_TC_Error_1), 4=Cx4_TF_TC_Error_2 (CM_DCDC_NV_Komponentenfehler_3_11_Cx4_TF_TC_Error_2), 5=Cx5_TF_TC_Error_3 (CM_DCDC_NV_Komponentenfehler_3_11_Cx5_TF_TC_Error_3), 6=Cx6_TF_TC_Error_4 (CM_DCDC_NV_Komponentenfehler_3_11_Cx6_TF_TC_Error_4), 7=Cx7_TF_TC_Error_5 (CM_DCDC_NV_Komponentenfehler_3_11_Cx7_TF_TC_Error_5)
  compu method CM_DS_Hybrid_01_Subsystemaktiv: 0=Cx0_war_nicht_lokal_aktiv (CM_DS_Hybrid_01_Subsystemaktiv_Cx0_war_nicht_lokal_aktiv), 1=Cx1_war_lokal_aktiv (CM_DS_Hybrid_01_Subsystemaktiv_Cx1_war_lokal_aktiv)
  compu method CM_BJB_CVN_Byte_3: phys=raw for raw 0..255
  compu method CM_BMC_CMC_Temperatur_013: phys=raw*0.5-40 for raw 0..252, 253=Cxfd_nicht_vorhanden (CM_BMC_CMC_Temperatur_013_Cxfd_nicht_vorhanden), 254=Cxfe_Init (CM_BMC_CMC_Temperatur_013_Cxfe_Init), 255=Cxff_Fehler (CM_BMC_CMC_Temperatur_013_Cxff_Fehler); unit Unit_DegreCelsi
  compu method CM_DCDC_NV_Komponentenfehler_3_12: 0=Cx0_TNCTOC (CM_DCDC_NV_Komponentenfehler_3_12_Cx0_TNCTOC), 1=Cx1_TP_TC (CM_DCDC_NV_Komponentenfehler_3_12_Cx1_TP_TC), 2=Cx2_TP_TC_WCMTL (CM_DCDC_NV_Komponentenfehler_3_12_Cx2_TP_TC_WCMTL), 3=Cx3_TF_TC_Error_1 (CM_DCDC_NV_Komponentenfehler_3_12_Cx3_TF_TC_Error_1), 4=Cx4_TF_TC_Error_2 (CM_DCDC_NV_Komponentenfehler_3_12_Cx4_TF_TC_Error_2), 5=Cx5_TF_TC_Error_3 (CM_DCDC_NV_Komponentenfehler_3_12_Cx5_TF_TC_Error_3), 6=Cx6_TF_TC_Error_4 (CM_DCDC_NV_Komponentenfehler_3_12_Cx6_TF_TC_Error_4), 7=Cx7_TF_TC_Error_5 (CM_DCDC_NV_Komponentenfehler_3_12_Cx7_TF_TC_Error_5)
  compu method CM_DS_Hybrid_01_TestFailedChanged: phys=raw for raw 0..1
  compu method CM_BJB_CVN_Byte_4: phys=raw for raw 0..255
  compu method CM_DCDC_NV_Komponentenfehler_3_13: 0=Cx0_TNCTOC (CM_DCDC_NV_Komponentenfehler_3_13_Cx0_TNCTOC), 1=Cx1_TP_TC (CM_DCDC_NV_Komponentenfehler_3_13_Cx1_TP_TC), 2=Cx2_TP_TC_WCMTL (CM_DCDC_NV_Komponentenfehler_3_13_Cx2_TP_TC_WCMTL), 3=Cx3_TF_TC_Error_1 (CM_DCDC_NV_Komponentenfehler_3_13_Cx3_TF_TC_Error_1), 4=Cx4_TF_TC_Error_2 (CM_DCDC_NV_Komponentenfehler_3_13_Cx4_TF_TC_Error_2), 5=Cx5_TF_TC_Error_3 (CM_DCDC_NV_Komponentenfehler_3_13_Cx5_TF_TC_Error_3), 6=Cx6_TF_TC_Error_4 (CM_DCDC_NV_Komponentenfehler_3_13_Cx6_TF_TC_Error_4), 7=Cx7_TF_TC_Error_5 (CM_DCDC_NV_Komponentenfehler_3_13_Cx7_TF_TC_Error_5)
  compu method CM_BJB_CVN_VLD: 0=Cx0_Ungueltig (CM_BJB_CVN_VLD_Cx0_Ungueltig), 1=Cx1_Gueltig (CM_BJB_CVN_VLD_Cx1_Gueltig)
  compu method CM_DS_Hybrid_01_WIRChanged: phys=raw for raw 0..1
  compu method CM_BMC_CMC_Temperatur_014: phys=raw*0.5-40 for raw 0..252, 253=Cxfd_nicht_vorhanden (CM_BMC_CMC_Temperatur_014_Cxfd_nicht_vorhanden), 254=Cxfe_Init (CM_BMC_CMC_Temperatur_014_Cxfe_Init), 255=Cxff_Fehler (CM_BMC_CMC_Temperatur_014_Cxff_Fehler); unit Unit_DegreCelsi
  compu method CM_BJB_Lebensdauer_Trennelemente: phys=raw for raw 0..100000, 131070=Cx1fffe_InitWert (CM_BJB_Lebensdauer_Trennelemente_Cx1fffe_InitWert), 131071=Cx1ffff_Fehler (CM_BJB_Lebensdauer_Trennelemente_Cx1ffff_Fehler); unit Unit_None
  compu method CM_BMC_CMC_Temperatur_015: phys=raw*0.5-40 for raw 0..252, 253=Cxfd_nicht_vorhanden (CM_BMC_CMC_Temperatur_015_Cxfd_nicht_vorhanden), 254=Cxfe_Init (CM_BMC_CMC_Temperatur_015_Cxfe_Init), 255=Cxff_Fehler (CM_BMC_CMC_Temperatur_015_Cxff_Fehler); unit Unit_DegreCelsi
  compu method CM_DCDC_NV_Komponentenfehler_3_14: 0=Cx0_TNCTOC (CM_DCDC_NV_Komponentenfehler_3_14_Cx0_TNCTOC), 1=Cx1_TP_TC (CM_DCDC_NV_Komponentenfehler_3_14_Cx1_TP_TC), 2=Cx2_TP_TC_WCMTL (CM_DCDC_NV_Komponentenfehler_3_14_Cx2_TP_TC_WCMTL), 3=Cx3_TF_TC_Error_1 (CM_DCDC_NV_Komponentenfehler_3_14_Cx3_TF_TC_Error_1), 4=Cx4_TF_TC_Error_2 (CM_DCDC_NV_Komponentenfehler_3_14_Cx4_TF_TC_Error_2), 5=Cx5_TF_TC_Error_3 (CM_DCDC_NV_Komponentenfehler_3_14_Cx5_TF_TC_Error_3), 6=Cx6_TF_TC_Error_4 (CM_DCDC_NV_Komponentenfehler_3_14_Cx6_TF_TC_Error_4), 7=Cx7_TF_TC_Error_5 (CM_DCDC_NV_Komponentenfehler_3_14_Cx7_TF_TC_Error_5)
  compu method CM_DW_Kilometerstand: phys=raw for raw 0..1048573, 1048574=Cxffffe_Init (CM_DW_Kilometerstand_Cxffffe_Init), 1048575=Cxfffff_Fehler (CM_DW_Kilometerstand_Cxfffff_Fehler); unit Unit_KiloMeter
  compu method CM_BMC_CMC_Temperatur_016: phys=raw*0.5-40 for raw 0..252, 253=Cxfd_nicht_vorhanden (CM_BMC_CMC_Temperatur_016_Cxfd_nicht_vorhanden), 254=Cxfe_Init (CM_BMC_CMC_Temperatur_016_Cxfe_Init), 255=Cxff_Fehler (CM_BMC_CMC_Temperatur_016_Cxff_Fehler); unit Unit_DegreCelsi
  compu method CM_BJB_Sperrung_Ueberspannung: 0=Cx0_keine_Sperrung (CM_BJB_Sperrung_Ueberspannung_Cx0_keine_Sperrung), 1=Cx1_Sperrung (CM_BJB_Sperrung_Ueberspannung_Cx1_Sperrung), 2=Cx2_InitWert (CM_BJB_Sperrung_Ueberspannung_Cx2_InitWert), 3=Cx3_Fehler (CM_BJB_Sperrung_Ueberspannung_Cx3_Fehler)
  compu method CM_BMC_CMC_Temperatur_017: phys=raw*0.5-40 for raw 0..252, 253=Cxfd_nicht_vorhanden (CM_BMC_CMC_Temperatur_017_Cxfd_nicht_vorhanden), 254=Cxfe_Init (CM_BMC_CMC_Temperatur_017_Cxfe_Init), 255=Cxff_Fehler (CM_BMC_CMC_Temperatur_017_Cxff_Fehler); unit Unit_DegreCelsi
  compu method CM_BJB_Sperrung_Uebertemperatur: 0=Cx0_keine_Sperrung (CM_BJB_Sperrung_Uebertemperatur_Cx0_keine_Sperrung), 1=Cx1_Sperrung (CM_BJB_Sperrung_Uebertemperatur_Cx1_Sperrung), 2=Cx2_InitWert (CM_BJB_Sperrung_Uebertemperatur_Cx2_InitWert), 3=Cx3_Fehler (CM_BJB_Sperrung_Uebertemperatur_Cx3_Fehler)
  compu method CM_DCDC_NV_Komponentenfehler_3_15: 0=Cx0_TNCTOC (CM_DCDC_NV_Komponentenfehler_3_15_Cx0_TNCTOC), 1=Cx1_TP_TC (CM_DCDC_NV_Komponentenfehler_3_15_Cx1_TP_TC), 2=Cx2_TP_TC_WCMTL (CM_DCDC_NV_Komponentenfehler_3_15_Cx2_TP_TC_WCMTL), 3=Cx3_TF_TC_Error_1 (CM_DCDC_NV_Komponentenfehler_3_15_Cx3_TF_TC_Error_1), 4=Cx4_TF_TC_Error_2 (CM_DCDC_NV_Komponentenfehler_3_15_Cx4_TF_TC_Error_2), 5=Cx5_TF_TC_Error_3 (CM_DCDC_NV_Komponentenfehler_3_15_Cx5_TF_TC_Error_3), 6=Cx6_TF_TC_Error_4 (CM_DCDC_NV_Komponentenfehler_3_15_Cx6_TF_TC_Error_4), 7=Cx7_TF_TC_Error_5 (CM_DCDC_NV_Komponentenfehler_3_15_Cx7_TF_TC_Error_5)
  compu method CM_BMC_CMC_Temperatur_018: phys=raw*0.5-40 for raw 0..252, 253=Cxfd_nicht_vorhanden (CM_BMC_CMC_Temperatur_018_Cxfd_nicht_vorhanden), 254=Cxfe_Init (CM_BMC_CMC_Temperatur_018_Cxfe_Init), 255=Cxff_Fehler (CM_BMC_CMC_Temperatur_018_Cxff_Fehler); unit Unit_DegreCelsi
  compu method CM_EKK_HVK_EoHVL_Status: 0=Cx0_Init (CM_EKK_HVK_EoHVL_Status_Cx0_Init), 1=Cx1_Uzwkr_kleiner_UEoHVL_Schwell (CM_EKK_HVK_EoHVL_Status_Cx1_Uzwkr_kleiner_UEoHVL_Schwell), 2=Cx2_Uzwkr_groesgleich_UEoHVL_Schwell (CM_EKK_HVK_EoHVL_Status_Cx2_Uzwkr_groesgleich_UEoHVL_Schwell), 3=Cx3_Fehler (CM_EKK_HVK_EoHVL_Status_Cx3_Fehler)
  compu method CM_BJB_Sperrung_Unterspannung: 0=Cx0_keine_Sperrung (CM_BJB_Sperrung_Unterspannung_Cx0_keine_Sperrung), 1=Cx1_Sperrung (CM_BJB_Sperrung_Unterspannung_Cx1_Sperrung), 2=Cx2_InitWert (CM_BJB_Sperrung_Unterspannung_Cx2_InitWert), 3=Cx3_Fehler (CM_BJB_Sperrung_Unterspannung_Cx3_Fehler)
  compu method CM_BJB_Status_HV_Spannungssensorik: 0=Cx0_InitWert_kein_Fehler (CM_BJB_Status_HV_Spannungssensorik_Cx0_InitWert_kein_Fehler), 1=Cx1_Fehler (CM_BJB_Status_HV_Spannungssensorik_Cx1_Fehler)
  compu method CM_BMC_CMC_Temperatur_019: phys=raw*0.5-40 for raw 0..252, 253=Cxfd_nicht_vorhanden (CM_BMC_CMC_Temperatur_019_Cxfd_nicht_vorhanden), 254=Cxfe_Init (CM_BMC_CMC_Temperatur_019_Cxfe_Init), 255=Cxff_Fehler (CM_BMC_CMC_Temperatur_019_Cxff_Fehler); unit Unit_DegreCelsi
  compu method CM_DCDC_NV_Komponentenfehler_3_16: 0=Cx0_TNCTOC (CM_DCDC_NV_Komponentenfehler_3_16_Cx0_TNCTOC), 1=Cx1_TP_TC (CM_DCDC_NV_Komponentenfehler_3_16_Cx1_TP_TC), 2=Cx2_TP_TC_WCMTL (CM_DCDC_NV_Komponentenfehler_3_16_Cx2_TP_TC_WCMTL), 3=Cx3_TF_TC_Error_1 (CM_DCDC_NV_Komponentenfehler_3_16_Cx3_TF_TC_Error_1), 4=Cx4_TF_TC_Error_2 (CM_DCDC_NV_Komponentenfehler_3_16_Cx4_TF_TC_Error_2), 5=Cx5_TF_TC_Error_3 (CM_DCDC_NV_Komponentenfehler_3_16_Cx5_TF_TC_Error_3), 6=Cx6_TF_TC_Error_4 (CM_DCDC_NV_Komponentenfehler_3_16_Cx6_TF_TC_Error_4), 7=Cx7_TF_TC_Error_5 (CM_DCDC_NV_Komponentenfehler_3_16_Cx7_TF_TC_Error_5)
  compu method CM_BJB_Status_Trennelemente: 0=Cx0_kein_Fehler (CM_BJB_Status_Trennelemente_Cx0_kein_Fehler), 1=Cx1_Haupt_TrEl_klemmt_geschl (CM_BJB_Status_Trennelemente_Cx1_Haupt_TrEl_klemmt_geschl), 2=Cx2_AC_TrEl_klemmt_geschl (CM_BJB_Status_Trennelemente_Cx2_AC_TrEl_klemmt_geschl), 3=Cx3_Haupt_und_AC_TrEl_klemmt_geschl (CM_BJB_Status_Trennelemente_Cx3_Haupt_und_AC_TrEl_klemmt_geschl), 6=Cx6_InitWert (CM_BJB_Status_Trennelemente_Cx6_InitWert), 7=Cx7_Fehler (CM_BJB_Status_Trennelemente_Cx7_Fehler)
  compu method CM_BMC_CMC_Temperatur_01_Messzeit: phys=raw for raw 0..253, 254=Cxfe_Init (CM_BMC_CMC_Temperatur_01_Messzeit_Cxfe_Init), 255=Cxff_Fehler (CM_BMC_CMC_Temperatur_01_Messzeit_Cxff_Fehler); unit Unit_None
  compu method CM_EKK_HVK_Fehler_intern: 0=Cx0_kein_Fehler (CM_EKK_HVK_Fehler_intern_Cx0_kein_Fehler) (kein Fehler), 1=Cx1_Fehler_aktiv (CM_EKK_HVK_Fehler_intern_Cx1_Fehler_aktiv)
  compu method CM_BMC_CMC_Temperatur_020: phys=raw*0.5-40 for raw 0..252, 253=Cxfd_nicht_vorhanden (CM_BMC_CMC_Temperatur_020_Cxfd_nicht_vorhanden), 254=Cxfe_Init (CM_BMC_CMC_Temperatur_020_Cxfe_Init), 255=Cxff_Fehler (CM_BMC_CMC_Temperatur_020_Cxff_Fehler); unit Unit_DegreCelsi
  compu method CM_BJB_Ueberspannungszaehler_CMC01: phys=raw for raw 0..400, 510=Cx1fe_InitWert (CM_BJB_Ueberspannungszaehler_CMC01_Cx1fe_InitWert), 511=Cx1ff_Fehler (CM_BJB_Ueberspannungszaehler_CMC01_Cx1ff_Fehler); unit Unit_None
  compu method CM_DCDC_NV_Komponentenfehler_3_2: 0=Cx0_TNCTOC (CM_DCDC_NV_Komponentenfehler_3_2_Cx0_TNCTOC), 1=Cx1_TP_TC (CM_DCDC_NV_Komponentenfehler_3_2_Cx1_TP_TC), 2=Cx2_TP_TC_WCMTL (CM_DCDC_NV_Komponentenfehler_3_2_Cx2_TP_TC_WCMTL), 3=Cx3_TF_TC_Error_1 (CM_DCDC_NV_Komponentenfehler_3_2_Cx3_TF_TC_Error_1), 4=Cx4_TF_TC_Error_2 (CM_DCDC_NV_Komponentenfehler_3_2_Cx4_TF_TC_Error_2), 5=Cx5_TF_TC_Error_3 (CM_DCDC_NV_Komponentenfehler_3_2_Cx5_TF_TC_Error_3), 6=Cx6_TF_TC_Error_4 (CM_DCDC_NV_Komponentenfehler_3_2_Cx6_TF_TC_Error_4), 7=Cx7_TF_TC_Error_5 (CM_DCDC_NV_Komponentenfehler_3_2_Cx7_TF_TC_Error_5)
  compu method CM_BMC_CMC_Temperatur_021: phys=raw*0.5-40 for raw 0..252, 253=Cxfd_nicht_vorhanden (CM_BMC_CMC_Temperatur_021_Cxfd_nicht_vorhanden), 254=Cxfe_Init (CM_BMC_CMC_Temperatur_021_Cxfe_Init), 255=Cxff_Fehler (CM_BMC_CMC_Temperatur_021_Cxff_Fehler); unit Unit_DegreCelsi
  compu method CM_BMC_CMC_Zellspannung_010: phys=raw+1000 for raw 0..4091, 4092=Cxffc_kleiner_1V (CM_BMC_CMC_Zellspannung_010_Cxffc_kleiner_1V), 4093=Cxffd_nicht_vorhanden (CM_BMC_CMC_Zellspannung_010_Cxffd_nicht_vorhanden), 4094=Cxffe_Init (CM_BMC_CMC_Zellspannung_010_Cxffe_Init), 4095=Cxfff_Fehler (CM_BMC_CMC_Zellspannung_010_Cxfff_Fehler); unit Unit_MilliVolt
  compu method CM_BJB_Ueberspannungszaehler_CMC02: phys=raw for raw 0..400, 510=Cx1fe_InitWert (CM_BJB_Ueberspannungszaehler_CMC02_Cx1fe_InitWert), 511=Cx1ff_Fehler (CM_BJB_Ueberspannungszaehler_CMC02_Cx1ff_Fehler); unit Unit_None
  compu method CM_EKK_HVK_Status_Spgfreiheit: 0=Cx0_Init (CM_EKK_HVK_Status_Spgfreiheit_Cx0_Init), 1=Cx1_HV_Komponente_spannungsfrei (CM_EKK_HVK_Status_Spgfreiheit_Cx1_HV_Komponente_spannungsfrei), 2=Cx2_HV_Komp_nicht_spannungsfrei (CM_EKK_HVK_Status_Spgfreiheit_Cx2_HV_Komp_nicht_spannungsfrei), 3=Cx3_Fehler (CM_EKK_HVK_Status_Spgfreiheit_Cx3_Fehler)
  compu method CM_BMC_CMC_Temperatur_022: phys=raw*0.5-40 for raw 0..252, 253=Cxfd_nicht_vorhanden (CM_BMC_CMC_Temperatur_022_Cxfd_nicht_vorhanden), 254=Cxfe_Init (CM_BMC_CMC_Temperatur_022_Cxfe_Init), 255=Cxff_Fehler (CM_BMC_CMC_Temperatur_022_Cxff_Fehler); unit Unit_DegreCelsi
  compu method CM_BJB_Ueberspannungszaehler_CMC03: phys=raw for raw 0..400, 510=Cx1fe_InitWert (CM_BJB_Ueberspannungszaehler_CMC03_Cx1fe_InitWert), 511=Cx1ff_Fehler (CM_BJB_Ueberspannungszaehler_CMC03_Cx1ff_Fehler); unit Unit_None
  compu method CM_DCDC_NV_Komponentenfehler_3_3: 0=Cx0_TNCTOC (CM_DCDC_NV_Komponentenfehler_3_3_Cx0_TNCTOC), 1=Cx1_TP_TC (CM_DCDC_NV_Komponentenfehler_3_3_Cx1_TP_TC), 2=Cx2_TP_TC_WCMTL (CM_DCDC_NV_Komponentenfehler_3_3_Cx2_TP_TC_WCMTL), 3=Cx3_TF_TC_Error_1 (CM_DCDC_NV_Komponentenfehler_3_3_Cx3_TF_TC_Error_1), 4=Cx4_TF_TC_Error_2 (CM_DCDC_NV_Komponentenfehler_3_3_Cx4_TF_TC_Error_2), 5=Cx5_TF_TC_Error_3 (CM_DCDC_NV_Komponentenfehler_3_3_Cx5_TF_TC_Error_3), 6=Cx6_TF_TC_Error_4 (CM_DCDC_NV_Komponentenfehler_3_3_Cx6_TF_TC_Error_4), 7=Cx7_TF_TC_Error_5 (CM_DCDC_NV_Komponentenfehler_3_3_Cx7_TF_TC_Error_5)
  compu method CM_BJB_Ueberspannungszaehler_CMC04: phys=raw for raw 0..400, 510=Cx1fe_InitWert (CM_BJB_Ueberspannungszaehler_CMC04_Cx1fe_InitWert), 511=Cx1ff_Fehler (CM_BJB_Ueberspannungszaehler_CMC04_Cx1ff_Fehler); unit Unit_None
  compu method CM_BMC_CMC_Temperatur_023: phys=raw*0.5-40 for raw 0..252, 253=Cxfd_nicht_vorhanden (CM_BMC_CMC_Temperatur_023_Cxfd_nicht_vorhanden), 254=Cxfe_Init (CM_BMC_CMC_Temperatur_023_Cxfe_Init), 255=Cxff_Fehler (CM_BMC_CMC_Temperatur_023_Cxff_Fehler); unit Unit_DegreCelsi
  compu method CM_ELF_GeplEndeLadevorgangJahr: phys=raw for raw 0..4094, 4095=Cxfff_InitWert (CM_ELF_GeplEndeLadevorgangJahr_Cxfff_InitWert); unit Unit_Year
  compu method CM_BJB_Uebertemperaturzaehler_CMC01: phys=raw*10 for raw 0..60480, 65534=Cxfffe_InitWert (CM_BJB_Uebertemperaturzaehler_CMC01_Cxfffe_InitWert), 65535=Cxffff_Fehler (CM_BJB_Uebertemperaturzaehler_CMC01_Cxffff_Fehler); unit Unit_None
  compu method CM_BMC_CMC_Temperatur_024: phys=raw*0.5-40 for raw 0..252, 253=Cxfd_nicht_vorhanden (CM_BMC_CMC_Temperatur_024_Cxfd_nicht_vorhanden), 254=Cxfe_Init (CM_BMC_CMC_Temperatur_024_Cxfe_Init), 255=Cxff_Fehler (CM_BMC_CMC_Temperatur_024_Cxff_Fehler); unit Unit_DegreCelsi
  compu method CM_BMC_CMC_Zellspannung_011: phys=raw+1000 for raw 0..4091, 4092=Cxffc_kleiner_1V (CM_BMC_CMC_Zellspannung_011_Cxffc_kleiner_1V), 4093=Cxffd_nicht_vorhanden (CM_BMC_CMC_Zellspannung_011_Cxffd_nicht_vorhanden), 4094=Cxffe_Init (CM_BMC_CMC_Zellspannung_011_Cxffe_Init), 4095=Cxfff_Fehler (CM_BMC_CMC_Zellspannung_011_Cxfff_Fehler); unit Unit_MilliVolt
  compu method CM_BMC_CMC_Temperatur_025: phys=raw*0.5-40 for raw 0..252, 253=Cxfd_nicht_vorhanden (CM_BMC_CMC_Temperatur_025_Cxfd_nicht_vorhanden), 254=Cxfe_Init (CM_BMC_CMC_Temperatur_025_Cxfe_Init), 255=Cxff_Fehler (CM_BMC_CMC_Temperatur_025_Cxff_Fehler); unit Unit_DegreCelsi
  compu method CM_BJB_Uebertemperaturzaehler_CMC02: phys=raw*10 for raw 0..60480, 65534=Cxfffe_InitWert (CM_BJB_Uebertemperaturzaehler_CMC02_Cxfffe_InitWert), 65535=Cxffff_Fehler (CM_BJB_Uebertemperaturzaehler_CMC02_Cxffff_Fehler); unit Unit_None
  compu method CM_DCDC_NV_Komponentenfehler_3_4: 0=Cx0_TNCTOC (CM_DCDC_NV_Komponentenfehler_3_4_Cx0_TNCTOC), 1=Cx1_TP_TC (CM_DCDC_NV_Komponentenfehler_3_4_Cx1_TP_TC), 2=Cx2_TP_TC_WCMTL (CM_DCDC_NV_Komponentenfehler_3_4_Cx2_TP_TC_WCMTL), 3=Cx3_TF_TC_Error_1 (CM_DCDC_NV_Komponentenfehler_3_4_Cx3_TF_TC_Error_1), 4=Cx4_TF_TC_Error_2 (CM_DCDC_NV_Komponentenfehler_3_4_Cx4_TF_TC_Error_2), 5=Cx5_TF_TC_Error_3 (CM_DCDC_NV_Komponentenfehler_3_4_Cx5_TF_TC_Error_3), 6=Cx6_TF_TC_Error_4 (CM_DCDC_NV_Komponentenfehler_3_4_Cx6_TF_TC_Error_4), 7=Cx7_TF_TC_Error_5 (CM_DCDC_NV_Komponentenfehler_3_4_Cx7_TF_TC_Error_5)
  compu method CM_BMC_CMC_Zellspannung_012: phys=raw+1000 for raw 0..4091, 4092=Cxffc_kleiner_1V (CM_BMC_CMC_Zellspannung_012_Cxffc_kleiner_1V), 4093=Cxffd_nicht_vorhanden (CM_BMC_CMC_Zellspannung_012_Cxffd_nicht_vorhanden), 4094=Cxffe_Init (CM_BMC_CMC_Zellspannung_012_Cxffe_Init), 4095=Cxfff_Fehler (CM_BMC_CMC_Zellspannung_012_Cxfff_Fehler); unit Unit_MilliVolt
  compu method CM_BMC_CMC_Temperatur_026: phys=raw*0.5-40 for raw 0..252, 253=Cxfd_nicht_vorhanden (CM_BMC_CMC_Temperatur_026_Cxfd_nicht_vorhanden), 254=Cxfe_Init (CM_BMC_CMC_Temperatur_026_Cxfe_Init), 255=Cxff_Fehler (CM_BMC_CMC_Temperatur_026_Cxff_Fehler); unit Unit_DegreCelsi
  compu method CM_ELF_GeplEndeLadevorgangMinute: phys=raw for raw 0..59, 63=Cx3f_InitWert (CM_ELF_GeplEndeLadevorgangMinute_Cx3f_InitWert); unit Unit_Minut
  compu method CM_BJB_Uebertemperaturzaehler_CMC03: phys=raw*10 for raw 0..60480, 65534=Cxfffe_InitWert (CM_BJB_Uebertemperaturzaehler_CMC03_Cxfffe_InitWert), 65535=Cxffff_Fehler (CM_BJB_Uebertemperaturzaehler_CMC03_Cxffff_Fehler); unit Unit_None
  compu method CM_BMC_CMC_Zellspannung_013: phys=raw+1000 for raw 0..4091, 4092=Cxffc_kleiner_1V (CM_BMC_CMC_Zellspannung_013_Cxffc_kleiner_1V), 4093=Cxffd_nicht_vorhanden (CM_BMC_CMC_Zellspannung_013_Cxffd_nicht_vorhanden), 4094=Cxffe_Init (CM_BMC_CMC_Zellspannung_013_Cxffe_Init), 4095=Cxfff_Fehler (CM_BMC_CMC_Zellspannung_013_Cxfff_Fehler); unit Unit_MilliVolt
  compu method CM_BMC_CMC_Temperatur_027: phys=raw*0.5-40 for raw 0..252, 253=Cxfd_nicht_vorhanden (CM_BMC_CMC_Temperatur_027_Cxfd_nicht_vorhanden), 254=Cxfe_Init (CM_BMC_CMC_Temperatur_027_Cxfe_Init), 255=Cxff_Fehler (CM_BMC_CMC_Temperatur_027_Cxff_Fehler); unit Unit_DegreCelsi
  compu method CM_BJB_Uebertemperaturzaehler_CMC04: phys=raw*10 for raw 0..60480, 65534=Cxfffe_InitWert (CM_BJB_Uebertemperaturzaehler_CMC04_Cxfffe_InitWert), 65535=Cxffff_Fehler (CM_BJB_Uebertemperaturzaehler_CMC04_Cxffff_Fehler); unit Unit_None
  compu method CM_BMC_CMC_Zellspannung_014: phys=raw+1000 for raw 0..4091, 4092=Cxffc_kleiner_1V (CM_BMC_CMC_Zellspannung_014_Cxffc_kleiner_1V), 4093=Cxffd_nicht_vorhanden (CM_BMC_CMC_Zellspannung_014_Cxffd_nicht_vorhanden), 4094=Cxffe_Init (CM_BMC_CMC_Zellspannung_014_Cxffe_Init), 4095=Cxfff_Fehler (CM_BMC_CMC_Zellspannung_014_Cxfff_Fehler); unit Unit_MilliVolt
  compu method CM_DCDC_NV_Komponentenfehler_3_5: 0=Cx0_TNCTOC (CM_DCDC_NV_Komponentenfehler_3_5_Cx0_TNCTOC), 1=Cx1_TP_TC (CM_DCDC_NV_Komponentenfehler_3_5_Cx1_TP_TC), 2=Cx2_TP_TC_WCMTL (CM_DCDC_NV_Komponentenfehler_3_5_Cx2_TP_TC_WCMTL), 3=Cx3_TF_TC_Error_1 (CM_DCDC_NV_Komponentenfehler_3_5_Cx3_TF_TC_Error_1), 4=Cx4_TF_TC_Error_2 (CM_DCDC_NV_Komponentenfehler_3_5_Cx4_TF_TC_Error_2), 5=Cx5_TF_TC_Error_3 (CM_DCDC_NV_Komponentenfehler_3_5_Cx5_TF_TC_Error_3), 6=Cx6_TF_TC_Error_4 (CM_DCDC_NV_Komponentenfehler_3_5_Cx6_TF_TC_Error_4), 7=Cx7_TF_TC_Error_5 (CM_DCDC_NV_Komponentenfehler_3_5_Cx7_TF_TC_Error_5)
  compu method CM_BJB_Unterspannungszaehler_CMC01: phys=raw for raw 0..400, 510=Cx1fe_InitWert (CM_BJB_Unterspannungszaehler_CMC01_Cx1fe_InitWert), 511=Cx1ff_Fehler (CM_BJB_Unterspannungszaehler_CMC01_Cx1ff_Fehler); unit Unit_None
  compu method CM_BMC_CMC_Temperatur_028: phys=raw*0.5-40 for raw 0..252, 253=Cxfd_nicht_vorhanden (CM_BMC_CMC_Temperatur_028_Cxfd_nicht_vorhanden), 254=Cxfe_Init (CM_BMC_CMC_Temperatur_028_Cxfe_Init), 255=Cxff_Fehler (CM_BMC_CMC_Temperatur_028_Cxff_Fehler); unit Unit_DegreCelsi
  compu method CM_ELF_GeplEndeLadevorgangMonat: phys=raw for raw 1..12, 15=Cxf_Init (CM_ELF_GeplEndeLadevorgangMonat_Cxf_Init); unit Unit_Month
  compu method CM_BJB_Unterspannungszaehler_CMC02: phys=raw for raw 0..400, 510=Cx1fe_InitWert (CM_BJB_Unterspannungszaehler_CMC02_Cx1fe_InitWert), 511=Cx1ff_Fehler (CM_BJB_Unterspannungszaehler_CMC02_Cx1ff_Fehler); unit Unit_None
  compu method CM_BMC_CMC_Zellspannung_015: phys=raw+1000 for raw 0..4091, 4092=Cxffc_kleiner_1V (CM_BMC_CMC_Zellspannung_015_Cxffc_kleiner_1V), 4093=Cxffd_nicht_vorhanden (CM_BMC_CMC_Zellspannung_015_Cxffd_nicht_vorhanden), 4094=Cxffe_Init (CM_BMC_CMC_Zellspannung_015_Cxffe_Init), 4095=Cxfff_Fehler (CM_BMC_CMC_Zellspannung_015_Cxfff_Fehler); unit Unit_MilliVolt
  compu method CM_BMC_CMC_Temperatur_029: phys=raw*0.5-40 for raw 0..252, 253=Cxfd_nicht_vorhanden (CM_BMC_CMC_Temperatur_029_Cxfd_nicht_vorhanden), 254=Cxfe_Init (CM_BMC_CMC_Temperatur_029_Cxfe_Init), 255=Cxff_Fehler (CM_BMC_CMC_Temperatur_029_Cxff_Fehler); unit Unit_DegreCelsi
  compu method CM_DCDC_NV_Komponentenfehler_3_6: 0=Cx0_TNCTOC (CM_DCDC_NV_Komponentenfehler_3_6_Cx0_TNCTOC), 1=Cx1_TP_TC (CM_DCDC_NV_Komponentenfehler_3_6_Cx1_TP_TC), 2=Cx2_TP_TC_WCMTL (CM_DCDC_NV_Komponentenfehler_3_6_Cx2_TP_TC_WCMTL), 3=Cx3_TF_TC_Error_1 (CM_DCDC_NV_Komponentenfehler_3_6_Cx3_TF_TC_Error_1), 4=Cx4_TF_TC_Error_2 (CM_DCDC_NV_Komponentenfehler_3_6_Cx4_TF_TC_Error_2), 5=Cx5_TF_TC_Error_3 (CM_DCDC_NV_Komponentenfehler_3_6_Cx5_TF_TC_Error_3), 6=Cx6_TF_TC_Error_4 (CM_DCDC_NV_Komponentenfehler_3_6_Cx6_TF_TC_Error_4), 7=Cx7_TF_TC_Error_5 (CM_DCDC_NV_Komponentenfehler_3_6_Cx7_TF_TC_Error_5)
  compu method CM_BMC_CMC_Zellspannung_016: phys=raw+1000 for raw 0..4091, 4092=Cxffc_kleiner_1V (CM_BMC_CMC_Zellspannung_016_Cxffc_kleiner_1V), 4093=Cxffd_nicht_vorhanden (CM_BMC_CMC_Zellspannung_016_Cxffd_nicht_vorhanden), 4094=Cxffe_Init (CM_BMC_CMC_Zellspannung_016_Cxffe_Init), 4095=Cxfff_Fehler (CM_BMC_CMC_Zellspannung_016_Cxfff_Fehler); unit Unit_MilliVolt
  compu method CM_BJB_Unterspannungszaehler_CMC03: phys=raw for raw 0..400, 510=Cx1fe_InitWert (CM_BJB_Unterspannungszaehler_CMC03_Cx1fe_InitWert), 511=Cx1ff_Fehler (CM_BJB_Unterspannungszaehler_CMC03_Cx1ff_Fehler); unit Unit_None
  compu method CM_BMC_CMC_Temperatur_02_Messzeit: phys=raw for raw 0..253, 254=Cxfe_Init (CM_BMC_CMC_Temperatur_02_Messzeit_Cxfe_Init), 255=Cxff_Fehler (CM_BMC_CMC_Temperatur_02_Messzeit_Cxff_Fehler); unit Unit_None
  compu method CM_ELF_GeplEndeLadevorgangStatus: 0=Cx0_Startzeit_nicht_beruecksichtigen (CM_ELF_GeplEndeLadevorgangStatus_Cx0_Startzeit_nicht_beruecksichtigen), 1=Cx1_Startzeit_beruecksichtigen (CM_ELF_GeplEndeLadevorgangStatus_Cx1_Startzeit_beruecksichtigen)
  compu method CM_BMC_CMC_Zellspannung_017: phys=raw+1000 for raw 0..4091, 4092=Cxffc_kleiner_1V (CM_BMC_CMC_Zellspannung_017_Cxffc_kleiner_1V), 4093=Cxffd_nicht_vorhanden (CM_BMC_CMC_Zellspannung_017_Cxffd_nicht_vorhanden), 4094=Cxffe_Init (CM_BMC_CMC_Zellspannung_017_Cxffe_Init), 4095=Cxfff_Fehler (CM_BMC_CMC_Zellspannung_017_Cxfff_Fehler); unit Unit_MilliVolt
  compu method CM_BMC_CMC_Temperatur_030: phys=raw*0.5-40 for raw 0..252, 253=Cxfd_nicht_vorhanden (CM_BMC_CMC_Temperatur_030_Cxfd_nicht_vorhanden), 254=Cxfe_Init (CM_BMC_CMC_Temperatur_030_Cxfe_Init), 255=Cxff_Fehler (CM_BMC_CMC_Temperatur_030_Cxff_Fehler); unit Unit_DegreCelsi
  compu method CM_BJB_Unterspannungszaehler_CMC04: phys=raw for raw 0..400, 510=Cx1fe_InitWert (CM_BJB_Unterspannungszaehler_CMC04_Cx1fe_InitWert), 511=Cx1ff_Fehler (CM_BJB_Unterspannungszaehler_CMC04_Cx1ff_Fehler); unit Unit_None
  compu method CM_BMC_CMC_Zellspannung_018: phys=raw+1000 for raw 0..4091, 4092=Cxffc_kleiner_1V (CM_BMC_CMC_Zellspannung_018_Cxffc_kleiner_1V), 4093=Cxffd_nicht_vorhanden (CM_BMC_CMC_Zellspannung_018_Cxffd_nicht_vorhanden), 4094=Cxffe_Init (CM_BMC_CMC_Zellspannung_018_Cxffe_Init), 4095=Cxfff_Fehler (CM_BMC_CMC_Zellspannung_018_Cxfff_Fehler); unit Unit_MilliVolt
  compu method CM_DCDC_NV_Komponentenfehler_3_7: 0=Cx0_TNCTOC (CM_DCDC_NV_Komponentenfehler_3_7_Cx0_TNCTOC), 1=Cx1_TP_TC (CM_DCDC_NV_Komponentenfehler_3_7_Cx1_TP_TC), 2=Cx2_TP_TC_WCMTL (CM_DCDC_NV_Komponentenfehler_3_7_Cx2_TP_TC_WCMTL), 3=Cx3_TF_TC_Error_1 (CM_DCDC_NV_Komponentenfehler_3_7_Cx3_TF_TC_Error_1), 4=Cx4_TF_TC_Error_2 (CM_DCDC_NV_Komponentenfehler_3_7_Cx4_TF_TC_Error_2), 5=Cx5_TF_TC_Error_3 (CM_DCDC_NV_Komponentenfehler_3_7_Cx5_TF_TC_Error_3), 6=Cx6_TF_TC_Error_4 (CM_DCDC_NV_Komponentenfehler_3_7_Cx6_TF_TC_Error_4), 7=Cx7_TF_TC_Error_5 (CM_DCDC_NV_Komponentenfehler_3_7_Cx7_TF_TC_Error_5)
  compu method CM_BMC_Abschaltankuendigung: phys=raw*0.5 for raw 0..1021, 1022=Cx3fe_keine_Abschaltung (CM_BMC_Abschaltankuendigung_Cx3fe_keine_Abschaltung) (keine Abschaltung), 1023=Cx3ff_Fehler (CM_BMC_Abschaltankuendigung_Cx3ff_Fehler); unit Unit_Secon
  compu method CM_BMC_CMC_Temperatur_031: phys=raw*0.5-40 for raw 0..252, 253=Cxfd_nicht_vorhanden (CM_BMC_CMC_Temperatur_031_Cxfd_nicht_vorhanden), 254=Cxfe_Init (CM_BMC_CMC_Temperatur_031_Cxfe_Init), 255=Cxff_Fehler (CM_BMC_CMC_Temperatur_031_Cxff_Fehler); unit Unit_DegreCelsi
  compu method CM_BMC_CMC_Zellspannung_019: phys=raw+1000 for raw 0..4091, 4092=Cxffc_kleiner_1V (CM_BMC_CMC_Zellspannung_019_Cxffc_kleiner_1V), 4093=Cxffd_nicht_vorhanden (CM_BMC_CMC_Zellspannung_019_Cxffd_nicht_vorhanden), 4094=Cxffe_Init (CM_BMC_CMC_Zellspannung_019_Cxffe_Init), 4095=Cxfff_Fehler (CM_BMC_CMC_Zellspannung_019_Cxfff_Fehler); unit Unit_MilliVolt
  compu method CM_ELF_GeplEndeLadevorgangStunde: phys=raw for raw 0..23, 31=Cx1f_InitWert (CM_ELF_GeplEndeLadevorgangStunde_Cx1f_InitWert); unit Unit_Hours
  compu method CM_BMC_AC_Laden: 0=Cx0_Init (CM_BMC_AC_Laden_Cx0_Init), 1=Cx1_nicht_vorhanden (CM_BMC_AC_Laden_Cx1_nicht_vorhanden), 2=Cx2_vorhanden (CM_BMC_AC_Laden_Cx2_vorhanden), 3=Cx3_Fehler (CM_BMC_AC_Laden_Cx3_Fehler)
  compu method CM_BMC_CMC_Temperatur_032: phys=raw*0.5-40 for raw 0..252, 253=Cxfd_nicht_vorhanden (CM_BMC_CMC_Temperatur_032_Cxfd_nicht_vorhanden), 254=Cxfe_Init (CM_BMC_CMC_Temperatur_032_Cxfe_Init), 255=Cxff_Fehler (CM_BMC_CMC_Temperatur_032_Cxff_Fehler); unit Unit_DegreCelsi
  compu method CM_BMC_CMC_Zellspannung_01_Messzeit: phys=raw for raw 0..253, 254=Cxfe_Init (CM_BMC_CMC_Zellspannung_01_Messzeit_Cxfe_Init), 255=Cxff_Fehler (CM_BMC_CMC_Zellspannung_01_Messzeit_Cxff_Fehler); unit Unit_None
  compu method CM_BMC_Bank_Notlauf_erlaubt: 0=Cx0_inaktiv (CM_BMC_Bank_Notlauf_erlaubt_Cx0_inaktiv), 1=Cx1_aktiv (CM_BMC_Bank_Notlauf_erlaubt_Cx1_aktiv)
  compu method CM_DCDC_NV_Komponentenfehler_3_8: 0=Cx0_TNCTOC (CM_DCDC_NV_Komponentenfehler_3_8_Cx0_TNCTOC), 1=Cx1_TP_TC (CM_DCDC_NV_Komponentenfehler_3_8_Cx1_TP_TC), 2=Cx2_TP_TC_WCMTL (CM_DCDC_NV_Komponentenfehler_3_8_Cx2_TP_TC_WCMTL), 3=Cx3_TF_TC_Error_1 (CM_DCDC_NV_Komponentenfehler_3_8_Cx3_TF_TC_Error_1), 4=Cx4_TF_TC_Error_2 (CM_DCDC_NV_Komponentenfehler_3_8_Cx4_TF_TC_Error_2), 5=Cx5_TF_TC_Error_3 (CM_DCDC_NV_Komponentenfehler_3_8_Cx5_TF_TC_Error_3), 6=Cx6_TF_TC_Error_4 (CM_DCDC_NV_Komponentenfehler_3_8_Cx6_TF_TC_Error_4), 7=Cx7_TF_TC_Error_5 (CM_DCDC_NV_Komponentenfehler_3_8_Cx7_TF_TC_Error_5)
  compu method CM_BMC_CMC_Temperatur_033: phys=raw*0.5-40 for raw 0..252, 253=Cxfd_nicht_vorhanden (CM_BMC_CMC_Temperatur_033_Cxfd_nicht_vorhanden), 254=Cxfe_Init (CM_BMC_CMC_Temperatur_033_Cxfe_Init), 255=Cxff_Fehler (CM_BMC_CMC_Temperatur_033_Cxff_Fehler); unit Unit_DegreCelsi
  compu method CM_BMC_CMC_Zellspannung_069: phys=raw+1000 for raw 0..4091, 4092=Cxffc_kleiner_1V (CM_BMC_CMC_Zellspannung_069_Cxffc_kleiner_1V), 4093=Cxffd_nicht_vorhanden (CM_BMC_CMC_Zellspannung_069_Cxffd_nicht_vorhanden), 4094=Cxffe_Init (CM_BMC_CMC_Zellspannung_069_Cxffe_Init), 4095=Cxfff_Fehler (CM_BMC_CMC_Zellspannung_069_Cxfff_Fehler); unit Unit_MilliVolt
  compu method CM_BMC_CMC_Zellspannung_020: phys=raw+1000 for raw 0..4091, 4092=Cxffc_kleiner_1V (CM_BMC_CMC_Zellspannung_020_Cxffc_kleiner_1V), 4093=Cxffd_nicht_vorhanden (CM_BMC_CMC_Zellspannung_020_Cxffd_nicht_vorhanden), 4094=Cxffe_Init (CM_BMC_CMC_Zellspannung_020_Cxffe_Init), 4095=Cxfff_Fehler (CM_BMC_CMC_Zellspannung_020_Cxfff_Fehler); unit Unit_MilliVolt
  compu method CM_ELF_GeplEndeLadevorgangTag: 0=Cx0_Init (CM_ELF_GeplEndeLadevorgangTag_Cx0_Init), phys=raw for raw 1..31; unit Unit_Day
  compu method CM_BMC_Bank_parallel_erlaubt: 0=Cx0_inaktiv (CM_BMC_Bank_parallel_erlaubt_Cx0_inaktiv), 1=Cx1_aktiv (CM_BMC_Bank_parallel_erlaubt_Cx1_aktiv)
  compu method CM_BMC_CMC_Temperatur_034: phys=raw*0.5-40 for raw 0..252, 253=Cxfd_nicht_vorhanden (CM_BMC_CMC_Temperatur_034_Cxfd_nicht_vorhanden), 254=Cxfe_Init (CM_BMC_CMC_Temperatur_034_Cxfe_Init), 255=Cxff_Fehler (CM_BMC_CMC_Temperatur_034_Cxff_Fehler); unit Unit_DegreCelsi
  compu method CM_BMC_CMC_Zellspannung_021: phys=raw+1000 for raw 0..4091, 4092=Cxffc_kleiner_1V (CM_BMC_CMC_Zellspannung_021_Cxffc_kleiner_1V), 4093=Cxffd_nicht_vorhanden (CM_BMC_CMC_Zellspannung_021_Cxffd_nicht_vorhanden), 4094=Cxffe_Init (CM_BMC_CMC_Zellspannung_021_Cxffe_Init), 4095=Cxfff_Fehler (CM_BMC_CMC_Zellspannung_021_Cxfff_Fehler); unit Unit_MilliVolt
  compu method CM_BMC_CMC_Temperatur_035: phys=raw*0.5-40 for raw 0..252, 253=Cxfd_nicht_vorhanden (CM_BMC_CMC_Temperatur_035_Cxfd_nicht_vorhanden), 254=Cxfe_Init (CM_BMC_CMC_Temperatur_035_Cxfe_Init), 255=Cxff_Fehler (CM_BMC_CMC_Temperatur_035_Cxff_Fehler); unit Unit_DegreCelsi
  compu method CM_BMC_Bank_seriell_erlaubt: 0=Cx0_inaktiv (CM_BMC_Bank_seriell_erlaubt_Cx0_inaktiv), 1=Cx1_aktiv (CM_BMC_Bank_seriell_erlaubt_Cx1_aktiv)
  compu method CM_BMC_CMC_Zellspannung_022: phys=raw+1000 for raw 0..4091, 4092=Cxffc_kleiner_1V (CM_BMC_CMC_Zellspannung_022_Cxffc_kleiner_1V), 4093=Cxffd_nicht_vorhanden (CM_BMC_CMC_Zellspannung_022_Cxffd_nicht_vorhanden), 4094=Cxffe_Init (CM_BMC_CMC_Zellspannung_022_Cxffe_Init), 4095=Cxfff_Fehler (CM_BMC_CMC_Zellspannung_022_Cxfff_Fehler); unit Unit_MilliVolt
  compu method CM_DCDC_NV_Komponentenfehler_3_9: 0=Cx0_TNCTOC (CM_DCDC_NV_Komponentenfehler_3_9_Cx0_TNCTOC), 1=Cx1_TP_TC (CM_DCDC_NV_Komponentenfehler_3_9_Cx1_TP_TC), 2=Cx2_TP_TC_WCMTL (CM_DCDC_NV_Komponentenfehler_3_9_Cx2_TP_TC_WCMTL), 3=Cx3_TF_TC_Error_1 (CM_DCDC_NV_Komponentenfehler_3_9_Cx3_TF_TC_Error_1), 4=Cx4_TF_TC_Error_2 (CM_DCDC_NV_Komponentenfehler_3_9_Cx4_TF_TC_Error_2), 5=Cx5_TF_TC_Error_3 (CM_DCDC_NV_Komponentenfehler_3_9_Cx5_TF_TC_Error_3), 6=Cx6_TF_TC_Error_4 (CM_DCDC_NV_Komponentenfehler_3_9_Cx6_TF_TC_Error_4), 7=Cx7_TF_TC_Error_5 (CM_DCDC_NV_Komponentenfehler_3_9_Cx7_TF_TC_Error_5)
  compu method CM_BMC_CMC_Zellspannung_133: phys=raw+1000 for raw 0..4091, 4092=Cxffc_kleiner_1V (CM_BMC_CMC_Zellspannung_133_Cxffc_kleiner_1V), 4093=Cxffd_nicht_vorhanden (CM_BMC_CMC_Zellspannung_133_Cxffd_nicht_vorhanden), 4094=Cxffe_Init (CM_BMC_CMC_Zellspannung_133_Cxffe_Init), 4095=Cxfff_Fehler (CM_BMC_CMC_Zellspannung_133_Cxfff_Fehler); unit Unit_MilliVolt
  compu method CM_BMC_Bankstatus: 0=Cx0_Keine_Bank_aktiv (CM_BMC_Bankstatus_Cx0_Keine_Bank_aktiv), 1=Cx1_800V_Seriellbetrieb (CM_BMC_Bankstatus_Cx1_800V_Seriellbetrieb), 2=Cx2_400V_Parallelbetrieb (CM_BMC_Bankstatus_Cx2_400V_Parallelbetrieb), 3=Cx3_400V_Ausgleichsbetrieb (CM_BMC_Bankstatus_Cx3_400V_Ausgleichsbetrieb), 4=Cx4_400V_Notlaufbetrieb_Bank0 (CM_BMC_Bankstatus_Cx4_400V_Notlaufbetrieb_Bank0), 5=Cx5_400V_Notlaufbetrieb_Bank1 (CM_BMC_Bankstatus_Cx5_400V_Notlaufbetrieb_Bank1), 14=Cxe_Init (CM_BMC_Bankstatus_Cxe_Init), 15=Cxf_Fehler (CM_BMC_Bankstatus_Cxf_Fehler)
  compu method CM_BMC_CMC_Temperatur_036: phys=raw*0.5-40 for raw 0..252, 253=Cxfd_nicht_vorhanden (CM_BMC_CMC_Temperatur_036_Cxfd_nicht_vorhanden), 254=Cxfe_Init (CM_BMC_CMC_Temperatur_036_Cxfe_Init), 255=Cxff_Fehler (CM_BMC_CMC_Temperatur_036_Cxff_Fehler); unit Unit_DegreCelsi
  compu method CM_HCP1_Indc_StChk: 0=Cx0_Completed (CM_HCP1_Indc_StChk_Cx0_Completed), 1=Cx1_NotCompleted (CM_HCP1_Indc_StChk_Cx1_NotCompleted)
  compu method CM_BMC_CMC_Zellspannung_023: phys=raw+1000 for raw 0..4091, 4092=Cxffc_kleiner_1V (CM_BMC_CMC_Zellspannung_023_Cxffc_kleiner_1V), 4093=Cxffd_nicht_vorhanden (CM_BMC_CMC_Zellspannung_023_Cxffd_nicht_vorhanden), 4094=Cxffe_Init (CM_BMC_CMC_Zellspannung_023_Cxffe_Init), 4095=Cxfff_Fehler (CM_BMC_CMC_Zellspannung_023_Cxfff_Fehler); unit Unit_MilliVolt
  compu method CM_BMC_Bidi_Energie_Absolut: phys=raw for raw 0..65533, 65534=Cxfffe_Init (CM_BMC_Bidi_Energie_Absolut_Cxfffe_Init), 65535=Cxffff_Fehler (CM_BMC_Bidi_Energie_Absolut_Cxffff_Fehler); unit Unit_KiloWattHour
  compu method CM_BMC_CMC_Temperatur_037: phys=raw*0.5-40 for raw 0..252, 253=Cxfd_nicht_vorhanden (CM_BMC_CMC_Temperatur_037_Cxfd_nicht_vorhanden), 254=Cxfe_Init (CM_BMC_CMC_Temperatur_037_Cxfe_Init), 255=Cxff_Fehler (CM_BMC_CMC_Temperatur_037_Cxff_Fehler); unit Unit_DegreCelsi
  compu method CM_BMC_CMC_Zellspannung_024: phys=raw+1000 for raw 0..4091, 4092=Cxffc_kleiner_1V (CM_BMC_CMC_Zellspannung_024_Cxffc_kleiner_1V), 4093=Cxffd_nicht_vorhanden (CM_BMC_CMC_Zellspannung_024_Cxffd_nicht_vorhanden), 4094=Cxffe_Init (CM_BMC_CMC_Zellspannung_024_Cxffe_Init), 4095=Cxfff_Fehler (CM_BMC_CMC_Zellspannung_024_Cxfff_Fehler); unit Unit_MilliVolt
  compu method CM_DCDC_NV_Komponentenfehler_40: 0=Cx0_TstNotComplThisOpCycle_Init (CM_DCDC_NV_Komponentenfehler_40_Cx0_TstNotComplThisOpCycle_Init), 1=Cx1_TstComplThisOpCycle_Pass (CM_DCDC_NV_Komponentenfehler_40_Cx1_TstComplThisOpCycle_Pass), 2=Cx2_TstCmplThisCycle_Pass_TimeElapse (CM_DCDC_NV_Komponentenfehler_40_Cx2_TstCmplThisCycle_Pass_TimeElapse), 3=Cx3_TstComplThisOpCycle_FAIL (CM_DCDC_NV_Komponentenfehler_40_Cx3_TstComplThisOpCycle_FAIL)
  compu method CM_BMC_CMC_Zellspannung_070: phys=raw+1000 for raw 0..4091, 4092=Cxffc_kleiner_1V (CM_BMC_CMC_Zellspannung_070_Cxffc_kleiner_1V), 4093=Cxffd_nicht_vorhanden (CM_BMC_CMC_Zellspannung_070_Cxffd_nicht_vorhanden), 4094=Cxffe_Init (CM_BMC_CMC_Zellspannung_070_Cxffe_Init), 4095=Cxfff_Fehler (CM_BMC_CMC_Zellspannung_070_Cxfff_Fehler); unit Unit_MilliVolt
  compu method CM_BMC_CMC_Temperatur_038: phys=raw*0.5-40 for raw 0..252, 253=Cxfd_nicht_vorhanden (CM_BMC_CMC_Temperatur_038_Cxfd_nicht_vorhanden), 254=Cxfe_Init (CM_BMC_CMC_Temperatur_038_Cxfe_Init), 255=Cxff_Fehler (CM_BMC_CMC_Temperatur_038_Cxff_Fehler); unit Unit_DegreCelsi
  compu method CM_BMC_Bidi_Freigabe: 0=Cx0_entladen_nicht_erlaubt (CM_BMC_Bidi_Freigabe_Cx0_entladen_nicht_erlaubt), 1=Cx1_entladen_erlaubt (CM_BMC_Bidi_Freigabe_Cx1_entladen_erlaubt), 2=Cx2_Init (CM_BMC_Bidi_Freigabe_Cx2_Init), 3=Cx3_Fehler (CM_BMC_Bidi_Freigabe_Cx3_Fehler)
  compu method CM_HCP1_Indc_StFail: 0=Cx0_Passive (CM_HCP1_Indc_StFail_Cx0_Passive), 1=Cx1_Active (CM_HCP1_Indc_StFail_Cx1_Active)
  compu method CM_BMC_CMC_Zellspannung_025: phys=raw+1000 for raw 0..4091, 4092=Cxffc_kleiner_1V (CM_BMC_CMC_Zellspannung_025_Cxffc_kleiner_1V), 4093=Cxffd_nicht_vorhanden (CM_BMC_CMC_Zellspannung_025_Cxffd_nicht_vorhanden), 4094=Cxffe_Init (CM_BMC_CMC_Zellspannung_025_Cxffe_Init), 4095=Cxfff_Fehler (CM_BMC_CMC_Zellspannung_025_Cxfff_Fehler); unit Unit_MilliVolt
  compu method CM_BMC_CMC_Temperatur_039: phys=raw*0.5-40 for raw 0..252, 253=Cxfd_nicht_vorhanden (CM_BMC_CMC_Temperatur_039_Cxfd_nicht_vorhanden), 254=Cxfe_Init (CM_BMC_CMC_Temperatur_039_Cxfe_Init), 255=Cxff_Fehler (CM_BMC_CMC_Temperatur_039_Cxff_Fehler); unit Unit_DegreCelsi
  compu method CM_BMC_Bidi_GenutzteEnergie: phys=raw for raw 0..65533, 65534=Cxfffe_Init (CM_BMC_Bidi_GenutzteEnergie_Cxfffe_Init), 65535=Cxffff_Fehler (CM_BMC_Bidi_GenutzteEnergie_Cxffff_Fehler); unit Unit_KiloWattHour
  compu method CM_BMC_CMC_Zellspannung_134: phys=raw+1000 for raw 0..4091, 4092=Cxffc_kleiner_1V (CM_BMC_CMC_Zellspannung_134_Cxffc_kleiner_1V), 4093=Cxffd_nicht_vorhanden (CM_BMC_CMC_Zellspannung_134_Cxffd_nicht_vorhanden), 4094=Cxffe_Init (CM_BMC_CMC_Zellspannung_134_Cxffe_Init), 4095=Cxfff_Fehler (CM_BMC_CMC_Zellspannung_134_Cxfff_Fehler); unit Unit_MilliVolt
  compu method CM_BMC_CMC_Zellspannung_071: phys=raw+1000 for raw 0..4091, 4092=Cxffc_kleiner_1V (CM_BMC_CMC_Zellspannung_071_Cxffc_kleiner_1V), 4093=Cxffd_nicht_vorhanden (CM_BMC_CMC_Zellspannung_071_Cxffd_nicht_vorhanden), 4094=Cxffe_Init (CM_BMC_CMC_Zellspannung_071_Cxffe_Init), 4095=Cxfff_Fehler (CM_BMC_CMC_Zellspannung_071_Cxfff_Fehler); unit Unit_MilliVolt
  compu method CM_BMC_CMC_Zellspannung_026: phys=raw+1000 for raw 0..4091, 4092=Cxffc_kleiner_1V (CM_BMC_CMC_Zellspannung_026_Cxffc_kleiner_1V), 4093=Cxffd_nicht_vorhanden (CM_BMC_CMC_Zellspannung_026_Cxffd_nicht_vorhanden), 4094=Cxffe_Init (CM_BMC_CMC_Zellspannung_026_Cxffe_Init), 4095=Cxfff_Fehler (CM_BMC_CMC_Zellspannung_026_Cxfff_Fehler); unit Unit_MilliVolt
  compu method CM_BMC_Pack_SN_08: 255=Cxff_Init (CM_BMC_Pack_SN_08_Cxff_Init)
  compu method CM_DCDC_NV_Komponentenfehler_41: 0=Cx0_TstNotComplThisOpCycle_Init (CM_DCDC_NV_Komponentenfehler_41_Cx0_TstNotComplThisOpCycle_Init), 1=Cx1_TstComplThisOpCycle_Pass (CM_DCDC_NV_Komponentenfehler_41_Cx1_TstComplThisOpCycle_Pass), 2=Cx2_TstCmplThisCycle_Pass_TimeElapse (CM_DCDC_NV_Komponentenfehler_41_Cx2_TstCmplThisCycle_Pass_TimeElapse), 3=Cx3_TstComplThisOpCycle_FAIL (CM_DCDC_NV_Komponentenfehler_41_Cx3_TstComplThisOpCycle_FAIL)
  compu method CM_BMC_CMC_Temperatur_03_Messzeit: phys=raw for raw 0..253, 254=Cxfe_Init (CM_BMC_CMC_Temperatur_03_Messzeit_Cxfe_Init), 255=Cxff_Fehler (CM_BMC_CMC_Temperatur_03_Messzeit_Cxff_Fehler); unit Unit_None
  compu method CM_BMC_Bidi_Max_SoC: phys=raw for raw 0..100, 126=Cx7e_Init (CM_BMC_Bidi_Max_SoC_Cx7e_Init), 127=Cx7f_Fehler (CM_BMC_Bidi_Max_SoC_Cx7f_Fehler); unit Unit_PerCent
  compu method CM_BMC_CMC_Zellspannung_027: phys=raw+1000 for raw 0..4091, 4092=Cxffc_kleiner_1V (CM_BMC_CMC_Zellspannung_027_Cxffc_kleiner_1V), 4093=Cxffd_nicht_vorhanden (CM_BMC_CMC_Zellspannung_027_Cxffd_nicht_vorhanden), 4094=Cxffe_Init (CM_BMC_CMC_Zellspannung_027_Cxffe_Init), 4095=Cxfff_Fehler (CM_BMC_CMC_Zellspannung_027_Cxfff_Fehler); unit Unit_MilliVolt
  compu method CM_HV_Bordnetz_aktiv: 0=Cx0_inaktiv (CM_HV_Bordnetz_aktiv_Cx0_inaktiv), 1=Cx1_aktiv (CM_HV_Bordnetz_aktiv_Cx1_aktiv)
  compu method CM_BMC_CMC_Zellspannung_135: phys=raw+1000 for raw 0..4091, 4092=Cxffc_kleiner_1V (CM_BMC_CMC_Zellspannung_135_Cxffc_kleiner_1V), 4093=Cxffd_nicht_vorhanden (CM_BMC_CMC_Zellspannung_135_Cxffd_nicht_vorhanden), 4094=Cxffe_Init (CM_BMC_CMC_Zellspannung_135_Cxffe_Init), 4095=Cxfff_Fehler (CM_BMC_CMC_Zellspannung_135_Cxfff_Fehler); unit Unit_MilliVolt
  compu method CM_BMC_Bidi_Min_SoC: phys=raw for raw 0..100, 126=Cx7e_Init (CM_BMC_Bidi_Min_SoC_Cx7e_Init), 127=Cx7f_Fehler (CM_BMC_Bidi_Min_SoC_Cx7f_Fehler); unit Unit_PerCent
  compu method CM_BMC_CMC_Zellspannung_072: phys=raw+1000 for raw 0..4091, 4092=Cxffc_kleiner_1V (CM_BMC_CMC_Zellspannung_072_Cxffc_kleiner_1V), 4093=Cxffd_nicht_vorhanden (CM_BMC_CMC_Zellspannung_072_Cxffd_nicht_vorhanden), 4094=Cxffe_Init (CM_BMC_CMC_Zellspannung_072_Cxffe_Init), 4095=Cxfff_Fehler (CM_BMC_CMC_Zellspannung_072_Cxfff_Fehler); unit Unit_MilliVolt
  compu method CM_BMC_CMC_Zellspannung_028: phys=raw+1000 for raw 0..4091, 4092=Cxffc_kleiner_1V (CM_BMC_CMC_Zellspannung_028_Cxffc_kleiner_1V), 4093=Cxffd_nicht_vorhanden (CM_BMC_CMC_Zellspannung_028_Cxffd_nicht_vorhanden), 4094=Cxffe_Init (CM_BMC_CMC_Zellspannung_028_Cxffe_Init), 4095=Cxfff_Fehler (CM_BMC_CMC_Zellspannung_028_Cxfff_Fehler); unit Unit_MilliVolt
  compu method CM_BMC_CMC_Temperatur_040: phys=raw*0.5-40 for raw 0..252, 253=Cxfd_nicht_vorhanden (CM_BMC_CMC_Temperatur_040_Cxfd_nicht_vorhanden), 254=Cxfe_Init (CM_BMC_CMC_Temperatur_040_Cxfe_Init), 255=Cxff_Fehler (CM_BMC_CMC_Temperatur_040_Cxff_Fehler); unit Unit_DegreCelsi
  compu method CM_BMC_CMC_Zellspannung_136: phys=raw+1000 for raw 0..4091, 4092=Cxffc_kleiner_1V (CM_BMC_CMC_Zellspannung_136_Cxffc_kleiner_1V), 4093=Cxffd_nicht_vorhanden (CM_BMC_CMC_Zellspannung_136_Cxffd_nicht_vorhanden), 4094=Cxffe_Init (CM_BMC_CMC_Zellspannung_136_Cxffe_Init), 4095=Cxfff_Fehler (CM_BMC_CMC_Zellspannung_136_Cxfff_Fehler); unit Unit_MilliVolt
  compu method CM_BMC_Bidi_Veto_Energie: 0=Cx0_kein_Veto (CM_BMC_Bidi_Veto_Energie_Cx0_kein_Veto), 1=Cx1_Veto (CM_BMC_Bidi_Veto_Energie_Cx1_Veto)
  compu method CM_DCDC_NV_Komponentenfehler_42: 0=Cx0_TstNotComplThisOpCycle_Init (CM_DCDC_NV_Komponentenfehler_42_Cx0_TstNotComplThisOpCycle_Init), 1=Cx1_TstComplThisOpCycle_Pass (CM_DCDC_NV_Komponentenfehler_42_Cx1_TstComplThisOpCycle_Pass), 2=Cx2_TstCmplThisCycle_Pass_TimeElapse (CM_DCDC_NV_Komponentenfehler_42_Cx2_TstCmplThisCycle_Pass_TimeElapse), 3=Cx3_TstComplThisOpCycle_FAIL (CM_DCDC_NV_Komponentenfehler_42_Cx3_TstComplThisOpCycle_FAIL)
  compu method CM_BMC_CMC_Zellspannung_073: phys=raw+1000 for raw 0..4091, 4092=Cxffc_kleiner_1V (CM_BMC_CMC_Zellspannung_073_Cxffc_kleiner_1V), 4093=Cxffd_nicht_vorhanden (CM_BMC_CMC_Zellspannung_073_Cxffd_nicht_vorhanden), 4094=Cxffe_Init (CM_BMC_CMC_Zellspannung_073_Cxffe_Init), 4095=Cxfff_Fehler (CM_BMC_CMC_Zellspannung_073_Cxfff_Fehler); unit Unit_MilliVolt
  compu method CM_BMC_CMC_Temperatur_041: phys=raw*0.5-40 for raw 0..252, 253=Cxfd_nicht_vorhanden (CM_BMC_CMC_Temperatur_041_Cxfd_nicht_vorhanden), 254=Cxfe_Init (CM_BMC_CMC_Temperatur_041_Cxfe_Init), 255=Cxff_Fehler (CM_BMC_CMC_Temperatur_041_Cxff_Fehler); unit Unit_DegreCelsi
  compu method CM_BMC_CMC_Zellspannung_029: phys=raw+1000 for raw 0..4091, 4092=Cxffc_kleiner_1V (CM_BMC_CMC_Zellspannung_029_Cxffc_kleiner_1V), 4093=Cxffd_nicht_vorhanden (CM_BMC_CMC_Zellspannung_029_Cxffd_nicht_vorhanden), 4094=Cxffe_Init (CM_BMC_CMC_Zellspannung_029_Cxffe_Init), 4095=Cxfff_Fehler (CM_BMC_CMC_Zellspannung_029_Cxfff_Fehler); unit Unit_MilliVolt
  compu method CM_HV_Bordnetz_Fehler: 0=Cx0_kein_Fehler (CM_HV_Bordnetz_Fehler_Cx0_kein_Fehler), 1=Cx1_Fehler (CM_HV_Bordnetz_Fehler_Cx1_Fehler)
  compu method CM_BMC_CMC_Zellspannung_137: phys=raw+1000 for raw 0..4091, 4092=Cxffc_kleiner_1V (CM_BMC_CMC_Zellspannung_137_Cxffc_kleiner_1V), 4093=Cxffd_nicht_vorhanden (CM_BMC_CMC_Zellspannung_137_Cxffd_nicht_vorhanden), 4094=Cxffe_Init (CM_BMC_CMC_Zellspannung_137_Cxffe_Init), 4095=Cxfff_Fehler (CM_BMC_CMC_Zellspannung_137_Cxfff_Fehler); unit Unit_MilliVolt
  compu method CM_BMC_Bidi_Veto_Temp: 0=Cx0_kein_Veto (CM_BMC_Bidi_Veto_Temp_Cx0_kein_Veto), 1=Cx1_Veto (CM_BMC_Bidi_Veto_Temp_Cx1_Veto)
  compu method CM_BMC_CMC_Zellspannung_02_Messzeit: phys=raw for raw 0..253, 254=Cxfe_Init (CM_BMC_CMC_Zellspannung_02_Messzeit_Cxfe_Init), 255=Cxff_Fehler (CM_BMC_CMC_Zellspannung_02_Messzeit_Cxff_Fehler); unit Unit_None
  compu method CM_BMC_Pack_SN_09: 255=Cxff_Init (CM_BMC_Pack_SN_09_Cxff_Init)
  compu method CM_BMC_CMC_Temperatur_042: phys=raw*0.5-40 for raw 0..252, 253=Cxfd_nicht_vorhanden (CM_BMC_CMC_Temperatur_042_Cxfd_nicht_vorhanden), 254=Cxfe_Init (CM_BMC_CMC_Temperatur_042_Cxfe_Init), 255=Cxff_Fehler (CM_BMC_CMC_Temperatur_042_Cxff_Fehler); unit Unit_DegreCelsi
  compu method CM_BMC_CMC_Zellspannung_074: phys=raw+1000 for raw 0..4091, 4092=Cxffc_kleiner_1V (CM_BMC_CMC_Zellspannung_074_Cxffc_kleiner_1V), 4093=Cxffd_nicht_vorhanden (CM_BMC_CMC_Zellspannung_074_Cxffd_nicht_vorhanden), 4094=Cxffe_Init (CM_BMC_CMC_Zellspannung_074_Cxffe_Init), 4095=Cxfff_Fehler (CM_BMC_CMC_Zellspannung_074_Cxfff_Fehler); unit Unit_MilliVolt
  compu method CM_BMC_CMC_Zellspannung_138: phys=raw+1000 for raw 0..4091, 4092=Cxffc_kleiner_1V (CM_BMC_CMC_Zellspannung_138_Cxffc_kleiner_1V), 4093=Cxffd_nicht_vorhanden (CM_BMC_CMC_Zellspannung_138_Cxffd_nicht_vorhanden), 4094=Cxffe_Init (CM_BMC_CMC_Zellspannung_138_Cxffe_Init), 4095=Cxfff_Fehler (CM_BMC_CMC_Zellspannung_138_Cxfff_Fehler); unit Unit_MilliVolt
  compu method CM_BMC_CMC_Temperatur_001: phys=raw*0.5-40 for raw 0..252, 253=Cxfd_nicht_vorhanden (CM_BMC_CMC_Temperatur_001_Cxfd_nicht_vorhanden), 254=Cxfe_Init (CM_BMC_CMC_Temperatur_001_Cxfe_Init), 255=Cxff_Fehler (CM_BMC_CMC_Temperatur_001_Cxff_Fehler); unit Unit_DegreCelsi
  compu method CM_DCDC_NV_Komponentenfehler_43: 0=Cx0_TstNotComplThisOpCycle_Init (CM_DCDC_NV_Komponentenfehler_43_Cx0_TstNotComplThisOpCycle_Init), 1=Cx1_TstComplThisOpCycle_Pass (CM_DCDC_NV_Komponentenfehler_43_Cx1_TstComplThisOpCycle_Pass), 2=Cx2_TstCmplThisCycle_Pass_TimeElapse (CM_DCDC_NV_Komponentenfehler_43_Cx2_TstCmplThisCycle_Pass_TimeElapse), 3=Cx3_TstComplThisOpCycle_FAIL (CM_DCDC_NV_Komponentenfehler_43_Cx3_TstComplThisOpCycle_FAIL)
  compu method CM_BMC_CMC_Zellspannung_030: phys=raw+1000 for raw 0..4091, 4092=Cxffc_kleiner_1V (CM_BMC_CMC_Zellspannung_030_Cxffc_kleiner_1V), 4093=Cxffd_nicht_vorhanden (CM_BMC_CMC_Zellspannung_030_Cxffd_nicht_vorhanden), 4094=Cxffe_Init (CM_BMC_CMC_Zellspannung_030_Cxffe_Init), 4095=Cxfff_Fehler (CM_BMC_CMC_Zellspannung_030_Cxfff_Fehler); unit Unit_MilliVolt
  compu method CM_BMC_CMC_Zellspannung_139: phys=raw+1000 for raw 0..4091, 4092=Cxffc_kleiner_1V (CM_BMC_CMC_Zellspannung_139_Cxffc_kleiner_1V), 4093=Cxffd_nicht_vorhanden (CM_BMC_CMC_Zellspannung_139_Cxffd_nicht_vorhanden), 4094=Cxffe_Init (CM_BMC_CMC_Zellspannung_139_Cxffe_Init), 4095=Cxfff_Fehler (CM_BMC_CMC_Zellspannung_139_Cxfff_Fehler); unit Unit_MilliVolt
  compu method CM_HV_Heizer_Status: 0=Cx0_nicht_aktiv (CM_HV_Heizer_Status_Cx0_nicht_aktiv), 1=Cx1_aktiv (CM_HV_Heizer_Status_Cx1_aktiv), 3=Cx3_nicht_verfuegbar (CM_HV_Heizer_Status_Cx3_nicht_verfuegbar)
  compu method CM_BMC_CMC_Temperatur_043: phys=raw*0.5-40 for raw 0..252, 253=Cxfd_nicht_vorhanden (CM_BMC_CMC_Temperatur_043_Cxfd_nicht_vorhanden), 254=Cxfe_Init (CM_BMC_CMC_Temperatur_043_Cxfe_Init), 255=Cxff_Fehler (CM_BMC_CMC_Temperatur_043_Cxff_Fehler); unit Unit_DegreCelsi
  compu method CM_BMC_Pack_SN_10: 255=Cxff_Init (CM_BMC_Pack_SN_10_Cxff_Init)
  compu method CM_BMC_CMC_Temperatur_002: phys=raw*0.5-40 for raw 0..252, 253=Cxfd_nicht_vorhanden (CM_BMC_CMC_Temperatur_002_Cxfd_nicht_vorhanden), 254=Cxfe_Init (CM_BMC_CMC_Temperatur_002_Cxfe_Init), 255=Cxff_Fehler (CM_BMC_CMC_Temperatur_002_Cxff_Fehler); unit Unit_DegreCelsi
  compu method CM_BMC_CMC_Zellspannung_075: phys=raw+1000 for raw 0..4091, 4092=Cxffc_kleiner_1V (CM_BMC_CMC_Zellspannung_075_Cxffc_kleiner_1V), 4093=Cxffd_nicht_vorhanden (CM_BMC_CMC_Zellspannung_075_Cxffd_nicht_vorhanden), 4094=Cxffe_Init (CM_BMC_CMC_Zellspannung_075_Cxffe_Init), 4095=Cxfff_Fehler (CM_BMC_CMC_Zellspannung_075_Cxfff_Fehler); unit Unit_MilliVolt
  compu method CM_BMC_CMC_Zellspannung_031: phys=raw+1000 for raw 0..4091, 4092=Cxffc_kleiner_1V (CM_BMC_CMC_Zellspannung_031_Cxffc_kleiner_1V), 4093=Cxffd_nicht_vorhanden (CM_BMC_CMC_Zellspannung_031_Cxffd_nicht_vorhanden), 4094=Cxffe_Init (CM_BMC_CMC_Zellspannung_031_Cxffe_Init), 4095=Cxfff_Fehler (CM_BMC_CMC_Zellspannung_031_Cxfff_Fehler); unit Unit_MilliVolt
  compu method CM_CMM_FlgCHAFctLC: 0=Cx0_charisma_off (CM_CMM_FlgCHAFctLC_Cx0_charisma_off), 1=Cx1_charisma_on (CM_CMM_FlgCHAFctLC_Cx1_charisma_on)
  compu method CM_BMC_CMC_Zellspannung_140: phys=raw+1000 for raw 0..4091, 4092=Cxffc_kleiner_1V (CM_BMC_CMC_Zellspannung_140_Cxffc_kleiner_1V), 4093=Cxffd_nicht_vorhanden (CM_BMC_CMC_Zellspannung_140_Cxffd_nicht_vorhanden), 4094=Cxffe_Init (CM_BMC_CMC_Zellspannung_140_Cxffe_Init), 4095=Cxfff_Fehler (CM_BMC_CMC_Zellspannung_140_Cxfff_Fehler); unit Unit_MilliVolt
  compu method CM_BMC_CMC_Temperatur_003: phys=raw*0.5-40 for raw 0..252, 253=Cxfd_nicht_vorhanden (CM_BMC_CMC_Temperatur_003_Cxfd_nicht_vorhanden), 254=Cxfe_Init (CM_BMC_CMC_Temperatur_003_Cxfe_Init), 255=Cxff_Fehler (CM_BMC_CMC_Temperatur_003_Cxff_Fehler); unit Unit_DegreCelsi
  compu method CM_BMC_Pack_SN_11: 255=Cxff_Init (CM_BMC_Pack_SN_11_Cxff_Init)
  compu method CM_BMC_CMC_Temperatur_044: phys=raw*0.5-40 for raw 0..252, 253=Cxfd_nicht_vorhanden (CM_BMC_CMC_Temperatur_044_Cxfd_nicht_vorhanden), 254=Cxfe_Init (CM_BMC_CMC_Temperatur_044_Cxfe_Init), 255=Cxff_Fehler (CM_BMC_CMC_Temperatur_044_Cxff_Fehler); unit Unit_DegreCelsi
  compu method CM_BMC_CMC_Zellspannung_076: phys=raw+1000 for raw 0..4091, 4092=Cxffc_kleiner_1V (CM_BMC_CMC_Zellspannung_076_Cxffc_kleiner_1V), 4093=Cxffd_nicht_vorhanden (CM_BMC_CMC_Zellspannung_076_Cxffd_nicht_vorhanden), 4094=Cxffe_Init (CM_BMC_CMC_Zellspannung_076_Cxffe_Init), 4095=Cxfff_Fehler (CM_BMC_CMC_Zellspannung_076_Cxfff_Fehler); unit Unit_MilliVolt
  compu method CM_BMC_CMC_Zellspannung_032: phys=raw+1000 for raw 0..4091, 4092=Cxffc_kleiner_1V (CM_BMC_CMC_Zellspannung_032_Cxffc_kleiner_1V), 4093=Cxffd_nicht_vorhanden (CM_BMC_CMC_Zellspannung_032_Cxffd_nicht_vorhanden), 4094=Cxffe_Init (CM_BMC_CMC_Zellspannung_032_Cxffe_Init), 4095=Cxfff_Fehler (CM_BMC_CMC_Zellspannung_032_Cxfff_Fehler); unit Unit_MilliVolt
  compu method CM_DCDC_NV_Komponentenfehler_44: 0=Cx0_TstNotComplThisOpCycle_Init (CM_DCDC_NV_Komponentenfehler_44_Cx0_TstNotComplThisOpCycle_Init), 1=Cx1_TstComplThisOpCycle_Pass (CM_DCDC_NV_Komponentenfehler_44_Cx1_TstComplThisOpCycle_Pass), 2=Cx2_TstCmplThisCycle_Pass_TimeElapse (CM_DCDC_NV_Komponentenfehler_44_Cx2_TstCmplThisCycle_Pass_TimeElapse), 3=Cx3_TstComplThisOpCycle_FAIL (CM_DCDC_NV_Komponentenfehler_44_Cx3_TstComplThisOpCycle_FAIL)
  compu method CM_BMC_CMC_Temperatur_004: phys=raw*0.5-40 for raw 0..252, 253=Cxfd_nicht_vorhanden (CM_BMC_CMC_Temperatur_004_Cxfd_nicht_vorhanden), 254=Cxfe_Init (CM_BMC_CMC_Temperatur_004_Cxfe_Init), 255=Cxff_Fehler (CM_BMC_CMC_Temperatur_004_Cxff_Fehler); unit Unit_DegreCelsi
  compu method CM_BMC_CMC_Zellspannung_141: phys=raw+1000 for raw 0..4091, 4092=Cxffc_kleiner_1V (CM_BMC_CMC_Zellspannung_141_Cxffc_kleiner_1V), 4093=Cxffd_nicht_vorhanden (CM_BMC_CMC_Zellspannung_141_Cxffd_nicht_vorhanden), 4094=Cxffe_Init (CM_BMC_CMC_Zellspannung_141_Cxffe_Init), 4095=Cxfff_Fehler (CM_BMC_CMC_Zellspannung_141_Cxfff_Fehler); unit Unit_MilliVolt
  compu method CM_HVEM_Abschaltstufe: 0=Cx0_Stufe0 (CM_HVEM_Abschaltstufe_Cx0_Stufe0), 1=Cx1_Stufe1 (CM_HVEM_Abschaltstufe_Cx1_Stufe1), 2=Cx2_Stufe2 (CM_HVEM_Abschaltstufe_Cx2_Stufe2), 3=Cx3_Stufe3 (CM_HVEM_Abschaltstufe_Cx3_Stufe3), 4=Cx4_Stufe4 (CM_HVEM_Abschaltstufe_Cx4_Stufe4), 5=Cx5_Stufe5 (CM_HVEM_Abschaltstufe_Cx5_Stufe5), 6=Cx6_Init (CM_HVEM_Abschaltstufe_Cx6_Init), 7=Cx7_Fehler (CM_HVEM_Abschaltstufe_Cx7_Fehler)
  compu method CM_BMC_Pack_SN_12: 255=Cxff_Init (CM_BMC_Pack_SN_12_Cxff_Init)
  compu method CM_BMC_CMC_Temperatur_045: phys=raw*0.5-40 for raw 0..252, 253=Cxfd_nicht_vorhanden (CM_BMC_CMC_Temperatur_045_Cxfd_nicht_vorhanden), 254=Cxfe_Init (CM_BMC_CMC_Temperatur_045_Cxfe_Init), 255=Cxff_Fehler (CM_BMC_CMC_Temperatur_045_Cxff_Fehler); unit Unit_DegreCelsi
  compu method CM_BMC_CMC_Zellspannung_033: phys=raw+1000 for raw 0..4091, 4092=Cxffc_kleiner_1V (CM_BMC_CMC_Zellspannung_033_Cxffc_kleiner_1V), 4093=Cxffd_nicht_vorhanden (CM_BMC_CMC_Zellspannung_033_Cxffd_nicht_vorhanden), 4094=Cxffe_Init (CM_BMC_CMC_Zellspannung_033_Cxffe_Init), 4095=Cxfff_Fehler (CM_BMC_CMC_Zellspannung_033_Cxfff_Fehler); unit Unit_MilliVolt
  compu method CM_BMC_CMC_Zellspannung_142: phys=raw+1000 for raw 0..4091, 4092=Cxffc_kleiner_1V (CM_BMC_CMC_Zellspannung_142_Cxffc_kleiner_1V), 4093=Cxffd_nicht_vorhanden (CM_BMC_CMC_Zellspannung_142_Cxffd_nicht_vorhanden), 4094=Cxffe_Init (CM_BMC_CMC_Zellspannung_142_Cxffe_Init), 4095=Cxfff_Fehler (CM_BMC_CMC_Zellspannung_142_Cxfff_Fehler); unit Unit_MilliVolt
  compu method CM_BMC_CMC_Zellspannung_077: phys=raw+1000 for raw 0..4091, 4092=Cxffc_kleiner_1V (CM_BMC_CMC_Zellspannung_077_Cxffc_kleiner_1V), 4093=Cxffd_nicht_vorhanden (CM_BMC_CMC_Zellspannung_077_Cxffd_nicht_vorhanden), 4094=Cxffe_Init (CM_BMC_CMC_Zellspannung_077_Cxffe_Init), 4095=Cxfff_Fehler (CM_BMC_CMC_Zellspannung_077_Cxfff_Fehler); unit Unit_MilliVolt
  compu method CM_BMC_CMC_Temperatur_005: phys=raw*0.5-40 for raw 0..252, 253=Cxfd_nicht_vorhanden (CM_BMC_CMC_Temperatur_005_Cxfd_nicht_vorhanden), 254=Cxfe_Init (CM_BMC_CMC_Temperatur_005_Cxfe_Init), 255=Cxff_Fehler (CM_BMC_CMC_Temperatur_005_Cxff_Fehler); unit Unit_DegreCelsi
  compu method CM_BMC_Pack_SN_13: 255=Cxff_Init (CM_BMC_Pack_SN_13_Cxff_Init)
  compu method CM_BMC_CMC_Zellspannung_143: phys=raw+1000 for raw 0..4091, 4092=Cxffc_kleiner_1V (CM_BMC_CMC_Zellspannung_143_Cxffc_kleiner_1V), 4093=Cxffd_nicht_vorhanden (CM_BMC_CMC_Zellspannung_143_Cxffd_nicht_vorhanden), 4094=Cxffe_Init (CM_BMC_CMC_Zellspannung_143_Cxffe_Init), 4095=Cxfff_Fehler (CM_BMC_CMC_Zellspannung_143_Cxfff_Fehler); unit Unit_MilliVolt
  compu method CM_DCDC_NV_Komponentenfehler_45: 0=Cx0_TstNotComplThisOpCycle_Init (CM_DCDC_NV_Komponentenfehler_45_Cx0_TstNotComplThisOpCycle_Init), 1=Cx1_TstComplThisOpCycle_Pass (CM_DCDC_NV_Komponentenfehler_45_Cx1_TstComplThisOpCycle_Pass), 2=Cx2_TstCmplThisCycle_Pass_TimeElapse (CM_DCDC_NV_Komponentenfehler_45_Cx2_TstCmplThisCycle_Pass_TimeElapse), 3=Cx3_TstComplThisOpCycle_FAIL (CM_DCDC_NV_Komponentenfehler_45_Cx3_TstComplThisOpCycle_FAIL)
  compu method CM_BMC_CMC_Temperatur_046: phys=raw*0.5-40 for raw 0..252, 253=Cxfd_nicht_vorhanden (CM_BMC_CMC_Temperatur_046_Cxfd_nicht_vorhanden), 254=Cxfe_Init (CM_BMC_CMC_Temperatur_046_Cxfe_Init), 255=Cxff_Fehler (CM_BMC_CMC_Temperatur_046_Cxff_Fehler); unit Unit_DegreCelsi
  compu method CM_BMC_CMC_Zellspannung_034: phys=raw+1000 for raw 0..4091, 4092=Cxffc_kleiner_1V (CM_BMC_CMC_Zellspannung_034_Cxffc_kleiner_1V), 4093=Cxffd_nicht_vorhanden (CM_BMC_CMC_Zellspannung_034_Cxffd_nicht_vorhanden), 4094=Cxffe_Init (CM_BMC_CMC_Zellspannung_034_Cxffe_Init), 4095=Cxfff_Fehler (CM_BMC_CMC_Zellspannung_034_Cxfff_Fehler); unit Unit_MilliVolt
  compu method CM_CMM_FlgGlbFallBkIdc: 0=Cx0_no_fallback (CM_CMM_FlgGlbFallBkIdc_Cx0_no_fallback), 1=Cx1_fallback_requested (CM_CMM_FlgGlbFallBkIdc_Cx1_fallback_requested)
  compu method CM_BMC_CMC_Temperatur_006: phys=raw*0.5-40 for raw 0..252, 253=Cxfd_nicht_vorhanden (CM_BMC_CMC_Temperatur_006_Cxfd_nicht_vorhanden), 254=Cxfe_Init (CM_BMC_CMC_Temperatur_006_Cxfe_Init), 255=Cxff_Fehler (CM_BMC_CMC_Temperatur_006_Cxff_Fehler); unit Unit_DegreCelsi
  compu method CM_BMC_CMC_Zellspannung_078: phys=raw+1000 for raw 0..4091, 4092=Cxffc_kleiner_1V (CM_BMC_CMC_Zellspannung_078_Cxffc_kleiner_1V), 4093=Cxffd_nicht_vorhanden (CM_BMC_CMC_Zellspannung_078_Cxffd_nicht_vorhanden), 4094=Cxffe_Init (CM_BMC_CMC_Zellspannung_078_Cxffe_Init), 4095=Cxfff_Fehler (CM_BMC_CMC_Zellspannung_078_Cxfff_Fehler); unit Unit_MilliVolt
  compu method CM_HVEM_AIAD_Energieinhalt: phys=raw*50 for raw 0..2045, 2046=Cx7fe_Init (CM_HVEM_AIAD_Energieinhalt_Cx7fe_Init), 2047=Cx7ff_Fehler (CM_HVEM_AIAD_Energieinhalt_Cx7ff_Fehler); unit Unit_WattHour
  compu method CM_BMC_CMC_Zellspannung_144: phys=raw+1000 for raw 0..4091, 4092=Cxffc_kleiner_1V (CM_BMC_CMC_Zellspannung_144_Cxffc_kleiner_1V), 4093=Cxffd_nicht_vorhanden (CM_BMC_CMC_Zellspannung_144_Cxffd_nicht_vorhanden), 4094=Cxffe_Init (CM_BMC_CMC_Zellspannung_144_Cxffe_Init), 4095=Cxfff_Fehler (CM_BMC_CMC_Zellspannung_144_Cxfff_Fehler); unit Unit_MilliVolt
  compu method CM_BMC_CMC_Temperatur_007: phys=raw*0.5-40 for raw 0..252, 253=Cxfd_nicht_vorhanden (CM_BMC_CMC_Temperatur_007_Cxfd_nicht_vorhanden), 254=Cxfe_Init (CM_BMC_CMC_Temperatur_007_Cxfe_Init), 255=Cxff_Fehler (CM_BMC_CMC_Temperatur_007_Cxff_Fehler); unit Unit_DegreCelsi
  compu method CM_BMC_Pack_SN_14: 255=Cxff_Init (CM_BMC_Pack_SN_14_Cxff_Init)
  compu method CM_BMC_CMC_Zellspannung_035: phys=raw+1000 for raw 0..4091, 4092=Cxffc_kleiner_1V (CM_BMC_CMC_Zellspannung_035_Cxffc_kleiner_1V), 4093=Cxffd_nicht_vorhanden (CM_BMC_CMC_Zellspannung_035_Cxffd_nicht_vorhanden), 4094=Cxffe_Init (CM_BMC_CMC_Zellspannung_035_Cxffe_Init), 4095=Cxfff_Fehler (CM_BMC_CMC_Zellspannung_035_Cxfff_Fehler); unit Unit_MilliVolt
  compu method CM_BMC_CMC_Temperatur_047: phys=raw*0.5-40 for raw 0..252, 253=Cxfd_nicht_vorhanden (CM_BMC_CMC_Temperatur_047_Cxfd_nicht_vorhanden), 254=Cxfe_Init (CM_BMC_CMC_Temperatur_047_Cxfe_Init), 255=Cxff_Fehler (CM_BMC_CMC_Temperatur_047_Cxff_Fehler); unit Unit_DegreCelsi
  compu method CM_DC_Fehler_extern: 0=Cx0_kein_Fehler (CM_DC_Fehler_extern_Cx0_kein_Fehler), 1=Cx1_Fehler (CM_DC_Fehler_extern_Cx1_Fehler)
  compu method CM_BMC_CMC_Zellspannung_079: phys=raw+1000 for raw 0..4091, 4092=Cxffc_kleiner_1V (CM_BMC_CMC_Zellspannung_079_Cxffc_kleiner_1V), 4093=Cxffd_nicht_vorhanden (CM_BMC_CMC_Zellspannung_079_Cxffd_nicht_vorhanden), 4094=Cxffe_Init (CM_BMC_CMC_Zellspannung_079_Cxffe_Init), 4095=Cxfff_Fehler (CM_BMC_CMC_Zellspannung_079_Cxfff_Fehler); unit Unit_MilliVolt
  compu method CM_BMC_CMC_Temperatur_008: phys=raw*0.5-40 for raw 0..252, 253=Cxfd_nicht_vorhanden (CM_BMC_CMC_Temperatur_008_Cxfd_nicht_vorhanden), 254=Cxfe_Init (CM_BMC_CMC_Temperatur_008_Cxfe_Init), 255=Cxff_Fehler (CM_BMC_CMC_Temperatur_008_Cxff_Fehler); unit Unit_DegreCelsi
  compu method CM_DCDC_NV_Komponentenfehler_46: 0=Cx0_TstNotComplThisOpCycle_Init (CM_DCDC_NV_Komponentenfehler_46_Cx0_TstNotComplThisOpCycle_Init), 1=Cx1_TstComplThisOpCycle_Pass (CM_DCDC_NV_Komponentenfehler_46_Cx1_TstComplThisOpCycle_Pass), 2=Cx2_TstCmplThisCycle_Pass_TimeElapse (CM_DCDC_NV_Komponentenfehler_46_Cx2_TstCmplThisCycle_Pass_TimeElapse), 3=Cx3_TstComplThisOpCycle_FAIL (CM_DCDC_NV_Komponentenfehler_46_Cx3_TstComplThisOpCycle_FAIL)
  compu method CM_BMC_CMC_Zellspannung_145: phys=raw+1000 for raw 0..4091, 4092=Cxffc_kleiner_1V (CM_BMC_CMC_Zellspannung_145_Cxffc_kleiner_1V), 4093=Cxffd_nicht_vorhanden (CM_BMC_CMC_Zellspannung_145_Cxffd_nicht_vorhanden), 4094=Cxffe_Init (CM_BMC_CMC_Zellspannung_145_Cxffe_Init), 4095=Cxfff_Fehler (CM_BMC_CMC_Zellspannung_145_Cxfff_Fehler); unit Unit_MilliVolt
  compu method CM_BMC_CMC_Zellspannung_036: phys=raw+1000 for raw 0..4091, 4092=Cxffc_kleiner_1V (CM_BMC_CMC_Zellspannung_036_Cxffc_kleiner_1V), 4093=Cxffd_nicht_vorhanden (CM_BMC_CMC_Zellspannung_036_Cxffd_nicht_vorhanden), 4094=Cxffe_Init (CM_BMC_CMC_Zellspannung_036_Cxffe_Init), 4095=Cxfff_Fehler (CM_BMC_CMC_Zellspannung_036_Cxfff_Fehler); unit Unit_MilliVolt
