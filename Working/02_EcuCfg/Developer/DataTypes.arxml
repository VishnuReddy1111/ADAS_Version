[part 4 of 5: package /Semantics]
AUTOSAR XML (schema 00048)
package /Semantics  (continued)
  compu method CM_AB_Gurtwarn_Reihe2_BF: 0=Cx0_nicht_verbaut (CM_AB_Gurtwarn_Reihe2_BF_Cx0_nicht_verbaut), 1=Cx1_keine_Gurtwarnung_Sitz_leer (CM_AB_Gurtwarn_Reihe2_BF_Cx1_keine_Gurtwarnung_Sitz_leer), 2=Cx2_keine_Gurtwarnung_Sitz_belegt (CM_AB_Gurtwarn_Reihe2_BF_Cx2_keine_Gurtwarnung_Sitz_belegt), 3=Cx3_Gurtwarnung_Sitz_belegt (CM_AB_Gurtwarn_Reihe2_BF_Cx3_Gurtwarnung_Sitz_belegt)
  compu method CM_NM_aktiv_RemoteDiensteGW: 0=Cx0_Inaktiv (CM_NM_aktiv_RemoteDiensteGW_Cx0_Inaktiv), 1=Cx1_Aktiv (CM_NM_aktiv_RemoteDiensteGW_Cx1_Aktiv)
  compu method CM_NVEM_MV_DC_uSollLV: phys=raw*0.05+10.6 for raw 0..108, 126=Cx7e_Init (CM_NVEM_MV_DC_uSollLV_Cx7e_Init), 127=Cx7f_Fehler (CM_NVEM_MV_DC_uSollLV_Cx7f_Fehler); unit Unit_Volt
  compu method CM_HVK_DCDC_Sollmodus: 0=Cx0_Standby (CM_HVK_DCDC_Sollmodus_Cx0_Standby), 1=Cx1_HV_On_Vorladen (CM_HVK_DCDC_Sollmodus_Cx1_HV_On_Vorladen), 2=Cx2_Tiefsetzen (CM_HVK_DCDC_Sollmodus_Cx2_Tiefsetzen), 3=Cx3_Hochsetzen (CM_HVK_DCDC_Sollmodus_Cx3_Hochsetzen), 4=Cx4_Pruefpuls_12V (CM_HVK_DCDC_Sollmodus_Cx4_Pruefpuls_12V), 6=Cx6_Pruefpuls_DC_Laden (CM_HVK_DCDC_Sollmodus_Cx6_Pruefpuls_DC_Laden), 7=Cx7_Initialisierung (CM_HVK_DCDC_Sollmodus_Cx7_Initialisierung)
  compu method CM_NM_HVZB_NM_State: 0=Cx0_Init (CM_NM_HVZB_NM_State_Cx0_Init), 1=Cx1_NM_RM_aus_BSM (CM_NM_HVZB_NM_State_Cx1_NM_RM_aus_BSM), 2=Cx2_NM_RM_aus_PBSM (CM_NM_HVZB_NM_State_Cx2_NM_RM_aus_PBSM), 4=Cx4_NM_NO_aus_RM (CM_NM_HVZB_NM_State_Cx4_NM_NO_aus_RM), 8=Cx8_NM_NO_aus_RS (CM_NM_HVZB_NM_State_Cx8_NM_NO_aus_RS), 16=Cx10_reserved (CM_NM_HVZB_NM_State_Cx10_reserved), 32=Cx20_reserved (CM_NM_HVZB_NM_State_Cx20_reserved)
  compu method CM_HVLM_Stecker_VerEntriegelnAnf_B: 0=Cx0_keine_Anforderung (CM_HVLM_Stecker_VerEntriegelnAnf_B_Cx0_keine_Anforderung), 1=Cx1_Ladestecker_verriegeln (CM_HVLM_Stecker_VerEntriegelnAnf_B_Cx1_Ladestecker_verriegeln), 2=Cx2_Ladestecker_entriegeln (CM_HVLM_Stecker_VerEntriegelnAnf_B_Cx2_Ladestecker_entriegeln), 3=Cx3_reserve (CM_HVLM_Stecker_VerEntriegelnAnf_B_Cx3_reserve)
  compu method CM_DCDC_NV_Komponentenfehler_80: 0=Cx0_TstNotComplThisOpCycle_Init (CM_DCDC_NV_Komponentenfehler_80_Cx0_TstNotComplThisOpCycle_Init), 1=Cx1_TstComplThisOpCycle_Pass (CM_DCDC_NV_Komponentenfehler_80_Cx1_TstComplThisOpCycle_Pass), 2=Cx2_TstCmplThisCycle_Pass_TimeElapse (CM_DCDC_NV_Komponentenfehler_80_Cx2_TstCmplThisCycle_Pass_TimeElapse), 3=Cx3_TstComplThisOpCycle_FAIL (CM_DCDC_NV_Komponentenfehler_80_Cx3_TstComplThisOpCycle_FAIL)
  compu method CM_BMC_UI2_Spannung1_Schalt_Anf: 0=Cx0_aus (CM_BMC_UI2_Spannung1_Schalt_Anf_Cx0_aus), 1=Cx1_ein (CM_BMC_UI2_Spannung1_Schalt_Anf_Cx1_ein)
  compu method CM_BMC_CMC_Zellspannung_008: phys=raw+1000 for raw 0..4091, 4092=Cxffc_kleiner_1V (CM_BMC_CMC_Zellspannung_008_Cxffc_kleiner_1V), 4093=Cxffd_nicht_vorhanden (CM_BMC_CMC_Zellspannung_008_Cxffd_nicht_vorhanden), 4094=Cxffe_Init (CM_BMC_CMC_Zellspannung_008_Cxffe_Init), 4095=Cxfff_Fehler (CM_BMC_CMC_Zellspannung_008_Cxfff_Fehler); unit Unit_MilliVolt
  compu method CM_BMC_HVK_EoHVL_Status: 0=Cx0_Init (CM_BMC_HVK_EoHVL_Status_Cx0_Init), 1=Cx1_Uzwkr_kleiner_UEoHVL_Schwell (CM_BMC_HVK_EoHVL_Status_Cx1_Uzwkr_kleiner_UEoHVL_Schwell), 2=Cx2_Uzwkr_groesgleich_UEoHVL_Schwell (CM_BMC_HVK_EoHVL_Status_Cx2_Uzwkr_groesgleich_UEoHVL_Schwell), 3=Cx3_Fehler (CM_BMC_HVK_EoHVL_Status_Cx3_Fehler)
  compu method CM_NM_aktiv_RemoteStart: 0=Cx0_Inaktiv (CM_NM_aktiv_RemoteStart_Cx0_Inaktiv), 1=Cx1_Aktiv (CM_NM_aktiv_RemoteStart_Cx1_Aktiv)
  compu method CM_NVEM_NV_BAT_ZellStatus_Index_Anf: 0=Cx0_Cell_Nr_1 (CM_NVEM_NV_BAT_ZellStatus_Index_Anf_Cx0_Cell_Nr_1), 1=Cx1_Cell_Nr_2 (CM_NVEM_NV_BAT_ZellStatus_Index_Anf_Cx1_Cell_Nr_2), 2=Cx2_Cell_Nr_3 (CM_NVEM_NV_BAT_ZellStatus_Index_Anf_Cx2_Cell_Nr_3), 3=Cx3_Cell_Nr_4 (CM_NVEM_NV_BAT_ZellStatus_Index_Anf_Cx3_Cell_Nr_4), 4=Cx4_Cell_Nr_5 (CM_NVEM_NV_BAT_ZellStatus_Index_Anf_Cx4_Cell_Nr_5), 5=Cx5_Cell_Nr_6 (CM_NVEM_NV_BAT_ZellStatus_Index_Anf_Cx5_Cell_Nr_6), 6=Cx6_Cell_Nr_7 (CM_NVEM_NV_BAT_ZellStatus_Index_Anf_Cx6_Cell_Nr_7), 7=Cx7_Cell_Nr_8 (CM_NVEM_NV_BAT_ZellStatus_Index_Anf_Cx7_Cell_Nr_8), 8=Cx8_Cell_Nr_9 (CM_NVEM_NV_BAT_ZellStatus_Index_Anf_Cx8_Cell_Nr_9), 9=Cx9_Cell_Nr_10 (CM_NVEM_NV_BAT_ZellStatus_Index_Anf_Cx9_Cell_Nr_10), 10=Cxa_Cell_Nr_11 (CM_NVEM_NV_BAT_ZellStatus_Index_Anf_Cxa_Cell_Nr_11), 11=Cxb_Cell_Nr_12 (CM_NVEM_NV_BAT_ZellStatus_Index_Anf_Cxb_Cell_Nr_12), 12=Cxc_Cell_Nr_13 (CM_NVEM_NV_BAT_ZellStatus_Index_Anf_Cxc_Cell_Nr_13), 13=Cxd_Cell_Nr_14 (CM_NVEM_NV_BAT_ZellStatus_Index_Anf_Cxd_Cell_Nr_14), 14=Cxe_Cell_Nr_15 (CM_NVEM_NV_BAT_ZellStatus_Index_Anf_Cxe_Cell_Nr_15), 15=Cxf_Cell_Nr_16 (CM_NVEM_NV_BAT_ZellStatus_Index_Anf_Cxf_Cell_Nr_16)
  compu method CM_KST_Deaktivierungs_Trigger: 0=Cx0_KEINE_DEAKTIVIERUNG_ERFOLGT_0 (CM_KST_Deaktivierungs_Trigger_Cx0_KEINE_DEAKTIVIERUNG_ERFOLGT_0), 1=Cx1_DEAKTIVIERUNG_UEBER_ZAT_1 (CM_KST_Deaktivierungs_Trigger_Cx1_DEAKTIVIERUNG_UEBER_ZAT_1), 2=Cx2_DEAKTIVIERUNG_VEREINFACHT_VLK_2 (CM_KST_Deaktivierungs_Trigger_Cx2_DEAKTIVIERUNG_VEREINFACHT_VLK_2)
  compu method CM_DCDC_NV_Komponentenfehler_28: 0=Cx0_TstNotComplThisOpCycle_Init (CM_DCDC_NV_Komponentenfehler_28_Cx0_TstNotComplThisOpCycle_Init), 1=Cx1_TstComplThisOpCycle_Pass (CM_DCDC_NV_Komponentenfehler_28_Cx1_TstComplThisOpCycle_Pass), 2=Cx2_TstCmplThisCycle_Pass_TimeElapse (CM_DCDC_NV_Komponentenfehler_28_Cx2_TstCmplThisCycle_Pass_TimeElapse), 3=Cx3_TstComplThisOpCycle_FAIL (CM_DCDC_NV_Komponentenfehler_28_Cx3_TstComplThisOpCycle_FAIL)
  compu method CM_NM_HVZB_SNI_10: 285=Cx11d_HVZB_SNI (CM_NM_HVZB_SNI_10_Cx11d_HVZB_SNI)
  compu method CM_HVLM_Stecker_VerEntriegelnAnf_C: 0=Cx0_keine_Anforderung (CM_HVLM_Stecker_VerEntriegelnAnf_C_Cx0_keine_Anforderung), 1=Cx1_Ladestecker_verriegeln (CM_HVLM_Stecker_VerEntriegelnAnf_C_Cx1_Ladestecker_verriegeln), 2=Cx2_Ladestecker_entriegeln (CM_HVLM_Stecker_VerEntriegelnAnf_C_Cx2_Ladestecker_entriegeln)
  compu method CM_NM_aktiv_RemoteVehicleTracking: 0=Cx0_Inaktiv (CM_NM_aktiv_RemoteVehicleTracking_Cx0_Inaktiv), 1=Cx1_Aktiv (CM_NM_aktiv_RemoteVehicleTracking_Cx1_Aktiv)
  compu method CM_HVK_eKAT_Sollmodus: 0=Cx0_Standby (CM_HVK_eKAT_Sollmodus_Cx0_Standby), 1=Cx1_Freigabe (CM_HVK_eKAT_Sollmodus_Cx1_Freigabe), 2=Cx2_Freigabe_ausgesetzt (CM_HVK_eKAT_Sollmodus_Cx2_Freigabe_ausgesetzt), 3=Cx3_Init (CM_HVK_eKAT_Sollmodus_Cx3_Init)
  compu method CM_NVEM_NV_BAT_ZellStatus_Typ_Anf: 0=Cx0_Init (CM_NVEM_NV_BAT_ZellStatus_Typ_Anf_Cx0_Init), 1=Cx1_Voltage (CM_NVEM_NV_BAT_ZellStatus_Typ_Anf_Cx1_Voltage), 2=Cx2_Temperature (CM_NVEM_NV_BAT_ZellStatus_Typ_Anf_Cx2_Temperature), 3=Cx3_Voltage_limit (CM_NVEM_NV_BAT_ZellStatus_Typ_Anf_Cx3_Voltage_limit) (Voltage limit), 4=Cx4_SoF (CM_NVEM_NV_BAT_ZellStatus_Typ_Anf_Cx4_SoF), 5=Cx5_SoH_C (CM_NVEM_NV_BAT_ZellStatus_Typ_Anf_Cx5_SoH_C), 6=Cx6_reserved (CM_NVEM_NV_BAT_ZellStatus_Typ_Anf_Cx6_reserved), 7=Cx7_reserved (CM_NVEM_NV_BAT_ZellStatus_Typ_Anf_Cx7_reserved)
  compu method CM_DCDC_NV_Komponentenfehler_29: 0=Cx0_TstNotComplThisOpCycle_Init (CM_DCDC_NV_Komponentenfehler_29_Cx0_TstNotComplThisOpCycle_Init), 1=Cx1_TstComplThisOpCycle_Pass (CM_DCDC_NV_Komponentenfehler_29_Cx1_TstComplThisOpCycle_Pass), 2=Cx2_TstCmplThisCycle_Pass_TimeElapse (CM_DCDC_NV_Komponentenfehler_29_Cx2_TstCmplThisCycle_Pass_TimeElapse), 3=Cx3_TstComplThisOpCycle_FAIL (CM_DCDC_NV_Komponentenfehler_29_Cx3_TstComplThisOpCycle_FAIL)
  compu method CM_DCDC_NV_Komponentenfehler_VLD: 0=Cx0_ungueltig (CM_DCDC_NV_Komponentenfehler_VLD_Cx0_ungueltig), 1=Cx1_gueltig (CM_DCDC_NV_Komponentenfehler_VLD_Cx1_gueltig)
  compu method CM_AB_Gurtwarn_Reihe2_FA: 0=Cx0_nicht_verbaut (CM_AB_Gurtwarn_Reihe2_FA_Cx0_nicht_verbaut), 1=Cx1_keine_Gurtwarnung_Sitz_leer (CM_AB_Gurtwarn_Reihe2_FA_Cx1_keine_Gurtwarnung_Sitz_leer), 2=Cx2_keine_Gurtwarnung_Sitz_belegt (CM_AB_Gurtwarn_Reihe2_FA_Cx2_keine_Gurtwarnung_Sitz_belegt), 3=Cx3_Gurtwarnung_Sitz_belegt (CM_AB_Gurtwarn_Reihe2_FA_Cx3_Gurtwarnung_Sitz_belegt)
  compu method CM_KST_Fahrerhinweis_1: 0=Cx0_inaktiv (CM_KST_Fahrerhinweis_1_Cx0_inaktiv), 1=Cx1_aktiv (CM_KST_Fahrerhinweis_1_Cx1_aktiv)
  compu method CM_BMC_HVK_Fehler_HVIL: 0=Cx0_HVIL_geschlossen (CM_BMC_HVK_Fehler_HVIL_Cx0_HVIL_geschlossen) (HVIL geschlossen), 1=Cx1_HVIL_offen (CM_BMC_HVK_Fehler_HVIL_Cx1_HVIL_offen) (HVIL offen), 2=Cx2_Fehler (CM_BMC_HVK_Fehler_HVIL_Cx2_Fehler), 3=Cx3_Init (CM_BMC_HVK_Fehler_HVIL_Cx3_Init)
  compu method CM_BMC_CMC_Zellspannung_009: phys=raw+1000 for raw 0..4091, 4092=Cxffc_kleiner_1V (CM_BMC_CMC_Zellspannung_009_Cxffc_kleiner_1V), 4093=Cxffd_nicht_vorhanden (CM_BMC_CMC_Zellspannung_009_Cxffd_nicht_vorhanden), 4094=Cxffe_Init (CM_BMC_CMC_Zellspannung_009_Cxffe_Init), 4095=Cxfff_Fehler (CM_BMC_CMC_Zellspannung_009_Cxfff_Fehler); unit Unit_MilliVolt
  compu method CM_NM_aktiv_RequestWirelessCharging: 0=Cx0_Inaktiv (CM_NM_aktiv_RequestWirelessCharging_Cx0_Inaktiv), 1=Cx1_Aktiv (CM_NM_aktiv_RequestWirelessCharging_Cx1_Aktiv)
  compu method CM_NM_HVZB_UDS_CC: 0=Cx0_Inaktiv (CM_NM_HVZB_UDS_CC_Cx0_Inaktiv), 1=Cx1_CC_aktiv (CM_NM_HVZB_UDS_CC_Cx1_CC_aktiv)
  compu method CM_HVLM_Steckerstatus: 0=Cx0_Init (CM_HVLM_Steckerstatus_Cx0_Init), 1=Cx1_kein_Stecker_erkannt (CM_HVLM_Steckerstatus_Cx1_kein_Stecker_erkannt), 2=Cx2_Stecker_erkannt (CM_HVLM_Steckerstatus_Cx2_Stecker_erkannt), 3=Cx3_Fehler (CM_HVLM_Steckerstatus_Cx3_Fehler)
  compu method CM_BMC_UI2_Spannung2_Schalt_Anf: 0=Cx0_aus (CM_BMC_UI2_Spannung2_Schalt_Anf_Cx0_aus), 1=Cx1_ein (CM_BMC_UI2_Spannung2_Schalt_Anf_Cx1_ein)
  compu method CM_NVEM_Verbraucher_Information: 0=Cx0_Keine_Anzeige (CM_NVEM_Verbraucher_Information_Cx0_Keine_Anzeige), 1=Cx1_MMI_Vorwarnung (CM_NVEM_Verbraucher_Information_Cx1_MMI_Vorwarnung), 2=Cx2_Anzeige_Verbraucherabschaltung (CM_NVEM_Verbraucher_Information_Cx2_Anzeige_Verbraucherabschaltung), 3=Cx3_reserviert (CM_NVEM_Verbraucher_Information_Cx3_reserviert), 4=Cx4_reserviert (CM_NVEM_Verbraucher_Information_Cx4_reserviert), 5=Cx5_reserviert (CM_NVEM_Verbraucher_Information_Cx5_reserviert), 6=Cx6_Init (CM_NVEM_Verbraucher_Information_Cx6_Init), 7=Cx7_Fehler (CM_NVEM_Verbraucher_Information_Cx7_Fehler)
  compu method CM_NM_aktiv_SmartCharging_Aktiv: 0=Cx0_Inaktiv (CM_NM_aktiv_SmartCharging_Aktiv_Cx0_Inaktiv), 1=Cx1_Aktiv (CM_NM_aktiv_SmartCharging_Aktiv_Cx1_Aktiv)
  compu method CM_PTOVeh_FlgTqWhlPos: 0=Cx0_overall_static_wheel_torque_is_negative_or_zero (CM_PTOVeh_FlgTqWhlPos_Cx0_overall_static_wheel_torque_is_negative_or_zero), 1=Cx1_overall_static_wheel_torque_is_positive (CM_PTOVeh_FlgTqWhlPos_Cx1_overall_static_wheel_torque_is_positive)
  compu method CM_DCDC_NV_Komponentenfehler_30: 0=Cx0_TstNotComplThisOpCycle_Init (CM_DCDC_NV_Komponentenfehler_30_Cx0_TstNotComplThisOpCycle_Init), 1=Cx1_TstComplThisOpCycle_Pass (CM_DCDC_NV_Komponentenfehler_30_Cx1_TstComplThisOpCycle_Pass), 2=Cx2_TstCmplThisCycle_Pass_TimeElapse (CM_DCDC_NV_Komponentenfehler_30_Cx2_TstCmplThisCycle_Pass_TimeElapse), 3=Cx3_TstComplThisOpCycle_FAIL (CM_DCDC_NV_Komponentenfehler_30_Cx3_TstComplThisOpCycle_FAIL)
  compu method CM_KST_Fahrerhinweis_2: 0=Cx0_inaktiv (CM_KST_Fahrerhinweis_2_Cx0_inaktiv), 1=Cx1_aktiv (CM_KST_Fahrerhinweis_2_Cx1_aktiv)
  compu method CM_HVLM_VA_Sollmodus: 0=Cx0_Nicht_aktivieren (CM_HVLM_VA_Sollmodus_Cx0_Nicht_aktivieren), 1=Cx1_Aktivieren (CM_HVLM_VA_Sollmodus_Cx1_Aktivieren), 2=Cx2_Reserviert (CM_HVLM_VA_Sollmodus_Cx2_Reserviert), 3=Cx3_Reserviert (CM_HVLM_VA_Sollmodus_Cx3_Reserviert)
  compu method CM_OBD_Abs_Pedal_Pos: phys=raw*0.3921568627 for raw 0..255; unit Unit_PerCent
  compu method CM_NM_HVZB_Wakeup_V12: 0=Cx0_Peripherie_Wakeup_Ursache_nicht_bekannt (CM_NM_HVZB_Wakeup_V12_Cx0_Peripherie_Wakeup_Ursache_nicht_bekannt), 1=Cx1_Bus_Wakeup (CM_NM_HVZB_Wakeup_V12_Cx1_Bus_Wakeup), 2=Cx2_KL15_HW (CM_NM_HVZB_Wakeup_V12_Cx2_KL15_HW)
  compu method CM_NM_aktiv_SubbusSteuerung_BMC_HV: 0=Cx0_Inaktiv (CM_NM_aktiv_SubbusSteuerung_BMC_HV_Cx0_Inaktiv), 1=Cx1_Aktiv (CM_NM_aktiv_SubbusSteuerung_BMC_HV_Cx1_Aktiv)
  compu method CM_AB_Gurtwarn_Reihe2_MI: 0=Cx0_nicht_verbaut (CM_AB_Gurtwarn_Reihe2_MI_Cx0_nicht_verbaut), 1=Cx1_keine_Gurtwarnung_Sitz_leer (CM_AB_Gurtwarn_Reihe2_MI_Cx1_keine_Gurtwarnung_Sitz_leer), 2=Cx2_keine_Gurtwarnung_Sitz_belegt (CM_AB_Gurtwarn_Reihe2_MI_Cx2_keine_Gurtwarnung_Sitz_belegt), 3=Cx3_Gurtwarnung_Sitz_belegt (CM_AB_Gurtwarn_Reihe2_MI_Cx3_Gurtwarnung_Sitz_belegt)
  compu method CM_BMC_HVK_Fehler_Intern: 0=Cx0_nicht_aktiv (CM_BMC_HVK_Fehler_Intern_Cx0_nicht_aktiv), 1=Cx1_aktiv (CM_BMC_HVK_Fehler_Intern_Cx1_aktiv), 2=Cx2_Fehler (CM_BMC_HVK_Fehler_Intern_Cx2_Fehler), 3=Cx3_Init (CM_BMC_HVK_Fehler_Intern_Cx3_Init)
  compu method CM_SI_Diagnose_Aktiv: 0=Cx0_inaktiv (CM_SI_Diagnose_Aktiv_Cx0_inaktiv), 1=Cx1_aktiv (CM_SI_Diagnose_Aktiv_Cx1_aktiv)
  compu method CM_BMC_Unterboden_Warnung: 0=Cx0_BMC_Unterboden_Warnung_keine_Warnung (CM_BMC_Unterboden_Warnung_Cx0_BMC_Unterboden_Warnung_keine_Warnung) (BMC_Unterboden_Warnung=keine_Warnung), 1=Cx1_BMC_Unterboden_Warnung_1 (CM_BMC_Unterboden_Warnung_Cx1_BMC_Unterboden_Warnung_1) (BMC_Unterboden_Warnung=1), 2=Cx2_BMC_Unterboden_Warnung_2 (CM_BMC_Unterboden_Warnung_Cx2_BMC_Unterboden_Warnung_2) (BMC_Unterboden_Warnung=2), 3=Cx3_BMC_Unterboden_Warnung_3 (CM_BMC_Unterboden_Warnung_Cx3_BMC_Unterboden_Warnung_3) (BMC_Unterboden_Warnung=3), 4=Cx4_BMC_Unterboden_Warnung_4 (CM_BMC_Unterboden_Warnung_Cx4_BMC_Unterboden_Warnung_4) (BMC_Unterboden_Warnung=4), 5=Cx5_BMC_Unterboden_Warnung_5 (CM_BMC_Unterboden_Warnung_Cx5_BMC_Unterboden_Warnung_5) (BMC_Unterboden_Warnung=5), 6=Cx6_BMC_Unterboden_Warnung_6 (CM_BMC_Unterboden_Warnung_Cx6_BMC_Unterboden_Warnung_6) (BMC_Unterboden_Warnung=6), 7=Cx7_Fehler (CM_BMC_Unterboden_Warnung_Cx7_Fehler)
  compu method CM_OBD_Aussen_Temp_gef: phys=raw-40 for raw 0..253, 254=Cxfe_Initwert (CM_OBD_Aussen_Temp_gef_Cxfe_Initwert), 255=Cxff_Fehler (CM_OBD_Aussen_Temp_gef_Cxff_Fehler); unit Unit_DegreCelsi
  compu method CM_KST_Fahrerhinweis_3: 0=Cx0_inaktiv (CM_KST_Fahrerhinweis_3_Cx0_inaktiv), 1=Cx1_aktiv (CM_KST_Fahrerhinweis_3_Cx1_aktiv)
  compu method CM_DCDC_NV_Komponentenfehler_31: 0=Cx0_TstNotComplThisOpCycle_Init (CM_DCDC_NV_Komponentenfehler_31_Cx0_TstNotComplThisOpCycle_Init), 1=Cx1_TstComplThisOpCycle_Pass (CM_DCDC_NV_Komponentenfehler_31_Cx1_TstComplThisOpCycle_Pass), 2=Cx2_TstCmplThisCycle_Pass_TimeElapse (CM_DCDC_NV_Komponentenfehler_31_Cx2_TstCmplThisCycle_Pass_TimeElapse), 3=Cx3_TstComplThisOpCycle_FAIL (CM_DCDC_NV_Komponentenfehler_31_Cx3_TstComplThisOpCycle_FAIL)
  compu method CM_NM_aktiv_SubbusSteuerung_HCP5: 0=Cx0_Inaktiv (CM_NM_aktiv_SubbusSteuerung_HCP5_Cx0_Inaktiv), 1=Cx1_Aktiv (CM_NM_aktiv_SubbusSteuerung_HCP5_Cx1_Aktiv)
  compu method CM_HVLM_VALeistungFzg: phys=raw*10 for raw 0..4092, 4093=Cxffd_keine_Angabe (CM_HVLM_VALeistungFzg_Cxffd_keine_Angabe), 4094=Cxffe_Init (CM_HVLM_VALeistungFzg_Cxffe_Init), 4095=Cxfff_Fehler (CM_HVLM_VALeistungFzg_Cxfff_Fehler); unit Unit_Watt
  compu method CM_NM_Hybrid_01_CAB_V12: 0=Cx0_Inaktiv (CM_NM_Hybrid_01_CAB_V12_Cx0_Inaktiv), 1=Cx1_01_CarWakeUp (CM_NM_Hybrid_01_CAB_V12_Cx1_01_CarWakeUp), 2=Cx2_30_EnergyManagement (CM_NM_Hybrid_01_CAB_V12_Cx2_30_EnergyManagement), 4=Cx4_40_Diagnosis_Energy (CM_NM_Hybrid_01_CAB_V12_Cx4_40_Diagnosis_Energy)
  compu method CM_TME_Kuehlerjalousie_Ausfall: 0=Cx0_kein_Ausfall (CM_TME_Kuehlerjalousie_Ausfall_Cx0_kein_Ausfall), 1=Cx1_Ausfall (CM_TME_Kuehlerjalousie_Ausfall_Cx1_Ausfall)
  compu method CM_OBD_Barometric_Pressure: phys=raw for raw 0..255; unit Unit_KiloPascal
  compu method CM_SI_NWDF: 0=Cx0_Ueberwachung_nicht_freigegeben (CM_SI_NWDF_Cx0_Ueberwachung_nicht_freigegeben), 1=Cx1_Ueberwachung_freigegeben (CM_SI_NWDF_Cx1_Ueberwachung_freigegeben)
  compu method CM_NM_aktiv_Timer_abgelaufen: 0=Cx0_Inaktiv (CM_NM_aktiv_Timer_abgelaufen_Cx0_Inaktiv), 1=Cx1_Aktiv (CM_NM_aktiv_Timer_abgelaufen_Cx1_Aktiv)
  compu method CM_KST_Fahrerhinweis_4: 0=Cx0_inaktiv (CM_KST_Fahrerhinweis_4_Cx0_inaktiv), 1=Cx1_aktiv (CM_KST_Fahrerhinweis_4_Cx1_aktiv)
  compu method CM_DCDC_NV_Komponentenfehler_32: 0=Cx0_TstNotComplThisOpCycle_Init (CM_DCDC_NV_Komponentenfehler_32_Cx0_TstNotComplThisOpCycle_Init), 1=Cx1_TstComplThisOpCycle_Pass (CM_DCDC_NV_Komponentenfehler_32_Cx1_TstComplThisOpCycle_Pass), 2=Cx2_TstCmplThisCycle_Pass_TimeElapse (CM_DCDC_NV_Komponentenfehler_32_Cx2_TstCmplThisCycle_Pass_TimeElapse), 3=Cx3_TstComplThisOpCycle_FAIL (CM_DCDC_NV_Komponentenfehler_32_Cx3_TstComplThisOpCycle_FAIL)
  compu method CM_AB_Gurtwarn_Reihe3_BF: 0=Cx0_nicht_verbaut (CM_AB_Gurtwarn_Reihe3_BF_Cx0_nicht_verbaut), 1=Cx1_keine_Gurtwarnung_Sitz_leer (CM_AB_Gurtwarn_Reihe3_BF_Cx1_keine_Gurtwarnung_Sitz_leer), 2=Cx2_keine_Gurtwarnung_Sitz_belegt (CM_AB_Gurtwarn_Reihe3_BF_Cx2_keine_Gurtwarnung_Sitz_belegt), 3=Cx3_Gurtwarnung_Sitz_belegt (CM_AB_Gurtwarn_Reihe3_BF_Cx3_Gurtwarnung_Sitz_belegt)
  compu method CM_NM_Hybrid_01_CBV_AWB: 0=Cx0_Passiver_WakeUp (CM_NM_Hybrid_01_CBV_AWB_Cx0_Passiver_WakeUp), 1=Cx1_Aktiver_WakeUp (CM_NM_Hybrid_01_CBV_AWB_Cx1_Aktiver_WakeUp)
  compu method CM_HVLM_VASpannungFzg: phys=raw for raw 0..1020, 1021=Cx3fd_keine_Angabe (CM_HVLM_VASpannungFzg_Cx3fd_keine_Angabe), 1022=Cx3fe_Init (CM_HVLM_VASpannungFzg_Cx3fe_Init), 1023=Cx3ff_Fehler (CM_HVLM_VASpannungFzg_Cx3ff_Fehler); unit Unit_Volt
  compu method CM_BMC_Unterspannungszaehler_CMC01: phys=raw for raw 0..400, 510=Cx1fe_InitWert (CM_BMC_Unterspannungszaehler_CMC01_Cx1fe_InitWert), 511=Cx1ff_Fehler (CM_BMC_Unterspannungszaehler_CMC01_Cx1ff_Fehler); unit Unit_None
  compu method CM_NM_aktiv_VehicleStatReport_Main: 0=Cx0_Inaktiv (CM_NM_aktiv_VehicleStatReport_Main_Cx0_Inaktiv), 1=Cx1_Aktiv (CM_NM_aktiv_VehicleStatReport_Main_Cx1_Aktiv)
  compu method CM_UI1_KompFehlerModus2_18: 0=Cx0_TNCTOC (CM_UI1_KompFehlerModus2_18_Cx0_TNCTOC), 1=Cx1_TP_TC (CM_UI1_KompFehlerModus2_18_Cx1_TP_TC), 2=Cx2_TP_TC_WCMTL (CM_UI1_KompFehlerModus2_18_Cx2_TP_TC_WCMTL), 3=Cx3_TF_TC_Error (CM_UI1_KompFehlerModus2_18_Cx3_TF_TC_Error)
  compu method CM_BMC_HVK_Fehler_SD: 0=Cx0_SD_gesteckt (CM_BMC_HVK_Fehler_SD_Cx0_SD_gesteckt), 1=Cx1_SD_gezogen (CM_BMC_HVK_Fehler_SD_Cx1_SD_gezogen), 2=Cx2_Fehler (CM_BMC_HVK_Fehler_SD_Cx2_Fehler), 3=Cx3_Init (CM_BMC_HVK_Fehler_SD_Cx3_Init)
  compu method CM_OBD_Calc_Load_Val: phys=raw*0.3921568627 for raw 0..255; unit Unit_PerCent
  compu method CM_SI_NWDF_30: 0=Cx0_Ueberwachung_nicht_freigegeben (CM_SI_NWDF_30_Cx0_Ueberwachung_nicht_freigegeben), 1=Cx1_Ueberwachung_freigegeben (CM_SI_NWDF_30_Cx1_Ueberwachung_freigegeben)
  compu method CM_DCDC_NV_Komponentenfehler_33: 0=Cx0_TstNotComplThisOpCycle_Init (CM_DCDC_NV_Komponentenfehler_33_Cx0_TstNotComplThisOpCycle_Init), 1=Cx1_TstComplThisOpCycle_Pass (CM_DCDC_NV_Komponentenfehler_33_Cx1_TstComplThisOpCycle_Pass), 2=Cx2_TstCmplThisCycle_Pass_TimeElapse (CM_DCDC_NV_Komponentenfehler_33_Cx2_TstCmplThisCycle_Pass_TimeElapse), 3=Cx3_TstComplThisOpCycle_FAIL (CM_DCDC_NV_Komponentenfehler_33_Cx3_TstComplThisOpCycle_FAIL)
  compu method CM_TME_Kuehlerluefter_Totalausfall: 0=Cx0_kein_Ausfall (CM_TME_Kuehlerluefter_Totalausfall_Cx0_kein_Ausfall), 1=Cx1_Ausfall (CM_TME_Kuehlerluefter_Totalausfall_Cx1_Ausfall)
  compu method CM_KST_Fahrerhinweis_5: 0=Cx0_inaktiv (CM_KST_Fahrerhinweis_5_Cx0_inaktiv), 1=Cx1_aktiv (CM_KST_Fahrerhinweis_5_Cx1_aktiv)
  compu method CM_NM_aktiv_WarnblinkerInfo: 0=Cx0_Inaktiv (CM_NM_aktiv_WarnblinkerInfo_Cx0_Inaktiv), 1=Cx1_Aktiv (CM_NM_aktiv_WarnblinkerInfo_Cx1_Aktiv)
  compu method CM_NM_Hybrid_01_CBV_CRI: 0=Cx0_NM_ohne_Clusteranforderungen (CM_NM_Hybrid_01_CBV_CRI_Cx0_NM_ohne_Clusteranforderungen), 1=Cx1_NM_mit_Clusteranforderungen (CM_NM_Hybrid_01_CBV_CRI_Cx1_NM_mit_Clusteranforderungen)
  compu method CM_HVLM_VAStromFzg: phys=raw*0.1 for raw 0..1020, 1021=Cx3fd_keine_Angabe (CM_HVLM_VAStromFzg_Cx3fd_keine_Angabe), 1022=Cx3fe_Init (CM_HVLM_VAStromFzg_Cx3fe_Init), 1023=Cx3ff_Fehler (CM_HVLM_VAStromFzg_Cx3ff_Fehler); unit Unit_Amper
  compu method CM_OBD_ClearMem_Inhibit: 0=Cx0_FSP_Loeschen_zulaessig (CM_OBD_ClearMem_Inhibit_Cx0_FSP_Loeschen_zulaessig), 1=Cx1_FSP_Loeschen_nicht_zulaessig (CM_OBD_ClearMem_Inhibit_Cx1_FSP_Loeschen_nicht_zulaessig)
  compu method CM_AB_Gurtwarn_Reihe3_FA: 0=Cx0_nicht_verbaut (CM_AB_Gurtwarn_Reihe3_FA_Cx0_nicht_verbaut), 1=Cx1_keine_Gurtwarnung_Sitz_leer (CM_AB_Gurtwarn_Reihe3_FA_Cx1_keine_Gurtwarnung_Sitz_leer), 2=Cx2_keine_Gurtwarnung_Sitz_belegt (CM_AB_Gurtwarn_Reihe3_FA_Cx2_keine_Gurtwarnung_Sitz_belegt), 3=Cx3_Gurtwarnung_Sitz_belegt (CM_AB_Gurtwarn_Reihe3_FA_Cx3_Gurtwarnung_Sitz_belegt)
  compu method CM_SI_NWDF_gueltig: 0=Cx0_NWDF_wird_nicht_unterstuetzt (CM_SI_NWDF_gueltig_Cx0_NWDF_wird_nicht_unterstuetzt), 1=Cx1_NWDF_wird_unterstuetzt (CM_SI_NWDF_gueltig_Cx1_NWDF_wird_unterstuetzt)
  compu method CM_NM_AWC_CBV_AWB: 0=Cx0_Passiver_WakeUp (CM_NM_AWC_CBV_AWB_Cx0_Passiver_WakeUp), 1=Cx1_Aktiver_WakeUp (CM_NM_AWC_CBV_AWB_Cx1_Aktiver_WakeUp)
  compu method CM_BMC_Unterspannungszaehler_CMC02: phys=raw for raw 0..400, 510=Cx1fe_InitWert (CM_BMC_Unterspannungszaehler_CMC02_Cx1fe_InitWert), 511=Cx1ff_Fehler (CM_BMC_Unterspannungszaehler_CMC02_Cx1ff_Fehler); unit Unit_None
  compu method CM_OBD_Driving_Cycle: 0=Cx0_kein_Driving_Cycle_erkannt (CM_OBD_Driving_Cycle_Cx0_kein_Driving_Cycle_erkannt), 1=Cx1_Driving_Cycle_erkannt (CM_OBD_Driving_Cycle_Cx1_Driving_Cycle_erkannt)
  compu method CM_KST_Fahrerhinweis_6: 0=Cx0_inaktiv (CM_KST_Fahrerhinweis_6_Cx0_inaktiv), 1=Cx1_aktiv (CM_KST_Fahrerhinweis_6_Cx1_aktiv)
  compu method CM_UI2_KompFehlerModus2_24: 0=Cx0_TNCTOC (CM_UI2_KompFehlerModus2_24_Cx0_TNCTOC), 1=Cx1_TP_TC (CM_UI2_KompFehlerModus2_24_Cx1_TP_TC), 2=Cx2_TP_TC_WCMTL (CM_UI2_KompFehlerModus2_24_Cx2_TP_TC_WCMTL), 3=Cx3_TF_TC_Error (CM_UI2_KompFehlerModus2_24_Cx3_TF_TC_Error)
  compu method CM_HVLM_WakeUpZaehlerResetAnf: 0=Cx0_keine_Anforderung (CM_HVLM_WakeUpZaehlerResetAnf_Cx0_keine_Anforderung), 1=Cx1_Reset_Zaehler (CM_HVLM_WakeUpZaehlerResetAnf_Cx1_Reset_Zaehler)
  compu method CM_NM_Hybrid_01_FCAB: 0=Cx0_Init (CM_NM_Hybrid_01_FCAB_Cx0_Init), 1=Cx1_01_CarWakeUp (CM_NM_Hybrid_01_FCAB_Cx1_01_CarWakeUp), 2=Cx2_02_Basefunction_Powertrain (CM_NM_Hybrid_01_FCAB_Cx2_02_Basefunction_Powertrain), 4=Cx4_03_Basefunction_Chassis (CM_NM_Hybrid_01_FCAB_Cx4_03_Basefunction_Chassis), 8=Cx8_04_Basefunction_DrivingAssistance (CM_NM_Hybrid_01_FCAB_Cx8_04_Basefunction_DrivingAssistance), 16=Cx10_05_Basefunction_Infotainment (CM_NM_Hybrid_01_FCAB_Cx10_05_Basefunction_Infotainment), 32=Cx20_06_Basefunction_ComfortLight (CM_NM_Hybrid_01_FCAB_Cx20_06_Basefunction_ComfortLight), 64=Cx40_07_Basefunction_CrossSection (CM_NM_Hybrid_01_FCAB_Cx40_07_Basefunction_CrossSection), 128=Cx80_08_Basefunction_Connectivity (CM_NM_Hybrid_01_FCAB_Cx80_08_Basefunction_Connectivity), 256=Cx100_09_Basefunction_DrivingAssistanceCore (CM_NM_Hybrid_01_FCAB_Cx100_09_Basefunction_DrivingAssistanceCore), 512=Cx200_10_Powertrain (CM_NM_Hybrid_01_FCAB_Cx200_10_Powertrain), 1024=Cx400_11_Chassis (CM_NM_Hybrid_01_FCAB_Cx400_11_Chassis), 2048=Cx800_12_GearSelector (CM_NM_Hybrid_01_FCAB_Cx800_12_GearSelector), 4096=Cx1000_13_Airbag (CM_NM_Hybrid_01_FCAB_Cx1000_13_Airbag), 8192=Cx2000_14_InfotainmentExtensions (CM_NM_Hybrid_01_FCAB_Cx2000_14_InfotainmentExtensions), 16384=Cx4000_15_InstrumentclusterDisplay (CM_NM_Hybrid_01_FCAB_Cx4000_15_InstrumentclusterDisplay), 32768=Cx8000_16_InfotainmentDisplay (CM_NM_Hybrid_01_FCAB_Cx8000_16_InfotainmentDisplay), 65536=Cx10000_17_Audio (CM_NM_Hybrid_01_FCAB_Cx10000_17_Audio), 131072=Cx20000_18_VirtualSideMirrors (CM_NM_Hybrid_01_FCAB_Cx20000_18_VirtualSideMirrors), 262144=Cx40000_19_Doors_Hatches (CM_NM_Hybrid_01_FCAB_Cx40000_19_Doors_Hatches), 524288=Cx80000_20_OptionalComfort (CM_NM_Hybrid_01_FCAB_Cx80000_20_OptionalComfort), 1048576=Cx100000_21_AirSuspension (CM_NM_Hybrid_01_FCAB_Cx100000_21_AirSuspension), 2097152=Cx200000_22_ExteriorLights (CM_NM_Hybrid_01_FCAB_Cx200000_22_ExteriorLights), 4194304=Cx400000_23_Climate (CM_NM_Hybrid_01_FCAB_Cx400000_23_Climate), 8388608=Cx800000_24_ThermoManagement (CM_NM_Hybrid_01_FCAB_Cx800000_24_ThermoManagement), 16777216=Cx1000000_25_AccessSystemSensors (CM_NM_Hybrid_01_FCAB_Cx1000000_25_AccessSystemSensors), 33554432=Cx2000000_26_HighVoltage_Charging (CM_NM_Hybrid_01_FCAB_Cx2000000_26_HighVoltage_Charging), 67108864=Cx4000000_27_Timemaster_Timer (CM_NM_Hybrid_01_FCAB_Cx4000000_27_Timemaster_Timer), 134217728=Cx8000000_28_OnboardTester_DataCollector (CM_NM_Hybrid_01_FCAB_Cx8000000_28_OnboardTester_DataCollector), 268435456=Cx10000000_29_SteeringColumnLock (CM_NM_Hybrid_01_FCAB_Cx10000000_29_SteeringColumnLock), 536870912=Cx20000000_30_EnergyManagement (CM_NM_Hybrid_01_FCAB_Cx20000000_30_EnergyManagement), 1073741824=Cx40000000_31_MultifunctionalSteeringWheel (CM_NM_Hybrid_01_FCAB_Cx40000000_31_MultifunctionalSteeringWheel), 2147483648=Cx80000000_32_OnlineAccess (CM_NM_Hybrid_01_FCAB_Cx80000000_32_OnlineAccess), 4294967296=Cx100000000_33_ExternalWirelessCommunication (CM_NM_Hybrid_01_FCAB_Cx100000000_33_ExternalWirelessCommunication), 8589934592=Cx200000000_34_GPS_Localization (CM_NM_Hybrid_01_FCAB_Cx200000000_34_GPS_Localization), 17179869184=Cx400000000_35_ExteriorSound (CM_NM_Hybrid_01_FCAB_Cx400000000_35_ExteriorSound), 34359738368=Cx800000000_36_Preheater (CM_NM_Hybrid_01_FCAB_Cx800000000_36_Preheater), 68719476736=Cx1000000000_37_HighVoltage_WirelessChargingStation (CM_NM_Hybrid_01_FCAB_Cx1000000000_37_HighVoltage_WirelessChargingStation), 549755813888=Cx8000000000_40_Diagnosis_Energy (CM_NM_Hybrid_01_FCAB_Cx8000000000_40_Diagnosis_Energy), 1099511627776=Cx10000000000_41_Diagnosis_Powertrain (CM_NM_Hybrid_01_FCAB_Cx10000000000_41_Diagnosis_Powertrain), 2199023255552=Cx20000000000_42_Diagnosis_FlexRay (CM_NM_Hybrid_01_FCAB_Cx20000000000_42_Diagnosis_FlexRay), 4398046511104=Cx40000000000_43_Diagnosis_DrivingAssistance (CM_NM_Hybrid_01_FCAB_Cx40000000000_43_Diagnosis_DrivingAssistance), 8796093022208=Cx80000000000_44_Diagnosis_Infotainment (CM_NM_Hybrid_01_FCAB_Cx80000000000_44_Diagnosis_Infotainment), 17592186044416=Cx100000000000_45_Diagnosis_Comfort (CM_NM_Hybrid_01_FCAB_Cx100000000000_45_Diagnosis_Comfort), 35184372088832=Cx200000000000_46_Diagnosis_Light (CM_NM_Hybrid_01_FCAB_Cx200000000000_46_Diagnosis_Light), 70368744177664=Cx400000000000_47_Diagnosis_ComfortLINs (CM_NM_Hybrid_01_FCAB_Cx400000000000_47_Diagnosis_ComfortLINs), 140737488355328=Cx800000000000_48_Diagnosis_ClimateTmeLINs (CM_NM_Hybrid_01_FCAB_Cx800000000000_48_Diagnosis_ClimateTmeLINs), 281474976710656=Cx1000000000000_49_reserved (CM_NM_Hybrid_01_FCAB_Cx1000000000000_49_reserved) (49_<reserved>), 4503599627370496=Cx10000000000000_53_Lock_Unlock (CM_NM_Hybrid_01_FCAB_Cx10000000000000_53_Lock_Unlock), 9007199254740992=Cx20000000000000_54_reserved (CM_NM_Hybrid_01_FCAB_Cx20000000000000_54_reserved) (54_<reserved>), 18014398509481984=Cx40000000000000_55_Dimming (CM_NM_Hybrid_01_FCAB_Cx40000000000000_55_Dimming), 36028797018963968=Cx80000000000000_56_ChargingStatus (CM_NM_Hybrid_01_FCAB_Cx80000000000000_56_ChargingStatus)
  compu method CM_BMC_Iso_Mode_Anf: 0=Cx0_Init (CM_BMC_Iso_Mode_Anf_Cx0_Init), 1=Cx1_zyklisch_Zeit1 (CM_BMC_Iso_Mode_Anf_Cx1_zyklisch_Zeit1), 2=Cx2_zyklisch_Zeit2 (CM_BMC_Iso_Mode_Anf_Cx2_zyklisch_Zeit2), 3=Cx3_zyklisch_Zeit3 (CM_BMC_Iso_Mode_Anf_Cx3_zyklisch_Zeit3), 4=Cx4_Pause (CM_BMC_Iso_Mode_Anf_Cx4_Pause), 5=Cx5_Einzelmessung (CM_BMC_Iso_Mode_Anf_Cx5_Einzelmessung), 6=Cx6_Schnellmessung (CM_BMC_Iso_Mode_Anf_Cx6_Schnellmessung), 7=Cx7_Aus (CM_BMC_Iso_Mode_Anf_Cx7_Aus)
  compu method CM_NM_AWC_CBV_CRI: 0=Cx0_NM_ohne_Clusteranforderungen (CM_NM_AWC_CBV_CRI_Cx0_NM_ohne_Clusteranforderungen), 1=Cx1_NM_mit_Clusteranforderungen (CM_NM_AWC_CBV_CRI_Cx1_NM_mit_Clusteranforderungen)
  compu method CM_UI2Sens02_CALID_Index_09: phys=raw for raw 0..255
  compu method CM_UI1_KompFehlerModus2_19: 0=Cx0_TNCTOC (CM_UI1_KompFehlerModus2_19_Cx0_TNCTOC), 1=Cx1_TP_TC (CM_UI1_KompFehlerModus2_19_Cx1_TP_TC), 2=Cx2_TP_TC_WCMTL (CM_UI1_KompFehlerModus2_19_Cx2_TP_TC_WCMTL), 3=Cx3_TF_TC_Error (CM_UI1_KompFehlerModus2_19_Cx3_TF_TC_Error)
  compu method CM_SI_P_Mode: 0=Cx0_inaktiv (CM_SI_P_Mode_Cx0_inaktiv), 1=Cx1_aktiv (CM_SI_P_Mode_Cx1_aktiv)
  compu method CM_OBD_Eng_Cool_Temp: phys=raw-40 for raw 0..255; unit Unit_DegreCelsi
  compu method CM_AB_Gurtwarn_Reihe3_MI: 0=Cx0_nicht_verbaut (CM_AB_Gurtwarn_Reihe3_MI_Cx0_nicht_verbaut), 1=Cx1_keine_Gurtwarnung_Sitz_leer (CM_AB_Gurtwarn_Reihe3_MI_Cx1_keine_Gurtwarnung_Sitz_leer), 2=Cx2_keine_Gurtwarnung_Sitz_belegt (CM_AB_Gurtwarn_Reihe3_MI_Cx2_keine_Gurtwarnung_Sitz_belegt), 3=Cx3_Gurtwarnung_Sitz_belegt (CM_AB_Gurtwarn_Reihe3_MI_Cx3_Gurtwarnung_Sitz_belegt)
  compu method CM_TME_LED_STK: 0=Cx0_LED_aus (CM_TME_LED_STK_Cx0_LED_aus), 1=Cx1_LED_ein (CM_TME_LED_STK_Cx1_LED_ein), 2=Cx2_LED_blinken (CM_TME_LED_STK_Cx2_LED_blinken), 3=Cx3_Funktion_gesperrt_LED_aus (CM_TME_LED_STK_Cx3_Funktion_gesperrt_LED_aus), 6=Cx6_Init (CM_TME_LED_STK_Cx6_Init)
  compu method CM_HVLM_WLAN_Aktivieren: 0=Cx0_Nicht_aktivieren (CM_HVLM_WLAN_Aktivieren_Cx0_Nicht_aktivieren), 1=Cx1_Aktivieren (CM_HVLM_WLAN_Aktivieren_Cx1_Aktivieren)
  compu method CM_KST_KL_15: 0=Cx0_aus (CM_KST_KL_15_Cx0_aus), 1=Cx1_ein (CM_KST_KL_15_Cx1_ein)
  compu method CM_NM_Hybrid_01_FCIB: 1=Cx1_01_CarWakeUp (CM_NM_Hybrid_01_FCIB_Cx1_01_CarWakeUp), 2=Cx2_02_Basefunction_Powertrain (CM_NM_Hybrid_01_FCIB_Cx2_02_Basefunction_Powertrain), 4=Cx4_03_Basefunction_Chassis (CM_NM_Hybrid_01_FCIB_Cx4_03_Basefunction_Chassis), 8=Cx8_04_Basefunction_DrivingAssistance (CM_NM_Hybrid_01_FCIB_Cx8_04_Basefunction_DrivingAssistance), 16=Cx10_05_Basefunction_Infotainment (CM_NM_Hybrid_01_FCIB_Cx10_05_Basefunction_Infotainment), 32=Cx20_06_Basefunction_ComfortLight (CM_NM_Hybrid_01_FCIB_Cx20_06_Basefunction_ComfortLight), 64=Cx40_07_Basefunction_CrossSection (CM_NM_Hybrid_01_FCIB_Cx40_07_Basefunction_CrossSection), 128=Cx80_08_Basefunction_Connectivity (CM_NM_Hybrid_01_FCIB_Cx80_08_Basefunction_Connectivity), 256=Cx100_09_reserved (CM_NM_Hybrid_01_FCIB_Cx100_09_reserved) (09_<reserved>), 512=Cx200_10_Powertrain (CM_NM_Hybrid_01_FCIB_Cx200_10_Powertrain), 1024=Cx400_11_Chassis (CM_NM_Hybrid_01_FCIB_Cx400_11_Chassis), 2048=Cx800_12_GearSelector (CM_NM_Hybrid_01_FCIB_Cx800_12_GearSelector), 4096=Cx1000_13_Airbag (CM_NM_Hybrid_01_FCIB_Cx1000_13_Airbag), 8192=Cx2000_14_InfotainmentExtensions (CM_NM_Hybrid_01_FCIB_Cx2000_14_InfotainmentExtensions), 16384=Cx4000_15_InstrumentclusterDisplay (CM_NM_Hybrid_01_FCIB_Cx4000_15_InstrumentclusterDisplay), 32768=Cx8000_16_InfotainmentDisplay (CM_NM_Hybrid_01_FCIB_Cx8000_16_InfotainmentDisplay), 65536=Cx10000_17_Audio (CM_NM_Hybrid_01_FCIB_Cx10000_17_Audio), 131072=Cx20000_18_VirtualSideMirrors (CM_NM_Hybrid_01_FCIB_Cx20000_18_VirtualSideMirrors), 262144=Cx40000_19_Doors_Hatches (CM_NM_Hybrid_01_FCIB_Cx40000_19_Doors_Hatches), 524288=Cx80000_20_OptionalComfort (CM_NM_Hybrid_01_FCIB_Cx80000_20_OptionalComfort), 1048576=Cx100000_21_AirSuspension (CM_NM_Hybrid_01_FCIB_Cx100000_21_AirSuspension), 2097152=Cx200000_22_ExteriorLights (CM_NM_Hybrid_01_FCIB_Cx200000_22_ExteriorLights), 4194304=Cx400000_23_Climate (CM_NM_Hybrid_01_FCIB_Cx400000_23_Climate), 8388608=Cx800000_24_ThermoManagement (CM_NM_Hybrid_01_FCIB_Cx800000_24_ThermoManagement), 16777216=Cx1000000_25_AccessSystemSensors (CM_NM_Hybrid_01_FCIB_Cx1000000_25_AccessSystemSensors), 33554432=Cx2000000_26_HighVoltage_Charging (CM_NM_Hybrid_01_FCIB_Cx2000000_26_HighVoltage_Charging), 67108864=Cx4000000_27_Timemaster_Timer (CM_NM_Hybrid_01_FCIB_Cx4000000_27_Timemaster_Timer), 134217728=Cx8000000_28_OnboardTester_DataCollector (CM_NM_Hybrid_01_FCIB_Cx8000000_28_OnboardTester_DataCollector), 268435456=Cx10000000_29_SteeringColumnLock (CM_NM_Hybrid_01_FCIB_Cx10000000_29_SteeringColumnLock), 536870912=Cx20000000_30_EnergyManagement (CM_NM_Hybrid_01_FCIB_Cx20000000_30_EnergyManagement), 1073741824=Cx40000000_31_MultifunctionalSteeringWheel (CM_NM_Hybrid_01_FCIB_Cx40000000_31_MultifunctionalSteeringWheel), 2147483648=Cx80000000_32_OnlineAccess (CM_NM_Hybrid_01_FCIB_Cx80000000_32_OnlineAccess), 4294967296=Cx100000000_33_ExternalWirelessCommunication (CM_NM_Hybrid_01_FCIB_Cx100000000_33_ExternalWirelessCommunication), 8589934592=Cx200000000_34_GPS_Localization (CM_NM_Hybrid_01_FCIB_Cx200000000_34_GPS_Localization), 17179869184=Cx400000000_35_ExteriorSound (CM_NM_Hybrid_01_FCIB_Cx400000000_35_ExteriorSound), 34359738368=Cx800000000_36_Preheater (CM_NM_Hybrid_01_FCIB_Cx800000000_36_Preheater), 68719476736=Cx1000000000_37_HighVoltage_WirelessChargingStation (CM_NM_Hybrid_01_FCIB_Cx1000000000_37_HighVoltage_WirelessChargingStation), 549755813888=Cx8000000000_40_Diagnosis_Energy (CM_NM_Hybrid_01_FCIB_Cx8000000000_40_Diagnosis_Energy), 550326239233=Cx8022000001_InitValueFCIB (CM_NM_Hybrid_01_FCIB_Cx8022000001_InitValueFCIB), 1099511627776=Cx10000000000_41_Diagnosis_Powertrain (CM_NM_Hybrid_01_FCIB_Cx10000000000_41_Diagnosis_Powertrain), 2199023255552=Cx20000000000_42_Diagnosis_FlexRay (CM_NM_Hybrid_01_FCIB_Cx20000000000_42_Diagnosis_FlexRay), 4398046511104=Cx40000000000_43_Diagnosis_DrivingAssistance (CM_NM_Hybrid_01_FCIB_Cx40000000000_43_Diagnosis_DrivingAssistance), 8796093022208=Cx80000000000_44_Diagnosis_Infotainment (CM_NM_Hybrid_01_FCIB_Cx80000000000_44_Diagnosis_Infotainment), 17592186044416=Cx100000000000_45_Diagnosis_Comfort (CM_NM_Hybrid_01_FCIB_Cx100000000000_45_Diagnosis_Comfort), 35184372088832=Cx200000000000_46_Diagnosis_Light (CM_NM_Hybrid_01_FCIB_Cx200000000000_46_Diagnosis_Light), 70368744177664=Cx400000000000_47_Diagnosis_ComfortLINs (CM_NM_Hybrid_01_FCIB_Cx400000000000_47_Diagnosis_ComfortLINs), 140737488355328=Cx800000000000_48_Diagnosis_ClimateTmeLINs (CM_NM_Hybrid_01_FCIB_Cx800000000000_48_Diagnosis_ClimateTmeLINs), 281474976710656=Cx1000000000000_49_reserved (CM_NM_Hybrid_01_FCIB_Cx1000000000000_49_reserved) (49_<reserved>), 4503599627370496=Cx10000000000000_53_Lock_Unlock (CM_NM_Hybrid_01_FCIB_Cx10000000000000_53_Lock_Unlock), 9007199254740992=Cx20000000000000_54_reserved (CM_NM_Hybrid_01_FCIB_Cx20000000000000_54_reserved) (54_<reserved>), 18014398509481984=Cx40000000000000_55_Dimming (CM_NM_Hybrid_01_FCIB_Cx40000000000000_55_Dimming), 36028797018963968=Cx80000000000000_56_ChargingStatus (CM_NM_Hybrid_01_FCIB_Cx80000000000000_56_ChargingStatus)
  compu method CM_NM_AWC_FCAB: 0=Cx0_Init (CM_NM_AWC_FCAB_Cx0_Init), 1=Cx1_01_CarWakeUp (CM_NM_AWC_FCAB_Cx1_01_CarWakeUp), 2=Cx2_02_Basefunction_Powertrain (CM_NM_AWC_FCAB_Cx2_02_Basefunction_Powertrain), 4=Cx4_03_Basefunction_Chassis (CM_NM_AWC_FCAB_Cx4_03_Basefunction_Chassis), 8=Cx8_04_Basefunction_DrivingAssistance (CM_NM_AWC_FCAB_Cx8_04_Basefunction_DrivingAssistance), 16=Cx10_05_Basefunction_Infotainment (CM_NM_AWC_FCAB_Cx10_05_Basefunction_Infotainment), 32=Cx20_06_Basefunction_ComfortLight (CM_NM_AWC_FCAB_Cx20_06_Basefunction_ComfortLight), 64=Cx40_07_Basefunction_CrossSection (CM_NM_AWC_FCAB_Cx40_07_Basefunction_CrossSection), 128=Cx80_08_Basefunction_Connectivity (CM_NM_AWC_FCAB_Cx80_08_Basefunction_Connectivity), 256=Cx100_09_Basefunction_DrivingAssistanceCore (CM_NM_AWC_FCAB_Cx100_09_Basefunction_DrivingAssistanceCore), 512=Cx200_10_Powertrain (CM_NM_AWC_FCAB_Cx200_10_Powertrain), 1024=Cx400_11_Chassis (CM_NM_AWC_FCAB_Cx400_11_Chassis), 2048=Cx800_12_GearSelector (CM_NM_AWC_FCAB_Cx800_12_GearSelector), 4096=Cx1000_13_Airbag (CM_NM_AWC_FCAB_Cx1000_13_Airbag), 8192=Cx2000_14_InfotainmentExtensions (CM_NM_AWC_FCAB_Cx2000_14_InfotainmentExtensions), 16384=Cx4000_15_InstrumentclusterDisplay (CM_NM_AWC_FCAB_Cx4000_15_InstrumentclusterDisplay), 32768=Cx8000_16_InfotainmentDisplay (CM_NM_AWC_FCAB_Cx8000_16_InfotainmentDisplay), 65536=Cx10000_17_Audio (CM_NM_AWC_FCAB_Cx10000_17_Audio), 131072=Cx20000_18_VirtualSideMirrors (CM_NM_AWC_FCAB_Cx20000_18_VirtualSideMirrors), 262144=Cx40000_19_Doors_Hatches (CM_NM_AWC_FCAB_Cx40000_19_Doors_Hatches), 524288=Cx80000_20_OptionalComfort (CM_NM_AWC_FCAB_Cx80000_20_OptionalComfort), 1048576=Cx100000_21_AirSuspension (CM_NM_AWC_FCAB_Cx100000_21_AirSuspension), 2097152=Cx200000_22_ExteriorLights (CM_NM_AWC_FCAB_Cx200000_22_ExteriorLights), 4194304=Cx400000_23_Climate (CM_NM_AWC_FCAB_Cx400000_23_Climate), 8388608=Cx800000_24_ThermoManagement (CM_NM_AWC_FCAB_Cx800000_24_ThermoManagement), 16777216=Cx1000000_25_AccessSystemSensors (CM_NM_AWC_FCAB_Cx1000000_25_AccessSystemSensors), 33554432=Cx2000000_26_HighVoltage_Charging (CM_NM_AWC_FCAB_Cx2000000_26_HighVoltage_Charging), 67108864=Cx4000000_27_Timemaster_Timer (CM_NM_AWC_FCAB_Cx4000000_27_Timemaster_Timer), 134217728=Cx8000000_28_OnboardTester_DataCollector (CM_NM_AWC_FCAB_Cx8000000_28_OnboardTester_DataCollector), 268435456=Cx10000000_29_SteeringColumnLock (CM_NM_AWC_FCAB_Cx10000000_29_SteeringColumnLock), 536870912=Cx20000000_30_EnergyManagement (CM_NM_AWC_FCAB_Cx20000000_30_EnergyManagement), 1073741824=Cx40000000_31_MultifunctionalSteeringWheel (CM_NM_AWC_FCAB_Cx40000000_31_MultifunctionalSteeringWheel), 2147483648=Cx80000000_32_OnlineAccess (CM_NM_AWC_FCAB_Cx80000000_32_OnlineAccess), 4294967296=Cx100000000_33_ExternalWirelessCommunication (CM_NM_AWC_FCAB_Cx100000000_33_ExternalWirelessCommunication), 8589934592=Cx200000000_34_GPS_Localization (CM_NM_AWC_FCAB_Cx200000000_34_GPS_Localization), 17179869184=Cx400000000_35_ExteriorSound (CM_NM_AWC_FCAB_Cx400000000_35_ExteriorSound), 34359738368=Cx800000000_36_Preheater (CM_NM_AWC_FCAB_Cx800000000_36_Preheater), 68719476736=Cx1000000000_37_HighVoltage_WirelessChargingStation (CM_NM_AWC_FCAB_Cx1000000000_37_HighVoltage_WirelessChargingStation), 549755813888=Cx8000000000_40_Diagnosis_Energy (CM_NM_AWC_FCAB_Cx8000000000_40_Diagnosis_Energy), 1099511627776=Cx10000000000_41_Diagnosis_Powertrain (CM_NM_AWC_FCAB_Cx10000000000_41_Diagnosis_Powertrain), 2199023255552=Cx20000000000_42_Diagnosis_FlexRay (CM_NM_AWC_FCAB_Cx20000000000_42_Diagnosis_FlexRay), 4398046511104=Cx40000000000_43_Diagnosis_DrivingAssistance (CM_NM_AWC_FCAB_Cx40000000000_43_Diagnosis_DrivingAssistance), 8796093022208=Cx80000000000_44_Diagnosis_Infotainment (CM_NM_AWC_FCAB_Cx80000000000_44_Diagnosis_Infotainment), 17592186044416=Cx100000000000_45_Diagnosis_Comfort (CM_NM_AWC_FCAB_Cx100000000000_45_Diagnosis_Comfort), 35184372088832=Cx200000000000_46_Diagnosis_Light (CM_NM_AWC_FCAB_Cx200000000000_46_Diagnosis_Light), 70368744177664=Cx400000000000_47_Diagnosis_ComfortLINs (CM_NM_AWC_FCAB_Cx400000000000_47_Diagnosis_ComfortLINs), 140737488355328=Cx800000000000_48_Diagnosis_ClimateTmeLINs (CM_NM_AWC_FCAB_Cx800000000000_48_Diagnosis_ClimateTmeLINs), 281474976710656=Cx1000000000000_49_reserved (CM_NM_AWC_FCAB_Cx1000000000000_49_reserved) (49_<reserved>), 4503599627370496=Cx10000000000000_53_Lock_Unlock (CM_NM_AWC_FCAB_Cx10000000000000_53_Lock_Unlock), 9007199254740992=Cx20000000000000_54_reserved (CM_NM_AWC_FCAB_Cx20000000000000_54_reserved) (54_<reserved>), 18014398509481984=Cx40000000000000_55_Dimming (CM_NM_AWC_FCAB_Cx40000000000000_55_Dimming), 36028797018963968=Cx80000000000000_56_ChargingStatus (CM_NM_AWC_FCAB_Cx80000000000000_56_ChargingStatus)
  compu method CM_OBD_Engine_RPM: phys=raw*0.25 for raw 0..65535; unit Unit_MinutInver
  compu method CM_UI2Sens02_CALID_Index_10: phys=raw for raw 0..255
  compu method CM_SI_P_Mode_gueltig: 0=Cx0_dezentraler_Produktionsmode (CM_SI_P_Mode_gueltig_Cx0_dezentraler_Produktionsmode), 1=Cx1_zentraler_Produktionsmode (CM_SI_P_Mode_gueltig_Cx1_zentraler_Produktionsmode)
  compu method CM_BMC_Unterspannungszaehler_CMC03: phys=raw for raw 0..400, 510=Cx1fe_InitWert (CM_BMC_Unterspannungszaehler_CMC03_Cx1fe_InitWert), 511=Cx1ff_Fehler (CM_BMC_Unterspannungszaehler_CMC03_Cx1ff_Fehler); unit Unit_None
  compu method CM_UI2_KompFehlerModus2_25: 0=Cx0_TNCTOC (CM_UI2_KompFehlerModus2_25_Cx0_TNCTOC), 1=Cx1_TP_TC (CM_UI2_KompFehlerModus2_25_Cx1_TP_TC), 2=Cx2_TP_TC_WCMTL (CM_UI2_KompFehlerModus2_25_Cx2_TP_TC_WCMTL), 3=Cx3_TF_TC_Error (CM_UI2_KompFehlerModus2_25_Cx3_TF_TC_Error)
  compu method CM_BMC_IstTemperaturMax_Modul_ID: phys=raw for raw 1..254, 255=Cxff_Init (CM_BMC_IstTemperaturMax_Modul_ID_Cxff_Init); unit Unit_None
  compu method CM_NM_AWC_NM_aktiv_Diag: 0=Cx0_Inaktiv (CM_NM_AWC_NM_aktiv_Diag_Cx0_Inaktiv), 1=Cx1_Diagnose_aktiv (CM_NM_AWC_NM_aktiv_Diag_Cx1_Diagnose_aktiv)
  compu method CM_HVLM_WLAN_Verbinden: 0=Cx0_Nicht_Verbinden (CM_HVLM_WLAN_Verbinden_Cx0_Nicht_Verbinden), 1=Cx1_Verbinden (CM_HVLM_WLAN_Verbinden_Cx1_Verbinden), 2=Cx2_Reserviert (CM_HVLM_WLAN_Verbinden_Cx2_Reserviert), 3=Cx3_Reserviert (CM_HVLM_WLAN_Verbinden_Cx3_Reserviert)
  compu method CM_KST_Kl_50_Startanforderung: 0=Cx0_aus (CM_KST_Kl_50_Startanforderung_Cx0_aus), 1=Cx1_KL50_ein_Startwunsch_Fahrer (CM_KST_Kl_50_Startanforderung_Cx1_KL50_ein_Startwunsch_Fahrer)
  compu method CM_NM_Hybrid_01_Lokalaktiv: 0=Cx0_war_nicht_lokal_aktiv (CM_NM_Hybrid_01_Lokalaktiv_Cx0_war_nicht_lokal_aktiv), 1=Cx1_war_lokal_aktiv (CM_NM_Hybrid_01_Lokalaktiv_Cx1_war_lokal_aktiv)
  compu method CM_UI1_KompFehlerModus2_20: 0=Cx0_TNCTOC (CM_UI1_KompFehlerModus2_20_Cx0_TNCTOC), 1=Cx1_TP_TC (CM_UI1_KompFehlerModus2_20_Cx1_TP_TC), 2=Cx2_TP_TC_WCMTL (CM_UI1_KompFehlerModus2_20_Cx2_TP_TC_WCMTL), 3=Cx3_TF_TC_Error (CM_UI1_KompFehlerModus2_20_Cx3_TF_TC_Error)
  compu method CM_UI2Sens02_CALID_Index_11: phys=raw for raw 0..255
  compu method CM_SI_QRS_Mode: 0=Cx0_QRS_Messmodus_nicht_aktiv (CM_SI_QRS_Mode_Cx0_QRS_Messmodus_nicht_aktiv), 1=Cx1_QRS_Messmodus_aktiv (CM_SI_QRS_Mode_Cx1_QRS_Messmodus_aktiv)
  compu method CM_NM_AWC_NM_aktiv_KL15: 0=Cx0_Inaktiv (CM_NM_AWC_NM_aktiv_KL15_Cx0_Inaktiv), 1=Cx1_KL15_EIN (CM_NM_AWC_NM_aktiv_KL15_Cx1_KL15_EIN)
  compu method CM_OBD_Kaltstart_Denominator: 0=Cx0_Denominator_nicht_hochzaehlen (CM_OBD_Kaltstart_Denominator_Cx0_Denominator_nicht_hochzaehlen), 1=Cx1_Bedingungen_zum_Inkr_des_Kaltstart_Denom_erf (CM_OBD_Kaltstart_Denominator_Cx1_Bedingungen_zum_Inkr_des_Kaltstart_Denom_erf)
  compu method CM_TME_LED_STK_Timer: 0=Cx0_LED_aus (CM_TME_LED_STK_Timer_Cx0_LED_aus), 1=Cx1_LED_ein (CM_TME_LED_STK_Timer_Cx1_LED_ein), 2=Cx2_LED_blinken (CM_TME_LED_STK_Timer_Cx2_LED_blinken), 3=Cx3_Funktion_gesperrt_LED_aus (CM_TME_LED_STK_Timer_Cx3_Funktion_gesperrt_LED_aus), 6=Cx6_Init (CM_TME_LED_STK_Timer_Cx6_Init)
  compu method CM_HVLM_ZustandLadeablauf: 0=Cx0_Init (CM_HVLM_ZustandLadeablauf_Cx0_Init), 1=Cx1_Stby_Ladevorbed_erfuellt (CM_HVLM_ZustandLadeablauf_Cx1_Stby_Ladevorbed_erfuellt), 2=Cx2_Stby_Ladevorbed_nicht_erfuellt (CM_HVLM_ZustandLadeablauf_Cx2_Stby_Ladevorbed_nicht_erfuellt), 3=Cx3_Fehler (CM_HVLM_ZustandLadeablauf_Cx3_Fehler), 4=Cx4_Laden_starten (CM_HVLM_ZustandLadeablauf_Cx4_Laden_starten), 5=Cx5_Laden_beenden (CM_HVLM_ZustandLadeablauf_Cx5_Laden_beenden), 6=Cx6_HVBatterie_Laden (CM_HVLM_ZustandLadeablauf_Cx6_HVBatterie_Laden), 7=Cx7_HVBatterie_Entladen (CM_HVLM_ZustandLadeablauf_Cx7_HVBatterie_Entladen), 8=Cx8_Erhaltungsladen (CM_HVLM_ZustandLadeablauf_Cx8_Erhaltungsladen)
  compu method CM_KST_Kl_S: 0=Cx0_aus (CM_KST_Kl_S_Cx0_aus), 1=Cx1_S_Kontakt_ein (CM_KST_Kl_S_Cx1_S_Kontakt_ein)
  compu method CM_NM_Hybrid_01_NM_aktiv_Diag: 0=Cx0_Inaktiv (CM_NM_Hybrid_01_NM_aktiv_Diag_Cx0_Inaktiv), 1=Cx1_Diagnose_aktiv (CM_NM_Hybrid_01_NM_aktiv_Diag_Cx1_Diagnose_aktiv)
  compu method CM_NM_AWC_NM_aktiv_Tmin: 0=Cx0_Inaktiv (CM_NM_AWC_NM_aktiv_Tmin_Cx0_Inaktiv), 1=Cx1_Mindestaktivzeit (CM_NM_AWC_NM_aktiv_Tmin_Cx1_Mindestaktivzeit)
  compu method CM_AB_Gurtwarn_VB: 0=Cx0_keine_Warnung (CM_AB_Gurtwarn_VB_Cx0_keine_Warnung), 1=Cx1_Gurtwarnung_ausloesen (CM_AB_Gurtwarn_VB_Cx1_Gurtwarnung_ausloesen)
  compu method CM_OBD_MIL: 0=Cx0_Lampe_aus (CM_OBD_MIL_Cx0_Lampe_aus), 1=Cx1_Fehler (CM_OBD_MIL_Cx1_Fehler)
  compu method CM_UI2Sens02_CALID_Index_12: phys=raw for raw 0..255
  compu method CM_BMC_IstTemperaturMax_Sensor_ID: phys=raw for raw 1..30, 31=Cx1f_Init (CM_BMC_IstTemperaturMax_Sensor_ID_Cx1f_Init); unit Unit_None
  compu method CM_SI_T_Mode: 0=Cx0_Transportmodus_nicht_aktiv (CM_SI_T_Mode_Cx0_Transportmodus_nicht_aktiv), 1=Cx1_Transportmodus_aktiv (CM_SI_T_Mode_Cx1_Transportmodus_aktiv)
  compu method CM_UI2_KompFehlerModus2_26: 0=Cx0_TNCTOC (CM_UI2_KompFehlerModus2_26_Cx0_TNCTOC), 1=Cx1_TP_TC (CM_UI2_KompFehlerModus2_26_Cx1_TP_TC), 2=Cx2_TP_TC_WCMTL (CM_UI2_KompFehlerModus2_26_Cx2_TP_TC_WCMTL), 3=Cx3_TF_TC_Error (CM_UI2_KompFehlerModus2_26_Cx3_TF_TC_Error)
  compu method CM_NM_AWC_NM_State: 0=Cx0_Init (CM_NM_AWC_NM_State_Cx0_Init), 1=Cx1_NM_RM_aus_BSM (CM_NM_AWC_NM_State_Cx1_NM_RM_aus_BSM), 2=Cx2_NM_RM_aus_PBSM (CM_NM_AWC_NM_State_Cx2_NM_RM_aus_PBSM), 4=Cx4_NM_NO_aus_RM (CM_NM_AWC_NM_State_Cx4_NM_NO_aus_RM), 8=Cx8_NM_NO_aus_RS (CM_NM_AWC_NM_State_Cx8_NM_NO_aus_RS), 16=Cx10_reserved (CM_NM_AWC_NM_State_Cx10_reserved), 32=Cx20_reserved (CM_NM_AWC_NM_State_Cx20_reserved)
  compu method CM_KST_Kl_X: 0=Cx0_aus (CM_KST_Kl_X_Cx0_aus), 1=Cx1_ein (CM_KST_Kl_X_Cx1_ein)
  compu method CM_BMC_Unterspannungszaehler_CMC04: phys=raw for raw 0..400, 510=Cx1fe_InitWert (CM_BMC_Unterspannungszaehler_CMC04_Cx1fe_InitWert), 511=Cx1ff_Fehler (CM_BMC_Unterspannungszaehler_CMC04_Cx1ff_Fehler); unit Unit_None
  compu method CM_UI1_KompFehlerModus2_21: 0=Cx0_TNCTOC (CM_UI1_KompFehlerModus2_21_Cx0_TNCTOC), 1=Cx1_TP_TC (CM_UI1_KompFehlerModus2_21_Cx1_TP_TC), 2=Cx2_TP_TC_WCMTL (CM_UI1_KompFehlerModus2_21_Cx2_TP_TC_WCMTL), 3=Cx3_TF_TC_Error (CM_UI1_KompFehlerModus2_21_Cx3_TF_TC_Error)
  compu method CM_Hybrid_01_Abschaltstufe: 0=Cx0_keine_Einschraenkung (CM_Hybrid_01_Abschaltstufe_Cx0_keine_Einschraenkung), 1=Cx1_Funktionseinschraenkung (CM_Hybrid_01_Abschaltstufe_Cx1_Funktionseinschraenkung)
  compu method CM_NM_Hybrid_01_NM_aktiv_KL15: 0=Cx0_Inaktiv (CM_NM_Hybrid_01_NM_aktiv_KL15_Cx0_Inaktiv), 1=Cx1_KL15_EIN (CM_NM_Hybrid_01_NM_aktiv_KL15_Cx1_KL15_EIN)
  compu method CM_OBD_Minimum_Trip: 0=Cx0_kein_Min_Normed_Trip (CM_OBD_Minimum_Trip_Cx0_kein_Min_Normed_Trip), 1=Cx1_Min_Normed_Trip (CM_OBD_Minimum_Trip_Cx1_Min_Normed_Trip)
  compu method CM_TME_Min_Fahrdrehzahl: phys=raw*10+500 for raw 0..125, 126=Cx7e_Init (CM_TME_Min_Fahrdrehzahl_Cx7e_Init), 127=Cx7f_Fehler (CM_TME_Min_Fahrdrehzahl_Cx7f_Fehler); unit Unit_MinutInver
  compu method CM_UI2Sens02_CALID_Index_13: phys=raw for raw 0..255
  compu method CM_SI_T_Schutz: 0=Cx0_Transportschutz_nicht_aktiv (CM_SI_T_Schutz_Cx0_Transportschutz_nicht_aktiv), 1=Cx1_Transportschutz_aktiv (CM_SI_T_Schutz_Cx1_Transportschutz_aktiv)
  compu method CM_NM_AWC_SNI_10: 143=Cx8f_AWC_SNI (CM_NM_AWC_SNI_10_Cx8f_AWC_SNI)
  compu method CM_AB_Gurtwarn_VF: 0=Cx0_keine_Warnung (CM_AB_Gurtwarn_VF_Cx0_keine_Warnung), 1=Cx1_Gurtwarnung_ausloesen (CM_AB_Gurtwarn_VF_Cx1_Gurtwarnung_ausloesen)
  compu method CM_OBD_Normed_Trip: 0=Cx0_kein_Normed_Trip (CM_OBD_Normed_Trip_Cx0_kein_Normed_Trip), 1=Cx1_Normed_Trip (CM_OBD_Normed_Trip_Cx1_Normed_Trip)
  compu method CM_Hybrid_01_Indc_StChk: 0=Cx0_Completed (CM_Hybrid_01_Indc_StChk_Cx0_Completed), 1=Cx1_NotCompleted (CM_Hybrid_01_Indc_StChk_Cx1_NotCompleted)
  compu method CM_KST_Sonderzustand_Anforderung: 0=Cx0_Init (CM_KST_Sonderzustand_Anforderung_Cx0_Init), 1=Cx1_RemoteStart (CM_KST_Sonderzustand_Anforderung_Cx1_RemoteStart), 2=Cx2_RemoteParkAssist (CM_KST_Sonderzustand_Anforderung_Cx2_RemoteParkAssist), 3=Cx3_IntelligentParkAssist (CM_KST_Sonderzustand_Anforderung_Cx3_IntelligentParkAssist), 4=Cx4_TrainiertesParken (CM_KST_Sonderzustand_Anforderung_Cx4_TrainiertesParken), 5=Cx5_OnlineRemoteUpdate (CM_KST_Sonderzustand_Anforderung_Cx5_OnlineRemoteUpdate), 6=Cx6_Einfrierschutz (CM_KST_Sonderzustand_Anforderung_Cx6_Einfrierschutz), 7=Cx7_Klemme15ViaDiagnose (CM_KST_Sonderzustand_Anforderung_Cx7_Klemme15ViaDiagnose), 8=Cx8_RueckwandklappenSicherungPDC (CM_KST_Sonderzustand_Anforderung_Cx8_RueckwandklappenSicherungPDC), 9=Cx9_ParkHausPilot (CM_KST_Sonderzustand_Anforderung_Cx9_ParkHausPilot), 10=Cxa_AnhaengerAnkuppelAssistent (CM_KST_Sonderzustand_Anforderung_Cxa_AnhaengerAnkuppelAssistent), 11=Cxb_MotorWeiterlaufSchaltung (CM_KST_Sonderzustand_Anforderung_Cxb_MotorWeiterlaufSchaltung), 31=Cx1f_Fehler (CM_KST_Sonderzustand_Anforderung_Cx1f_Fehler)
  compu method CM_NM_Hybrid_01_NM_aktiv_KondAnf: 0=Cx0_kein_Nachlauf (CM_NM_Hybrid_01_NM_aktiv_KondAnf_Cx0_kein_Nachlauf), 1=Cx1_Hochvolt_aktiv (CM_NM_Hybrid_01_NM_aktiv_KondAnf_Cx1_Hochvolt_aktiv)
  compu method CM_BMC_IstTemperaturMin_Modul_ID: phys=raw for raw 1..254, 255=Cxff_Init (CM_BMC_IstTemperaturMin_Modul_ID_Cxff_Init); unit Unit_None
  compu method CM_NM_AWC_UDS_CC: 0=Cx0_Inaktiv (CM_NM_AWC_UDS_CC_Cx0_Inaktiv), 1=Cx1_CC_aktiv (CM_NM_AWC_UDS_CC_Cx1_CC_aktiv)
  compu method CM_UI2Sens02_CALID_Index_14: phys=raw for raw 0..255
  compu method CM_UI2_KompFehlerModus4_01: 0=Cx0_TNCTOC (CM_UI2_KompFehlerModus4_01_Cx0_TNCTOC), 1=Cx1_TP_TC (CM_UI2_KompFehlerModus4_01_Cx1_TP_TC), 2=Cx2_TP_TC_WCMTL (CM_UI2_KompFehlerModus4_01_Cx2_TP_TC_WCMTL), 3=Cx3_TF_TC_Error_1 (CM_UI2_KompFehlerModus4_01_Cx3_TF_TC_Error_1), 4=Cx4_TF_TC_Error_2 (CM_UI2_KompFehlerModus4_01_Cx4_TF_TC_Error_2), 5=Cx5_TF_TC_Error_3 (CM_UI2_KompFehlerModus4_01_Cx5_TF_TC_Error_3), 6=Cx6_TF_TC_Error_4 (CM_UI2_KompFehlerModus4_01_Cx6_TF_TC_Error_4), 7=Cx7_TF_TC_Error_5 (CM_UI2_KompFehlerModus4_01_Cx7_TF_TC_Error_5)
  compu method CM_SOK_ungeschuetzte_Zeit: 0=Cx0_Init (CM_SOK_ungeschuetzte_Zeit_Cx0_Init), phys=raw for raw 1..72057594037927935; unit Unit_None
  compu method CM_BMC_Verbauinfo_ACSchuetz: 0=Cx0_Init (CM_BMC_Verbauinfo_ACSchuetz_Cx0_Init), 1=Cx1_nicht_verbaut (CM_BMC_Verbauinfo_ACSchuetz_Cx1_nicht_verbaut), 2=Cx2_verbaut (CM_BMC_Verbauinfo_ACSchuetz_Cx2_verbaut)
  compu method CM_OBD_Normed_Trip_Wout_Fu_Cdn: 0=Cx0_kein_Normed_Trip_wo_Fu_Cdn (CM_OBD_Normed_Trip_Wout_Fu_Cdn_Cx0_kein_Normed_Trip_wo_Fu_Cdn), 1=Cx1_Normed_Trip_wo_Fu_Cdn (CM_OBD_Normed_Trip_Wout_Fu_Cdn_Cx1_Normed_Trip_wo_Fu_Cdn)
  compu method CM_UI1_KompFehlerModus2_22: 0=Cx0_TNCTOC (CM_UI1_KompFehlerModus2_22_Cx0_TNCTOC), 1=Cx1_TP_TC (CM_UI1_KompFehlerModus2_22_Cx1_TP_TC), 2=Cx2_TP_TC_WCMTL (CM_UI1_KompFehlerModus2_22_Cx2_TP_TC_WCMTL), 3=Cx3_TF_TC_Error (CM_UI1_KompFehlerModus2_22_Cx3_TF_TC_Error)
  compu method CM_Hybrid_01_Indc_StFail: 0=Cx0_Passive (CM_Hybrid_01_Indc_StFail_Cx0_Passive), 1=Cx1_Active (CM_Hybrid_01_Indc_StFail_Cx1_Active)
  compu method CM_KST_Sonderzustand_Status: 0=Cx0_Init (CM_KST_Sonderzustand_Status_Cx0_Init), 1=Cx1_Uebergang_neue_Anforderung (CM_KST_Sonderzustand_Status_Cx1_Uebergang_neue_Anforderung), 2=Cx2_Aktiv (CM_KST_Sonderzustand_Status_Cx2_Aktiv), 3=Cx3_Fehler (CM_KST_Sonderzustand_Status_Cx3_Fehler)
  compu method CM_TME_Min_Leerlaufdrehzahl: phys=raw*10+500 for raw 0..125, 126=Cx7e_Init (CM_TME_Min_Leerlaufdrehzahl_Cx7e_Init), 127=Cx7f_Fehler (CM_TME_Min_Leerlaufdrehzahl_Cx7f_Fehler); unit Unit_MinutInver
  compu method CM_NM_AWC_Wakeup_V12: 0=Cx0_Peripherie_Wakeup_Ursache_nicht_bekannt (CM_NM_AWC_Wakeup_V12_Cx0_Peripherie_Wakeup_Ursache_nicht_bekannt), 1=Cx1_Bus_Wakeup (CM_NM_AWC_Wakeup_V12_Cx1_Bus_Wakeup), 2=Cx2_KL15_HW (CM_NM_AWC_Wakeup_V12_Cx2_KL15_HW), 128=Cx80_RequestWirelessCharging (CM_NM_AWC_Wakeup_V12_Cx80_RequestWirelessCharging)
  compu method CM_NM_Hybrid_01_NM_aktiv_Tmin: 0=Cx0_Inaktiv (CM_NM_Hybrid_01_NM_aktiv_Tmin_Cx0_Inaktiv), 1=Cx1_Mindestaktivzeit (CM_NM_Hybrid_01_NM_aktiv_Tmin_Cx1_Mindestaktivzeit)
  compu method CM_SOK_Zeit_Hybrid_01_Challenge: phys=raw for raw 0..18446744073709551615; unit Unit_None
  compu method CM_AB_Heck_Crash: 0=Cx0_kein_Heck_Crash (CM_AB_Heck_Crash_Cx0_kein_Heck_Crash), 1=Cx1_Heck_Crash (CM_AB_Heck_Crash_Cx1_Heck_Crash)
  compu method CM_OBD_NumDcyMilOnReq: phys=raw for raw 0..255; unit Unit_None
  compu method CM_UI2Sens02_CALID_Index_15: phys=raw for raw 0..255
  compu method CM_NM_Dummy01_CAB: 0=Cx0_inaktiv (CM_NM_Dummy01_CAB_Cx0_inaktiv), 1=Cx1_CAB_01_Tueren (CM_NM_Dummy01_CAB_Cx1_CAB_01_Tueren) (CAB_01__Tueren), 2=Cx2_CAB_02_Anhaenger_KCAN (CM_NM_Dummy01_CAB_Cx2_CAB_02_Anhaenger_KCAN) (CAB_02__Anhaenger_KCAN), 4=Cx4_CAB_03_Nightvision (CM_NM_Dummy01_CAB_Cx4_CAB_03_Nightvision) (CAB_03__Nightvision), 8=Cx8_CAB_04_Sitzverstellung (CM_NM_Dummy01_CAB_Cx8_CAB_04_Sitzverstellung) (CAB_04__Sitzverstellung), 16=Cx10_CAB_05_Klappen (CM_NM_Dummy01_CAB_Cx10_CAB_05_Klappen) (CAB_05__Klappen), 32=Cx20_CAB_06_Infotainment (CM_NM_Dummy01_CAB_Cx20_CAB_06_Infotainment) (CAB_06__Infotainment), 64=Cx40_CAB_07_Sub_Infotainment (CM_NM_Dummy01_CAB_Cx40_CAB_07_Sub_Infotainment) (CAB_07__Sub_Infotainment), 128=Cx80_CAB_08_Anzeige (CM_NM_Dummy01_CAB_Cx80_CAB_08_Anzeige) (CAB_08__Anzeige), 256=Cx100_CAB_09_Laden_HCAN (CM_NM_Dummy01_CAB_Cx100_CAB_09_Laden_HCAN) (CAB_09__Laden_HCAN), 512=Cx200_CAB_10_Klima (CM_NM_Dummy01_CAB_Cx200_CAB_10_Klima) (CAB_10__Klima), 1024=Cx400_CAB_11_FlexRay (CM_NM_Dummy01_CAB_Cx400_CAB_11_FlexRay) (CAB_11__FlexRay), 262144=Cx40000_CAB_19_VLAN_RemoteFC (CM_NM_Dummy01_CAB_Cx40000_CAB_19_VLAN_RemoteFC) (CAB_19__VLAN_RemoteFC), 524288=Cx80000_CAB_20_VLAN_Komfort (CM_NM_Dummy01_CAB_Cx80000_CAB_20_VLAN_Komfort) (CAB_20__VLAN_Komfort), 1048576=Cx100000_CAB_21_VLAN_Internet (CM_NM_Dummy01_CAB_Cx100000_CAB_21_VLAN_Internet) (CAB_21__VLAN_Internet), 2097152=Cx200000_CAB_22_VLAN_Connect (CM_NM_Dummy01_CAB_Cx200000_CAB_22_VLAN_Connect) (CAB_22__VLAN_Connect), 4194304=Cx400000_CAB_23_VLAN_Infotainment (CM_NM_Dummy01_CAB_Cx400000_CAB_23_VLAN_Infotainment) (CAB_23__VLAN_Infotainment), 8388608=Cx800000_CAB_24_VLAN_FAS (CM_NM_Dummy01_CAB_Cx800000_CAB_24_VLAN_FAS) (CAB_24__VLAN_FAS)
  compu method CM_Hybrid_01_KD_Fehler: 0=Cx0_Kein_KD_Fehler (CM_Hybrid_01_KD_Fehler_Cx0_Kein_KD_Fehler), 1=Cx1_KD_Fehler (CM_Hybrid_01_KD_Fehler_Cx1_KD_Fehler)
  compu method CM_KST_StPtAcvReq: 0=Cx0_NoActivationRequest (CM_KST_StPtAcvReq_Cx0_NoActivationRequest), 1=Cx1_StoredActivationRequest (CM_KST_StPtAcvReq_Cx1_StoredActivationRequest), 2=Cx2_CurrentActivationRequest (CM_KST_StPtAcvReq_Cx2_CurrentActivationRequest)
  compu method CM_NM_Hybrid_01_NM_State: 0=Cx0_Init (CM_NM_Hybrid_01_NM_State_Cx0_Init), 1=Cx1_NM_RM_aus_BSM (CM_NM_Hybrid_01_NM_State_Cx1_NM_RM_aus_BSM), 2=Cx2_NM_RM_aus_PBSM (CM_NM_Hybrid_01_NM_State_Cx2_NM_RM_aus_PBSM), 4=Cx4_NM_NO_aus_RM (CM_NM_Hybrid_01_NM_State_Cx4_NM_NO_aus_RM), 8=Cx8_NM_NO_aus_RS (CM_NM_Hybrid_01_NM_State_Cx8_NM_NO_aus_RS), 16=Cx10_reserved (CM_NM_Hybrid_01_NM_State_Cx10_reserved), 32=Cx20_reserved (CM_NM_Hybrid_01_NM_State_Cx20_reserved)
  compu method CM_UI2_KompFehlerModus4_02: 0=Cx0_TNCTOC (CM_UI2_KompFehlerModus4_02_Cx0_TNCTOC), 1=Cx1_TP_TC (CM_UI2_KompFehlerModus4_02_Cx1_TP_TC), 2=Cx2_TP_TC_WCMTL (CM_UI2_KompFehlerModus4_02_Cx2_TP_TC_WCMTL), 3=Cx3_TF_TC_Error_1 (CM_UI2_KompFehlerModus4_02_Cx3_TF_TC_Error_1), 4=Cx4_TF_TC_Error_2 (CM_UI2_KompFehlerModus4_02_Cx4_TF_TC_Error_2), 5=Cx5_TF_TC_Error_3 (CM_UI2_KompFehlerModus4_02_Cx5_TF_TC_Error_3), 6=Cx6_TF_TC_Error_4 (CM_UI2_KompFehlerModus4_02_Cx6_TF_TC_Error_4), 7=Cx7_TF_TC_Error_5 (CM_UI2_KompFehlerModus4_02_Cx7_TF_TC_Error_5)
  compu method CM_BMC_IstTemperaturMin_Sensor_ID: phys=raw for raw 1..30, 31=Cx1f_Init (CM_BMC_IstTemperaturMin_Sensor_ID_Cx1f_Init); unit Unit_None
  compu method CM_BMC_Verbauinfo_Bank: 0=Cx0_Init (CM_BMC_Verbauinfo_Bank_Cx0_Init), 1=Cx1_nicht_verbaut (CM_BMC_Verbauinfo_Bank_Cx1_nicht_verbaut), 2=Cx2_verbaut (CM_BMC_Verbauinfo_Bank_Cx2_verbaut)
  compu method CM_UI1_KompFehlerModus2_23: 0=Cx0_TNCTOC (CM_UI1_KompFehlerModus2_23_Cx0_TNCTOC), 1=Cx1_TP_TC (CM_UI1_KompFehlerModus2_23_Cx1_TP_TC), 2=Cx2_TP_TC_WCMTL (CM_UI1_KompFehlerModus2_23_Cx2_TP_TC_WCMTL), 3=Cx3_TF_TC_Error (CM_UI1_KompFehlerModus2_23_Cx3_TF_TC_Error)
  compu method CM_OBD_QBit_Aussen_Temp: 0=Cx0_gueltiger_Wert (CM_OBD_QBit_Aussen_Temp_Cx0_gueltiger_Wert), 1=Cx1_Ersatz_Init_oder_Fehlerwert (CM_OBD_QBit_Aussen_Temp_Cx1_Ersatz_Init_oder_Fehlerwert)
  compu method CM_NM_Dummy01_CBV_AWB: 0=Cx0_Passiver_WakeUp (CM_NM_Dummy01_CBV_AWB_Cx0_Passiver_WakeUp), 1=Cx1_Aktiver_WakeUp (CM_NM_Dummy01_CBV_AWB_Cx1_Aktiver_WakeUp)
  compu method CM_SOK_Zeit_Hybrid_01_Zeit: phys=raw for raw 0..72057594037927935; unit Unit_None
  compu method CM_UI2Sens02_CALID_Index_16: phys=raw for raw 0..255
  compu method CM_Hybrid_01_KompSchutz: 0=Cx0_KS_nicht_aktiv (CM_Hybrid_01_KompSchutz_Cx0_KS_nicht_aktiv), 1=Cx1_KS_sktiv (CM_Hybrid_01_KompSchutz_Cx1_KS_sktiv)
  compu method CM_KST_StPtDeacReq: 0=Cx0_NoRequest (CM_KST_StPtDeacReq_Cx0_NoRequest), 1=Cx1_RequestDeactivatePowertrain (CM_KST_StPtDeacReq_Cx1_RequestDeactivatePowertrain)
  compu method CM_AB_Lampe: 0=Cx0_Aus (CM_AB_Lampe_Cx0_Aus), 1=Cx1_Ein (CM_AB_Lampe_Cx1_Ein)
  compu method CM_NM_Hybrid_01_SNI_10: 123=Cx7b_Hybrid_01_SNI (CM_NM_Hybrid_01_SNI_10_Cx7b_Hybrid_01_SNI)
  compu method CM_OBD_Sperrung_IUMPR: 0=Cx0_IUMPR_Berechnung_freigegeben (CM_OBD_Sperrung_IUMPR_Cx0_IUMPR_Berechnung_freigegeben), 1=Cx1_IUMPR_Berechnung_gesperrt (CM_OBD_Sperrung_IUMPR_Cx1_IUMPR_Berechnung_gesperrt)
  compu method CM_TME_MSF_Stufe: 0=Cx0_Init (CM_TME_MSF_Stufe_Cx0_Init), 1=Cx1_Stufe_1 (CM_TME_MSF_Stufe_Cx1_Stufe_1) (Stufe 1), 2=Cx2_Stufe_2 (CM_TME_MSF_Stufe_Cx2_Stufe_2) (Stufe 2), 3=Cx3_reserve (CM_TME_MSF_Stufe_Cx3_reserve)
  compu method CM_NM_Dummy01_CBV_CRI: 0=Cx0_NM_ohne_Clusteranforderungen (CM_NM_Dummy01_CBV_CRI_Cx0_NM_ohne_Clusteranforderungen), 1=Cx1_NM_mit_Clusteranforderungen (CM_NM_Dummy01_CBV_CRI_Cx1_NM_mit_Clusteranforderungen)
  compu method CM_UI2Sens02_CVN_Byte_1: phys=raw for raw 0..255
  compu method CM_UI2_KompFehlerModus4_03: 0=Cx0_TNCTOC (CM_UI2_KompFehlerModus4_03_Cx0_TNCTOC), 1=Cx1_TP_TC (CM_UI2_KompFehlerModus4_03_Cx1_TP_TC), 2=Cx2_TP_TC_WCMTL (CM_UI2_KompFehlerModus4_03_Cx2_TP_TC_WCMTL), 3=Cx3_TF_TC_Error_1 (CM_UI2_KompFehlerModus4_03_Cx3_TF_TC_Error_1), 4=Cx4_TF_TC_Error_2 (CM_UI2_KompFehlerModus4_03_Cx4_TF_TC_Error_2), 5=Cx5_TF_TC_Error_3 (CM_UI2_KompFehlerModus4_03_Cx5_TF_TC_Error_3), 6=Cx6_TF_TC_Error_4 (CM_UI2_KompFehlerModus4_03_Cx6_TF_TC_Error_4), 7=Cx7_TF_TC_Error_5 (CM_UI2_KompFehlerModus4_03_Cx7_TF_TC_Error_5)
  compu method CM_BMC_IstZellspannungMax: phys=raw+1000 for raw 0..4091, 4092=Cxffc_kleiner_1V (CM_BMC_IstZellspannungMax_Cxffc_kleiner_1V), 4093=Cxffd_reserviert (CM_BMC_IstZellspannungMax_Cxffd_reserviert), 4094=Cxffe_Init (CM_BMC_IstZellspannungMax_Cxffe_Init), 4095=Cxfff_Fehler (CM_BMC_IstZellspannungMax_Cxfff_Fehler); unit Unit_MilliVolt
  compu method CM_KST_Txt_Panikabschaltung: 0=Cx0_Aus (CM_KST_Txt_Panikabschaltung_Cx0_Aus), 1=Cx1_Ein (CM_KST_Txt_Panikabschaltung_Cx1_Ein)
  compu method CM_BMC_Verbrauch: phys=raw*10 for raw 0..65535; unit Unit_WattSecond
  compu method CM_Thermo_Verbrauch_BTL: phys=raw for raw 0..8191; unit Unit_WattSecond
  compu method CM_Hybrid_01_Nachlauftyp: 0=Cx0_Komm_bei_KL15_EIN (CM_Hybrid_01_Nachlauftyp_Cx0_Komm_bei_KL15_EIN), 1=Cx1_Komm_nach_KL15_AUS (CM_Hybrid_01_Nachlauftyp_Cx1_Komm_nach_KL15_AUS), 2=Cx2_Komm_bei_KL15_AUS (CM_Hybrid_01_Nachlauftyp_Cx2_Komm_bei_KL15_AUS)
  compu method CM_NM_Dummy01_NM_State: 0=Cx0_Init (CM_NM_Dummy01_NM_State_Cx0_Init), 1=Cx1_NM_RM_aus_BSM (CM_NM_Dummy01_NM_State_Cx1_NM_RM_aus_BSM), 2=Cx2_NM_RM_aus_PBSM (CM_NM_Dummy01_NM_State_Cx2_NM_RM_aus_PBSM), 4=Cx4_NM_NO_aus_RM (CM_NM_Dummy01_NM_State_Cx4_NM_NO_aus_RM), 8=Cx8_NM_NO_aus_RS (CM_NM_Dummy01_NM_State_Cx8_NM_NO_aus_RS), 16=Cx10_reserved (CM_NM_Dummy01_NM_State_Cx10_reserved), 32=Cx20_reserved (CM_NM_Dummy01_NM_State_Cx20_reserved)
  compu method CM_OBD_Sperrung_Kaltstart_Denom: 0=Cx0_EVAP_Berechnung_freigegeben (CM_OBD_Sperrung_Kaltstart_Denom_Cx0_EVAP_Berechnung_freigegeben), 1=Cx1_EVAP_Berechnung_gesperrt (CM_OBD_Sperrung_Kaltstart_Denom_Cx1_EVAP_Berechnung_gesperrt)
  compu method CM_UI1_KompFehlerModus2_24: 0=Cx0_TNCTOC (CM_UI1_KompFehlerModus2_24_Cx0_TNCTOC), 1=Cx1_TP_TC (CM_UI1_KompFehlerModus2_24_Cx1_TP_TC), 2=Cx2_TP_TC_WCMTL (CM_UI1_KompFehlerModus2_24_Cx2_TP_TC_WCMTL), 3=Cx3_TF_TC_Error (CM_UI1_KompFehlerModus2_24_Cx3_TF_TC_Error)
  compu method CM_NM_Hybrid_01_Subsystemaktiv: 0=Cx0_war_nicht_lokal_aktiv (CM_NM_Hybrid_01_Subsystemaktiv_Cx0_war_nicht_lokal_aktiv), 1=Cx1_war_lokal_aktiv (CM_NM_Hybrid_01_Subsystemaktiv_Cx1_war_lokal_aktiv)
  compu method CM_UI2Sens02_CVN_Byte_2: phys=raw for raw 0..255
  compu method CM_AB_PSS_SollZustand: 0=Cx0_disabled (CM_AB_PSS_SollZustand_Cx0_disabled), 1=Cx1_enabled (CM_AB_PSS_SollZustand_Cx1_enabled)
  compu method CM_NM_Gateway_CBV_AWB: 0=Cx0_Passiver_WakeUp (CM_NM_Gateway_CBV_AWB_Cx0_Passiver_WakeUp), 1=Cx1_Aktiver_WakeUp (CM_NM_Gateway_CBV_AWB_Cx1_Aktiver_WakeUp)
  compu method CM_TME_MVEM_MinLeistung: phys=raw*50 for raw 0..253, 254=Cxfe_Init (CM_TME_MVEM_MinLeistung_Cxfe_Init), 255=Cxff_Fehler (CM_TME_MVEM_MinLeistung_Cxff_Fehler); unit Unit_Watt
  compu method CM_OBD_Typ: 0=Cx0_OBDReady (CM_OBD_Typ_Cx0_OBDReady), 1=Cx1_FullOBD (CM_OBD_Typ_Cx1_FullOBD)
  compu method CM_KST_Warn_P1_ZAT_def: 0=Cx0_nicht_defekt (CM_KST_Warn_P1_ZAT_def_Cx0_nicht_defekt), 1=Cx1_defekt (CM_KST_Warn_P1_ZAT_def_Cx1_defekt)
  compu method CM_Thermo_Verbrauch_BTL_Ueberlauf: 0=Cx0_kein_Ueberlauf (CM_Thermo_Verbrauch_BTL_Ueberlauf_Cx0_kein_Ueberlauf), 1=Cx1_Ueberlauf (CM_Thermo_Verbrauch_BTL_Ueberlauf_Cx1_Ueberlauf)
  compu method CM_Hybrid_01_OBD_Lampe_Anf: 0=Cx0_Kein_MIL_Request (CM_Hybrid_01_OBD_Lampe_Anf_Cx0_Kein_MIL_Request) (Kein MIL_Request), 1=Cx1_MIL_Request (CM_Hybrid_01_OBD_Lampe_Anf_Cx1_MIL_Request)
  compu method CM_NM_Hybrid_01_UDS_CC: 0=Cx0_Inaktiv (CM_NM_Hybrid_01_UDS_CC_Cx0_Inaktiv), 1=Cx1_CC_aktiv (CM_NM_Hybrid_01_UDS_CC_Cx1_CC_aktiv)
  compu method CM_UI2_KompFehlerModus4_04: 0=Cx0_TNCTOC (CM_UI2_KompFehlerModus4_04_Cx0_TNCTOC), 1=Cx1_TP_TC (CM_UI2_KompFehlerModus4_04_Cx1_TP_TC), 2=Cx2_TP_TC_WCMTL (CM_UI2_KompFehlerModus4_04_Cx2_TP_TC_WCMTL), 3=Cx3_TF_TC_Error_1 (CM_UI2_KompFehlerModus4_04_Cx3_TF_TC_Error_1), 4=Cx4_TF_TC_Error_2 (CM_UI2_KompFehlerModus4_04_Cx4_TF_TC_Error_2), 5=Cx5_TF_TC_Error_3 (CM_UI2_KompFehlerModus4_04_Cx5_TF_TC_Error_3), 6=Cx6_TF_TC_Error_4 (CM_UI2_KompFehlerModus4_04_Cx6_TF_TC_Error_4), 7=Cx7_TF_TC_Error_5 (CM_UI2_KompFehlerModus4_04_Cx7_TF_TC_Error_5)
  compu method CM_UI2Sens02_CVN_Byte_3: phys=raw for raw 0..255
  compu method CM_BMC_IstZellSpannungMax_Modul_ID: phys=raw for raw 1..254, 255=Cxff_Init (CM_BMC_IstZellSpannungMax_Modul_ID_Cxff_Init); unit Unit_None
  compu method CM_NM_Gateway_CBV_CRI: 0=Cx0_NM_ohne_Clusteranforderungen (CM_NM_Gateway_CBV_CRI_Cx0_NM_ohne_Clusteranforderungen), 1=Cx1_NM_mit_Clusteranforderungen (CM_NM_Gateway_CBV_CRI_Cx1_NM_mit_Clusteranforderungen)
  compu method CM_BMC_Verbrauch_Ueberlauf: 0=Cx0_nicht_Ueberlauf (CM_BMC_Verbrauch_Ueberlauf_Cx0_nicht_Ueberlauf), 1=Cx1_Ueberlauf (CM_BMC_Verbrauch_Ueberlauf_Cx1_Ueberlauf)
  compu method CM_KST_Warn_P2_ZAT_def: 0=Cx0_nicht_defekt (CM_KST_Warn_P2_ZAT_def_Cx0_nicht_defekt), 1=Cx1_defekt (CM_KST_Warn_P2_ZAT_def_Cx1_defekt)
  compu method CM_Thermo_Verbrauch_Innen: phys=raw for raw 0..8191; unit Unit_WattSecond
  compu method CM_UI1_KompFehlerModus2_25: 0=Cx0_TNCTOC (CM_UI1_KompFehlerModus2_25_Cx0_TNCTOC), 1=Cx1_TP_TC (CM_UI1_KompFehlerModus2_25_Cx1_TP_TC), 2=Cx2_TP_TC_WCMTL (CM_UI1_KompFehlerModus2_25_Cx2_TP_TC_WCMTL), 3=Cx3_TF_TC_Error (CM_UI1_KompFehlerModus2_25_Cx3_TF_TC_Error)
  compu method CM_Hybrid_01_SNI_10: phys=raw for raw 0..1023; unit Unit_None
  compu method CM_OBD_Warm_Up_Cycle: 0=Cx0_kein_Warm_Up_Cycle_erkannt (CM_OBD_Warm_Up_Cycle_Cx0_kein_Warm_Up_Cycle_erkannt), 1=Cx1_Warm_Up_Cycle_erkannt (CM_OBD_Warm_Up_Cycle_Cx1_Warm_Up_Cycle_erkannt)
  compu method CM_NM_Gateway_FCAB: 0=Cx0_Init (CM_NM_Gateway_FCAB_Cx0_Init), 1=Cx1_01_CarWakeUp (CM_NM_Gateway_FCAB_Cx1_01_CarWakeUp), 2=Cx2_02_Basefunction_Powertrain (CM_NM_Gateway_FCAB_Cx2_02_Basefunction_Powertrain), 4=Cx4_03_Basefunction_Chassis (CM_NM_Gateway_FCAB_Cx4_03_Basefunction_Chassis), 8=Cx8_04_Basefunction_DrivingAssistance (CM_NM_Gateway_FCAB_Cx8_04_Basefunction_DrivingAssistance), 16=Cx10_05_Basefunction_Infotainment (CM_NM_Gateway_FCAB_Cx10_05_Basefunction_Infotainment), 32=Cx20_06_Basefunction_ComfortLight (CM_NM_Gateway_FCAB_Cx20_06_Basefunction_ComfortLight), 64=Cx40_07_Basefunction_CrossSection (CM_NM_Gateway_FCAB_Cx40_07_Basefunction_CrossSection), 128=Cx80_08_Basefunction_Connectivity (CM_NM_Gateway_FCAB_Cx80_08_Basefunction_Connectivity), 256=Cx100_09_Basefunction_DrivingAssistanceCore (CM_NM_Gateway_FCAB_Cx100_09_Basefunction_DrivingAssistanceCore), 512=Cx200_10_Powertrain (CM_NM_Gateway_FCAB_Cx200_10_Powertrain), 1024=Cx400_11_Chassis (CM_NM_Gateway_FCAB_Cx400_11_Chassis), 2048=Cx800_12_GearSelector (CM_NM_Gateway_FCAB_Cx800_12_GearSelector), 4096=Cx1000_13_Airbag (CM_NM_Gateway_FCAB_Cx1000_13_Airbag), 8192=Cx2000_14_InfotainmentExtensions (CM_NM_Gateway_FCAB_Cx2000_14_InfotainmentExtensions), 16384=Cx4000_15_InstrumentclusterDisplay (CM_NM_Gateway_FCAB_Cx4000_15_InstrumentclusterDisplay), 32768=Cx8000_16_InfotainmentDisplay (CM_NM_Gateway_FCAB_Cx8000_16_InfotainmentDisplay), 65536=Cx10000_17_Audio (CM_NM_Gateway_FCAB_Cx10000_17_Audio), 131072=Cx20000_18_VirtualSideMirrors (CM_NM_Gateway_FCAB_Cx20000_18_VirtualSideMirrors), 262144=Cx40000_19_Doors_Hatches (CM_NM_Gateway_FCAB_Cx40000_19_Doors_Hatches), 524288=Cx80000_20_OptionalComfort (CM_NM_Gateway_FCAB_Cx80000_20_OptionalComfort), 1048576=Cx100000_21_AirSuspension (CM_NM_Gateway_FCAB_Cx100000_21_AirSuspension), 2097152=Cx200000_22_ExteriorLights (CM_NM_Gateway_FCAB_Cx200000_22_ExteriorLights), 4194304=Cx400000_23_Climate (CM_NM_Gateway_FCAB_Cx400000_23_Climate), 8388608=Cx800000_24_ThermoManagement (CM_NM_Gateway_FCAB_Cx800000_24_ThermoManagement), 16777216=Cx1000000_25_AccessSystemSensors (CM_NM_Gateway_FCAB_Cx1000000_25_AccessSystemSensors), 33554432=Cx2000000_26_HighVoltage_Charging (CM_NM_Gateway_FCAB_Cx2000000_26_HighVoltage_Charging), 67108864=Cx4000000_27_Timemaster_Timer (CM_NM_Gateway_FCAB_Cx4000000_27_Timemaster_Timer), 134217728=Cx8000000_28_OnboardTester_DataCollector (CM_NM_Gateway_FCAB_Cx8000000_28_OnboardTester_DataCollector), 268435456=Cx10000000_29_SteeringColumnLock (CM_NM_Gateway_FCAB_Cx10000000_29_SteeringColumnLock), 536870912=Cx20000000_30_EnergyManagement (CM_NM_Gateway_FCAB_Cx20000000_30_EnergyManagement), 1073741824=Cx40000000_31_MultifunctionalSteeringWheel (CM_NM_Gateway_FCAB_Cx40000000_31_MultifunctionalSteeringWheel), 2147483648=Cx80000000_32_OnlineAccess (CM_NM_Gateway_FCAB_Cx80000000_32_OnlineAccess), 4294967296=Cx100000000_33_ExternalWirelessCommunication (CM_NM_Gateway_FCAB_Cx100000000_33_ExternalWirelessCommunication), 8589934592=Cx200000000_34_GPS_Localization (CM_NM_Gateway_FCAB_Cx200000000_34_GPS_Localization), 17179869184=Cx400000000_35_ExteriorSound (CM_NM_Gateway_FCAB_Cx400000000_35_ExteriorSound), 34359738368=Cx800000000_36_Preheater (CM_NM_Gateway_FCAB_Cx800000000_36_Preheater), 68719476736=Cx1000000000_37_HighVoltage_WirelessChargingStation (CM_NM_Gateway_FCAB_Cx1000000000_37_HighVoltage_WirelessChargingStation), 549755813888=Cx8000000000_40_Diagnosis_Energy (CM_NM_Gateway_FCAB_Cx8000000000_40_Diagnosis_Energy), 1099511627776=Cx10000000000_41_Diagnosis_Powertrain (CM_NM_Gateway_FCAB_Cx10000000000_41_Diagnosis_Powertrain), 2199023255552=Cx20000000000_42_Diagnosis_FlexRay (CM_NM_Gateway_FCAB_Cx20000000000_42_Diagnosis_FlexRay), 4398046511104=Cx40000000000_43_Diagnosis_DrivingAssistance (CM_NM_Gateway_FCAB_Cx40000000000_43_Diagnosis_DrivingAssistance), 8796093022208=Cx80000000000_44_Diagnosis_Infotainment (CM_NM_Gateway_FCAB_Cx80000000000_44_Diagnosis_Infotainment), 17592186044416=Cx100000000000_45_Diagnosis_Comfort (CM_NM_Gateway_FCAB_Cx100000000000_45_Diagnosis_Comfort), 35184372088832=Cx200000000000_46_Diagnosis_Light (CM_NM_Gateway_FCAB_Cx200000000000_46_Diagnosis_Light), 70368744177664=Cx400000000000_47_Diagnosis_ComfortLINs (CM_NM_Gateway_FCAB_Cx400000000000_47_Diagnosis_ComfortLINs), 140737488355328=Cx800000000000_48_Diagnosis_ClimateTmeLINs (CM_NM_Gateway_FCAB_Cx800000000000_48_Diagnosis_ClimateTmeLINs), 281474976710656=Cx1000000000000_49_reserved (CM_NM_Gateway_FCAB_Cx1000000000000_49_reserved) (49_<reserved>), 4503599627370496=Cx10000000000000_53_Lock_Unlock (CM_NM_Gateway_FCAB_Cx10000000000000_53_Lock_Unlock), 9007199254740992=Cx20000000000000_54_reserved (CM_NM_Gateway_FCAB_Cx20000000000000_54_reserved) (54_<reserved>), 18014398509481984=Cx40000000000000_55_Dimming (CM_NM_Gateway_FCAB_Cx40000000000000_55_Dimming), 36028797018963968=Cx80000000000000_56_ChargingStatus (CM_NM_Gateway_FCAB_Cx80000000000000_56_ChargingStatus)
  compu method CM_NM_Hybrid_01_Wakeup_V12: 0=Cx0_Peripherie_Wakeup_Ursache_nicht_bekannt (CM_NM_Hybrid_01_Wakeup_V12_Cx0_Peripherie_Wakeup_Ursache_nicht_bekannt), 1=Cx1_Bus_Wakeup (CM_NM_Hybrid_01_Wakeup_V12_Cx1_Bus_Wakeup), 2=Cx2_KL15_HW (CM_NM_Hybrid_01_Wakeup_V12_Cx2_KL15_HW), 128=Cx80_Konditionierungsbedarf (CM_NM_Hybrid_01_Wakeup_V12_Cx80_Konditionierungsbedarf)
  compu method CM_TME_MVEM_Wunschleistung: phys=raw*50 for raw 0..253, 254=Cxfe_Init (CM_TME_MVEM_Wunschleistung_Cxfe_Init), 255=Cxff_Fehler (CM_TME_MVEM_Wunschleistung_Cxff_Fehler); unit Unit_Watt
  compu method CM_UI2Sens02_CVN_Byte_4: phys=raw for raw 0..255
  compu method CM_AB_Rollover_Crash: 0=Cx0_kein_Rollover (CM_AB_Rollover_Crash_Cx0_kein_Rollover), 1=Cx1_Rollover (CM_AB_Rollover_Crash_Cx1_Rollover)
  compu method CM_KST_WFS_Fahrfreigabe_Anforderung: 0=Cx0_Keine (CM_KST_WFS_Fahrfreigabe_Anforderung_Cx0_Keine), 1=Cx1_Uneingeschraenkt (CM_KST_WFS_Fahrfreigabe_Anforderung_Cx1_Uneingeschraenkt), 2=Cx2_Eingeschraenkt (CM_KST_WFS_Fahrfreigabe_Anforderung_Cx2_Eingeschraenkt)
  compu method CM_OBDProtocol_Hybrid_01: 0=Cx0_not_available (CM_OBDProtocol_Hybrid_01_Cx0_not_available), 1=Cx1_OBDclassic (CM_OBDProtocol_Hybrid_01_Cx1_OBDclassic), 2=Cx2_OBDonUDS (CM_OBDProtocol_Hybrid_01_Cx2_OBDonUDS), 3=Cx3_ZEVonUDS (CM_OBDProtocol_Hybrid_01_Cx3_ZEVonUDS), 4=Cx4_NoOBD (CM_OBDProtocol_Hybrid_01_Cx4_NoOBD), 14=Cxe_Init (CM_OBDProtocol_Hybrid_01_Cxe_Init), 15=Cxf_Fehler (CM_OBDProtocol_Hybrid_01_Cxf_Fehler)
  compu method CM_Thermo_Verbrauch_Innen_Ueberlauf: 0=Cx0_kein_Ueberlauf (CM_Thermo_Verbrauch_Innen_Ueberlauf_Cx0_kein_Ueberlauf), 1=Cx1_Ueberlauf (CM_Thermo_Verbrauch_Innen_Ueberlauf_Cx1_Ueberlauf)
  compu method CM_Hybrid_01_Transport_Mode: 0=Cx0_keine_Einschraenkung (CM_Hybrid_01_Transport_Mode_Cx0_keine_Einschraenkung), 1=Cx1_Funktionseinschraenkung (CM_Hybrid_01_Transport_Mode_Cx1_Funktionseinschraenkung)
  compu method CM_BMC_IstZellSpannungMax_Zell_ID: phys=raw for raw 1..254, 255=Cxff_Init (CM_BMC_IstZellSpannungMax_Zell_ID_Cxff_Init); unit Unit_None
  compu method CM_NM_Gateway_NM_aktiv_CABaktiv: 0=Cx0_Inaktiv (CM_NM_Gateway_NM_aktiv_CABaktiv_Cx0_Inaktiv), 1=Cx1_Cluster_Min_Req_TimeOfVNSM (CM_NM_Gateway_NM_aktiv_CABaktiv_Cx1_Cluster_Min_Req_TimeOfVNSM)
  compu method CM_NM_Ladegeraet_CBV_AWB: 0=Cx0_Passiver_WakeUp (CM_NM_Ladegeraet_CBV_AWB_Cx0_Passiver_WakeUp), 1=Cx1_Aktiver_WakeUp (CM_NM_Ladegeraet_CBV_AWB_Cx1_Aktiver_WakeUp)
  compu method CM_UI2_KompFehlerModus4_05: 0=Cx0_TNCTOC (CM_UI2_KompFehlerModus4_05_Cx0_TNCTOC), 1=Cx1_TP_TC (CM_UI2_KompFehlerModus4_05_Cx1_TP_TC), 2=Cx2_TP_TC_WCMTL (CM_UI2_KompFehlerModus4_05_Cx2_TP_TC_WCMTL), 3=Cx3_TF_TC_Error_1 (CM_UI2_KompFehlerModus4_05_Cx3_TF_TC_Error_1), 4=Cx4_TF_TC_Error_2 (CM_UI2_KompFehlerModus4_05_Cx4_TF_TC_Error_2), 5=Cx5_TF_TC_Error_3 (CM_UI2_KompFehlerModus4_05_Cx5_TF_TC_Error_3), 6=Cx6_TF_TC_Error_4 (CM_UI2_KompFehlerModus4_05_Cx6_TF_TC_Error_4), 7=Cx7_TF_TC_Error_5 (CM_UI2_KompFehlerModus4_05_Cx7_TF_TC_Error_5)
  compu method CM_UI2Sens02_CVN_VLD: 0=Cx0_Ungueltig (CM_UI2Sens02_CVN_VLD_Cx0_Ungueltig), 1=Cx1_Gueltig (CM_UI2Sens02_CVN_VLD_Cx1_Gueltig)
  compu method CM_OBDProtocol_req: 0=Cx0_not_available (CM_OBDProtocol_req_Cx0_not_available), 1=Cx1_OBDclassic (CM_OBDProtocol_req_Cx1_OBDclassic), 2=Cx2_OBDonUDS (CM_OBDProtocol_req_Cx2_OBDonUDS), 3=Cx3_ZEVonUDS (CM_OBDProtocol_req_Cx3_ZEVonUDS), 14=Cxe_Init (CM_OBDProtocol_req_Cxe_Init), 15=Cxf_Fehler (CM_OBDProtocol_req_Cxf_Fehler)
  compu method CM_UI1_KompFehlerModus2_26: 0=Cx0_TNCTOC (CM_UI1_KompFehlerModus2_26_Cx0_TNCTOC), 1=Cx1_TP_TC (CM_UI1_KompFehlerModus2_26_Cx1_TP_TC), 2=Cx2_TP_TC_WCMTL (CM_UI1_KompFehlerModus2_26_Cx2_TP_TC_WCMTL), 3=Cx3_TF_TC_Error (CM_UI1_KompFehlerModus2_26_Cx3_TF_TC_Error)
  compu method CM_BMC_VerlustEnergie: phys=raw*4 for raw 0..8189, 8190=Cx1ffe_Init (CM_BMC_VerlustEnergie_Cx1ffe_Init), 8191=Cx1fff_Fehler (CM_BMC_VerlustEnergie_Cx1fff_Fehler); unit Unit_WattHour
  compu method CM_NM_Gateway_NM_aktiv_Diag: 0=Cx0_Inaktiv (CM_NM_Gateway_NM_aktiv_Diag_Cx0_Inaktiv), 1=Cx1_Diagnose_aktiv (CM_NM_Gateway_NM_aktiv_Diag_Cx1_Diagnose_aktiv)
  compu method CM_KST_ZAT_betaetigt: 0=Cx0_Aus (CM_KST_ZAT_betaetigt_Cx0_Aus), 1=Cx1_Ein (CM_KST_ZAT_betaetigt_Cx1_Ein)
  compu method CM_TME_Anforderung_Heizkreispumpe: phys=raw for raw 0..100, 126=Cx7e_Init (CM_TME_Anforderung_Heizkreispumpe_Cx7e_Init), 127=Cx7f_Fehler (CM_TME_Anforderung_Heizkreispumpe_Cx7f_Fehler); unit Unit_PerCent
  compu method CM_IMMO_ClampPermStatus: 0=Cx0_keine_Freigabe (CM_IMMO_ClampPermStatus_Cx0_keine_Freigabe), 1=Cx1_Normale_Freigabe (CM_IMMO_ClampPermStatus_Cx1_Normale_Freigabe), 3=Cx3_Diagnose_Freigabe (CM_IMMO_ClampPermStatus_Cx3_Diagnose_Freigabe), 5=Cx5_RemoteDrive_Freigabe_Leistungsbereitstellung_mit_Vortrieb (CM_IMMO_ClampPermStatus_Cx5_RemoteDrive_Freigabe_Leistungsbereitstellung_mit_Vortrieb), 9=Cx9_RemoteStart_Freigabe_Leistungsbereitstellung (CM_IMMO_ClampPermStatus_Cx9_RemoteStart_Freigabe_Leistungsbereitstellung), 14=Cxe_Busy (CM_IMMO_ClampPermStatus_Cxe_Busy), 15=Cxf_Init (CM_IMMO_ClampPermStatus_Cxf_Init)
  compu method CM_TME_MVH_L_Istmodus: 0=Cx0_Standby (CM_TME_MVH_L_Istmodus_Cx0_Standby), 1=Cx1_Regelung_aktiv (CM_TME_MVH_L_Istmodus_Cx1_Regelung_aktiv), 2=Cx2_Freigabe_ausgesetzt (CM_TME_MVH_L_Istmodus_Cx2_Freigabe_ausgesetzt), 5=Cx5_Fehler (CM_TME_MVH_L_Istmodus_Cx5_Fehler), 7=Cx7_Init (CM_TME_MVH_L_Istmodus_Cx7_Init)
  compu method CM_NM_Ladegeraet_CBV_CRI: 0=Cx0_Standard_Layout (CM_NM_Ladegeraet_CBV_CRI_Cx0_Standard_Layout), 1=Cx1_TNB_Layout (CM_NM_Ladegeraet_CBV_CRI_Cx1_TNB_Layout)
  compu method CM_AB_SB_Crash: 0=Cx0_kein_Seiten_Crash_Beifahrer (CM_AB_SB_Crash_Cx0_kein_Seiten_Crash_Beifahrer), 1=Cx1_Seiten_Crash_Beifahrer (CM_AB_SB_Crash_Cx1_Seiten_Crash_Beifahrer)
  compu method CM_OBG_01_BZ: phys=raw for raw 0..15
  compu method CM_UI2Sens02_ErrMem_State: 1=Cx1_ErrMem_Active (CM_UI2Sens02_ErrMem_State_Cx1_ErrMem_Active), 2=Cx2_ErrMem_Init_Progress (CM_UI2Sens02_ErrMem_State_Cx2_ErrMem_Init_Progress), 3=Cx3_ErrMem_Init_Done (CM_UI2Sens02_ErrMem_State_Cx3_ErrMem_Init_Done)
  compu method CM_NM_Gateway_NM_aktiv_KL15: 0=Cx0_Inaktiv (CM_NM_Gateway_NM_aktiv_KL15_Cx0_Inaktiv), 1=Cx1_KL15_EIN (CM_NM_Gateway_NM_aktiv_KL15_Cx1_KL15_EIN)
  compu method CM_BMC_IstZellspannungMin: phys=raw+1000 for raw 0..4091, 4092=Cxffc_kleiner_1V (CM_BMC_IstZellspannungMin_Cxffc_kleiner_1V), 4093=Cxffd_reserviert (CM_BMC_IstZellspannungMin_Cxffd_reserviert), 4094=Cxffe_Init (CM_BMC_IstZellspannungMin_Cxffe_Init), 4095=Cxfff_Fehler (CM_BMC_IstZellspannungMin_Cxfff_Fehler); unit Unit_MilliVolt
  compu method CM_LR_StDiagPrcd: 0=Cx0_Inactive (CM_LR_StDiagPrcd_Cx0_Inactive), 1=Cx1_Not_available (CM_LR_StDiagPrcd_Cx1_Not_available), 2=Cx2_Conditions_not_fulfilled (CM_LR_StDiagPrcd_Cx2_Conditions_not_fulfilled), 3=Cx3_Running (CM_LR_StDiagPrcd_Cx3_Running), 4=Cx4_Finished_successful (CM_LR_StDiagPrcd_Cx4_Finished_successful), 5=Cx5_Finished_failed (CM_LR_StDiagPrcd_Cx5_Finished_failed), 6=Cx6_Init (CM_LR_StDiagPrcd_Cx6_Init), 7=Cx7_Fehler (CM_LR_StDiagPrcd_Cx7_Fehler)
  compu method CM_UI2_KompFehlerModus4_06: 0=Cx0_TNCTOC (CM_UI2_KompFehlerModus4_06_Cx0_TNCTOC), 1=Cx1_TP_TC (CM_UI2_KompFehlerModus4_06_Cx1_TP_TC), 2=Cx2_TP_TC_WCMTL (CM_UI2_KompFehlerModus4_06_Cx2_TP_TC_WCMTL), 3=Cx3_TF_TC_Error_1 (CM_UI2_KompFehlerModus4_06_Cx3_TF_TC_Error_1), 4=Cx4_TF_TC_Error_2 (CM_UI2_KompFehlerModus4_06_Cx4_TF_TC_Error_2), 5=Cx5_TF_TC_Error_3 (CM_UI2_KompFehlerModus4_06_Cx5_TF_TC_Error_3), 6=Cx6_TF_TC_Error_4 (CM_UI2_KompFehlerModus4_06_Cx6_TF_TC_Error_4), 7=Cx7_TF_TC_Error_5 (CM_UI2_KompFehlerModus4_06_Cx7_TF_TC_Error_5)
  compu method CM_NM_Gateway_NM_aktiv_Tmin: 0=Cx0_Inaktiv (CM_NM_Gateway_NM_aktiv_Tmin_Cx0_Inaktiv), 1=Cx1_Mindestaktivzeit (CM_NM_Gateway_NM_aktiv_Tmin_Cx1_Mindestaktivzeit)
  compu method CM_TME_Antriebszustand_Anf: 0=Cx0_keine_Anforderung (CM_TME_Antriebszustand_Anf_Cx0_keine_Anforderung) (keine Anforderung), 1=Cx1_Antriebszustand_1 (CM_TME_Antriebszustand_Anf_Cx1_Antriebszustand_1) (Antriebszustand 1), 2=Cx2_Antriebszustand_2 (CM_TME_Antriebszustand_Anf_Cx2_Antriebszustand_2) (Antriebszustand 2), 3=Cx3_Antriebszustand_3 (CM_TME_Antriebszustand_Anf_Cx3_Antriebszustand_3) (Antriebszustand 3), 4=Cx4_Antriebszustand_4 (CM_TME_Antriebszustand_Anf_Cx4_Antriebszustand_4) (Antriebszustand 4), 5=Cx5_Antriebszustand_5 (CM_TME_Antriebszustand_Anf_Cx5_Antriebszustand_5) (Antriebszustand 5), 6=Cx6_Antriebszustand_6 (CM_TME_Antriebszustand_Anf_Cx6_Antriebszustand_6) (Antriebszustand 6), 7=Cx7_Fehler (CM_TME_Antriebszustand_Anf_Cx7_Fehler)
  compu method CM_OnlineRemoteUpdateControlA: 0=Cx0_IDLE (CM_OnlineRemoteUpdateControlA_Cx0_IDLE), 1=Cx1_PENDING (CM_OnlineRemoteUpdateControlA_Cx1_PENDING), 2=Cx2_PREPARATION (CM_OnlineRemoteUpdateControlA_Cx2_PREPARATION), 3=Cx3_PREPARATION_HV (CM_OnlineRemoteUpdateControlA_Cx3_PREPARATION_HV), 4=Cx4_RUNNING (CM_OnlineRemoteUpdateControlA_Cx4_RUNNING), 5=Cx5_RUNNING_HV (CM_OnlineRemoteUpdateControlA_Cx5_RUNNING_HV), 6=Cx6_PENDING_NOTREADY (CM_OnlineRemoteUpdateControlA_Cx6_PENDING_NOTREADY), 7=Cx7_OTA_FAILURE_POWERTRAIN_DISABLED (CM_OnlineRemoteUpdateControlA_Cx7_OTA_FAILURE_POWERTRAIN_DISABLED), 8=Cx8_FUNCTIONAL_SAFETY_RELEASED (CM_OnlineRemoteUpdateControlA_Cx8_FUNCTIONAL_SAFETY_RELEASED), 9=Cx9_PREPARATION_SG (CM_OnlineRemoteUpdateControlA_Cx9_PREPARATION_SG), 15=Cxf_Fehler (CM_OnlineRemoteUpdateControlA_Cxf_Fehler)
  compu method CM_IMMO_Display: 0=Cx0_keine_Anzeige (CM_IMMO_Display_Cx0_keine_Anzeige) (keine Anzeige), 1=Cx1_Anzeige (CM_IMMO_Display_Cx1_Anzeige), 2=Cx2_Fehler (CM_IMMO_Display_Cx2_Fehler)
  compu method CM_UI1_KompFehlerModus4_01: 0=Cx0_TNCTOC (CM_UI1_KompFehlerModus4_01_Cx0_TNCTOC), 1=Cx1_TP_TC (CM_UI1_KompFehlerModus4_01_Cx1_TP_TC), 2=Cx2_TP_TC_WCMTL (CM_UI1_KompFehlerModus4_01_Cx2_TP_TC_WCMTL), 3=Cx3_TF_TC_Error_1 (CM_UI1_KompFehlerModus4_01_Cx3_TF_TC_Error_1), 4=Cx4_TF_TC_Error_2 (CM_UI1_KompFehlerModus4_01_Cx4_TF_TC_Error_2), 5=Cx5_TF_TC_Error_3 (CM_UI1_KompFehlerModus4_01_Cx5_TF_TC_Error_3), 6=Cx6_TF_TC_Error_4 (CM_UI1_KompFehlerModus4_01_Cx6_TF_TC_Error_4), 7=Cx7_TF_TC_Error_5 (CM_UI1_KompFehlerModus4_01_Cx7_TF_TC_Error_5)
  compu method CM_NM_Ladegeraet_FCAB: 0=Cx0_Init (CM_NM_Ladegeraet_FCAB_Cx0_Init), 1=Cx1_01_CarWakeUp (CM_NM_Ladegeraet_FCAB_Cx1_01_CarWakeUp), 2=Cx2_02_Basefunction_Powertrain (CM_NM_Ladegeraet_FCAB_Cx2_02_Basefunction_Powertrain), 4=Cx4_03_Basefunction_Chassis (CM_NM_Ladegeraet_FCAB_Cx4_03_Basefunction_Chassis), 8=Cx8_04_Basefunction_DrivingAssistance (CM_NM_Ladegeraet_FCAB_Cx8_04_Basefunction_DrivingAssistance), 16=Cx10_05_Basefunction_Infotainment (CM_NM_Ladegeraet_FCAB_Cx10_05_Basefunction_Infotainment), 32=Cx20_06_Basefunction_ComfortLight (CM_NM_Ladegeraet_FCAB_Cx20_06_Basefunction_ComfortLight), 64=Cx40_07_Basefunction_CrossSection (CM_NM_Ladegeraet_FCAB_Cx40_07_Basefunction_CrossSection), 128=Cx80_08_Basefunction_Connectivity (CM_NM_Ladegeraet_FCAB_Cx80_08_Basefunction_Connectivity), 256=Cx100_09_Basefunction_DrivingAssistanceCore (CM_NM_Ladegeraet_FCAB_Cx100_09_Basefunction_DrivingAssistanceCore), 512=Cx200_10_Powertrain (CM_NM_Ladegeraet_FCAB_Cx200_10_Powertrain), 1024=Cx400_11_Chassis (CM_NM_Ladegeraet_FCAB_Cx400_11_Chassis), 2048=Cx800_12_GearSelector (CM_NM_Ladegeraet_FCAB_Cx800_12_GearSelector), 4096=Cx1000_13_Airbag (CM_NM_Ladegeraet_FCAB_Cx1000_13_Airbag), 8192=Cx2000_14_InfotainmentExtensions (CM_NM_Ladegeraet_FCAB_Cx2000_14_InfotainmentExtensions), 16384=Cx4000_15_InstrumentclusterDisplay (CM_NM_Ladegeraet_FCAB_Cx4000_15_InstrumentclusterDisplay), 32768=Cx8000_16_InfotainmentDisplay (CM_NM_Ladegeraet_FCAB_Cx8000_16_InfotainmentDisplay), 65536=Cx10000_17_Audio (CM_NM_Ladegeraet_FCAB_Cx10000_17_Audio), 131072=Cx20000_18_VirtualSideMirrors (CM_NM_Ladegeraet_FCAB_Cx20000_18_VirtualSideMirrors), 262144=Cx40000_19_Doors_Hatches (CM_NM_Ladegeraet_FCAB_Cx40000_19_Doors_Hatches), 524288=Cx80000_20_OptionalComfort (CM_NM_Ladegeraet_FCAB_Cx80000_20_OptionalComfort), 1048576=Cx100000_21_AirSuspension (CM_NM_Ladegeraet_FCAB_Cx100000_21_AirSuspension), 2097152=Cx200000_22_ExteriorLights (CM_NM_Ladegeraet_FCAB_Cx200000_22_ExteriorLights), 4194304=Cx400000_23_Climate (CM_NM_Ladegeraet_FCAB_Cx400000_23_Climate), 8388608=Cx800000_24_ThermoManagement (CM_NM_Ladegeraet_FCAB_Cx800000_24_ThermoManagement), 16777216=Cx1000000_25_AccessSystemSensors (CM_NM_Ladegeraet_FCAB_Cx1000000_25_AccessSystemSensors), 33554432=Cx2000000_26_HighVoltage_Charging (CM_NM_Ladegeraet_FCAB_Cx2000000_26_HighVoltage_Charging), 67108864=Cx4000000_27_Timemaster_Timer (CM_NM_Ladegeraet_FCAB_Cx4000000_27_Timemaster_Timer), 134217728=Cx8000000_28_OnboardTester_DataCollector (CM_NM_Ladegeraet_FCAB_Cx8000000_28_OnboardTester_DataCollector), 268435456=Cx10000000_29_SteeringColumnLock (CM_NM_Ladegeraet_FCAB_Cx10000000_29_SteeringColumnLock), 536870912=Cx20000000_30_EnergyManagement (CM_NM_Ladegeraet_FCAB_Cx20000000_30_EnergyManagement), 1073741824=Cx40000000_31_MultifunctionalSteeringWheel (CM_NM_Ladegeraet_FCAB_Cx40000000_31_MultifunctionalSteeringWheel), 2147483648=Cx80000000_32_OnlineAccess (CM_NM_Ladegeraet_FCAB_Cx80000000_32_OnlineAccess), 4294967296=Cx100000000_33_ExternalWirelessCommunication (CM_NM_Ladegeraet_FCAB_Cx100000000_33_ExternalWirelessCommunication), 8589934592=Cx200000000_34_GPS_Localization (CM_NM_Ladegeraet_FCAB_Cx200000000_34_GPS_Localization), 17179869184=Cx400000000_35_ExteriorSound (CM_NM_Ladegeraet_FCAB_Cx400000000_35_ExteriorSound), 34359738368=Cx800000000_36_Preheater (CM_NM_Ladegeraet_FCAB_Cx800000000_36_Preheater), 68719476736=Cx1000000000_37_HighVoltage_WirelessChargingStation (CM_NM_Ladegeraet_FCAB_Cx1000000000_37_HighVoltage_WirelessChargingStation), 549755813888=Cx8000000000_40_Diagnosis_Energy (CM_NM_Ladegeraet_FCAB_Cx8000000000_40_Diagnosis_Energy), 1099511627776=Cx10000000000_41_Diagnosis_Powertrain (CM_NM_Ladegeraet_FCAB_Cx10000000000_41_Diagnosis_Powertrain), 2199023255552=Cx20000000000_42_Diagnosis_FlexRay (CM_NM_Ladegeraet_FCAB_Cx20000000000_42_Diagnosis_FlexRay), 4398046511104=Cx40000000000_43_Diagnosis_DrivingAssistance (CM_NM_Ladegeraet_FCAB_Cx40000000000_43_Diagnosis_DrivingAssistance), 8796093022208=Cx80000000000_44_Diagnosis_Infotainment (CM_NM_Ladegeraet_FCAB_Cx80000000000_44_Diagnosis_Infotainment), 17592186044416=Cx100000000000_45_Diagnosis_Comfort (CM_NM_Ladegeraet_FCAB_Cx100000000000_45_Diagnosis_Comfort), 35184372088832=Cx200000000000_46_Diagnosis_Light (CM_NM_Ladegeraet_FCAB_Cx200000000000_46_Diagnosis_Light), 70368744177664=Cx400000000000_47_Diagnosis_ComfortLINs (CM_NM_Ladegeraet_FCAB_Cx400000000000_47_Diagnosis_ComfortLINs), 140737488355328=Cx800000000000_48_Diagnosis_ClimateTmeLINs (CM_NM_Ladegeraet_FCAB_Cx800000000000_48_Diagnosis_ClimateTmeLINs), 281474976710656=Cx1000000000000_49_reserved (CM_NM_Ladegeraet_FCAB_Cx1000000000000_49_reserved) (49_<reserved>), 4503599627370496=Cx10000000000000_53_Lock_Unlock (CM_NM_Ladegeraet_FCAB_Cx10000000000000_53_Lock_Unlock), 9007199254740992=Cx20000000000000_54_reserved (CM_NM_Ladegeraet_FCAB_Cx20000000000000_54_reserved) (54_<reserved>), 18014398509481984=Cx40000000000000_55_Dimming (CM_NM_Ladegeraet_FCAB_Cx40000000000000_55_Dimming), 36028797018963968=Cx80000000000000_56_ChargingStatus (CM_NM_Ladegeraet_FCAB_Cx80000000000000_56_ChargingStatus)
  compu method CM_BMC_Vorlade_Zielspannung: phys=raw for raw 0..1021, 1022=Cx3fe_Init (CM_BMC_Vorlade_Zielspannung_Cx3fe_Init), 1023=Cx3ff_Fehler (CM_BMC_Vorlade_Zielspannung_Cx3ff_Fehler); unit Unit_Volt
  compu method CM_TME_MVH_L_Spannung: phys=raw*0.25 for raw 0..253, 254=Cxfe_Init (CM_TME_MVH_L_Spannung_Cxfe_Init), 255=Cxff_Fehler (CM_TME_MVH_L_Spannung_Cxff_Fehler); unit Unit_Volt
  compu method CM_NM_Gateway_NM_State: 0=Cx0_Init (CM_NM_Gateway_NM_State_Cx0_Init), 1=Cx1_NM_RM_aus_BSM (CM_NM_Gateway_NM_State_Cx1_NM_RM_aus_BSM), 2=Cx2_NM_RM_aus_PBSM (CM_NM_Gateway_NM_State_Cx2_NM_RM_aus_PBSM), 4=Cx4_NM_NO_aus_RM (CM_NM_Gateway_NM_State_Cx4_NM_NO_aus_RM), 8=Cx8_NM_NO_aus_RS (CM_NM_Gateway_NM_State_Cx8_NM_NO_aus_RS), 16=Cx10_reserved (CM_NM_Gateway_NM_State_Cx10_reserved), 32=Cx20_reserved (CM_NM_Gateway_NM_State_Cx20_reserved)
  compu method CM_LVB_Ladegeschw: phys=raw for raw 0..5000, 8190=Cx1ffe_Init (CM_LVB_Ladegeschw_Cx1ffe_Init); unit Unit_None
  compu method CM_AB_SBR_hinten_verbau: 0=Cx0_ohne_SBR_hinten (CM_AB_SBR_hinten_verbau_Cx0_ohne_SBR_hinten), 1=Cx1_mit_SBR_hinten (CM_AB_SBR_hinten_verbau_Cx1_mit_SBR_hinten), 2=Cx2_nicht_definiert (CM_AB_SBR_hinten_verbau_Cx2_nicht_definiert), 3=Cx3_Init (CM_AB_SBR_hinten_verbau_Cx3_Init)
  compu method CM_TME_Batt_Kond_status: 0=Cx0_inaktiv (CM_TME_Batt_Kond_status_Cx0_inaktiv), 1=Cx1_aktiv (CM_TME_Batt_Kond_status_Cx1_aktiv)
  compu method CM_KL_Verdampfertemperatur: phys=raw*0.1-20 for raw 0..900, 1022=Cx3fe_Init (CM_KL_Verdampfertemperatur_Cx3fe_Init), 1023=Cx3ff_Fehler (CM_KL_Verdampfertemperatur_Cx3ff_Fehler); unit Unit_DegreCelsi
  compu method CM_OnlineRemoteUpdateControlD: 0=Cx0_IDLE (CM_OnlineRemoteUpdateControlD_Cx0_IDLE), 1=Cx1_PENDING (CM_OnlineRemoteUpdateControlD_Cx1_PENDING), 2=Cx2_PREPARATION (CM_OnlineRemoteUpdateControlD_Cx2_PREPARATION), 3=Cx3_PREPARATION_HV (CM_OnlineRemoteUpdateControlD_Cx3_PREPARATION_HV), 4=Cx4_RUNNING (CM_OnlineRemoteUpdateControlD_Cx4_RUNNING), 5=Cx5_RUNNING_HV (CM_OnlineRemoteUpdateControlD_Cx5_RUNNING_HV), 6=Cx6_PENDING_NOTREADY (CM_OnlineRemoteUpdateControlD_Cx6_PENDING_NOTREADY), 7=Cx7_OTA_FAILURE_POWERTRAIN_DISABLED (CM_OnlineRemoteUpdateControlD_Cx7_OTA_FAILURE_POWERTRAIN_DISABLED), 8=Cx8_FUNCTIONAL_SAFETY_RELEASE (CM_OnlineRemoteUpdateControlD_Cx8_FUNCTIONAL_SAFETY_RELEASE), 9=Cx9_PREPARATION_SG (CM_OnlineRemoteUpdateControlD_Cx9_PREPARATION_SG), 15=Cxf_Fehler (CM_OnlineRemoteUpdateControlD_Cxf_Fehler)
  compu method CM_NM_Ladegeraet_NM_aktiv_Diag: 0=Cx0_Inaktiv (CM_NM_Ladegeraet_NM_aktiv_Diag_Cx0_Inaktiv), 1=Cx1_Diagnose_aktiv (CM_NM_Ladegeraet_NM_aktiv_Diag_Cx1_Diagnose_aktiv)
  compu method CM_BMC_IstZellSpannungMin_Modul_ID: phys=raw for raw 1..254, 255=Cxff_Init (CM_BMC_IstZellSpannungMin_Modul_ID_Cxff_Init); unit Unit_None
  compu method CM_UI2_KompFehlerModus4_07: 0=Cx0_TNCTOC (CM_UI2_KompFehlerModus4_07_Cx0_TNCTOC), 1=Cx1_TP_TC (CM_UI2_KompFehlerModus4_07_Cx1_TP_TC), 2=Cx2_TP_TC_WCMTL (CM_UI2_KompFehlerModus4_07_Cx2_TP_TC_WCMTL), 3=Cx3_TF_TC_Error_1 (CM_UI2_KompFehlerModus4_07_Cx3_TF_TC_Error_1), 4=Cx4_TF_TC_Error_2 (CM_UI2_KompFehlerModus4_07_Cx4_TF_TC_Error_2), 5=Cx5_TF_TC_Error_3 (CM_UI2_KompFehlerModus4_07_Cx5_TF_TC_Error_3), 6=Cx6_TF_TC_Error_4 (CM_UI2_KompFehlerModus4_07_Cx6_TF_TC_Error_4), 7=Cx7_TF_TC_Error_5 (CM_UI2_KompFehlerModus4_07_Cx7_TF_TC_Error_5)
  compu method CM_LVB_Ladegeschw_VZ: 0=Cx0_Wertebereich_positiv (CM_LVB_Ladegeschw_VZ_Cx0_Wertebereich_positiv), 1=Cx1_Wertebereich_negativ (CM_LVB_Ladegeschw_VZ_Cx1_Wertebereich_negativ)
  compu method CM_OnlineRemoteUpdateControlOldA: 0=Cx0_IDLE (CM_OnlineRemoteUpdateControlOldA_Cx0_IDLE), 1=Cx1_PENDING (CM_OnlineRemoteUpdateControlOldA_Cx1_PENDING), 2=Cx2_PREPARATION (CM_OnlineRemoteUpdateControlOldA_Cx2_PREPARATION), 3=Cx3_PREPARATION_HV (CM_OnlineRemoteUpdateControlOldA_Cx3_PREPARATION_HV), 4=Cx4_RUNNING (CM_OnlineRemoteUpdateControlOldA_Cx4_RUNNING), 5=Cx5_RUNNING_HV (CM_OnlineRemoteUpdateControlOldA_Cx5_RUNNING_HV), 6=Cx6_PENDING_NOTREADY (CM_OnlineRemoteUpdateControlOldA_Cx6_PENDING_NOTREADY), 7=Cx7_OTA_FAILURE_POWERTRAIN_DISABLED (CM_OnlineRemoteUpdateControlOldA_Cx7_OTA_FAILURE_POWERTRAIN_DISABLED), 8=Cx8_FUNCTIONAL_SAFETY_RELEASE (CM_OnlineRemoteUpdateControlOldA_Cx8_FUNCTIONAL_SAFETY_RELEASE), 9=Cx9_PREPARATION_SG (CM_OnlineRemoteUpdateControlOldA_Cx9_PREPARATION_SG), 15=Cxf_Fehler (CM_OnlineRemoteUpdateControlOldA_Cxf_Fehler)
  compu method CM_UI1_KompFehlerModus4_02: 0=Cx0_TNCTOC (CM_UI1_KompFehlerModus4_02_Cx0_TNCTOC), 1=Cx1_TP_TC (CM_UI1_KompFehlerModus4_02_Cx1_TP_TC), 2=Cx2_TP_TC_WCMTL (CM_UI1_KompFehlerModus4_02_Cx2_TP_TC_WCMTL), 3=Cx3_TF_TC_Error_1 (CM_UI1_KompFehlerModus4_02_Cx3_TF_TC_Error_1), 4=Cx4_TF_TC_Error_2 (CM_UI1_KompFehlerModus4_02_Cx4_TF_TC_Error_2), 5=Cx5_TF_TC_Error_3 (CM_UI1_KompFehlerModus4_02_Cx5_TF_TC_Error_3), 6=Cx6_TF_TC_Error_4 (CM_UI1_KompFehlerModus4_02_Cx6_TF_TC_Error_4), 7=Cx7_TF_TC_Error_5 (CM_UI1_KompFehlerModus4_02_Cx7_TF_TC_Error_5)
  compu method CM_BMC_VorlaufTemperatur: phys=raw*0.125-40 for raw 0..1020, 1021=Cx3fd_Nicht_verbaut (CM_BMC_VorlaufTemperatur_Cx3fd_Nicht_verbaut), 1022=Cx3fe_Init (CM_BMC_VorlaufTemperatur_Cx3fe_Init), 1023=Cx3ff_Fehler (CM_BMC_VorlaufTemperatur_Cx3ff_Fehler); unit Unit_DegreCelsi
  compu method CM_TME_Batt_Kond_Verf: 0=Cx0_nicht_verfuegbar (CM_TME_Batt_Kond_Verf_Cx0_nicht_verfuegbar) (nicht verfügbar), 1=Cx1_passive_Kuehlung (CM_TME_Batt_Kond_Verf_Cx1_passive_Kuehlung) (passive Kühlung), 2=Cx2_aktive_Kuehlung (CM_TME_Batt_Kond_Verf_Cx2_aktive_Kuehlung) (aktive Kühlung), 4=Cx4_Heizen (CM_TME_Batt_Kond_Verf_Cx4_Heizen)
  compu method CM_KN_Hybrid_01_BusKnockOut: 0=Cx0_Funktion_nicht_ausgeloest (CM_KN_Hybrid_01_BusKnockOut_Cx0_Funktion_nicht_ausgeloest), 1=Cx1_Veto_aktiv (CM_KN_Hybrid_01_BusKnockOut_Cx1_Veto_aktiv), 2=Cx2_Funktion_ausgeloest (CM_KN_Hybrid_01_BusKnockOut_Cx2_Funktion_ausgeloest), 3=Cx3_Funktion_deaktiviert (CM_KN_Hybrid_01_BusKnockOut_Cx3_Funktion_deaktiviert)
  compu method CM_NM_Ladegeraet_NM_aktiv_KL15: 0=Cx0_Inaktiv (CM_NM_Ladegeraet_NM_aktiv_KL15_Cx0_Inaktiv), 1=Cx1_KL15_EIN (CM_NM_Ladegeraet_NM_aktiv_KL15_Cx1_KL15_EIN)
  compu method CM_LVB_LadegeschwEinheit: 0=Cx0_Init (CM_LVB_LadegeschwEinheit_Cx0_Init), 1=Cx1_Kilometer_pro_Minute (CM_LVB_LadegeschwEinheit_Cx1_Kilometer_pro_Minute), 2=Cx2_Kilometer_pro_Stunde (CM_LVB_LadegeschwEinheit_Cx2_Kilometer_pro_Stunde), 3=Cx3_Meilen_pro_Minute (CM_LVB_LadegeschwEinheit_Cx3_Meilen_pro_Minute), 4=Cx4_Meilen_pro_Stunde (CM_LVB_LadegeschwEinheit_Cx4_Meilen_pro_Stunde)
  compu method CM_AB_SF_Crash: 0=Cx0_kein_Seiten_Crash_Fahrer (CM_AB_SF_Crash_Cx0_kein_Seiten_Crash_Fahrer), 1=Cx1_Seiten_Crash_Fahrer (CM_AB_SF_Crash_Cx1_Seiten_Crash_Fahrer)
  compu method CM_OnlineRemoteUpdateControlOldD: 0=Cx0_IDLE (CM_OnlineRemoteUpdateControlOldD_Cx0_IDLE), 1=Cx1_PENDING (CM_OnlineRemoteUpdateControlOldD_Cx1_PENDING), 2=Cx2_PREPARATION (CM_OnlineRemoteUpdateControlOldD_Cx2_PREPARATION), 3=Cx3_PREPARATION_HV (CM_OnlineRemoteUpdateControlOldD_Cx3_PREPARATION_HV), 4=Cx4_RUNNING (CM_OnlineRemoteUpdateControlOldD_Cx4_RUNNING), 5=Cx5_RUNNING_HV (CM_OnlineRemoteUpdateControlOldD_Cx5_RUNNING_HV), 6=Cx6_PENDING_NOTREADY (CM_OnlineRemoteUpdateControlOldD_Cx6_PENDING_NOTREADY), 7=Cx7_OTA_FAILURE_POWERTRAIN_DISABLED (CM_OnlineRemoteUpdateControlOldD_Cx7_OTA_FAILURE_POWERTRAIN_DISABLED), 8=Cx8_FUNCTIONAL_SAFETY_RELEASE (CM_OnlineRemoteUpdateControlOldD_Cx8_FUNCTIONAL_SAFETY_RELEASE), 9=Cx9_PREPARATION_SG (CM_OnlineRemoteUpdateControlOldD_Cx9_PREPARATION_SG), 15=Cxf_Fehler (CM_OnlineRemoteUpdateControlOldD_Cxf_Fehler)
  compu method CM_TME_DCDC_HV_Status_Kuehlung: 0=Cx0_kein_Fehler_AE (CM_TME_DCDC_HV_Status_Kuehlung_Cx0_kein_Fehler_AE), 1=Cx1_Fehler (CM_TME_DCDC_HV_Status_Kuehlung_Cx1_Fehler), 2=Cx2_InitWert_Init (CM_TME_DCDC_HV_Status_Kuehlung_Cx2_InitWert_Init)
  compu method CM_KN_Hybrid_01_BusKnockOutTimer: phys=raw for raw 0..254, 255=Cxff_BusKnockOut_deaktiviert (CM_KN_Hybrid_01_BusKnockOutTimer_Cxff_BusKnockOut_deaktiviert)
  compu method CM_LVB_Restladezeit: phys=raw for raw 0..3000, 4094=Cxffe_Init (CM_LVB_Restladezeit_Cxffe_Init), 4095=Cxfff_Fehler (CM_LVB_Restladezeit_Cxfff_Fehler); unit Unit_Minut
  compu method CM_UI2_KompFehlerModus4_08: 0=Cx0_TNCTOC (CM_UI2_KompFehlerModus4_08_Cx0_TNCTOC), 1=Cx1_TP_TC (CM_UI2_KompFehlerModus4_08_Cx1_TP_TC), 2=Cx2_TP_TC_WCMTL (CM_UI2_KompFehlerModus4_08_Cx2_TP_TC_WCMTL), 3=Cx3_TF_TC_Error_1 (CM_UI2_KompFehlerModus4_08_Cx3_TF_TC_Error_1), 4=Cx4_TF_TC_Error_2 (CM_UI2_KompFehlerModus4_08_Cx4_TF_TC_Error_2), 5=Cx5_TF_TC_Error_3 (CM_UI2_KompFehlerModus4_08_Cx5_TF_TC_Error_3), 6=Cx6_TF_TC_Error_4 (CM_UI2_KompFehlerModus4_08_Cx6_TF_TC_Error_4), 7=Cx7_TF_TC_Error_5 (CM_UI2_KompFehlerModus4_08_Cx7_TF_TC_Error_5)
  compu method CM_NM_Ladegeraet_NM_aktiv_Tmin: 0=Cx0_Inaktiv (CM_NM_Ladegeraet_NM_aktiv_Tmin_Cx0_Inaktiv), 1=Cx1_Mindestaktivzeit (CM_NM_Ladegeraet_NM_aktiv_Tmin_Cx1_Mindestaktivzeit)
  compu method CM_BMC_IstZellSpannungMin_Zell_ID: phys=raw for raw 1..254, 255=Cxff_Init (CM_BMC_IstZellSpannungMin_Zell_ID_Cxff_Init); unit Unit_None
  compu method CM_ORU_AgLgtSdsl: phys=raw*0.1-100 for raw 0..2000, 2001=Cx7d1_InitWert (CM_ORU_AgLgtSdsl_Cx7d1_InitWert), 2002=Cx7d2_Fehler (CM_ORU_AgLgtSdsl_Cx7d2_Fehler); unit Unit_PerCent
  compu method CM_BMC_ZellTemp_virtuell_max: phys=raw*0.125-40 for raw 0..1020, 1021=Cx3fd_Nicht_verfuegbar (CM_BMC_ZellTemp_virtuell_max_Cx3fd_Nicht_verfuegbar), 1022=Cx3fe_Init (CM_BMC_ZellTemp_virtuell_max_Cx3fe_Init), 1023=Cx3ff_Fehler (CM_BMC_ZellTemp_virtuell_max_Cx3ff_Fehler); unit Unit_DegreCelsi
  compu method CM_TME_EKK_HVK_Fehler_AE: 0=Cx0_kein_Fehler_AE (CM_TME_EKK_HVK_Fehler_AE_Cx0_kein_Fehler_AE), 1=Cx1_Fehler_AE (CM_TME_EKK_HVK_Fehler_AE_Cx1_Fehler_AE), 3=Cx3_Init (CM_TME_EKK_HVK_Fehler_AE_Cx3_Init)
  compu method CM_KN_Hybrid_01_DiagPfad_V12: 0=Cx0_Aktiv (CM_KN_Hybrid_01_DiagPfad_V12_Cx0_Aktiv), 1=Cx1_inaktiv (CM_KN_Hybrid_01_DiagPfad_V12_Cx1_inaktiv)
  compu method CM_AB_Sitzpos_Sens_BF: 0=Cx0_nicht_verfuegbar (CM_AB_Sitzpos_Sens_BF_Cx0_nicht_verfuegbar) (nicht verfügbar), 1=Cx1_Fehler (CM_AB_Sitzpos_Sens_BF_Cx1_Fehler), 2=Cx2_Sitz_nicht_vorne (CM_AB_Sitzpos_Sens_BF_Cx2_Sitz_nicht_vorne) (Sitz nicht vorne), 3=Cx3_Sitz_vorne (CM_AB_Sitzpos_Sens_BF_Cx3_Sitz_vorne) (Sitz vorne)
  compu method CM_ORU_Control_A_01_BZ: phys=raw for raw 0..15
  compu method CM_NM_Ladegeraet_NM_State: 0=Cx0_Init (CM_NM_Ladegeraet_NM_State_Cx0_Init), 1=Cx1_NM_RM_aus_BSM (CM_NM_Ladegeraet_NM_State_Cx1_NM_RM_aus_BSM), 2=Cx2_NM_RM_aus_PBSM (CM_NM_Ladegeraet_NM_State_Cx2_NM_RM_aus_PBSM), 4=Cx4_NM_NO_aus_RM (CM_NM_Ladegeraet_NM_State_Cx4_NM_NO_aus_RM), 8=Cx8_NM_NO_aus_RS (CM_NM_Ladegeraet_NM_State_Cx8_NM_NO_aus_RS), 16=Cx10_reserved (CM_NM_Ladegeraet_NM_State_Cx10_reserved), 32=Cx20_reserved (CM_NM_Ladegeraet_NM_State_Cx20_reserved)
  compu method CM_UI2_KompFehlerModus4_09: 0=Cx0_TNCTOC (CM_UI2_KompFehlerModus4_09_Cx0_TNCTOC), 1=Cx1_TP_TC (CM_UI2_KompFehlerModus4_09_Cx1_TP_TC), 2=Cx2_TP_TC_WCMTL (CM_UI2_KompFehlerModus4_09_Cx2_TP_TC_WCMTL), 3=Cx3_TF_TC_Error_1 (CM_UI2_KompFehlerModus4_09_Cx3_TF_TC_Error_1), 4=Cx4_TF_TC_Error_2 (CM_UI2_KompFehlerModus4_09_Cx4_TF_TC_Error_2), 5=Cx5_TF_TC_Error_3 (CM_UI2_KompFehlerModus4_09_Cx5_TF_TC_Error_3), 6=Cx6_TF_TC_Error_4 (CM_UI2_KompFehlerModus4_09_Cx6_TF_TC_Error_4), 7=Cx7_TF_TC_Error_5 (CM_UI2_KompFehlerModus4_09_Cx7_TF_TC_Error_5)
  compu method CM_BMC_IWU_Status: 0=Cx0_Init (CM_BMC_IWU_Status_Cx0_Init), 1=Cx1_IWU_defekt (CM_BMC_IWU_Status_Cx1_IWU_defekt), 2=Cx2_kein_Messwert (CM_BMC_IWU_Status_Cx2_kein_Messwert), 3=Cx3_ISO_Messung_aktiv (CM_BMC_IWU_Status_Cx3_ISO_Messung_aktiv), 4=Cx4_Deaktiviert (CM_BMC_IWU_Status_Cx4_Deaktiviert), 5=Cx5_ISO_Messung_abgeschlossen (CM_BMC_IWU_Status_Cx5_ISO_Messung_abgeschlossen), 6=Cx6_ISO_Messung_extern (CM_BMC_IWU_Status_Cx6_ISO_Messung_extern)
  compu method CM_BMC_ZellTemp_virtuell_min: phys=raw*0.125-40 for raw 0..1020, 1021=Cx3fd_Nicht_verfuegbar (CM_BMC_ZellTemp_virtuell_min_Cx3fd_Nicht_verfuegbar), 1022=Cx3fe_Init (CM_BMC_ZellTemp_virtuell_min_Cx3fe_Init), 1023=Cx3ff_Fehler (CM_BMC_ZellTemp_virtuell_min_Cx3ff_Fehler); unit Unit_DegreCelsi
  compu method CM_BMC_IWU_Wert_neg: phys=raw*100 for raw 0..65532, 65533=Cxfffd_kein_Messwert (CM_BMC_IWU_Wert_neg_Cxfffd_kein_Messwert), 65534=Cxfffe_Init (CM_BMC_IWU_Wert_neg_Cxfffe_Init), 65535=Cxffff_Fehler (CM_BMC_IWU_Wert_neg_Cxffff_Fehler); unit Unit_Ohm
  compu method CM_BMC_IWU_Wert_pos: phys=raw*100 for raw 0..65532, 65533=Cxfffd_kein_Messwert (CM_BMC_IWU_Wert_pos_Cxfffd_kein_Messwert), 65534=Cxfffe_Init (CM_BMC_IWU_Wert_pos_Cxfffe_Init), 65535=Cxffff_Fehler (CM_BMC_IWU_Wert_pos_Cxffff_Fehler); unit Unit_Ohm
  compu method CM_TME_MVH_L_Strom: phys=raw*0.25 for raw 0..509, 510=Cx1fe_Init (CM_TME_MVH_L_Strom_Cx1fe_Init), 511=Cx1ff_Fehler (CM_TME_MVH_L_Strom_Cx1ff_Fehler); unit Unit_Amper
  compu method CM_TME_EKK_Istmodus: 0=Cx0_Standby (CM_TME_EKK_Istmodus_Cx0_Standby), 1=Cx1_Regelung_aktiv (CM_TME_EKK_Istmodus_Cx1_Regelung_aktiv), 2=Cx2_Freigabe_ausgesetzt (CM_TME_EKK_Istmodus_Cx2_Freigabe_ausgesetzt), 5=Cx5_Fehler (CM_TME_EKK_Istmodus_Cx5_Fehler), 7=Cx7_Init (CM_TME_EKK_Istmodus_Cx7_Init)
  compu method CM_NM_Gateway_SNI_10: 16=Cx10_Gateway_SNI (CM_NM_Gateway_SNI_10_Cx10_Gateway_SNI)
  compu method CM_TME_eKMV_Istmodus: 0=Cx0_Standby (CM_TME_eKMV_Istmodus_Cx0_Standby), 1=Cx1_Regelung_aktiv (CM_TME_eKMV_Istmodus_Cx1_Regelung_aktiv), 2=Cx2_Freigabe_ausgesetzt (CM_TME_eKMV_Istmodus_Cx2_Freigabe_ausgesetzt), 5=Cx5_Fehler (CM_TME_eKMV_Istmodus_Cx5_Fehler), 7=Cx7_Init (CM_TME_eKMV_Istmodus_Cx7_Init)
  compu method CM_NM_Gateway_UDS_CC: 0=Cx0_Inaktiv (CM_NM_Gateway_UDS_CC_Cx0_Inaktiv), 1=Cx1_CC_aktiv (CM_NM_Gateway_UDS_CC_Cx1_CC_aktiv)
  compu method CM_TME_eKMV_Spannung: phys=raw*0.2 for raw 0..509, 510=Cx1fe_Init (CM_TME_eKMV_Spannung_Cx1fe_Init), 511=Cx1ff_Fehler (CM_TME_eKMV_Spannung_Cx1ff_Fehler); unit Unit_Volt
  compu method CM_NM_Gateway_Wakeup_V12: 0=Cx0_Peripherie_Wakeup_Ursache_nicht_bekannt (CM_NM_Gateway_Wakeup_V12_Cx0_Peripherie_Wakeup_Ursache_nicht_bekannt), 1=Cx1_Bus_Wakeup (CM_NM_Gateway_Wakeup_V12_Cx1_Bus_Wakeup), 2=Cx2_KL15_HW (CM_NM_Gateway_Wakeup_V12_Cx2_KL15_HW), 3=Cx3_KL30_Reset (CM_NM_Gateway_Wakeup_V12_Cx3_KL30_Reset), 4=Cx4_Buswakeup_WU_HCP1_CANFD (CM_NM_Gateway_Wakeup_V12_Cx4_Buswakeup_WU_HCP1_CANFD), 5=Cx5_Buswakeup_WU_HCP2_CANFD (CM_NM_Gateway_Wakeup_V12_Cx5_Buswakeup_WU_HCP2_CANFD), 6=Cx6_Buswakeup_WU_HCP3_CANFD (CM_NM_Gateway_Wakeup_V12_Cx6_Buswakeup_WU_HCP3_CANFD), 7=Cx7_Buswakeup_WU_HCP4_CANFD (CM_NM_Gateway_Wakeup_V12_Cx7_Buswakeup_WU_HCP4_CANFD), 8=Cx8_Buswakeup_HCP5_CANFD01 (CM_NM_Gateway_Wakeup_V12_Cx8_Buswakeup_HCP5_CANFD01), 9=Cx9_Buswakeup_HCP5_CANFD02 (CM_NM_Gateway_Wakeup_V12_Cx9_Buswakeup_HCP5_CANFD02), 10=Cxa_Buswakeup_HCP5_CAN03 (CM_NM_Gateway_Wakeup_V12_Cxa_Buswakeup_HCP5_CAN03), 11=Cxb_Buswakeup_HCP5_CANFD04 (CM_NM_Gateway_Wakeup_V12_Cxb_Buswakeup_HCP5_CANFD04), 12=Cxc_Buswakeup_HCP5_CANFD05 (CM_NM_Gateway_Wakeup_V12_Cxc_Buswakeup_HCP5_CANFD05), 13=Cxd_Buswakeup_HCP5_CANFD06 (CM_NM_Gateway_Wakeup_V12_Cxd_Buswakeup_HCP5_CANFD06), 14=Cxe_reserviert (CM_NM_Gateway_Wakeup_V12_Cxe_reserviert), 16=Cx10_WU_ConMod_CANFD (CM_NM_Gateway_Wakeup_V12_Cx10_WU_ConMod_CANFD), 17=Cx11_Buswakeup_Diag_CANFD (CM_NM_Gateway_Wakeup_V12_Cx11_Buswakeup_Diag_CANFD), 18=Cx12_Buswakeup_Diag_ETH (CM_NM_Gateway_Wakeup_V12_Cx12_Buswakeup_Diag_ETH), 128=Cx80_VNSM_Anforderung (CM_NM_Gateway_Wakeup_V12_Cx80_VNSM_Anforderung), 129=Cx81_Timer_TME_abgelaufen (CM_NM_Gateway_Wakeup_V12_Cx81_Timer_TME_abgelaufen), 130=Cx82_Timer_ELF_abgelaufen (CM_NM_Gateway_Wakeup_V12_Cx82_Timer_ELF_abgelaufen), 131=Cx83_Timer_pTMM_abgelaufen (CM_NM_Gateway_Wakeup_V12_Cx83_Timer_pTMM_abgelaufen), 132=Cx84_Batteriekonditionierung (CM_NM_Gateway_Wakeup_V12_Cx84_Batteriekonditionierung), 133=Cx85_Ladezustand (CM_NM_Gateway_Wakeup_V12_Cx85_Ladezustand), 134=Cx86_Start_HV_Grundladen (CM_NM_Gateway_Wakeup_V12_Cx86_Start_HV_Grundladen), 135=Cx87_Erw_HV_Laden_Anfordern (CM_NM_Gateway_Wakeup_V12_Cx87_Erw_HV_Laden_Anfordern), 136=Cx88_Erw_HV_Laden_Planen (CM_NM_Gateway_Wakeup_V12_Cx88_Erw_HV_Laden_Planen), 137=Cx89_Niveauverstellung_Anfordern (CM_NM_Gateway_Wakeup_V12_Cx89_Niveauverstellung_Anfordern), 138=Cx8a_MOD_Update_Ladevorgang (CM_NM_Gateway_Wakeup_V12_Cx8a_MOD_Update_Ladevorgang), 139=Cx8b_Ladevorbedingung_pruefen (CM_NM_Gateway_Wakeup_V12_Cx8b_Ladevorbedingung_pruefen), 140=Cx8c_NiedervoltEnergieMgmt (CM_NM_Gateway_Wakeup_V12_Cx8c_NiedervoltEnergieMgmt), 141=Cx8d_Timer_HVLM_abgelaufen (CM_NM_Gateway_Wakeup_V12_Cx8d_Timer_HVLM_abgelaufen), 142=Cx8e_SubbusSteuerung_HCP5 (CM_NM_Gateway_Wakeup_V12_Cx8e_SubbusSteuerung_HCP5), 143=Cx8f_CommunicationControl (CM_NM_Gateway_Wakeup_V12_Cx8f_CommunicationControl), 144=Cx90_Ladezugang_ansteuern (CM_NM_Gateway_Wakeup_V12_Cx90_Ladezugang_ansteuern), 145=Cx91_HV_Anforderung (CM_NM_Gateway_Wakeup_V12_Cx91_HV_Anforderung), 146=Cx92_Ladeanforderung (CM_NM_Gateway_Wakeup_V12_Cx92_Ladeanforderung), 147=Cx93_HV_Aktivieren (CM_NM_Gateway_Wakeup_V12_Cx93_HV_Aktivieren), 148=Cx94_Key_Authentifiz_SMS (CM_NM_Gateway_Wakeup_V12_Cx94_Key_Authentifiz_SMS), 150=Cx96_E3_SW_Plattform_1 (CM_NM_Gateway_Wakeup_V12_Cx96_E3_SW_Plattform_1), 151=Cx97_E3_SW_Plattform_2 (CM_NM_Gateway_Wakeup_V12_Cx97_E3_SW_Plattform_2), 152=Cx98_E3_SW_Plattform_3 (CM_NM_Gateway_Wakeup_V12_Cx98_E3_SW_Plattform_3), 153=Cx99_E3_SW_Plattform_4 (CM_NM_Gateway_Wakeup_V12_Cx99_E3_SW_Plattform_4), 154=Cx9a_E3_SW_Plattform_5 (CM_NM_Gateway_Wakeup_V12_Cx9a_E3_SW_Plattform_5), 155=Cx9b_Remote_Honk_Flash (CM_NM_Gateway_Wakeup_V12_Cx9b_Remote_Honk_Flash), 156=Cx9c_Remote_Lock_Unlock (CM_NM_Gateway_Wakeup_V12_Cx9c_Remote_Lock_Unlock), 157=Cx9d_Remote_PreKlimatisierung (CM_NM_Gateway_Wakeup_V12_Cx9d_Remote_PreKlimatisierung), 158=Cx9e_OnlineRemoteUpdate (CM_NM_Gateway_Wakeup_V12_Cx9e_OnlineRemoteUpdate), 159=Cx9f_OnlineRemoteUpdate_PrePost (CM_NM_Gateway_Wakeup_V12_Cx9f_OnlineRemoteUpdate_PrePost), 160=Cxa0_Displayanzeige (CM_NM_Gateway_Wakeup_V12_Cxa0_Displayanzeige), 161=Cxa1_VehicleStatusReport_Daten_Erfassen (CM_NM_Gateway_Wakeup_V12_Cxa1_VehicleStatusReport_Daten_Erfassen), 162=Cxa2_SOC_Abfrage (CM_NM_Gateway_Wakeup_V12_Cxa2_SOC_Abfrage), 163=Cxa3_LHW_eventAirBagDeployment (CM_NM_Gateway_Wakeup_V12_Cxa3_LHW_eventAirBagDeployment), 164=Cxa4_Ladeanforderung_Erweitert (CM_NM_Gateway_Wakeup_V12_Cxa4_Ladeanforderung_Erweitert), 165=Cxa5_Abschaltstufe (CM_NM_Gateway_Wakeup_V12_Cxa5_Abschaltstufe), 166=Cxa6_RemoteStart (CM_NM_Gateway_Wakeup_V12_Cxa6_RemoteStart), 167=Cxa7_Gefahreninfo (CM_NM_Gateway_Wakeup_V12_Cxa7_Gefahreninfo), 168=Cxa8_AutomotiveEdge_1 (CM_NM_Gateway_Wakeup_V12_Cxa8_AutomotiveEdge_1), 169=Cxa9_AutomotiveEdge_2 (CM_NM_Gateway_Wakeup_V12_Cxa9_AutomotiveEdge_2), 170=Cxaa_AutomotiveEdge_3 (CM_NM_Gateway_Wakeup_V12_Cxaa_AutomotiveEdge_3), 171=Cxab_AutomotiveEdge_4 (CM_NM_Gateway_Wakeup_V12_Cxab_AutomotiveEdge_4), 172=Cxac_AutomotiveEdge_5 (CM_NM_Gateway_Wakeup_V12_Cxac_AutomotiveEdge_5), 173=Cxad_RemoteVehicleTracking (CM_NM_Gateway_Wakeup_V12_Cxad_RemoteVehicleTracking), 174=Cxae_OnlinePannenruf (CM_NM_Gateway_Wakeup_V12_Cxae_OnlinePannenruf), 175=Cxaf_WarnblinkerStatusAenderung (CM_NM_Gateway_Wakeup_V12_Cxaf_WarnblinkerStatusAenderung), 176=Cxb0_ConnectVerbund_UseCase1 (CM_NM_Gateway_Wakeup_V12_Cxb0_ConnectVerbund_UseCase1), 177=Cxb1_ConnectVerbund_UseCase2 (CM_NM_Gateway_Wakeup_V12_Cxb1_ConnectVerbund_UseCase2), 178=Cxb2_ConnectVerbund_UseCase3 (CM_NM_Gateway_Wakeup_V12_Cxb2_ConnectVerbund_UseCase3), 179=Cxb3_ConnectVerbund_UseCase4 (CM_NM_Gateway_Wakeup_V12_Cxb3_ConnectVerbund_UseCase4), 180=Cxb4_ConnectVerbund_UseCase5 (CM_NM_Gateway_Wakeup_V12_Cxb4_ConnectVerbund_UseCase5), 181=Cxb5_ConnectVerbund_UseCase6 (CM_NM_Gateway_Wakeup_V12_Cxb5_ConnectVerbund_UseCase6), 182=Cxb6_Timer_ORU_abgelaufen (CM_NM_Gateway_Wakeup_V12_Cxb6_Timer_ORU_abgelaufen), 183=Cxb7_Remote_Repair (CM_NM_Gateway_Wakeup_V12_Cxb7_Remote_Repair)
  compu method CM_ORU_Control_A_01_CRC: phys=raw for raw 0..255
  compu method CM_TME_eKMV_Strom: phys=raw*0.75 for raw 0..253, 254=Cxfe_Init (CM_TME_eKMV_Strom_Cxfe_Init), 255=Cxff_Fehler (CM_TME_eKMV_Strom_Cxff_Fehler); unit Unit_Amper
  compu method CM_TME_MVH_L_Verbauinfo: 0=Cx0_InitWert (CM_TME_MVH_L_Verbauinfo_Cx0_InitWert), 1=Cx1_nicht_verbaut (CM_TME_MVH_L_Verbauinfo_Cx1_nicht_verbaut), 2=Cx2_verbaut (CM_TME_MVH_L_Verbauinfo_Cx2_verbaut)
  compu method CM_NM_HVZB_CBV_AWB: 0=Cx0_Passiver_WakeUp (CM_NM_HVZB_CBV_AWB_Cx0_Passiver_WakeUp), 1=Cx1_Aktiver_WakeUp (CM_NM_HVZB_CBV_AWB_Cx1_Aktiver_WakeUp)
  compu method CM_ORU_Control_D_01_BZ: phys=raw for raw 0..15
  compu method CM_TME_ELM1_IstVolumenstrom: phys=raw*0.5 for raw 0..29, 30=Cx1e_Init (CM_TME_ELM1_IstVolumenstrom_Cx1e_Init), 31=Cx1f_Fehler (CM_TME_ELM1_IstVolumenstrom_Cx1f_Fehler); unit Unit_LiterPerMinut
  compu method CM_NM_HVZB_CBV_CRI: 0=Cx0_NM_ohne_Clusteranforderungen (CM_NM_HVZB_CBV_CRI_Cx0_NM_ohne_Clusteranforderungen), 1=Cx1_NM_mit_Clusteranforderungen (CM_NM_HVZB_CBV_CRI_Cx1_NM_mit_Clusteranforderungen)
  compu method CM_ORU_Control_D_01_CRC: phys=raw for raw 0..255
  compu method CM_TME_Notbelueftung_Aktivierung: 0=Cx0_keine_Aktivierung (CM_TME_Notbelueftung_Aktivierung_Cx0_keine_Aktivierung), 1=Cx1_Aktivierung (CM_TME_Notbelueftung_Aktivierung_Cx1_Aktivierung)
  compu method CM_UI1_KompFehlerModus4_03: 0=Cx0_TNCTOC (CM_UI1_KompFehlerModus4_03_Cx0_TNCTOC), 1=Cx1_TP_TC (CM_UI1_KompFehlerModus4_03_Cx1_TP_TC), 2=Cx2_TP_TC_WCMTL (CM_UI1_KompFehlerModus4_03_Cx2_TP_TC_WCMTL), 3=Cx3_TF_TC_Error_1 (CM_UI1_KompFehlerModus4_03_Cx3_TF_TC_Error_1), 4=Cx4_TF_TC_Error_2 (CM_UI1_KompFehlerModus4_03_Cx4_TF_TC_Error_2), 5=Cx5_TF_TC_Error_3 (CM_UI1_KompFehlerModus4_03_Cx5_TF_TC_Error_3), 6=Cx6_TF_TC_Error_4 (CM_UI1_KompFehlerModus4_03_Cx6_TF_TC_Error_4), 7=Cx7_TF_TC_Error_5 (CM_UI1_KompFehlerModus4_03_Cx7_TF_TC_Error_5)
  compu method CM_ORU_Status: 0=Cx0_IDLE (CM_ORU_Status_Cx0_IDLE), 1=Cx1_PENDING (CM_ORU_Status_Cx1_PENDING), 2=Cx2_PREPARATION (CM_ORU_Status_Cx2_PREPARATION), 3=Cx3_PREPARATION_HV (CM_ORU_Status_Cx3_PREPARATION_HV), 4=Cx4_RUNNING (CM_ORU_Status_Cx4_RUNNING), 5=Cx5_RUNNING_HV (CM_ORU_Status_Cx5_RUNNING_HV), 6=Cx6_PENDING_NOTREADY (CM_ORU_Status_Cx6_PENDING_NOTREADY), 7=Cx7_FAILURE_POWERTRAIN_DISABLED (CM_ORU_Status_Cx7_FAILURE_POWERTRAIN_DISABLED)
  compu method CM_OruControlReleaseA: phys=raw for raw 0..65535; unit Unit_None
  compu method CM_TME_NT_Kreis_Status: 0=Cx0_kein_Fehler (CM_TME_NT_Kreis_Status_Cx0_kein_Fehler), 1=Cx1_Fehler (CM_TME_NT_Kreis_Status_Cx1_Fehler)
  compu method CM_LVB_StatusLadegeschw: 0=Cx0_calculating (CM_LVB_StatusLadegeschw_Cx0_calculating), 1=Cx1_valid (CM_LVB_StatusLadegeschw_Cx1_valid), 2=Cx2_invalid (CM_LVB_StatusLadegeschw_Cx2_invalid)
  compu method CM_LVB_StatusRestladezeit: 0=Cx0_calculating (CM_LVB_StatusRestladezeit_Cx0_calculating), 1=Cx1_valid (CM_LVB_StatusRestladezeit_Cx1_valid), 2=Cx2_invalid (CM_LVB_StatusRestladezeit_Cx2_invalid)
  compu method CM_UI1_KompFehlerModus4_04: 0=Cx0_TNCTOC (CM_UI1_KompFehlerModus4_04_Cx0_TNCTOC), 1=Cx1_TP_TC (CM_UI1_KompFehlerModus4_04_Cx1_TP_TC), 2=Cx2_TP_TC_WCMTL (CM_UI1_KompFehlerModus4_04_Cx2_TP_TC_WCMTL), 3=Cx3_TF_TC_Error_1 (CM_UI1_KompFehlerModus4_04_Cx3_TF_TC_Error_1), 4=Cx4_TF_TC_Error_2 (CM_UI1_KompFehlerModus4_04_Cx4_TF_TC_Error_2), 5=Cx5_TF_TC_Error_3 (CM_UI1_KompFehlerModus4_04_Cx5_TF_TC_Error_3), 6=Cx6_TF_TC_Error_4 (CM_UI1_KompFehlerModus4_04_Cx6_TF_TC_Error_4), 7=Cx7_TF_TC_Error_5 (CM_UI1_KompFehlerModus4_04_Cx7_TF_TC_Error_5)
  compu method CM_TME_NT_Kuehlmittel_Sensor_02: 0=Cx0_OK (CM_TME_NT_Kuehlmittel_Sensor_02_Cx0_OK), 1=Cx1_Kuehlmittel_unter_min (CM_TME_NT_Kuehlmittel_Sensor_02_Cx1_Kuehlmittel_unter_min)
  compu method CM_MKB_ScndCllsnMtgtn_StAbo: 0=Cx0_NoRequest (CM_MKB_ScndCllsnMtgtn_StAbo_Cx0_NoRequest), 1=Cx1_Abort (CM_MKB_ScndCllsnMtgtn_StAbo_Cx1_Abort)
  compu method CM_MKB_ScndCllsnMtgtn_StReq: 0=Cx0_NoRequest (CM_MKB_ScndCllsnMtgtn_StReq_Cx0_NoRequest), 1=Cx1_SecondCollisionMitigation (CM_MKB_ScndCllsnMtgtn_StReq_Cx1_SecondCollisionMitigation)
  compu method CM_UI1_KompFehlerModus4_05: 0=Cx0_TNCTOC (CM_UI1_KompFehlerModus4_05_Cx0_TNCTOC), 1=Cx1_TP_TC (CM_UI1_KompFehlerModus4_05_Cx1_TP_TC), 2=Cx2_TP_TC_WCMTL (CM_UI1_KompFehlerModus4_05_Cx2_TP_TC_WCMTL), 3=Cx3_TF_TC_Error_1 (CM_UI1_KompFehlerModus4_05_Cx3_TF_TC_Error_1), 4=Cx4_TF_TC_Error_2 (CM_UI1_KompFehlerModus4_05_Cx4_TF_TC_Error_2), 5=Cx5_TF_TC_Error_3 (CM_UI1_KompFehlerModus4_05_Cx5_TF_TC_Error_3), 6=Cx6_TF_TC_Error_4 (CM_UI1_KompFehlerModus4_05_Cx6_TF_TC_Error_4), 7=Cx7_TF_TC_Error_5 (CM_UI1_KompFehlerModus4_05_Cx7_TF_TC_Error_5)
  compu method CM_MM_PropulsionSystemActive: 0=Cx0_PropulsionSystemNotActive (CM_MM_PropulsionSystemActive_Cx0_PropulsionSystemNotActive), 1=Cx1_PropulsionSystemActive (CM_MM_PropulsionSystemActive_Cx1_PropulsionSystemActive)
  compu method CM_UI1_KompFehlerModus4_06: 0=Cx0_TNCTOC (CM_UI1_KompFehlerModus4_06_Cx0_TNCTOC), 1=Cx1_TP_TC (CM_UI1_KompFehlerModus4_06_Cx1_TP_TC), 2=Cx2_TP_TC_WCMTL (CM_UI1_KompFehlerModus4_06_Cx2_TP_TC_WCMTL), 3=Cx3_TF_TC_Error_1 (CM_UI1_KompFehlerModus4_06_Cx3_TF_TC_Error_1), 4=Cx4_TF_TC_Error_2 (CM_UI1_KompFehlerModus4_06_Cx4_TF_TC_Error_2), 5=Cx5_TF_TC_Error_3 (CM_UI1_KompFehlerModus4_06_Cx5_TF_TC_Error_3), 6=Cx6_TF_TC_Error_4 (CM_UI1_KompFehlerModus4_06_Cx6_TF_TC_Error_4), 7=Cx7_TF_TC_Error_5 (CM_UI1_KompFehlerModus4_06_Cx7_TF_TC_Error_5)
  compu method CM_UI1_KompFehlerModus4_07: 0=Cx0_TNCTOC (CM_UI1_KompFehlerModus4_07_Cx0_TNCTOC), 1=Cx1_TP_TC (CM_UI1_KompFehlerModus4_07_Cx1_TP_TC), 2=Cx2_TP_TC_WCMTL (CM_UI1_KompFehlerModus4_07_Cx2_TP_TC_WCMTL), 3=Cx3_TF_TC_Error_1 (CM_UI1_KompFehlerModus4_07_Cx3_TF_TC_Error_1), 4=Cx4_TF_TC_Error_2 (CM_UI1_KompFehlerModus4_07_Cx4_TF_TC_Error_2), 5=Cx5_TF_TC_Error_3 (CM_UI1_KompFehlerModus4_07_Cx5_TF_TC_Error_3), 6=Cx6_TF_TC_Error_4 (CM_UI1_KompFehlerModus4_07_Cx6_TF_TC_Error_4), 7=Cx7_TF_TC_Error_5 (CM_UI1_KompFehlerModus4_07_Cx7_TF_TC_Error_5)
  compu method CM_UISensorIso_02_BZ: phys=raw for raw 0..15
  compu method CM_UISensorIso_02_CRC: phys=raw for raw 0..255
  compu method CM_KN_Hybrid_01_ECUKnockOut: 0=Cx0_Funktion_nicht_ausgeloest (CM_KN_Hybrid_01_ECUKnockOut_Cx0_Funktion_nicht_ausgeloest), 1=Cx1_Veto_war_aktiv (CM_KN_Hybrid_01_ECUKnockOut_Cx1_Veto_war_aktiv), 2=Cx2_Funktion_ausgeloest (CM_KN_Hybrid_01_ECUKnockOut_Cx2_Funktion_ausgeloest), 3=Cx3_Funktion_deaktiviert (CM_KN_Hybrid_01_ECUKnockOut_Cx3_Funktion_deaktiviert)
  compu method CM_NM_Ladegeraet_SNI_10: 68=Cx44_Ladegeraet_SNI (CM_NM_Ladegeraet_SNI_10_Cx44_Ladegeraet_SNI)
  compu method CM_UISensorPyro_01_BZ: phys=raw for raw 0..15
  compu method CM_KN_Hybrid_01_ECUKnockOutTimer: phys=raw for raw 0..62, 63=Cx3f_ECUKnockOut_deaktiviert (CM_KN_Hybrid_01_ECUKnockOutTimer_Cx3f_ECUKnockOut_deaktiviert)
  compu method CM_NM_Ladegeraet_UDS_CC: 0=Cx0_Init (CM_NM_Ladegeraet_UDS_CC_Cx0_Init), 1=Cx1_CC_aktiv (CM_NM_Ladegeraet_UDS_CC_Cx1_CC_aktiv)
  compu method CM_UISensorPyro_01_CRC: phys=raw for raw 0..255
  compu method CM_Kompressor_Status: 0=Cx0_nicht_aktiv (CM_Kompressor_Status_Cx0_nicht_aktiv), 1=Cx1_aktiv (CM_Kompressor_Status_Cx1_aktiv), 3=Cx3_nicht_verfuegbar (CM_Kompressor_Status_Cx3_nicht_verfuegbar)
  compu method CM_BMC_Konditionierung_Anf: 0=Cx0_keine_Konditionierungsanforderung (CM_BMC_Konditionierung_Anf_Cx0_keine_Konditionierungsanforderung) (keine Konditionierungsanforderung), 1=Cx1_Konditionierungsanforderung (CM_BMC_Konditionierung_Anf_Cx1_Konditionierungsanforderung)
  compu method CM_UISensorPyro_02_BZ: phys=raw for raw 0..15
  compu method CM_NM_Ladegeraet_Wakeup_V12: 0=Cx0_Peripherie_Wakeup_Ursache_nicht_bekannt (CM_NM_Ladegeraet_Wakeup_V12_Cx0_Peripherie_Wakeup_Ursache_nicht_bekannt), 1=Cx1_Bus_Wakeup (CM_NM_Ladegeraet_Wakeup_V12_Cx1_Bus_Wakeup), 2=Cx2_KL15_HW (CM_NM_Ladegeraet_Wakeup_V12_Cx2_KL15_HW)
  compu method CM_NM_HVZB_FCAB: 0=Cx0_Init (CM_NM_HVZB_FCAB_Cx0_Init), 1=Cx1_01_CarWakeUp (CM_NM_HVZB_FCAB_Cx1_01_CarWakeUp), 2=Cx2_02_Basefunction_Powertrain (CM_NM_HVZB_FCAB_Cx2_02_Basefunction_Powertrain), 4=Cx4_03_Basefunction_Chassis (CM_NM_HVZB_FCAB_Cx4_03_Basefunction_Chassis), 8=Cx8_04_Basefunction_DrivingAssistance (CM_NM_HVZB_FCAB_Cx8_04_Basefunction_DrivingAssistance), 16=Cx10_05_Basefunction_Infotainment (CM_NM_HVZB_FCAB_Cx10_05_Basefunction_Infotainment), 32=Cx20_06_Basefunction_ComfortLight (CM_NM_HVZB_FCAB_Cx20_06_Basefunction_ComfortLight), 64=Cx40_07_Basefunction_CrossSection (CM_NM_HVZB_FCAB_Cx40_07_Basefunction_CrossSection), 128=Cx80_08_Basefunction_Connectivity (CM_NM_HVZB_FCAB_Cx80_08_Basefunction_Connectivity), 256=Cx100_09_Basefunction_DrivingAssistanceCore (CM_NM_HVZB_FCAB_Cx100_09_Basefunction_DrivingAssistanceCore), 512=Cx200_10_Powertrain (CM_NM_HVZB_FCAB_Cx200_10_Powertrain), 1024=Cx400_11_Chassis (CM_NM_HVZB_FCAB_Cx400_11_Chassis), 2048=Cx800_12_GearSelector (CM_NM_HVZB_FCAB_Cx800_12_GearSelector), 4096=Cx1000_13_Airbag (CM_NM_HVZB_FCAB_Cx1000_13_Airbag), 8192=Cx2000_14_InfotainmentExtensions (CM_NM_HVZB_FCAB_Cx2000_14_InfotainmentExtensions), 16384=Cx4000_15_InstrumentclusterDisplay (CM_NM_HVZB_FCAB_Cx4000_15_InstrumentclusterDisplay), 32768=Cx8000_16_InfotainmentDisplay (CM_NM_HVZB_FCAB_Cx8000_16_InfotainmentDisplay), 65536=Cx10000_17_Audio (CM_NM_HVZB_FCAB_Cx10000_17_Audio), 131072=Cx20000_18_VirtualSideMirrors (CM_NM_HVZB_FCAB_Cx20000_18_VirtualSideMirrors), 262144=Cx40000_19_Doors_Hatches (CM_NM_HVZB_FCAB_Cx40000_19_Doors_Hatches), 524288=Cx80000_20_OptionalComfort (CM_NM_HVZB_FCAB_Cx80000_20_OptionalComfort), 1048576=Cx100000_21_AirSuspension (CM_NM_HVZB_FCAB_Cx100000_21_AirSuspension), 2097152=Cx200000_22_ExteriorLights (CM_NM_HVZB_FCAB_Cx200000_22_ExteriorLights), 4194304=Cx400000_23_Climate (CM_NM_HVZB_FCAB_Cx400000_23_Climate), 8388608=Cx800000_24_ThermoManagement (CM_NM_HVZB_FCAB_Cx800000_24_ThermoManagement), 16777216=Cx1000000_25_AccessSystemSensors (CM_NM_HVZB_FCAB_Cx1000000_25_AccessSystemSensors), 33554432=Cx2000000_26_HighVoltage_Charging (CM_NM_HVZB_FCAB_Cx2000000_26_HighVoltage_Charging), 67108864=Cx4000000_27_Timemaster_Timer (CM_NM_HVZB_FCAB_Cx4000000_27_Timemaster_Timer), 134217728=Cx8000000_28_OnboardTester_DataCollector (CM_NM_HVZB_FCAB_Cx8000000_28_OnboardTester_DataCollector), 268435456=Cx10000000_29_SteeringColumnLock (CM_NM_HVZB_FCAB_Cx10000000_29_SteeringColumnLock), 536870912=Cx20000000_30_EnergyManagement (CM_NM_HVZB_FCAB_Cx20000000_30_EnergyManagement), 1073741824=Cx40000000_31_MultifunctionalSteeringWheel (CM_NM_HVZB_FCAB_Cx40000000_31_MultifunctionalSteeringWheel), 2147483648=Cx80000000_32_OnlineAccess (CM_NM_HVZB_FCAB_Cx80000000_32_OnlineAccess), 4294967296=Cx100000000_33_ExternalWirelessCommunication (CM_NM_HVZB_FCAB_Cx100000000_33_ExternalWirelessCommunication), 8589934592=Cx200000000_34_GPS_Localization (CM_NM_HVZB_FCAB_Cx200000000_34_GPS_Localization), 17179869184=Cx400000000_35_ExteriorSound (CM_NM_HVZB_FCAB_Cx400000000_35_ExteriorSound), 34359738368=Cx800000000_36_Preheater (CM_NM_HVZB_FCAB_Cx800000000_36_Preheater), 68719476736=Cx1000000000_37_HighVoltage_WirelessChargingStation (CM_NM_HVZB_FCAB_Cx1000000000_37_HighVoltage_WirelessChargingStation), 549755813888=Cx8000000000_40_Diagnosis_Energy (CM_NM_HVZB_FCAB_Cx8000000000_40_Diagnosis_Energy), 1099511627776=Cx10000000000_41_Diagnosis_Powertrain (CM_NM_HVZB_FCAB_Cx10000000000_41_Diagnosis_Powertrain), 2199023255552=Cx20000000000_42_Diagnosis_FlexRay (CM_NM_HVZB_FCAB_Cx20000000000_42_Diagnosis_FlexRay), 4398046511104=Cx40000000000_43_Diagnosis_DrivingAssistance (CM_NM_HVZB_FCAB_Cx40000000000_43_Diagnosis_DrivingAssistance), 8796093022208=Cx80000000000_44_Diagnosis_Infotainment (CM_NM_HVZB_FCAB_Cx80000000000_44_Diagnosis_Infotainment), 17592186044416=Cx100000000000_45_Diagnosis_Comfort (CM_NM_HVZB_FCAB_Cx100000000000_45_Diagnosis_Comfort), 35184372088832=Cx200000000000_46_Diagnosis_Light (CM_NM_HVZB_FCAB_Cx200000000000_46_Diagnosis_Light), 70368744177664=Cx400000000000_47_Diagnosis_ComfortLINs (CM_NM_HVZB_FCAB_Cx400000000000_47_Diagnosis_ComfortLINs), 140737488355328=Cx800000000000_48_Diagnosis_ClimateTmeLINs (CM_NM_HVZB_FCAB_Cx800000000000_48_Diagnosis_ClimateTmeLINs), 281474976710656=Cx1000000000000_49_reserved (CM_NM_HVZB_FCAB_Cx1000000000000_49_reserved) (49_<reserved>), 4503599627370496=Cx10000000000000_53_Lock_Unlock (CM_NM_HVZB_FCAB_Cx10000000000000_53_Lock_Unlock), 9007199254740992=Cx20000000000000_54_reserved (CM_NM_HVZB_FCAB_Cx20000000000000_54_reserved) (54_<reserved>), 18014398509481984=Cx40000000000000_55_Dimming (CM_NM_HVZB_FCAB_Cx40000000000000_55_Dimming), 36028797018963968=Cx80000000000000_56_ChargingStatus (CM_NM_HVZB_FCAB_Cx80000000000000_56_ChargingStatus)
  compu method CM_NM_SACID_1_CBV_AWB: 0=Cx0_Passiver_WakeUp (CM_NM_SACID_1_CBV_AWB_Cx0_Passiver_WakeUp), 1=Cx1_Aktiver_WakeUp (CM_NM_SACID_1_CBV_AWB_Cx1_Aktiver_WakeUp)
  compu method CM_WFS_Schluessel_Soll: phys=raw for raw 0..8; unit Unit_None
  compu method CM_AB_Sitzpos_Sens_FA: 0=Cx0_nicht_verfuegbar (CM_AB_Sitzpos_Sens_FA_Cx0_nicht_verfuegbar) (nicht verfügbar), 1=Cx1_Fehler (CM_AB_Sitzpos_Sens_FA_Cx1_Fehler), 2=Cx2_Sitz_nicht_vorne (CM_AB_Sitzpos_Sens_FA_Cx2_Sitz_nicht_vorne) (Sitz nicht vorne), 3=Cx3_Sitz_vorne (CM_AB_Sitzpos_Sens_FA_Cx3_Sitz_vorne) (Sitz vorne)
  compu method CM_ZM_Fahrzeugabstellzeit: phys=raw*4 for raw 0..4093, 4094=Cxffe_Init (CM_ZM_Fahrzeugabstellzeit_Cxffe_Init), 4095=Cxfff_Fehler (CM_ZM_Fahrzeugabstellzeit_Cxfff_Fehler); unit Unit_Minut
  compu method CM_BMC_KundenWarnung: 0=Cx0_keine_Warnung (CM_BMC_KundenWarnung_Cx0_keine_Warnung), 1=Cx1_Warnung_Temperaturlevel_1 (CM_BMC_KundenWarnung_Cx1_Warnung_Temperaturlevel_1), 2=Cx2_Warnung_Temperaturlevel_2 (CM_BMC_KundenWarnung_Cx2_Warnung_Temperaturlevel_2)
  compu method CM_ZM_Fahrzeugabstellzeit_HiRes: phys=raw*10 for raw 0..65330, 65534=Cxfffe_Init (CM_ZM_Fahrzeugabstellzeit_HiRes_Cxfffe_Init), 65535=Cxffff_Fehler (CM_ZM_Fahrzeugabstellzeit_HiRes_Cxffff_Fehler); unit Unit_Secon
  compu method CM_UI2_KompFehlerModus4_10: 0=Cx0_TNCTOC (CM_UI2_KompFehlerModus4_10_Cx0_TNCTOC), 1=Cx1_TP_TC (CM_UI2_KompFehlerModus4_10_Cx1_TP_TC), 2=Cx2_TP_TC_WCMTL (CM_UI2_KompFehlerModus4_10_Cx2_TP_TC_WCMTL), 3=Cx3_TF_TC_Error_1 (CM_UI2_KompFehlerModus4_10_Cx3_TF_TC_Error_1), 4=Cx4_TF_TC_Error_2 (CM_UI2_KompFehlerModus4_10_Cx4_TF_TC_Error_2), 5=Cx5_TF_TC_Error_3 (CM_UI2_KompFehlerModus4_10_Cx5_TF_TC_Error_3), 6=Cx6_TF_TC_Error_4 (CM_UI2_KompFehlerModus4_10_Cx6_TF_TC_Error_4), 7=Cx7_TF_TC_Error_5 (CM_UI2_KompFehlerModus4_10_Cx7_TF_TC_Error_5)
  compu method CM_ZM_Fahrzeugabstellzeit_Status: 0=Cx0_Abstellzeit_nicht_berechnet (CM_ZM_Fahrzeugabstellzeit_Status_Cx0_Abstellzeit_nicht_berechnet), 1=Cx1_Abstellzeit_berechnet (CM_ZM_Fahrzeugabstellzeit_Status_Cx1_Abstellzeit_berechnet), 2=Cx2_Abstellzeit_Minimalwert (CM_ZM_Fahrzeugabstellzeit_Status_Cx2_Abstellzeit_Minimalwert), 3=Cx3_Abstellzeit_ungueltig (CM_ZM_Fahrzeugabstellzeit_Status_Cx3_Abstellzeit_ungueltig)
  compu method CM_TME_ELM2_IstVolumenstrom: phys=raw*0.5 for raw 0..29, 30=Cx1e_Init (CM_TME_ELM2_IstVolumenstrom_Cx1e_Init), 31=Cx1f_Fehler (CM_TME_ELM2_IstVolumenstrom_Cx1f_Fehler); unit Unit_LiterPerMinut
  compu method CM_AB_Stellgliedtest: 0=Cx0_nicht_im_Stellgliedtest (CM_AB_Stellgliedtest_Cx0_nicht_im_Stellgliedtest), 1=Cx1_Airbag_im_Stellgliedtest (CM_AB_Stellgliedtest_Cx1_Airbag_im_Stellgliedtest)
  compu method CM_TME_ELM3_IstVolumenstrom: phys=raw*0.5 for raw 0..29, 30=Cx1e_Init (CM_TME_ELM3_IstVolumenstrom_Cx1e_Init), 31=Cx1f_Fehler (CM_TME_ELM3_IstVolumenstrom_Cx1f_Fehler); unit Unit_LiterPerMinut
  compu method CM_BMC_Lebensdauer_Trennelemente: phys=raw for raw 0..100000, 131070=Cx1fffe_InitWert (CM_BMC_Lebensdauer_Trennelemente_Cx1fffe_InitWert), 131071=Cx1ffff_Fehler (CM_BMC_Lebensdauer_Trennelemente_Cx1ffff_Fehler); unit Unit_None
  compu method CM_CHA_CurProf: 0=Cx0_no_profile (CM_CHA_CurProf_Cx0_no_profile), 1=Cx1_profile_1 (CM_CHA_CurProf_Cx1_profile_1), 2=Cx2_profile_2 (CM_CHA_CurProf_Cx2_profile_2), 3=Cx3_profile_3 (CM_CHA_CurProf_Cx3_profile_3), 4=Cx4_profile_4 (CM_CHA_CurProf_Cx4_profile_4), 5=Cx5_profile_5 (CM_CHA_CurProf_Cx5_profile_5), 6=Cx6_profile_6 (CM_CHA_CurProf_Cx6_profile_6), 7=Cx7_profile_7 (CM_CHA_CurProf_Cx7_profile_7), 8=Cx8_profile_8 (CM_CHA_CurProf_Cx8_profile_8), 9=Cx9_profile_9 (CM_CHA_CurProf_Cx9_profile_9), 10=Cxa_profile_10 (CM_CHA_CurProf_Cxa_profile_10), 11=Cxb_profile_11 (CM_CHA_CurProf_Cxb_profile_11), 12=Cxc_profile_12 (CM_CHA_CurProf_Cxc_profile_12), 13=Cxd_profile_13 (CM_CHA_CurProf_Cxd_profile_13), 14=Cxe_profile_14 (CM_CHA_CurProf_Cxe_profile_14), 15=Cxf_profile_15 (CM_CHA_CurProf_Cxf_profile_15), 16=Cx10_profile_16 (CM_CHA_CurProf_Cx10_profile_16), 17=Cx11_profile_17 (CM_CHA_CurProf_Cx11_profile_17), 18=Cx12_profile_18 (CM_CHA_CurProf_Cx12_profile_18), 19=Cx13_profile_19 (CM_CHA_CurProf_Cx13_profile_19), 20=Cx14_profile_20 (CM_CHA_CurProf_Cx14_profile_20), 21=Cx15_profile_21 (CM_CHA_CurProf_Cx15_profile_21), 22=Cx16_profile_22 (CM_CHA_CurProf_Cx16_profile_22), 23=Cx17_profile_23 (CM_CHA_CurProf_Cx17_profile_23), 24=Cx18_profile_24 (CM_CHA_CurProf_Cx18_profile_24), 25=Cx19_profile_25 (CM_CHA_CurProf_Cx19_profile_25), 26=Cx1a_profile_26 (CM_CHA_CurProf_Cx1a_profile_26), 27=Cx1b_profile_27 (CM_CHA_CurProf_Cx1b_profile_27), 28=Cx1c_profile_28 (CM_CHA_CurProf_Cx1c_profile_28), 29=Cx1d_profile_29 (CM_CHA_CurProf_Cx1d_profile_29), 30=Cx1e_profile_30 (CM_CHA_CurProf_Cx1e_profile_30), 31=Cx1f_profile_31 (CM_CHA_CurProf_Cx1f_profile_31)
  compu method CM_TME_ETV_IstVolumenstrom: phys=raw*0.1 for raw 0..300, 510=Cx1fe_Init (CM_TME_ETV_IstVolumenstrom_Cx1fe_Init), 511=Cx1ff_Fehler (CM_TME_ETV_IstVolumenstrom_Cx1ff_Fehler); unit Unit_LiterPerMinut
  compu method CM_AB_Systemfehler: 0=Cx0_kein_Fehler (CM_AB_Systemfehler_Cx0_kein_Fehler), 1=Cx1_Airbag_Systemfehler (CM_AB_Systemfehler_Cx1_Airbag_Systemfehler)
  compu method CM_TME_Heizanforderung_Innenraum: 0=Cx0_kein_Heizbedarf (CM_TME_Heizanforderung_Innenraum_Cx0_kein_Heizbedarf), 1=Cx1_kleiner_Heizbedarf (CM_TME_Heizanforderung_Innenraum_Cx1_kleiner_Heizbedarf), 2=Cx2_mittlerer_Heizbedarf (CM_TME_Heizanforderung_Innenraum_Cx2_mittlerer_Heizbedarf), 3=Cx3_max_Heizbedarf (CM_TME_Heizanforderung_Innenraum_Cx3_max_Heizbedarf)
  compu method CM_BMC_Leerlaufspannung: phys=raw for raw 0..1021, 1022=Cx3fe_Init (CM_BMC_Leerlaufspannung_Cx3fe_Init), 1023=Cx3ff_Fehler (CM_BMC_Leerlaufspannung_Cx3ff_Fehler); unit Unit_Volt
  compu method CM_TME_HT_Kuehlmittel_Sensor: 0=Cx0_OK (CM_TME_HT_Kuehlmittel_Sensor_Cx0_OK), 1=Cx1_Kuehlmittel_unter_min (CM_TME_HT_Kuehlmittel_Sensor_Cx1_Kuehlmittel_unter_min)
  compu method CM_UI2_KompFehlerModus4_11: 0=Cx0_TNCTOC (CM_UI2_KompFehlerModus4_11_Cx0_TNCTOC), 1=Cx1_TP_TC (CM_UI2_KompFehlerModus4_11_Cx1_TP_TC), 2=Cx2_TP_TC_WCMTL (CM_UI2_KompFehlerModus4_11_Cx2_TP_TC_WCMTL), 3=Cx3_TF_TC_Error_1 (CM_UI2_KompFehlerModus4_11_Cx3_TF_TC_Error_1), 4=Cx4_TF_TC_Error_2 (CM_UI2_KompFehlerModus4_11_Cx4_TF_TC_Error_2), 5=Cx5_TF_TC_Error_3 (CM_UI2_KompFehlerModus4_11_Cx5_TF_TC_Error_3), 6=Cx6_TF_TC_Error_4 (CM_UI2_KompFehlerModus4_11_Cx6_TF_TC_Error_4), 7=Cx7_TF_TC_Error_5 (CM_UI2_KompFehlerModus4_11_Cx7_TF_TC_Error_5)
  compu method CM_CHA_FlgEndOfList: 0=Cx0_no_trigger (CM_CHA_FlgEndOfList_Cx0_no_trigger), 1=Cx1_left_end_reached_trigger (CM_CHA_FlgEndOfList_Cx1_left_end_reached_trigger), 2=Cx2_right_end_reached_trigger (CM_CHA_FlgEndOfList_Cx2_right_end_reached_trigger)
  compu method CM_AB_Versorgungsspannung: 0=Cx0_plausibel (CM_AB_Versorgungsspannung_Cx0_plausibel), 1=Cx1_unplausibel (CM_AB_Versorgungsspannung_Cx1_unplausibel)
  compu method CM_BMC_Max_Entladeleistung: phys=raw*100 for raw 0..8189, 8190=Cx1ffe_Init (CM_BMC_Max_Entladeleistung_Cx1ffe_Init), 8191=Cx1fff_Fehler (CM_BMC_Max_Entladeleistung_Cx1fff_Fehler); unit Unit_Watt
  compu method CM_UI2_KompFehlerModus4_12: 0=Cx0_TNCTOC (CM_UI2_KompFehlerModus4_12_Cx0_TNCTOC), 1=Cx1_TP_TC (CM_UI2_KompFehlerModus4_12_Cx1_TP_TC), 2=Cx2_TP_TC_WCMTL (CM_UI2_KompFehlerModus4_12_Cx2_TP_TC_WCMTL), 3=Cx3_TF_TC_Error_1 (CM_UI2_KompFehlerModus4_12_Cx3_TF_TC_Error_1), 4=Cx4_TF_TC_Error_2 (CM_UI2_KompFehlerModus4_12_Cx4_TF_TC_Error_2), 5=Cx5_TF_TC_Error_3 (CM_UI2_KompFehlerModus4_12_Cx5_TF_TC_Error_3), 6=Cx6_TF_TC_Error_4 (CM_UI2_KompFehlerModus4_12_Cx6_TF_TC_Error_4), 7=Cx7_TF_TC_Error_5 (CM_UI2_KompFehlerModus4_12_Cx7_TF_TC_Error_5)
  compu method CM_CHA_FlgGlbFallBkIdc: 0=Cx0_global_fall_back_not_indicated (CM_CHA_FlgGlbFallBkIdc_Cx0_global_fall_back_not_indicated), 1=Cx1_global_fall_back_indicated (CM_CHA_FlgGlbFallBkIdc_Cx1_global_fall_back_indicated)
  compu method CM_AB_VRU_Crash: 0=Cx0_No_VRU_Crash (CM_AB_VRU_Crash_Cx0_No_VRU_Crash), 1=Cx1_VRU_Crash (CM_AB_VRU_Crash_Cx1_VRU_Crash)
  compu method CM_CHA_ProfChanged: 0=Cx0_profile_not_changed (CM_CHA_ProfChanged_Cx0_profile_not_changed), 1=Cx1_profile_changed (CM_CHA_ProfChanged_Cx1_profile_changed)
  compu method CM_UI2_KompFehlerModus4_13: 0=Cx0_TNCTOC (CM_UI2_KompFehlerModus4_13_Cx0_TNCTOC), 1=Cx1_TP_TC (CM_UI2_KompFehlerModus4_13_Cx1_TP_TC), 2=Cx2_TP_TC_WCMTL (CM_UI2_KompFehlerModus4_13_Cx2_TP_TC_WCMTL), 3=Cx3_TF_TC_Error_1 (CM_UI2_KompFehlerModus4_13_Cx3_TF_TC_Error_1), 4=Cx4_TF_TC_Error_2 (CM_UI2_KompFehlerModus4_13_Cx4_TF_TC_Error_2), 5=Cx5_TF_TC_Error_3 (CM_UI2_KompFehlerModus4_13_Cx5_TF_TC_Error_3), 6=Cx6_TF_TC_Error_4 (CM_UI2_KompFehlerModus4_13_Cx6_TF_TC_Error_4), 7=Cx7_TF_TC_Error_5 (CM_UI2_KompFehlerModus4_13_Cx7_TF_TC_Error_5)
  compu method CM_UI2_KompFehlerModus4_14: 0=Cx0_TNCTOC (CM_UI2_KompFehlerModus4_14_Cx0_TNCTOC), 1=Cx1_TP_TC (CM_UI2_KompFehlerModus4_14_Cx1_TP_TC), 2=Cx2_TP_TC_WCMTL (CM_UI2_KompFehlerModus4_14_Cx2_TP_TC_WCMTL), 3=Cx3_TF_TC_Error_1 (CM_UI2_KompFehlerModus4_14_Cx3_TF_TC_Error_1), 4=Cx4_TF_TC_Error_2 (CM_UI2_KompFehlerModus4_14_Cx4_TF_TC_Error_2), 5=Cx5_TF_TC_Error_3 (CM_UI2_KompFehlerModus4_14_Cx5_TF_TC_Error_3), 6=Cx6_TF_TC_Error_4 (CM_UI2_KompFehlerModus4_14_Cx6_TF_TC_Error_4), 7=Cx7_TF_TC_Error_5 (CM_UI2_KompFehlerModus4_14_Cx7_TF_TC_Error_5)
  compu method CM_CHA_ReqPrgAcc: 0=Cx0_no_program (CM_CHA_ReqPrgAcc_Cx0_no_program), 1=Cx1_program_1 (CM_CHA_ReqPrgAcc_Cx1_program_1), 2=Cx2_program_2 (CM_CHA_ReqPrgAcc_Cx2_program_2), 3=Cx3_program_3 (CM_CHA_ReqPrgAcc_Cx3_program_3), 4=Cx4_program_4 (CM_CHA_ReqPrgAcc_Cx4_program_4), 5=Cx5_program_5 (CM_CHA_ReqPrgAcc_Cx5_program_5), 6=Cx6_program_6 (CM_CHA_ReqPrgAcc_Cx6_program_6), 7=Cx7_program_7 (CM_CHA_ReqPrgAcc_Cx7_program_7), 8=Cx8_program_8 (CM_CHA_ReqPrgAcc_Cx8_program_8), 9=Cx9_program_9 (CM_CHA_ReqPrgAcc_Cx9_program_9), 10=Cxa_program_10 (CM_CHA_ReqPrgAcc_Cxa_program_10), 11=Cxb_program_11 (CM_CHA_ReqPrgAcc_Cxb_program_11), 12=Cxc_program_12 (CM_CHA_ReqPrgAcc_Cxc_program_12), 13=Cxd_program_13 (CM_CHA_ReqPrgAcc_Cxd_program_13), 14=Cxe_program_14 (CM_CHA_ReqPrgAcc_Cxe_program_14), 15=Cxf_program_15 (CM_CHA_ReqPrgAcc_Cxf_program_15)
  compu method CM_OruControlReleaseD: phys=raw for raw 0..65535; unit Unit_None
  compu method CM_UISensorPyro_02_CRC: phys=raw for raw 0..255
  compu method CM_OruControlStateA: 0=Cx0_Idle (CM_OruControlStateA_Cx0_Idle), 1=Cx1_Check (CM_OruControlStateA_Cx1_Check), 3=Cx3_DataPresent (CM_OruControlStateA_Cx3_DataPresent), 7=Cx7_LockActive (CM_OruControlStateA_Cx7_LockActive), 15=Cxf_Running (CM_OruControlStateA_Cxf_Running), 31=Cx1f_Save (CM_OruControlStateA_Cx1f_Save), 63=Cx3f_Done (CM_OruControlStateA_Cx3f_Done), 65=Cx41_Fail (CM_OruControlStateA_Cx41_Fail), 129=Cx81_Fehler (CM_OruControlStateA_Cx81_Fehler)
  compu method CM_UI2_KompFehlerModus4_15: 0=Cx0_TNCTOC (CM_UI2_KompFehlerModus4_15_Cx0_TNCTOC), 1=Cx1_TP_TC (CM_UI2_KompFehlerModus4_15_Cx1_TP_TC), 2=Cx2_TP_TC_WCMTL (CM_UI2_KompFehlerModus4_15_Cx2_TP_TC_WCMTL), 3=Cx3_TF_TC_Error_1 (CM_UI2_KompFehlerModus4_15_Cx3_TF_TC_Error_1), 4=Cx4_TF_TC_Error_2 (CM_UI2_KompFehlerModus4_15_Cx4_TF_TC_Error_2), 5=Cx5_TF_TC_Error_3 (CM_UI2_KompFehlerModus4_15_Cx5_TF_TC_Error_3), 6=Cx6_TF_TC_Error_4 (CM_UI2_KompFehlerModus4_15_Cx6_TF_TC_Error_4), 7=Cx7_TF_TC_Error_5 (CM_UI2_KompFehlerModus4_15_Cx7_TF_TC_Error_5)
  compu method CM_UISensorPyro_03_BZ: phys=raw for raw 0..15
  compu method CM_NM_aktiv_AutomotiveEdge_1: 0=Cx0_Inaktiv (CM_NM_aktiv_AutomotiveEdge_1_Cx0_Inaktiv), 1=Cx1_Aktiv (CM_NM_aktiv_AutomotiveEdge_1_Cx1_Aktiv)
  compu method CM_UISensorPyro_03_CRC: phys=raw for raw 0..255
  compu method CM_BMC_Sperrung_Ueberspannung: 0=Cx0_keine_Sperrung (CM_BMC_Sperrung_Ueberspannung_Cx0_keine_Sperrung), 1=Cx1_Sperrung (CM_BMC_Sperrung_Ueberspannung_Cx1_Sperrung), 2=Cx2_InitWert (CM_BMC_Sperrung_Ueberspannung_Cx2_InitWert), 3=Cx3_Fehler (CM_BMC_Sperrung_Ueberspannung_Cx3_Fehler)
  compu method CM_OruControlStateD: 0=Cx0_Idle (CM_OruControlStateD_Cx0_Idle), 1=Cx1_Check (CM_OruControlStateD_Cx1_Check), 3=Cx3_DataPresent (CM_OruControlStateD_Cx3_DataPresent), 7=Cx7_LockActive (CM_OruControlStateD_Cx7_LockActive), 15=Cxf_Running (CM_OruControlStateD_Cxf_Running), 31=Cx1f_Save (CM_OruControlStateD_Cx1f_Save), 63=Cx3f_Done (CM_OruControlStateD_Cx3f_Done), 65=Cx41_Fail (CM_OruControlStateD_Cx41_Fail), 129=Cx81_Fehler (CM_OruControlStateD_Cx81_Fehler)
  compu method CM_ZM_HV_Auszeit: phys=raw*4 for raw 0..4093, 4094=Cxffe_Init (CM_ZM_HV_Auszeit_Cxffe_Init), 4095=Cxfff_Fehler (CM_ZM_HV_Auszeit_Cxfff_Fehler); unit Unit_Minut
  compu method CM_NM_aktiv_AutomotiveEdge_2: 0=Cx0_Inaktiv (CM_NM_aktiv_AutomotiveEdge_2_Cx0_Inaktiv), 1=Cx1_Aktiv (CM_NM_aktiv_AutomotiveEdge_2_Cx1_Aktiv)
  compu method CM_VDSO_05_BZ: phys=raw for raw 0..15
  compu method CM_BMC_Sperrung_Uebertemperatur: 0=Cx0_keine_Sperrung (CM_BMC_Sperrung_Uebertemperatur_Cx0_keine_Sperrung), 1=Cx1_Sperrung (CM_BMC_Sperrung_Uebertemperatur_Cx1_Sperrung), 2=Cx2_InitWert (CM_BMC_Sperrung_Uebertemperatur_Cx2_InitWert), 3=Cx3_Fehler (CM_BMC_Sperrung_Uebertemperatur_Cx3_Fehler)
  compu method CM_NM_SACID_1_CBV_CRI: 0=Cx0_NM_ohne_Clusteranforderungen (CM_NM_SACID_1_CBV_CRI_Cx0_NM_ohne_Clusteranforderungen), 1=Cx1_NM_mit_Clusteranforderungen (CM_NM_SACID_1_CBV_CRI_Cx1_NM_mit_Clusteranforderungen)
  compu method CM_ZM_HV_Auszeit_HiRes: phys=raw*0.5 for raw 0..65533, 65534=Cxfffe_Init (CM_ZM_HV_Auszeit_HiRes_Cxfffe_Init), 65535=Cxffff_Fehler (CM_ZM_HV_Auszeit_HiRes_Cxffff_Fehler); unit Unit_Minut
  compu method CM_UI2_KompFehlerModus4_16: 0=Cx0_TNCTOC (CM_UI2_KompFehlerModus4_16_Cx0_TNCTOC), 1=Cx1_TP_TC (CM_UI2_KompFehlerModus4_16_Cx1_TP_TC), 2=Cx2_TP_TC_WCMTL (CM_UI2_KompFehlerModus4_16_Cx2_TP_TC_WCMTL), 3=Cx3_TF_TC_Error_1 (CM_UI2_KompFehlerModus4_16_Cx3_TF_TC_Error_1), 4=Cx4_TF_TC_Error_2 (CM_UI2_KompFehlerModus4_16_Cx4_TF_TC_Error_2), 5=Cx5_TF_TC_Error_3 (CM_UI2_KompFehlerModus4_16_Cx5_TF_TC_Error_3), 6=Cx6_TF_TC_Error_4 (CM_UI2_KompFehlerModus4_16_Cx6_TF_TC_Error_4), 7=Cx7_TF_TC_Error_5 (CM_UI2_KompFehlerModus4_16_Cx7_TF_TC_Error_5)
  compu method CM_TME_HV_Anf: 0=Cx0_Init (CM_TME_HV_Anf_Cx0_Init), 1=Cx1_HV_Netz_nicht_angefordet (CM_TME_HV_Anf_Cx1_HV_Netz_nicht_angefordet), 2=Cx2_HV_Netz_Stufe_1_angefordert (CM_TME_HV_Anf_Cx2_HV_Netz_Stufe_1_angefordert), 3=Cx3_HV_Netz_Stufe_2_angefordert (CM_TME_HV_Anf_Cx3_HV_Netz_Stufe_2_angefordert)
  compu method CM_KS_Hybrid_01_ChM: phys=raw for raw 0..18446744073709551615; unit Unit_None
  compu method CM_BMC_Max_Entladeleistung_02: phys=raw*100 for raw 0..32500, 32766=Cx7ffe_Init (CM_BMC_Max_Entladeleistung_02_Cx7ffe_Init), 32767=Cx7fff_Fehler (CM_BMC_Max_Entladeleistung_02_Cx7fff_Fehler); unit Unit_Watt
  compu method CM_BMC_Sperrung_Unterspannung: 0=Cx0_keine_Sperrung (CM_BMC_Sperrung_Unterspannung_Cx0_keine_Sperrung), 1=Cx1_Sperrung (CM_BMC_Sperrung_Unterspannung_Cx1_Sperrung), 2=Cx2_InitWert (CM_BMC_Sperrung_Unterspannung_Cx2_InitWert), 3=Cx3_Fehler (CM_BMC_Sperrung_Unterspannung_Cx3_Fehler)
  compu method CM_NM_aktiv_AutomotiveEdge_3: 0=Cx0_Inaktiv (CM_NM_aktiv_AutomotiveEdge_3_Cx0_Inaktiv), 1=Cx1_Aktiv (CM_NM_aktiv_AutomotiveEdge_3_Cx1_Aktiv)
  compu method CM_ZM_HV_Auszeit_Status: 0=Cx0_nicht_berechnet (CM_ZM_HV_Auszeit_Status_Cx0_nicht_berechnet), 1=Cx1_berechnet (CM_ZM_HV_Auszeit_Status_Cx1_berechnet), 2=Cx2_Minimalwert (CM_ZM_HV_Auszeit_Status_Cx2_Minimalwert), 3=Cx3_ungueltig (CM_ZM_HV_Auszeit_Status_Cx3_ungueltig)
  compu method CM_VDSO_05_CRC: phys=raw for raw 0..255
  compu method CM_OruHostUpdateA: 0=Cx0_Init (CM_OruHostUpdateA_Cx0_Init), 1=Cx1_HostControl1 (CM_OruHostUpdateA_Cx1_HostControl1), 2=Cx2_HostControl2 (CM_OruHostUpdateA_Cx2_HostControl2), 3=Cx3_HostControlOther (CM_OruHostUpdateA_Cx3_HostControlOther), 4=Cx4_Fehler (CM_OruHostUpdateA_Cx4_Fehler)
  compu method CM_NM_SACID_1_FCAB: 0=Cx0_Init (CM_NM_SACID_1_FCAB_Cx0_Init), 1=Cx1_01_CarWakeUp (CM_NM_SACID_1_FCAB_Cx1_01_CarWakeUp), 2=Cx2_02_Basefunction_Powertrain (CM_NM_SACID_1_FCAB_Cx2_02_Basefunction_Powertrain), 4=Cx4_03_Basefunction_Chassis (CM_NM_SACID_1_FCAB_Cx4_03_Basefunction_Chassis), 8=Cx8_04_Basefunction_DrivingAssistance (CM_NM_SACID_1_FCAB_Cx8_04_Basefunction_DrivingAssistance), 16=Cx10_05_Basefunction_Infotainment (CM_NM_SACID_1_FCAB_Cx10_05_Basefunction_Infotainment), 32=Cx20_06_Basefunction_ComfortLight (CM_NM_SACID_1_FCAB_Cx20_06_Basefunction_ComfortLight), 64=Cx40_07_Basefunction_CrossSection (CM_NM_SACID_1_FCAB_Cx40_07_Basefunction_CrossSection), 128=Cx80_08_Basefunction_Connectivity (CM_NM_SACID_1_FCAB_Cx80_08_Basefunction_Connectivity), 256=Cx100_09_Basefunction_DrivingAssistanceCore (CM_NM_SACID_1_FCAB_Cx100_09_Basefunction_DrivingAssistanceCore), 512=Cx200_10_Powertrain (CM_NM_SACID_1_FCAB_Cx200_10_Powertrain), 1024=Cx400_11_Chassis (CM_NM_SACID_1_FCAB_Cx400_11_Chassis), 2048=Cx800_12_GearSelector (CM_NM_SACID_1_FCAB_Cx800_12_GearSelector), 4096=Cx1000_13_Airbag (CM_NM_SACID_1_FCAB_Cx1000_13_Airbag), 8192=Cx2000_14_InfotainmentExtensions (CM_NM_SACID_1_FCAB_Cx2000_14_InfotainmentExtensions), 16384=Cx4000_15_InstrumentclusterDisplay (CM_NM_SACID_1_FCAB_Cx4000_15_InstrumentclusterDisplay), 32768=Cx8000_16_InfotainmentDisplay (CM_NM_SACID_1_FCAB_Cx8000_16_InfotainmentDisplay), 65536=Cx10000_17_Audio (CM_NM_SACID_1_FCAB_Cx10000_17_Audio), 131072=Cx20000_18_VirtualSideMirrors (CM_NM_SACID_1_FCAB_Cx20000_18_VirtualSideMirrors), 262144=Cx40000_19_Doors_Hatches (CM_NM_SACID_1_FCAB_Cx40000_19_Doors_Hatches), 524288=Cx80000_20_OptionalComfort (CM_NM_SACID_1_FCAB_Cx80000_20_OptionalComfort), 1048576=Cx100000_21_AirSuspension (CM_NM_SACID_1_FCAB_Cx100000_21_AirSuspension), 2097152=Cx200000_22_ExteriorLights (CM_NM_SACID_1_FCAB_Cx200000_22_ExteriorLights), 4194304=Cx400000_23_Climate (CM_NM_SACID_1_FCAB_Cx400000_23_Climate), 8388608=Cx800000_24_ThermoManagement (CM_NM_SACID_1_FCAB_Cx800000_24_ThermoManagement), 16777216=Cx1000000_25_AccessSystemSensors (CM_NM_SACID_1_FCAB_Cx1000000_25_AccessSystemSensors), 33554432=Cx2000000_26_HighVoltage_Charging (CM_NM_SACID_1_FCAB_Cx2000000_26_HighVoltage_Charging), 67108864=Cx4000000_27_Timemaster_Timer (CM_NM_SACID_1_FCAB_Cx4000000_27_Timemaster_Timer), 134217728=Cx8000000_28_OnboardTester_DataCollector (CM_NM_SACID_1_FCAB_Cx8000000_28_OnboardTester_DataCollector), 268435456=Cx10000000_29_SteeringColumnLock (CM_NM_SACID_1_FCAB_Cx10000000_29_SteeringColumnLock), 536870912=Cx20000000_30_EnergyManagement (CM_NM_SACID_1_FCAB_Cx20000000_30_EnergyManagement), 1073741824=Cx40000000_31_MultifunctionalSteeringWheel (CM_NM_SACID_1_FCAB_Cx40000000_31_MultifunctionalSteeringWheel), 2147483648=Cx80000000_32_OnlineAccess (CM_NM_SACID_1_FCAB_Cx80000000_32_OnlineAccess), 4294967296=Cx100000000_33_ExternalWirelessCommunication (CM_NM_SACID_1_FCAB_Cx100000000_33_ExternalWirelessCommunication), 8589934592=Cx200000000_34_GPS_Localization (CM_NM_SACID_1_FCAB_Cx200000000_34_GPS_Localization), 17179869184=Cx400000000_35_ExteriorSound (CM_NM_SACID_1_FCAB_Cx400000000_35_ExteriorSound), 34359738368=Cx800000000_36_Preheater (CM_NM_SACID_1_FCAB_Cx800000000_36_Preheater), 68719476736=Cx1000000000_37_HighVoltage_WirelessChargingStation (CM_NM_SACID_1_FCAB_Cx1000000000_37_HighVoltage_WirelessChargingStation), 549755813888=Cx8000000000_40_Diagnosis_Energy (CM_NM_SACID_1_FCAB_Cx8000000000_40_Diagnosis_Energy), 1099511627776=Cx10000000000_41_Diagnosis_Powertrain (CM_NM_SACID_1_FCAB_Cx10000000000_41_Diagnosis_Powertrain), 2199023255552=Cx20000000000_42_Diagnosis_FlexRay (CM_NM_SACID_1_FCAB_Cx20000000000_42_Diagnosis_FlexRay), 4398046511104=Cx40000000000_43_Diagnosis_DrivingAssistance (CM_NM_SACID_1_FCAB_Cx40000000000_43_Diagnosis_DrivingAssistance), 8796093022208=Cx80000000000_44_Diagnosis_Infotainment (CM_NM_SACID_1_FCAB_Cx80000000000_44_Diagnosis_Infotainment), 17592186044416=Cx100000000000_45_Diagnosis_Comfort (CM_NM_SACID_1_FCAB_Cx100000000000_45_Diagnosis_Comfort), 35184372088832=Cx200000000000_46_Diagnosis_Light (CM_NM_SACID_1_FCAB_Cx200000000000_46_Diagnosis_Light), 70368744177664=Cx400000000000_47_Diagnosis_ComfortLINs (CM_NM_SACID_1_FCAB_Cx400000000000_47_Diagnosis_ComfortLINs), 140737488355328=Cx800000000000_48_Diagnosis_ClimateTmeLINs (CM_NM_SACID_1_FCAB_Cx800000000000_48_Diagnosis_ClimateTmeLINs), 281474976710656=Cx1000000000000_49_reserved (CM_NM_SACID_1_FCAB_Cx1000000000000_49_reserved) (49_<reserved>), 4503599627370496=Cx10000000000000_53_Lock_Unlock (CM_NM_SACID_1_FCAB_Cx10000000000000_53_Lock_Unlock), 9007199254740992=Cx20000000000000_54_reserved (CM_NM_SACID_1_FCAB_Cx20000000000000_54_reserved) (54_<reserved>), 18014398509481984=Cx40000000000000_55_Dimming (CM_NM_SACID_1_FCAB_Cx40000000000000_55_Dimming), 36028797018963968=Cx80000000000000_56_ChargingStatus (CM_NM_SACID_1_FCAB_Cx80000000000000_56_ChargingStatus)
  compu method CM_TME_HV_IstLeistung: phys=raw*50 for raw 0..509, 510=Cx1fe_Init (CM_TME_HV_IstLeistung_Cx1fe_Init), 511=Cx1ff_Fehler (CM_TME_HV_IstLeistung_Cx1ff_Fehler); unit Unit_Watt
  compu method CM_KS_Hybrid_01_ChM_IKACtr: phys=raw for raw 0..255; unit Unit_None
  compu method CM_BMC_Status_DCLS: 0=Cx0_inaktiv (CM_BMC_Status_DCLS_Cx0_inaktiv), 1=Cx1_i_O (CM_BMC_Status_DCLS_Cx1_i_O), 2=Cx2_n_i_O (CM_BMC_Status_DCLS_Cx2_n_i_O), 3=Cx3_aktiv (CM_BMC_Status_DCLS_Cx3_aktiv)
  compu method CM_ZM_Standzeit: phys=raw for raw 0..131068, 131069=Cx1fffd_nicht_verfuegbar (CM_ZM_Standzeit_Cx1fffd_nicht_verfuegbar), 131070=Cx1fffe_Init (CM_ZM_Standzeit_Cx1fffe_Init), 131071=Cx1ffff_Fehler (CM_ZM_Standzeit_Cx1ffff_Fehler); unit Unit_Secon
  compu method CM_NM_aktiv_AutomotiveEdge_4: 0=Cx0_Inaktiv (CM_NM_aktiv_AutomotiveEdge_4_Cx0_Inaktiv), 1=Cx1_Aktiv (CM_NM_aktiv_AutomotiveEdge_4_Cx1_Aktiv)
  compu method CM_UI2_Pyro_Status: 0=Cx0_Init (CM_UI2_Pyro_Status_Cx0_Init), 1=Cx1_Fehler (CM_UI2_Pyro_Status_Cx1_Fehler), 2=Cx2_Funktion_verfuegbar (CM_UI2_Pyro_Status_Cx2_Funktion_verfuegbar), 3=Cx3_Funktion_ausgeloest (CM_UI2_Pyro_Status_Cx3_Funktion_ausgeloest), 4=Cx4_Funktion_zuendfaehig (CM_UI2_Pyro_Status_Cx4_Funktion_zuendfaehig)
  compu method CM_NM_SACID_1_NM_aktiv_Diag: 0=Cx0_Inaktiv (CM_NM_SACID_1_NM_aktiv_Diag_Cx0_Inaktiv), 1=Cx1_Diagnose_aktiv (CM_NM_SACID_1_NM_aktiv_Diag_Cx1_Diagnose_aktiv)
  compu method CM_BMC_Status_HV_Spannungssensorik: 0=Cx0_InitWert_kein_Fehler (CM_BMC_Status_HV_Spannungssensorik_Cx0_InitWert_kein_Fehler), 1=Cx1_Fehler (CM_BMC_Status_HV_Spannungssensorik_Cx1_Fehler)
  compu method CM_NM_aktiv_AutomotiveEdge_5: 0=Cx0_Inaktiv (CM_NM_aktiv_AutomotiveEdge_5_Cx0_Inaktiv), 1=Cx1_Aktiv (CM_NM_aktiv_AutomotiveEdge_5_Cx1_Aktiv)
  compu method CM_TME_HV_IstLeistung_BTL: phys=raw*50 for raw 0..509, 510=Cx1fe_Init (CM_TME_HV_IstLeistung_BTL_Cx1fe_Init), 511=Cx1ff_Fehler (CM_TME_HV_IstLeistung_BTL_Cx1ff_Fehler); unit Unit_Watt
  compu method CM_KS_Hybrid_01_ChM_SID: phys=raw for raw 0..65535; unit Unit_None
  compu method CM_OruHostUpdateD: 0=Cx0_Init (CM_OruHostUpdateD_Cx0_Init), 1=Cx1_HostControl1 (CM_OruHostUpdateD_Cx1_HostControl1), 2=Cx2_HostControl2 (CM_OruHostUpdateD_Cx2_HostControl2), 3=Cx3_HostControlOther (CM_OruHostUpdateD_Cx3_HostControlOther), 4=Cx4_Fehler (CM_OruHostUpdateD_Cx4_Fehler)
  compu method CM_BMC_Status_Spgfreiheit: 0=Cx0_Init (CM_BMC_Status_Spgfreiheit_Cx0_Init), 1=Cx1_HV_Komponente_spannungsfrei (CM_BMC_Status_Spgfreiheit_Cx1_HV_Komponente_spannungsfrei), 2=Cx2_HV_Komp_nicht_spannungsfrei (CM_BMC_Status_Spgfreiheit_Cx2_HV_Komp_nicht_spannungsfrei), 3=Cx3_Fehler_nicht_spannungsfrei (CM_BMC_Status_Spgfreiheit_Cx3_Fehler_nicht_spannungsfrei)
  compu method CM_NM_aktiv_Backend_KomGW: 0=Cx0_Inaktiv (CM_NM_aktiv_Backend_KomGW_Cx0_Inaktiv), 1=Cx1_Aktiv (CM_NM_aktiv_Backend_KomGW_Cx1_Aktiv)
  compu method CM_CHA_ReqPrgAcvChassis: 0=Cx0_no_program (CM_CHA_ReqPrgAcvChassis_Cx0_no_program), 1=Cx1_program_1 (CM_CHA_ReqPrgAcvChassis_Cx1_program_1), 2=Cx2_program_2 (CM_CHA_ReqPrgAcvChassis_Cx2_program_2), 3=Cx3_program_3 (CM_CHA_ReqPrgAcvChassis_Cx3_program_3), 4=Cx4_program_4 (CM_CHA_ReqPrgAcvChassis_Cx4_program_4), 5=Cx5_program_5 (CM_CHA_ReqPrgAcvChassis_Cx5_program_5), 6=Cx6_program_6 (CM_CHA_ReqPrgAcvChassis_Cx6_program_6), 7=Cx7_program_7 (CM_CHA_ReqPrgAcvChassis_Cx7_program_7), 8=Cx8_program_8 (CM_CHA_ReqPrgAcvChassis_Cx8_program_8), 9=Cx9_program_9 (CM_CHA_ReqPrgAcvChassis_Cx9_program_9), 10=Cxa_program_10 (CM_CHA_ReqPrgAcvChassis_Cxa_program_10), 11=Cxb_program_11 (CM_CHA_ReqPrgAcvChassis_Cxb_program_11), 12=Cxc_program_12 (CM_CHA_ReqPrgAcvChassis_Cxc_program_12), 13=Cxd_program_13 (CM_CHA_ReqPrgAcvChassis_Cxd_program_13), 14=Cxe_program_14 (CM_CHA_ReqPrgAcvChassis_Cxe_program_14), 15=Cxf_program_15 (CM_CHA_ReqPrgAcvChassis_Cxf_program_15)
  compu method CM_BMC_Status_Trennelemente: 0=Cx0_kein_Fehler (CM_BMC_Status_Trennelemente_Cx0_kein_Fehler), 1=Cx1_Haupt_TrEl_klemmt_geschl (CM_BMC_Status_Trennelemente_Cx1_Haupt_TrEl_klemmt_geschl), 2=Cx2_AC_TrEl_klemmt_geschl (CM_BMC_Status_Trennelemente_Cx2_AC_TrEl_klemmt_geschl), 3=Cx3_Haupt_und_AC_TrEl_klemmt_geschl (CM_BMC_Status_Trennelemente_Cx3_Haupt_und_AC_TrEl_klemmt_geschl), 6=Cx6_InitWert (CM_BMC_Status_Trennelemente_Cx6_InitWert), 7=Cx7_Fehler (CM_BMC_Status_Trennelemente_Cx7_Fehler)
  compu method CM_NM_aktiv_Batteriekonditionierung: 0=Cx0_Inaktiv (CM_NM_aktiv_Batteriekonditionierung_Cx0_Inaktiv), 1=Cx1_Aktiv (CM_NM_aktiv_Batteriekonditionierung_Cx1_Aktiv)
  compu method CM_TME_OBD_Lampe_Anf: 0=Cx0_kein_MIL_Request (CM_TME_OBD_Lampe_Anf_Cx0_kein_MIL_Request), 1=Cx1_MIL_Request (CM_TME_OBD_Lampe_Anf_Cx1_MIL_Request)
  compu method CM_NM_aktiv_Bedienung_an_Ladedose_1: 0=Cx0_Inaktiv (CM_NM_aktiv_Bedienung_an_Ladedose_1_Cx0_Inaktiv), 1=Cx1_Aktiv (CM_NM_aktiv_Bedienung_an_Ladedose_1_Cx1_Aktiv)
  compu method CM_VDSO_BasTi200_NumClc_05: phys=raw for raw 0..15; unit Unit_None
  compu method CM_BMC_Strom: phys=raw*0.0625-2047 for raw 0..65533, 65534=Cxfffe_Init (CM_BMC_Strom_Cxfffe_Init), 65535=Cxffff_Fehler (CM_BMC_Strom_Cxffff_Fehler); unit Unit_Amper
  compu method CM_UI1_KompFehlerModus4_08: 0=Cx0_TNCTOC (CM_UI1_KompFehlerModus4_08_Cx0_TNCTOC), 1=Cx1_TP_TC (CM_UI1_KompFehlerModus4_08_Cx1_TP_TC), 2=Cx2_TP_TC_WCMTL (CM_UI1_KompFehlerModus4_08_Cx2_TP_TC_WCMTL), 3=Cx3_TF_TC_Error_1 (CM_UI1_KompFehlerModus4_08_Cx3_TF_TC_Error_1), 4=Cx4_TF_TC_Error_2 (CM_UI1_KompFehlerModus4_08_Cx4_TF_TC_Error_2), 5=Cx5_TF_TC_Error_3 (CM_UI1_KompFehlerModus4_08_Cx5_TF_TC_Error_3), 6=Cx6_TF_TC_Error_4 (CM_UI1_KompFehlerModus4_08_Cx6_TF_TC_Error_4), 7=Cx7_TF_TC_Error_5 (CM_UI1_KompFehlerModus4_08_Cx7_TF_TC_Error_5)
  compu method CM_BMC_Strom_02: phys=raw*0.0625-3250 for raw 0..104000, 131070=Cx1fffe_InitWert (CM_BMC_Strom_02_Cx1fffe_InitWert), 131071=Cx1ffff_Fehler (CM_BMC_Strom_02_Cx1ffff_Fehler); unit Unit_Amper
  compu method CM_NM_aktiv_Bedienung_an_Ladedose_2: 0=Cx0_Inaktiv (CM_NM_aktiv_Bedienung_an_Ladedose_2_Cx0_Inaktiv), 1=Cx1_Aktiv (CM_NM_aktiv_Bedienung_an_Ladedose_2_Cx1_Aktiv)
  compu method CM_BMC_Max_Entladestrom: phys=raw*0.2 for raw 0..8189, 8190=Cx1ffe_Init (CM_BMC_Max_Entladestrom_Cx1ffe_Init), 8191=Cx1fff_Fehler (CM_BMC_Max_Entladestrom_Cx1fff_Fehler); unit Unit_Amper
  compu method CM_VDSO_Vx3d: phys=raw*0.0039-127.7874 for raw 0..65533, 65534=Cxfffe_Init (CM_VDSO_Vx3d_Cxfffe_Init), 65535=Cxffff_Fehler (CM_VDSO_Vx3d_Cxffff_Fehler); unit Unit_MeterPerSecon
  compu method CM_CHA_ReqPrgAcvStg: 0=Cx0_no_program (CM_CHA_ReqPrgAcvStg_Cx0_no_program), 1=Cx1_program_1 (CM_CHA_ReqPrgAcvStg_Cx1_program_1), 2=Cx2_program_2 (CM_CHA_ReqPrgAcvStg_Cx2_program_2), 3=Cx3_program_3 (CM_CHA_ReqPrgAcvStg_Cx3_program_3), 4=Cx4_program_4 (CM_CHA_ReqPrgAcvStg_Cx4_program_4), 5=Cx5_program_5 (CM_CHA_ReqPrgAcvStg_Cx5_program_5), 6=Cx6_program_6 (CM_CHA_ReqPrgAcvStg_Cx6_program_6), 7=Cx7_program_7 (CM_CHA_ReqPrgAcvStg_Cx7_program_7), 8=Cx8_program_8 (CM_CHA_ReqPrgAcvStg_Cx8_program_8), 9=Cx9_program_9 (CM_CHA_ReqPrgAcvStg_Cx9_program_9), 10=Cxa_program_10 (CM_CHA_ReqPrgAcvStg_Cxa_program_10), 11=Cxb_program_11 (CM_CHA_ReqPrgAcvStg_Cxb_program_11), 12=Cxc_program_12 (CM_CHA_ReqPrgAcvStg_Cxc_program_12), 13=Cxd_program_13 (CM_CHA_ReqPrgAcvStg_Cxd_program_13), 14=Cxe_program_14 (CM_CHA_ReqPrgAcvStg_Cxe_program_14), 15=Cxf_program_15 (CM_CHA_ReqPrgAcvStg_Cxf_program_15)
  compu method CM_BMC_Strom_Messzeit: phys=raw for raw 0..253, 254=Cxfe_Init (CM_BMC_Strom_Messzeit_Cxfe_Init), 255=Cxff_Fehler (CM_BMC_Strom_Messzeit_Cxff_Fehler); unit Unit_None
  compu method CM_UI2_Spannung1: phys=raw*0.0625-1023 for raw 0..32763, 32764=Cx7ffc_nicht_messbar (CM_UI2_Spannung1_Cx7ffc_nicht_messbar), 32765=Cx7ffd_nicht_verfuegbar (CM_UI2_Spannung1_Cx7ffd_nicht_verfuegbar), 32766=Cx7ffe_Init (CM_UI2_Spannung1_Cx7ffe_Init), 32767=Cx7fff_Fehler (CM_UI2_Spannung1_Cx7fff_Fehler); unit Unit_Volt
  compu method CM_NM_aktiv_Call: 0=Cx0_Inaktiv (CM_NM_aktiv_Call_Cx0_Inaktiv), 1=Cx1_Aktiv (CM_NM_aktiv_Call_Cx1_Aktiv)
  compu method CM_OruIntegrityCheckActiveA: 0=Cx0_Init (CM_OruIntegrityCheckActiveA_Cx0_Init), 1=Cx1_Inactive (CM_OruIntegrityCheckActiveA_Cx1_Inactive), 2=Cx2_Active (CM_OruIntegrityCheckActiveA_Cx2_Active), 3=Cx3_Fehler (CM_OruIntegrityCheckActiveA_Cx3_Fehler)
  compu method CM_VDSO_Vx3dDisp: phys=raw*0.0039-127.7874 for raw 0..65533, 65534=Cxfffe_Init (CM_VDSO_Vx3dDisp_Cxfffe_Init), 65535=Cxffff_Fehler (CM_VDSO_Vx3dDisp_Cxffff_Fehler); unit Unit_MeterPerSecon
  compu method CM_TME_PTC_Leistung_Ist: phys=raw*10 for raw 0..509, 510=Cx1fe_Init (CM_TME_PTC_Leistung_Ist_Cx1fe_Init), 511=Cx1ff_Fehler (CM_TME_PTC_Leistung_Ist_Cx1ff_Fehler); unit Unit_Watt
  compu method CM_BMC_Max_Entladestrom_02: phys=raw*0.2 for raw 0..16250, 16382=Cx3ffe_Init (CM_BMC_Max_Entladestrom_02_Cx3ffe_Init), 16383=Cx3fff_Fehler (CM_BMC_Max_Entladestrom_02_Cx3fff_Fehler); unit Unit_Amper
  compu method CM_VDSO_Vx3dKmph: phys=raw*0.014-458.724 for raw 0..65533, 65534=Cxfffe_Init (CM_VDSO_Vx3dKmph_Cxfffe_Init), 65535=Cxffff_Fehler (CM_VDSO_Vx3dKmph_Cxffff_Fehler); unit Unit_KiloMeterPerHour
  compu method CM_CHA_ReqPrgBms: 0=Cx0_no_program (CM_CHA_ReqPrgBms_Cx0_no_program), 1=Cx1_program_1 (CM_CHA_ReqPrgBms_Cx1_program_1), 2=Cx2_program_2 (CM_CHA_ReqPrgBms_Cx2_program_2), 3=Cx3_program_3 (CM_CHA_ReqPrgBms_Cx3_program_3), 4=Cx4_program_4 (CM_CHA_ReqPrgBms_Cx4_program_4), 5=Cx5_program_5 (CM_CHA_ReqPrgBms_Cx5_program_5), 6=Cx6_program_6 (CM_CHA_ReqPrgBms_Cx6_program_6), 7=Cx7_program_7 (CM_CHA_ReqPrgBms_Cx7_program_7), 8=Cx8_program_8 (CM_CHA_ReqPrgBms_Cx8_program_8), 9=Cx9_program_9 (CM_CHA_ReqPrgBms_Cx9_program_9), 10=Cxa_program_10 (CM_CHA_ReqPrgBms_Cxa_program_10), 11=Cxb_program_11 (CM_CHA_ReqPrgBms_Cxb_program_11), 12=Cxc_program_12 (CM_CHA_ReqPrgBms_Cxc_program_12), 13=Cxd_program_13 (CM_CHA_ReqPrgBms_Cxd_program_13), 14=Cxe_program_14 (CM_CHA_ReqPrgBms_Cxe_program_14), 15=Cxf_program_15 (CM_CHA_ReqPrgBms_Cxf_program_15)
  compu method CM_NM_SACID_1_NM_aktiv_KL15: 0=Cx0_Inaktiv (CM_NM_SACID_1_NM_aktiv_KL15_Cx0_Inaktiv), 1=Cx1_KL15_EIN (CM_NM_SACID_1_NM_aktiv_KL15_Cx1_KL15_EIN)
  compu method CM_UI2_Spannung1_Schalt_Status: 0=Cx0_offen (CM_UI2_Spannung1_Schalt_Status_Cx0_offen), 1=Cx1_geschlossen (CM_UI2_Spannung1_Schalt_Status_Cx1_geschlossen), 2=Cx2_defekt_geschlossen (CM_UI2_Spannung1_Schalt_Status_Cx2_defekt_geschlossen), 3=Cx3_defekt_offen (CM_UI2_Spannung1_Schalt_Status_Cx3_defekt_offen), 4=Cx4_nicht_schaltbar (CM_UI2_Spannung1_Schalt_Status_Cx4_nicht_schaltbar), 6=Cx6_Init (CM_UI2_Spannung1_Schalt_Status_Cx6_Init), 7=Cx7_Fehler (CM_UI2_Spannung1_Schalt_Status_Cx7_Fehler)
  compu method CM_TME_HV_IstLeistung_EKK: phys=raw*100 for raw 0..125, 126=Cx7e_Init (CM_TME_HV_IstLeistung_EKK_Cx7e_Init), 127=Cx7f_Fehler (CM_TME_HV_IstLeistung_EKK_Cx7f_Fehler); unit Unit_Watt
  compu method CM_OruIntegrityCheckActiveD: 0=Cx0_Init (CM_OruIntegrityCheckActiveD_Cx0_Init), 1=Cx1_Inactive (CM_OruIntegrityCheckActiveD_Cx1_Inactive), 2=Cx2_Active (CM_OruIntegrityCheckActiveD_Cx2_Active), 3=Cx3_Fehler (CM_OruIntegrityCheckActiveD_Cx3_Fehler)
  compu method CM_VehicleProtectedEnvironment_D: 0=Cx0_VPE_none (CM_VehicleProtectedEnvironment_D_Cx0_VPE_none), 1=Cx1_VPE_production (CM_VehicleProtectedEnvironment_D_Cx1_VPE_production), 2=Cx2_VPE_aftersales (CM_VehicleProtectedEnvironment_D_Cx2_VPE_aftersales)
  compu method CM_UI1_KompFehlerModus4_09: 0=Cx0_TNCTOC (CM_UI1_KompFehlerModus4_09_Cx0_TNCTOC), 1=Cx1_TP_TC (CM_UI1_KompFehlerModus4_09_Cx1_TP_TC), 2=Cx2_TP_TC_WCMTL (CM_UI1_KompFehlerModus4_09_Cx2_TP_TC_WCMTL), 3=Cx3_TF_TC_Error_1 (CM_UI1_KompFehlerModus4_09_Cx3_TF_TC_Error_1), 4=Cx4_TF_TC_Error_2 (CM_UI1_KompFehlerModus4_09_Cx4_TF_TC_Error_2), 5=Cx5_TF_TC_Error_3 (CM_UI1_KompFehlerModus4_09_Cx5_TF_TC_Error_3), 6=Cx6_TF_TC_Error_4 (CM_UI1_KompFehlerModus4_09_Cx6_TF_TC_Error_4), 7=Cx7_TF_TC_Error_5 (CM_UI1_KompFehlerModus4_09_Cx7_TF_TC_Error_5)
  compu method CM_NM_SACID_1_NM_aktiv_Tmin: 0=Cx0_Inaktiv (CM_NM_SACID_1_NM_aktiv_Tmin_Cx0_Inaktiv), 1=Cx1_Mindestaktivzeit (CM_NM_SACID_1_NM_aktiv_Tmin_Cx1_Mindestaktivzeit)
  compu method CM_TME_HV_IstLeistung_HVHL: phys=raw*100 for raw 0..125, 126=Cx7e_Init (CM_TME_HV_IstLeistung_HVHL_Cx7e_Init), 127=Cx7f_Fehler (CM_TME_HV_IstLeistung_HVHL_Cx7f_Fehler); unit Unit_Watt
  compu method CM_BMC_TechnischerSOC: phys=raw*0.05 for raw 0..2000, 2046=Cx7fe_Init (CM_BMC_TechnischerSOC_Cx7fe_Init), 2047=Cx7ff_Fehler (CM_BMC_TechnischerSOC_Cx7ff_Fehler); unit Unit_PerCent
  compu method CM_BMC_Max_Ladeleistung: phys=raw*100 for raw 0..8189, 8190=Cx1ffe_Init (CM_BMC_Max_Ladeleistung_Cx1ffe_Init), 8191=Cx1fff_Fehler (CM_BMC_Max_Ladeleistung_Cx1fff_Fehler); unit Unit_Watt
  compu method CM_TME_PTC_stufig_Status: 0=Cx0_Aus (CM_TME_PTC_stufig_Status_Cx0_Aus), 1=Cx1_Stufe_1_aktiv (CM_TME_PTC_stufig_Status_Cx1_Stufe_1_aktiv), 2=Cx2_Stufe_2_aktiv (CM_TME_PTC_stufig_Status_Cx2_Stufe_2_aktiv), 3=Cx3_Stufe_3_aktiv (CM_TME_PTC_stufig_Status_Cx3_Stufe_3_aktiv), 6=Cx6_Init_oder_nicht_verbaut (CM_TME_PTC_stufig_Status_Cx6_Init_oder_nicht_verbaut), 7=Cx7_Fehler (CM_TME_PTC_stufig_Status_Cx7_Fehler)
  compu method CM_NM_aktiv_ConnectVerbund_UseCase1: 0=Cx0_Inaktiv (CM_NM_aktiv_ConnectVerbund_UseCase1_Cx0_Inaktiv), 1=Cx1_Aktiv (CM_NM_aktiv_ConnectVerbund_UseCase1_Cx1_Aktiv)
  compu method CM_CHA_ReqPrgCMM: 0=Cx0_no_program (CM_CHA_ReqPrgCMM_Cx0_no_program), 1=Cx1_program_1 (CM_CHA_ReqPrgCMM_Cx1_program_1), 2=Cx2_program_2 (CM_CHA_ReqPrgCMM_Cx2_program_2), 3=Cx3_program_3 (CM_CHA_ReqPrgCMM_Cx3_program_3), 4=Cx4_program_4 (CM_CHA_ReqPrgCMM_Cx4_program_4), 5=Cx5_program_5 (CM_CHA_ReqPrgCMM_Cx5_program_5), 6=Cx6_program_6 (CM_CHA_ReqPrgCMM_Cx6_program_6), 7=Cx7_program_7 (CM_CHA_ReqPrgCMM_Cx7_program_7), 8=Cx8_program_8 (CM_CHA_ReqPrgCMM_Cx8_program_8), 9=Cx9_program_9 (CM_CHA_ReqPrgCMM_Cx9_program_9), 10=Cxa_program_10 (CM_CHA_ReqPrgCMM_Cxa_program_10), 11=Cxb_program_11 (CM_CHA_ReqPrgCMM_Cxb_program_11), 12=Cxc_program_12 (CM_CHA_ReqPrgCMM_Cxc_program_12), 13=Cxd_program_13 (CM_CHA_ReqPrgCMM_Cxd_program_13), 14=Cxe_program_14 (CM_CHA_ReqPrgCMM_Cxe_program_14), 15=Cxf_program_15 (CM_CHA_ReqPrgCMM_Cxf_program_15)
  compu method CM_BMC_Temperatur: phys=raw*0.125-40 for raw 0..1021, 1022=Cx3fe_Init (CM_BMC_Temperatur_Cx3fe_Init), 1023=Cx3ff_Fehler (CM_BMC_Temperatur_Cx3ff_Fehler); unit Unit_DegreCelsi
  compu method CM_OruReleasePartitionSwitchA: 0=Cx0_Init (CM_OruReleasePartitionSwitchA_Cx0_Init), 1=Cx1_Lock (CM_OruReleasePartitionSwitchA_Cx1_Lock), 2=Cx2_Release (CM_OruReleasePartitionSwitchA_Cx2_Release), 3=Cx3_Fehler (CM_OruReleasePartitionSwitchA_Cx3_Fehler)
  compu method CM_NM_aktiv_ConnectVerbund_UseCase2: 0=Cx0_Inaktiv (CM_NM_aktiv_ConnectVerbund_UseCase2_Cx0_Inaktiv), 1=Cx1_Aktiv (CM_NM_aktiv_ConnectVerbund_UseCase2_Cx1_Aktiv)
  compu method CM_UI1_KompFehlerModus4_10: 0=Cx0_TNCTOC (CM_UI1_KompFehlerModus4_10_Cx0_TNCTOC), 1=Cx1_TP_TC (CM_UI1_KompFehlerModus4_10_Cx1_TP_TC), 2=Cx2_TP_TC_WCMTL (CM_UI1_KompFehlerModus4_10_Cx2_TP_TC_WCMTL), 3=Cx3_TF_TC_Error_1 (CM_UI1_KompFehlerModus4_10_Cx3_TF_TC_Error_1), 4=Cx4_TF_TC_Error_2 (CM_UI1_KompFehlerModus4_10_Cx4_TF_TC_Error_2), 5=Cx5_TF_TC_Error_3 (CM_UI1_KompFehlerModus4_10_Cx5_TF_TC_Error_3), 6=Cx6_TF_TC_Error_4 (CM_UI1_KompFehlerModus4_10_Cx6_TF_TC_Error_4), 7=Cx7_TF_TC_Error_5 (CM_UI1_KompFehlerModus4_10_Cx7_TF_TC_Error_5)
  compu method CM_BMC_Temperatur_hoechste: phys=raw*0.125-40 for raw 0..1021, 1022=Cx3fe_Init (CM_BMC_Temperatur_hoechste_Cx3fe_Init), 1023=Cx3ff_Fehler (CM_BMC_Temperatur_hoechste_Cx3ff_Fehler); unit Unit_DegreCelsi
  compu method CM_BMC_Max_Ladeleistung_02: phys=raw*100 for raw 0..32500, 32766=Cx7ffe_Init (CM_BMC_Max_Ladeleistung_02_Cx7ffe_Init), 32767=Cx7fff_Fehler (CM_BMC_Max_Ladeleistung_02_Cx7fff_Fehler); unit Unit_Watt
  compu method CM_NM_aktiv_ConnectVerbund_UseCase3: 0=Cx0_Inaktiv (CM_NM_aktiv_ConnectVerbund_UseCase3_Cx0_Inaktiv), 1=Cx1_Aktiv (CM_NM_aktiv_ConnectVerbund_UseCase3_Cx1_Aktiv)
  compu method CM_TME_PTC_Verbauinfo: 0=Cx0_kein_PTC (CM_TME_PTC_Verbauinfo_Cx0_kein_PTC), 1=Cx1_600W_geschaltet (CM_TME_PTC_Verbauinfo_Cx1_600W_geschaltet), 2=Cx2_1000W_geschaltet (CM_TME_PTC_Verbauinfo_Cx2_1000W_geschaltet), 3=Cx3_1400W_LIN (CM_TME_PTC_Verbauinfo_Cx3_1400W_LIN)
  compu method CM_CHA_ReqPrgDC: 0=Cx0_no_program (CM_CHA_ReqPrgDC_Cx0_no_program), 1=Cx1_program_1 (CM_CHA_ReqPrgDC_Cx1_program_1), 2=Cx2_program_2 (CM_CHA_ReqPrgDC_Cx2_program_2), 3=Cx3_program_3 (CM_CHA_ReqPrgDC_Cx3_program_3), 4=Cx4_program_4 (CM_CHA_ReqPrgDC_Cx4_program_4), 5=Cx5_program_5 (CM_CHA_ReqPrgDC_Cx5_program_5), 6=Cx6_program_6 (CM_CHA_ReqPrgDC_Cx6_program_6), 7=Cx7_program_7 (CM_CHA_ReqPrgDC_Cx7_program_7), 8=Cx8_program_8 (CM_CHA_ReqPrgDC_Cx8_program_8), 9=Cx9_program_9 (CM_CHA_ReqPrgDC_Cx9_program_9), 10=Cxa_program_10 (CM_CHA_ReqPrgDC_Cxa_program_10), 11=Cxb_program_11 (CM_CHA_ReqPrgDC_Cxb_program_11), 12=Cxc_program_12 (CM_CHA_ReqPrgDC_Cxc_program_12), 13=Cxd_program_13 (CM_CHA_ReqPrgDC_Cxd_program_13), 14=Cxe_program_14 (CM_CHA_ReqPrgDC_Cxe_program_14), 15=Cxf_program_15 (CM_CHA_ReqPrgDC_Cxf_program_15)
  compu method CM_BMC_Temperatur_niedrigste: phys=raw*0.125-40 for raw 0..1021, 1022=Cx3fe_Init (CM_BMC_Temperatur_niedrigste_Cx3fe_Init), 1023=Cx3ff_Fehler (CM_BMC_Temperatur_niedrigste_Cx3ff_Fehler); unit Unit_DegreCelsi
  compu method CM_OruReleasePartitionSwitchD: 0=Cx0_Init (CM_OruReleasePartitionSwitchD_Cx0_Init), 1=Cx1_Lock (CM_OruReleasePartitionSwitchD_Cx1_Lock), 2=Cx2_Release (CM_OruReleasePartitionSwitchD_Cx2_Release), 3=Cx3_Fehler (CM_OruReleasePartitionSwitchD_Cx3_Fehler)
  compu method CM_NM_aktiv_ConnectVerbund_UseCase4: 0=Cx0_Inaktiv (CM_NM_aktiv_ConnectVerbund_UseCase4_Cx0_Inaktiv), 1=Cx1_Aktiv (CM_NM_aktiv_ConnectVerbund_UseCase4_Cx1_Aktiv)
  compu method CM_UI1_KompFehlerModus4_11: 0=Cx0_TNCTOC (CM_UI1_KompFehlerModus4_11_Cx0_TNCTOC), 1=Cx1_TP_TC (CM_UI1_KompFehlerModus4_11_Cx1_TP_TC), 2=Cx2_TP_TC_WCMTL (CM_UI1_KompFehlerModus4_11_Cx2_TP_TC_WCMTL), 3=Cx3_TF_TC_Error_1 (CM_UI1_KompFehlerModus4_11_Cx3_TF_TC_Error_1), 4=Cx4_TF_TC_Error_2 (CM_UI1_KompFehlerModus4_11_Cx4_TF_TC_Error_2), 5=Cx5_TF_TC_Error_3 (CM_UI1_KompFehlerModus4_11_Cx5_TF_TC_Error_3), 6=Cx6_TF_TC_Error_4 (CM_UI1_KompFehlerModus4_11_Cx6_TF_TC_Error_4), 7=Cx7_TF_TC_Error_5 (CM_UI1_KompFehlerModus4_11_Cx7_TF_TC_Error_5)
  compu method CM_TME_Temp_KM_vor_LE: phys=raw*0.75-48 for raw 0..253, 254=Cxfe_Init (CM_TME_Temp_KM_vor_LE_Cxfe_Init), 255=Cxff_Fehler (CM_TME_Temp_KM_vor_LE_Cxff_Fehler); unit Unit_DegreCelsi
  compu method CM_VIN_1: phys=raw for raw 0..255
  compu method CM_TME_HV_IstLeistung_HVHW: phys=raw*100 for raw 0..125, 126=Cx7e_InitWert (CM_TME_HV_IstLeistung_HVHW_Cx7e_InitWert), 127=Cx7f_Fehler (CM_TME_HV_IstLeistung_HVHW_Cx7f_Fehler); unit Unit_Watt
  compu method CM_UI1_KompFehlerModus4_12: 0=Cx0_TNCTOC (CM_UI1_KompFehlerModus4_12_Cx0_TNCTOC), 1=Cx1_TP_TC (CM_UI1_KompFehlerModus4_12_Cx1_TP_TC), 2=Cx2_TP_TC_WCMTL (CM_UI1_KompFehlerModus4_12_Cx2_TP_TC_WCMTL), 3=Cx3_TF_TC_Error_1 (CM_UI1_KompFehlerModus4_12_Cx3_TF_TC_Error_1), 4=Cx4_TF_TC_Error_2 (CM_UI1_KompFehlerModus4_12_Cx4_TF_TC_Error_2), 5=Cx5_TF_TC_Error_3 (CM_UI1_KompFehlerModus4_12_Cx5_TF_TC_Error_3), 6=Cx6_TF_TC_Error_4 (CM_UI1_KompFehlerModus4_12_Cx6_TF_TC_Error_4), 7=Cx7_TF_TC_Error_5 (CM_UI1_KompFehlerModus4_12_Cx7_TF_TC_Error_5)
  compu method CM_UI2_Spannung2: phys=raw*0.0625-1023 for raw 0..32763, 32764=Cx7ffc_nicht_messbar (CM_UI2_Spannung2_Cx7ffc_nicht_messbar), 32765=Cx7ffd_nicht_verfuegbar (CM_UI2_Spannung2_Cx7ffd_nicht_verfuegbar), 32766=Cx7ffe_Init (CM_UI2_Spannung2_Cx7ffe_Init), 32767=Cx7fff_Fehler (CM_UI2_Spannung2_Cx7fff_Fehler); unit Unit_Volt
  compu method CM_VIN_10: phys=raw for raw 0..255
  compu method CM_TME_HV_IstLeistung_Komfort: phys=raw*50 for raw 0..509, 510=Cx1fe_Init (CM_TME_HV_IstLeistung_Komfort_Cx1fe_Init), 511=Cx1ff_Fehler (CM_TME_HV_IstLeistung_Komfort_Cx1ff_Fehler); unit Unit_Watt
  compu method CM_VIN_11: phys=raw for raw 0..255
  compu method CM_TME_HVEM_Abschaltleistung: phys=raw*50 for raw 0..509, 510=Cx1fe_Init (CM_TME_HVEM_Abschaltleistung_Cx1fe_Init), 511=Cx1ff_Fehler (CM_TME_HVEM_Abschaltleistung_Cx1ff_Fehler); unit Unit_Watt
  compu method CM_NM_SACID_1_NM_State: 0=Cx0_Init (CM_NM_SACID_1_NM_State_Cx0_Init), 1=Cx1_NM_RM_aus_BSM (CM_NM_SACID_1_NM_State_Cx1_NM_RM_aus_BSM), 2=Cx2_NM_RM_aus_PBSM (CM_NM_SACID_1_NM_State_Cx2_NM_RM_aus_PBSM), 4=Cx4_NM_NO_aus_RM (CM_NM_SACID_1_NM_State_Cx4_NM_NO_aus_RM), 8=Cx8_NM_NO_aus_RS (CM_NM_SACID_1_NM_State_Cx8_NM_NO_aus_RS), 16=Cx10_reserved (CM_NM_SACID_1_NM_State_Cx10_reserved), 32=Cx20_reserved (CM_NM_SACID_1_NM_State_Cx20_reserved)
  compu method CM_VIN_12: phys=raw for raw 0..255
  compu method CM_TME_HVEM_HV_Anf: 0=Cx0_INIT (CM_TME_HVEM_HV_Anf_Cx0_INIT), 1=Cx1_HV_Netz_nicht_angefordert (CM_TME_HVEM_HV_Anf_Cx1_HV_Netz_nicht_angefordert), 2=Cx2_HV_Netz_angefordert (CM_TME_HVEM_HV_Anf_Cx2_HV_Netz_angefordert), 3=Cx3_Fehler (CM_TME_HVEM_HV_Anf_Cx3_Fehler)
  compu method CM_NM_SACID_1_SNI_10: 283=Cx11b_SACID_1_SNI (CM_NM_SACID_1_SNI_10_Cx11b_SACID_1_SNI)
  compu method CM_VIN_13: phys=raw for raw 0..255
  compu method CM_UI2_Spannung2_Schalt_Status: 0=Cx0_offen (CM_UI2_Spannung2_Schalt_Status_Cx0_offen), 1=Cx1_geschlossen (CM_UI2_Spannung2_Schalt_Status_Cx1_geschlossen), 2=Cx2_defekt_geschlossen (CM_UI2_Spannung2_Schalt_Status_Cx2_defekt_geschlossen), 3=Cx3_defekt_offen (CM_UI2_Spannung2_Schalt_Status_Cx3_defekt_offen), 4=Cx4_nicht_schaltbar (CM_UI2_Spannung2_Schalt_Status_Cx4_nicht_schaltbar), 6=Cx6_Init (CM_UI2_Spannung2_Schalt_Status_Cx6_Init), 7=Cx7_Fehler (CM_UI2_Spannung2_Schalt_Status_Cx7_Fehler)
  compu method CM_TME_HVEM_Minleistung: phys=raw*100 for raw 0..509, 510=Cx1fe_Init (CM_TME_HVEM_Minleistung_Cx1fe_Init), 511=Cx1ff_Fehler (CM_TME_HVEM_Minleistung_Cx1ff_Fehler); unit Unit_Watt
  compu method CM_NM_SACID_1_UDS_CC: 0=Cx0_Inaktiv (CM_NM_SACID_1_UDS_CC_Cx0_Inaktiv), 1=Cx1_CC_aktiv (CM_NM_SACID_1_UDS_CC_Cx1_CC_aktiv)
  compu method CM_UI2_Spannung3: phys=raw*0.0625-1023 for raw 0..32763, 32764=Cx7ffc_nicht_messbar (CM_UI2_Spannung3_Cx7ffc_nicht_messbar), 32765=Cx7ffd_nicht_verfuegbar (CM_UI2_Spannung3_Cx7ffd_nicht_verfuegbar), 32766=Cx7ffe_Init (CM_UI2_Spannung3_Cx7ffe_Init), 32767=Cx7fff_Fehler (CM_UI2_Spannung3_Cx7fff_Fehler); unit Unit_Volt
  compu method CM_NM_SACID_1_Wakeup_V12: 0=Cx0_Peripherie_Wakeup_Ursache_nicht_bekannt (CM_NM_SACID_1_Wakeup_V12_Cx0_Peripherie_Wakeup_Ursache_nicht_bekannt), 1=Cx1_Bus_Wakeup (CM_NM_SACID_1_Wakeup_V12_Cx1_Bus_Wakeup), 2=Cx2_KL15_HW (CM_NM_SACID_1_Wakeup_V12_Cx2_KL15_HW), 4=Cx4_Bedienung_an_Ladedose (CM_NM_SACID_1_Wakeup_V12_Cx4_Bedienung_an_Ladedose), 5=Cx5_Stecker_erkannt (CM_NM_SACID_1_Wakeup_V12_Cx5_Stecker_erkannt), 6=Cx6_SmartCharging_Aktualisierung (CM_NM_SACID_1_Wakeup_V12_Cx6_SmartCharging_Aktualisierung)
  compu method CM_NM_SACID_2_CBV_AWB: 0=Cx0_Passiver_WakeUp (CM_NM_SACID_2_CBV_AWB_Cx0_Passiver_WakeUp), 1=Cx1_Aktiver_WakeUp (CM_NM_SACID_2_CBV_AWB_Cx1_Aktiver_WakeUp)
  compu method CM_UI2_Spannung4: phys=raw*0.0625-1023 for raw 0..32763, 32764=Cx7ffc_nicht_messbar (CM_UI2_Spannung4_Cx7ffc_nicht_messbar), 32765=Cx7ffd_nicht_verfuegbar (CM_UI2_Spannung4_Cx7ffd_nicht_verfuegbar), 32766=Cx7ffe_Init (CM_UI2_Spannung4_Cx7ffe_Init), 32767=Cx7fff_Fehler (CM_UI2_Spannung4_Cx7fff_Fehler); unit Unit_Volt
  compu method CM_CHA_ReqPrgDispSetup: 0=Cx0_init (CM_CHA_ReqPrgDispSetup_Cx0_init), 1=Cx1_layout_comfort (CM_CHA_ReqPrgDispSetup_Cx1_layout_comfort), 2=Cx2_layout_eco (CM_CHA_ReqPrgDispSetup_Cx2_layout_eco), 3=Cx3_layout_sport (CM_CHA_ReqPrgDispSetup_Cx3_layout_sport), 4=Cx4_layout_offroad (CM_CHA_ReqPrgDispSetup_Cx4_layout_offroad), 5=Cx5_layout_sportplus (CM_CHA_ReqPrgDispSetup_Cx5_layout_sportplus), 6=Cx6_program_6 (CM_CHA_ReqPrgDispSetup_Cx6_program_6), 7=Cx7_program_7 (CM_CHA_ReqPrgDispSetup_Cx7_program_7), 8=Cx8_program_8 (CM_CHA_ReqPrgDispSetup_Cx8_program_8), 9=Cx9_program_9 (CM_CHA_ReqPrgDispSetup_Cx9_program_9), 10=Cxa_program_10 (CM_CHA_ReqPrgDispSetup_Cxa_program_10), 11=Cxb_program_11 (CM_CHA_ReqPrgDispSetup_Cxb_program_11), 12=Cxc_program_12 (CM_CHA_ReqPrgDispSetup_Cxc_program_12), 13=Cxd_program_13 (CM_CHA_ReqPrgDispSetup_Cxd_program_13), 14=Cxe_program_14 (CM_CHA_ReqPrgDispSetup_Cxe_program_14), 15=Cxf_program_15 (CM_CHA_ReqPrgDispSetup_Cxf_program_15)
  compu method CM_UI2_Spannung5: phys=raw*0.0625-1023 for raw 0..32763, 32764=Cx7ffc_nicht_messbar (CM_UI2_Spannung5_Cx7ffc_nicht_messbar), 32765=Cx7ffd_nicht_verfuegbar (CM_UI2_Spannung5_Cx7ffd_nicht_verfuegbar), 32766=Cx7ffe_Init (CM_UI2_Spannung5_Cx7ffe_Init), 32767=Cx7fff_Fehler (CM_UI2_Spannung5_Cx7fff_Fehler); unit Unit_Volt
  compu method CM_OruVehicleLockRequestA: 0=Cx0_Init (CM_OruVehicleLockRequestA_Cx0_Init), 1=Cx1_Lock (CM_OruVehicleLockRequestA_Cx1_Lock), 2=Cx2_Release (CM_OruVehicleLockRequestA_Cx2_Release), 3=Cx3_Fehler (CM_OruVehicleLockRequestA_Cx3_Fehler)
  compu method CM_CHA_ReqPrgDt: 0=Cx0_no_program (CM_CHA_ReqPrgDt_Cx0_no_program), 1=Cx1_program_1 (CM_CHA_ReqPrgDt_Cx1_program_1), 2=Cx2_program_2 (CM_CHA_ReqPrgDt_Cx2_program_2), 3=Cx3_program_3 (CM_CHA_ReqPrgDt_Cx3_program_3), 4=Cx4_program_4 (CM_CHA_ReqPrgDt_Cx4_program_4), 5=Cx5_program_5 (CM_CHA_ReqPrgDt_Cx5_program_5), 6=Cx6_program_6 (CM_CHA_ReqPrgDt_Cx6_program_6), 7=Cx7_program_7 (CM_CHA_ReqPrgDt_Cx7_program_7), 8=Cx8_program_8 (CM_CHA_ReqPrgDt_Cx8_program_8), 9=Cx9_program_9 (CM_CHA_ReqPrgDt_Cx9_program_9), 10=Cxa_program_10 (CM_CHA_ReqPrgDt_Cxa_program_10), 11=Cxb_program_11 (CM_CHA_ReqPrgDt_Cxb_program_11), 12=Cxc_program_12 (CM_CHA_ReqPrgDt_Cxc_program_12), 13=Cxd_program_13 (CM_CHA_ReqPrgDt_Cxd_program_13), 14=Cxe_program_14 (CM_CHA_ReqPrgDt_Cxe_program_14), 15=Cxf_program_15 (CM_CHA_ReqPrgDt_Cxf_program_15)
  compu method CM_VIN_14: phys=raw for raw 0..255
  compu method CM_VIN_15: phys=raw for raw 0..255
  compu method CM_CHA_ReqPrgDynTqCtrl: 0=Cx0_no_program (CM_CHA_ReqPrgDynTqCtrl_Cx0_no_program), 1=Cx1_program_1 (CM_CHA_ReqPrgDynTqCtrl_Cx1_program_1), 2=Cx2_program_2 (CM_CHA_ReqPrgDynTqCtrl_Cx2_program_2), 3=Cx3_program_3 (CM_CHA_ReqPrgDynTqCtrl_Cx3_program_3), 4=Cx4_program_4 (CM_CHA_ReqPrgDynTqCtrl_Cx4_program_4), 5=Cx5_program_5 (CM_CHA_ReqPrgDynTqCtrl_Cx5_program_5), 6=Cx6_program_6 (CM_CHA_ReqPrgDynTqCtrl_Cx6_program_6), 7=Cx7_program_7 (CM_CHA_ReqPrgDynTqCtrl_Cx7_program_7), 8=Cx8_program_8 (CM_CHA_ReqPrgDynTqCtrl_Cx8_program_8), 9=Cx9_program_9 (CM_CHA_ReqPrgDynTqCtrl_Cx9_program_9), 10=Cxa_program_10 (CM_CHA_ReqPrgDynTqCtrl_Cxa_program_10), 11=Cxb_program_11 (CM_CHA_ReqPrgDynTqCtrl_Cxb_program_11), 12=Cxc_program_12 (CM_CHA_ReqPrgDynTqCtrl_Cxc_program_12), 13=Cxd_program_13 (CM_CHA_ReqPrgDynTqCtrl_Cxd_program_13), 14=Cxe_program_14 (CM_CHA_ReqPrgDynTqCtrl_Cxe_program_14), 15=Cxf_program_15 (CM_CHA_ReqPrgDynTqCtrl_Cxf_program_15)
  compu method CM_OruVehicleLockRequestD: 0=Cx0_Init (CM_OruVehicleLockRequestD_Cx0_Init), 1=Cx1_Lock (CM_OruVehicleLockRequestD_Cx1_Lock), 2=Cx2_Release (CM_OruVehicleLockRequestD_Cx2_Release), 3=Cx3_Fehler (CM_OruVehicleLockRequestD_Cx3_Fehler)
  compu method CM_VIN_16: phys=raw for raw 0..255
  compu method CM_VIN_17: phys=raw for raw 0..255
  compu method CM_CHA_ReqPrgEps: 0=Cx0_no_program (CM_CHA_ReqPrgEps_Cx0_no_program), 1=Cx1_program_1 (CM_CHA_ReqPrgEps_Cx1_program_1), 2=Cx2_program_2 (CM_CHA_ReqPrgEps_Cx2_program_2), 3=Cx3_program_3 (CM_CHA_ReqPrgEps_Cx3_program_3), 4=Cx4_program_4 (CM_CHA_ReqPrgEps_Cx4_program_4), 5=Cx5_program_5 (CM_CHA_ReqPrgEps_Cx5_program_5), 6=Cx6_program_6 (CM_CHA_ReqPrgEps_Cx6_program_6), 7=Cx7_program_7 (CM_CHA_ReqPrgEps_Cx7_program_7), 8=Cx8_program_8 (CM_CHA_ReqPrgEps_Cx8_program_8), 9=Cx9_program_9 (CM_CHA_ReqPrgEps_Cx9_program_9), 10=Cxa_program_10 (CM_CHA_ReqPrgEps_Cxa_program_10), 11=Cxb_program_11 (CM_CHA_ReqPrgEps_Cxb_program_11), 12=Cxc_program_12 (CM_CHA_ReqPrgEps_Cxc_program_12), 13=Cxd_program_13 (CM_CHA_ReqPrgEps_Cxd_program_13), 14=Cxe_program_14 (CM_CHA_ReqPrgEps_Cxe_program_14), 15=Cxf_program_15 (CM_CHA_ReqPrgEps_Cxf_program_15)
  compu method CM_VIN_2: phys=raw for raw 0..255
  compu method CM_OTAMC_D_01_BZ: phys=raw for raw 0..15
  compu method CM_CHA_ReqPrgEsc: 0=Cx0_no_program (CM_CHA_ReqPrgEsc_Cx0_no_program), 1=Cx1_program_1 (CM_CHA_ReqPrgEsc_Cx1_program_1), 2=Cx2_program_2 (CM_CHA_ReqPrgEsc_Cx2_program_2), 3=Cx3_program_3 (CM_CHA_ReqPrgEsc_Cx3_program_3), 4=Cx4_program_4 (CM_CHA_ReqPrgEsc_Cx4_program_4), 5=Cx5_program_5 (CM_CHA_ReqPrgEsc_Cx5_program_5), 6=Cx6_program_6 (CM_CHA_ReqPrgEsc_Cx6_program_6), 7=Cx7_program_7 (CM_CHA_ReqPrgEsc_Cx7_program_7), 8=Cx8_program_8 (CM_CHA_ReqPrgEsc_Cx8_program_8), 9=Cx9_program_9 (CM_CHA_ReqPrgEsc_Cx9_program_9), 10=Cxa_program_10 (CM_CHA_ReqPrgEsc_Cxa_program_10), 11=Cxb_program_11 (CM_CHA_ReqPrgEsc_Cxb_program_11), 12=Cxc_program_12 (CM_CHA_ReqPrgEsc_Cxc_program_12), 13=Cxd_program_13 (CM_CHA_ReqPrgEsc_Cxd_program_13), 14=Cxe_program_14 (CM_CHA_ReqPrgEsc_Cxe_program_14), 15=Cxf_program_15 (CM_CHA_ReqPrgEsc_Cxf_program_15)
  compu method CM_BMC_Max_Ladestrom: phys=raw*0.2 for raw 0..8189, 8190=Cx1ffe_Init (CM_BMC_Max_Ladestrom_Cx1ffe_Init), 8191=Cx1fff_Fehler (CM_BMC_Max_Ladestrom_Cx1fff_Fehler); unit Unit_Amper
  compu method CM_OTAMC_D_01_CRC: phys=raw for raw 0..255
  compu method CM_OTP_01_BZ: phys=raw for raw 0..15
  compu method CM_TME_HVEM_Rekuleistung: phys=raw*100 for raw 0..509, 510=Cx1fe_Init (CM_TME_HVEM_Rekuleistung_Cx1fe_Init), 511=Cx1ff_Fehler (CM_TME_HVEM_Rekuleistung_Cx1ff_Fehler); unit Unit_Watt
  compu method CM_TME_Temp_nach_Heizregister: phys=raw*0.1-20 for raw 0..1020, 1021=Cx3fd_nicht_verfuegbar (CM_TME_Temp_nach_Heizregister_Cx3fd_nicht_verfuegbar) (nicht_verfügbar), 1022=Cx3fe_InitWert (CM_TME_Temp_nach_Heizregister_Cx3fe_InitWert), 1023=Cx3ff_Fehler (CM_TME_Temp_nach_Heizregister_Cx3ff_Fehler); unit Unit_DegreCelsi
  compu method CM_BMC_Max_Ladestrom_02: phys=raw*0.2 for raw 0..16250, 16382=Cx3ffe_Init (CM_BMC_Max_Ladestrom_02_Cx3ffe_Init), 16383=Cx3fff_Fehler (CM_BMC_Max_Ladestrom_02_Cx3fff_Fehler); unit Unit_Amper
  compu method CM_TME_HVEM_Vorhaltleistung: phys=raw*100 for raw 0..1021, 1022=Cx3fe_Init (CM_TME_HVEM_Vorhaltleistung_Cx3fe_Init), 1023=Cx3ff_Fehler (CM_TME_HVEM_Vorhaltleistung_Cx3ff_Fehler); unit Unit_Watt
  compu method CM_UI2_Spannung6: phys=raw*0.0625-1023 for raw 0..32763, 32764=Cx7ffc_nicht_messbar (CM_UI2_Spannung6_Cx7ffc_nicht_messbar), 32765=Cx7ffd_nicht_verfuegbar (CM_UI2_Spannung6_Cx7ffd_nicht_verfuegbar), 32766=Cx7ffe_Init (CM_UI2_Spannung6_Cx7ffe_Init), 32767=Cx7fff_Fehler (CM_UI2_Spannung6_Cx7fff_Fehler); unit Unit_Volt
  compu method CM_TME_HVEM_Wunschleistung: phys=raw*100 for raw 0..509, 510=Cx1fe_Init (CM_TME_HVEM_Wunschleistung_Cx1fe_Init), 511=Cx1ff_Fehler (CM_TME_HVEM_Wunschleistung_Cx1ff_Fehler); unit Unit_Watt
  compu method CM_NM_SACID_2_CBV_CRI: 0=Cx0_NM_ohne_Clusteranforderungen (CM_NM_SACID_2_CBV_CRI_Cx0_NM_ohne_Clusteranforderungen), 1=Cx1_NM_mit_Clusteranforderungen (CM_NM_SACID_2_CBV_CRI_Cx1_NM_mit_Clusteranforderungen)
  compu method CM_BMC_Max_Spannung: phys=raw for raw 0..1021, 1022=Cx3fe_Init (CM_BMC_Max_Spannung_Cx3fe_Init), 1023=Cx3ff_Fehler (CM_BMC_Max_Spannung_Cx3ff_Fehler); unit Unit_Volt
  compu method CM_VIN_3: phys=raw for raw 0..255
  compu method CM_TME_HVHL_Istmodus: 0=Cx0_Standby (CM_TME_HVHL_Istmodus_Cx0_Standby), 1=Cx1_Regelung_aktiv (CM_TME_HVHL_Istmodus_Cx1_Regelung_aktiv), 2=Cx2_Freigabe_ausgesetzt (CM_TME_HVHL_Istmodus_Cx2_Freigabe_ausgesetzt), 5=Cx5_Fehler (CM_TME_HVHL_Istmodus_Cx5_Fehler), 7=Cx7_Init (CM_TME_HVHL_Istmodus_Cx7_Init)
  compu method CM_NM_SACID_2_FCAB: 0=Cx0_Init (CM_NM_SACID_2_FCAB_Cx0_Init), 1=Cx1_01_CarWakeUp (CM_NM_SACID_2_FCAB_Cx1_01_CarWakeUp), 2=Cx2_02_Basefunction_Powertrain (CM_NM_SACID_2_FCAB_Cx2_02_Basefunction_Powertrain), 4=Cx4_03_Basefunction_Chassis (CM_NM_SACID_2_FCAB_Cx4_03_Basefunction_Chassis), 8=Cx8_04_Basefunction_DrivingAssistance (CM_NM_SACID_2_FCAB_Cx8_04_Basefunction_DrivingAssistance), 16=Cx10_05_Basefunction_Infotainment (CM_NM_SACID_2_FCAB_Cx10_05_Basefunction_Infotainment), 32=Cx20_06_Basefunction_ComfortLight (CM_NM_SACID_2_FCAB_Cx20_06_Basefunction_ComfortLight), 64=Cx40_07_Basefunction_CrossSection (CM_NM_SACID_2_FCAB_Cx40_07_Basefunction_CrossSection), 128=Cx80_08_Basefunction_Connectivity (CM_NM_SACID_2_FCAB_Cx80_08_Basefunction_Connectivity), 256=Cx100_09_Basefunction_DrivingAssistanceCore (CM_NM_SACID_2_FCAB_Cx100_09_Basefunction_DrivingAssistanceCore), 512=Cx200_10_Powertrain (CM_NM_SACID_2_FCAB_Cx200_10_Powertrain), 1024=Cx400_11_Chassis (CM_NM_SACID_2_FCAB_Cx400_11_Chassis), 2048=Cx800_12_GearSelector (CM_NM_SACID_2_FCAB_Cx800_12_GearSelector), 4096=Cx1000_13_Airbag (CM_NM_SACID_2_FCAB_Cx1000_13_Airbag), 8192=Cx2000_14_InfotainmentExtensions (CM_NM_SACID_2_FCAB_Cx2000_14_InfotainmentExtensions), 16384=Cx4000_15_InstrumentclusterDisplay (CM_NM_SACID_2_FCAB_Cx4000_15_InstrumentclusterDisplay), 32768=Cx8000_16_InfotainmentDisplay (CM_NM_SACID_2_FCAB_Cx8000_16_InfotainmentDisplay), 65536=Cx10000_17_Audio (CM_NM_SACID_2_FCAB_Cx10000_17_Audio), 131072=Cx20000_18_VirtualSideMirrors (CM_NM_SACID_2_FCAB_Cx20000_18_VirtualSideMirrors), 262144=Cx40000_19_Doors_Hatches (CM_NM_SACID_2_FCAB_Cx40000_19_Doors_Hatches), 524288=Cx80000_20_OptionalComfort (CM_NM_SACID_2_FCAB_Cx80000_20_OptionalComfort), 1048576=Cx100000_21_AirSuspension (CM_NM_SACID_2_FCAB_Cx100000_21_AirSuspension), 2097152=Cx200000_22_ExteriorLights (CM_NM_SACID_2_FCAB_Cx200000_22_ExteriorLights), 4194304=Cx400000_23_Climate (CM_NM_SACID_2_FCAB_Cx400000_23_Climate), 8388608=Cx800000_24_ThermoManagement (CM_NM_SACID_2_FCAB_Cx800000_24_ThermoManagement), 16777216=Cx1000000_25_AccessSystemSensors (CM_NM_SACID_2_FCAB_Cx1000000_25_AccessSystemSensors), 33554432=Cx2000000_26_HighVoltage_Charging (CM_NM_SACID_2_FCAB_Cx2000000_26_HighVoltage_Charging), 67108864=Cx4000000_27_Timemaster_Timer (CM_NM_SACID_2_FCAB_Cx4000000_27_Timemaster_Timer), 134217728=Cx8000000_28_OnboardTester_DataCollector (CM_NM_SACID_2_FCAB_Cx8000000_28_OnboardTester_DataCollector), 268435456=Cx10000000_29_SteeringColumnLock (CM_NM_SACID_2_FCAB_Cx10000000_29_SteeringColumnLock), 536870912=Cx20000000_30_EnergyManagement (CM_NM_SACID_2_FCAB_Cx20000000_30_EnergyManagement), 1073741824=Cx40000000_31_MultifunctionalSteeringWheel (CM_NM_SACID_2_FCAB_Cx40000000_31_MultifunctionalSteeringWheel), 2147483648=Cx80000000_32_OnlineAccess (CM_NM_SACID_2_FCAB_Cx80000000_32_OnlineAccess), 4294967296=Cx100000000_33_ExternalWirelessCommunication (CM_NM_SACID_2_FCAB_Cx100000000_33_ExternalWirelessCommunication), 8589934592=Cx200000000_34_GPS_Localization (CM_NM_SACID_2_FCAB_Cx200000000_34_GPS_Localization), 17179869184=Cx400000000_35_ExteriorSound (CM_NM_SACID_2_FCAB_Cx400000000_35_ExteriorSound), 34359738368=Cx800000000_36_Preheater (CM_NM_SACID_2_FCAB_Cx800000000_36_Preheater), 68719476736=Cx1000000000_37_HighVoltage_WirelessChargingStation (CM_NM_SACID_2_FCAB_Cx1000000000_37_HighVoltage_WirelessChargingStation), 549755813888=Cx8000000000_40_Diagnosis_Energy (CM_NM_SACID_2_FCAB_Cx8000000000_40_Diagnosis_Energy), 1099511627776=Cx10000000000_41_Diagnosis_Powertrain (CM_NM_SACID_2_FCAB_Cx10000000000_41_Diagnosis_Powertrain), 2199023255552=Cx20000000000_42_Diagnosis_FlexRay (CM_NM_SACID_2_FCAB_Cx20000000000_42_Diagnosis_FlexRay), 4398046511104=Cx40000000000_43_Diagnosis_DrivingAssistance (CM_NM_SACID_2_FCAB_Cx40000000000_43_Diagnosis_DrivingAssistance), 8796093022208=Cx80000000000_44_Diagnosis_Infotainment (CM_NM_SACID_2_FCAB_Cx80000000000_44_Diagnosis_Infotainment), 17592186044416=Cx100000000000_45_Diagnosis_Comfort (CM_NM_SACID_2_FCAB_Cx100000000000_45_Diagnosis_Comfort), 35184372088832=Cx200000000000_46_Diagnosis_Light (CM_NM_SACID_2_FCAB_Cx200000000000_46_Diagnosis_Light), 70368744177664=Cx400000000000_47_Diagnosis_ComfortLINs (CM_NM_SACID_2_FCAB_Cx400000000000_47_Diagnosis_ComfortLINs), 140737488355328=Cx800000000000_48_Diagnosis_ClimateTmeLINs (CM_NM_SACID_2_FCAB_Cx800000000000_48_Diagnosis_ClimateTmeLINs), 281474976710656=Cx1000000000000_49_reserved (CM_NM_SACID_2_FCAB_Cx1000000000000_49_reserved) (49_<reserved>), 4503599627370496=Cx10000000000000_53_Lock_Unlock (CM_NM_SACID_2_FCAB_Cx10000000000000_53_Lock_Unlock), 9007199254740992=Cx20000000000000_54_reserved (CM_NM_SACID_2_FCAB_Cx20000000000000_54_reserved) (54_<reserved>), 18014398509481984=Cx40000000000000_55_Dimming (CM_NM_SACID_2_FCAB_Cx40000000000000_55_Dimming), 36028797018963968=Cx80000000000000_56_ChargingStatus (CM_NM_SACID_2_FCAB_Cx80000000000000_56_ChargingStatus)
  compu method CM_VIN_4: phys=raw for raw 0..255
  compu method CM_TME_Temp_nach_Heizung_Front: phys=raw*0.1-20 for raw 0..1021, 1022=Cx3fe_Init (CM_TME_Temp_nach_Heizung_Front_Cx3fe_Init), 1023=Cx3ff_Fehler (CM_TME_Temp_nach_Heizung_Front_Cx3ff_Fehler); unit Unit_DegreCelsi
