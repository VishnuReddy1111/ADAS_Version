[part 5 of 5: packages /Semantics to /Ivd/DataTypes]
AUTOSAR XML (schema 00048)
package /Semantics  (continued)
  compu method CM_UI1_KompFehlerModus4_13: 0=Cx0_TNCTOC (CM_UI1_KompFehlerModus4_13_Cx0_TNCTOC), 1=Cx1_TP_TC (CM_UI1_KompFehlerModus4_13_Cx1_TP_TC), 2=Cx2_TP_TC_WCMTL (CM_UI1_KompFehlerModus4_13_Cx2_TP_TC_WCMTL), 3=Cx3_TF_TC_Error_1 (CM_UI1_KompFehlerModus4_13_Cx3_TF_TC_Error_1), 4=Cx4_TF_TC_Error_2 (CM_UI1_KompFehlerModus4_13_Cx4_TF_TC_Error_2), 5=Cx5_TF_TC_Error_3 (CM_UI1_KompFehlerModus4_13_Cx5_TF_TC_Error_3), 6=Cx6_TF_TC_Error_4 (CM_UI1_KompFehlerModus4_13_Cx6_TF_TC_Error_4), 7=Cx7_TF_TC_Error_5 (CM_UI1_KompFehlerModus4_13_Cx7_TF_TC_Error_5)
  compu method CM_TME_HVHL_NTC_Warnung: 0=Cx0_keine_Warnung (CM_TME_HVHL_NTC_Warnung_Cx0_keine_Warnung), 1=Cx1_Warnung_aktiv (CM_TME_HVHL_NTC_Warnung_Cx1_Warnung_aktiv)
  compu method CM_BMC_MaxEnergieinhalt: phys=raw*4 for raw 0..65533, 65534=Cxfffe_Init (CM_BMC_MaxEnergieinhalt_Cxfffe_Init), 65535=Cxffff_Fehler (CM_BMC_MaxEnergieinhalt_Cxffff_Fehler); unit Unit_WattHour
  compu method CM_NM_SACID_2_NM_aktiv_Diag: 0=Cx0_Inaktiv (CM_NM_SACID_2_NM_aktiv_Diag_Cx0_Inaktiv), 1=Cx1_Diagnose_aktiv (CM_NM_SACID_2_NM_aktiv_Diag_Cx1_Diagnose_aktiv)
  compu method CM_VIN_5: phys=raw for raw 0..255
  compu method CM_UI2_Status: 0=Cx0_Init (CM_UI2_Status_Cx0_Init), 1=Cx1_Aktiv (CM_UI2_Status_Cx1_Aktiv)
  compu method CM_VIN_6: phys=raw for raw 0..255
  compu method CM_NM_SACID_2_NM_aktiv_KL15: 0=Cx0_Inaktiv (CM_NM_SACID_2_NM_aktiv_KL15_Cx0_Inaktiv), 1=Cx1_KL15_EIN (CM_NM_SACID_2_NM_aktiv_KL15_Cx1_KL15_EIN)
  compu method CM_TME_Temp_nach_HVH_Heizk1_1: phys=raw*0.2-40 for raw 0..1021, 1022=Cx3fe_Init (CM_TME_Temp_nach_HVH_Heizk1_1_Cx3fe_Init), 1023=Cx3ff_Fehler (CM_TME_Temp_nach_HVH_Heizk1_1_Cx3ff_Fehler); unit Unit_DegreCelsi
  compu method CM_VIN_7: phys=raw for raw 0..255
  compu method CM_BMC_Min_Spannung: phys=raw for raw 0..1021, 1022=Cx3fe_Init (CM_BMC_Min_Spannung_Cx3fe_Init), 1023=Cx3ff_Fehler (CM_BMC_Min_Spannung_Cx3ff_Fehler); unit Unit_Volt
  compu method CM_UI1_KompFehlerModus4_14: 0=Cx0_TNCTOC (CM_UI1_KompFehlerModus4_14_Cx0_TNCTOC), 1=Cx1_TP_TC (CM_UI1_KompFehlerModus4_14_Cx1_TP_TC), 2=Cx2_TP_TC_WCMTL (CM_UI1_KompFehlerModus4_14_Cx2_TP_TC_WCMTL), 3=Cx3_TF_TC_Error_1 (CM_UI1_KompFehlerModus4_14_Cx3_TF_TC_Error_1), 4=Cx4_TF_TC_Error_2 (CM_UI1_KompFehlerModus4_14_Cx4_TF_TC_Error_2), 5=Cx5_TF_TC_Error_3 (CM_UI1_KompFehlerModus4_14_Cx5_TF_TC_Error_3), 6=Cx6_TF_TC_Error_4 (CM_UI1_KompFehlerModus4_14_Cx6_TF_TC_Error_4), 7=Cx7_TF_TC_Error_5 (CM_UI1_KompFehlerModus4_14_Cx7_TF_TC_Error_5)
  compu method CM_UI2_Strom: phys=raw*0.005-2621 for raw 0..1048573, 1048574=Cxffffe_Init (CM_UI2_Strom_Cxffffe_Init), 1048575=Cxfffff_Fehler (CM_UI2_Strom_Cxfffff_Fehler); unit Unit_Amper
  compu method CM_OTP_01_CRC: phys=raw for raw 0..255
  compu method CM_NM_SACID_2_NM_aktiv_Tmin: 0=Cx0_Inaktiv (CM_NM_SACID_2_NM_aktiv_Tmin_Cx0_Inaktiv), 1=Cx1_Mindestaktivzeit (CM_NM_SACID_2_NM_aktiv_Tmin_Cx1_Mindestaktivzeit)
  compu method CM_TME_Temp_nach_HVH_Heizk1_2: phys=raw*0.2-40 for raw 0..1021, 1022=Cx3fe_Init (CM_TME_Temp_nach_HVH_Heizk1_2_Cx3fe_Init), 1023=Cx3ff_Fehler (CM_TME_Temp_nach_HVH_Heizk1_2_Cx3ff_Fehler); unit Unit_DegreCelsi
  compu method CM_CHA_ReqPrgExtrLight: 0=Cx0_no_program (CM_CHA_ReqPrgExtrLight_Cx0_no_program), 1=Cx1_program_1 (CM_CHA_ReqPrgExtrLight_Cx1_program_1), 2=Cx2_program_2 (CM_CHA_ReqPrgExtrLight_Cx2_program_2), 3=Cx3_program_3 (CM_CHA_ReqPrgExtrLight_Cx3_program_3), 4=Cx4_program_4 (CM_CHA_ReqPrgExtrLight_Cx4_program_4), 5=Cx5_program_5 (CM_CHA_ReqPrgExtrLight_Cx5_program_5), 6=Cx6_program_6 (CM_CHA_ReqPrgExtrLight_Cx6_program_6), 7=Cx7_program_7 (CM_CHA_ReqPrgExtrLight_Cx7_program_7), 8=Cx8_program_8 (CM_CHA_ReqPrgExtrLight_Cx8_program_8), 9=Cx9_program_9 (CM_CHA_ReqPrgExtrLight_Cx9_program_9), 10=Cxa_program_10 (CM_CHA_ReqPrgExtrLight_Cxa_program_10), 11=Cxb_program_11 (CM_CHA_ReqPrgExtrLight_Cxb_program_11), 12=Cxc_program_12 (CM_CHA_ReqPrgExtrLight_Cxc_program_12), 13=Cxd_program_13 (CM_CHA_ReqPrgExtrLight_Cxd_program_13), 14=Cxe_program_14 (CM_CHA_ReqPrgExtrLight_Cxe_program_14), 15=Cxf_program_15 (CM_CHA_ReqPrgExtrLight_Cxf_program_15)
  compu method CM_UI1_KompFehlerModus4_15: 0=Cx0_TNCTOC (CM_UI1_KompFehlerModus4_15_Cx0_TNCTOC), 1=Cx1_TP_TC (CM_UI1_KompFehlerModus4_15_Cx1_TP_TC), 2=Cx2_TP_TC_WCMTL (CM_UI1_KompFehlerModus4_15_Cx2_TP_TC_WCMTL), 3=Cx3_TF_TC_Error_1 (CM_UI1_KompFehlerModus4_15_Cx3_TF_TC_Error_1), 4=Cx4_TF_TC_Error_2 (CM_UI1_KompFehlerModus4_15_Cx4_TF_TC_Error_2), 5=Cx5_TF_TC_Error_3 (CM_UI1_KompFehlerModus4_15_Cx5_TF_TC_Error_3), 6=Cx6_TF_TC_Error_4 (CM_UI1_KompFehlerModus4_15_Cx6_TF_TC_Error_4), 7=Cx7_TF_TC_Error_5 (CM_UI1_KompFehlerModus4_15_Cx7_TF_TC_Error_5)
  compu method CM_UI2_Stromintegral_Entladen: phys=raw for raw 0..65533, 65534=Cxfffe_Init (CM_UI2_Stromintegral_Entladen_Cxfffe_Init), 65535=Cxffff_Fehler (CM_UI2_Stromintegral_Entladen_Cxffff_Fehler); unit Unit_AmperSecon
  compu method CM_TME_Temp_nach_HVH_Heizk2_1: phys=raw*0.2-40 for raw 0..1021, 1022=Cx3fe_Init (CM_TME_Temp_nach_HVH_Heizk2_1_Cx3fe_Init), 1023=Cx3ff_Fehler (CM_TME_Temp_nach_HVH_Heizk2_1_Cx3ff_Fehler); unit Unit_DegreCelsi
  compu method CM_OTP_Aussen_Temp_FStatus: 0=Cx0_kein_Fehler_Init_nicht_verbaut (CM_OTP_Aussen_Temp_FStatus_Cx0_kein_Fehler_Init_nicht_verbaut) (kein Fehler / Init / nicht verbaut), 1=Cx1_KS_Kurzschluss_nach_minus (CM_OTP_Aussen_Temp_FStatus_Cx1_KS_Kurzschluss_nach_minus) (KS- (Kurzschluss nach minus)), 2=Cx2_KS_Kurzschluss_nach_plus (CM_OTP_Aussen_Temp_FStatus_Cx2_KS_Kurzschluss_nach_plus) (KS+ (Kurzschluss nach plus)), 3=Cx3_OC_Leitungsunterbrechung (CM_OTP_Aussen_Temp_FStatus_Cx3_OC_Leitungsunterbrechung) (OC (Leitungsunterbrechung)), 4=Cx4_OOR_Signal_zu_gross (CM_OTP_Aussen_Temp_FStatus_Cx4_OOR_Signal_zu_gross) (OOR+ (Signal zu gross)), 5=Cx5_OOR_Signal_zu_klein (CM_OTP_Aussen_Temp_FStatus_Cx5_OOR_Signal_zu_klein) (OOR- (Signal zu klein)), 6=Cx6_RC_Signal_unplausibel_zu_gross (CM_OTP_Aussen_Temp_FStatus_Cx6_RC_Signal_unplausibel_zu_gross) (RC+ (Signal unplausibel zu gross)), 7=Cx7_RC_Signal_unplausibel_zu_klein (CM_OTP_Aussen_Temp_FStatus_Cx7_RC_Signal_unplausibel_zu_klein) (RC- (Signal unplausibel zu klein)), 8=Cx8_KS_OC_Kurzschluss_nach_plus_Unterbrechung (CM_OTP_Aussen_Temp_FStatus_Cx8_KS_OC_Kurzschluss_nach_plus_Unterbrechung) (KS+/OC (Kurzschluss nach plus/Unterbrechung)), 9=Cx9_KS_OC_Kurzschluss_nach_minus_Unterbrechung (CM_OTP_Aussen_Temp_FStatus_Cx9_KS_OC_Kurzschluss_nach_minus_Unterbrechung) (KS-/OC (Kurzschluss nach minus/Unterbrechung)), 10=Cxa_KS_KS_Kurzschluss_nach_minus_plus (CM_OTP_Aussen_Temp_FStatus_Cxa_KS_KS_Kurzschluss_nach_minus_plus) (KS-/KS+ (Kurzschluss nach minus/plus)), 11=Cxb_KS_KS_OC_Kurzschluss_nach_minus_plus_Unterbrechung (CM_OTP_Aussen_Temp_FStatus_Cxb_KS_KS_OC_Kurzschluss_nach_minus_plus_Unterbrechung) (KS-/KS+/OC (Kurzschluss nach minus/plus/Unterbrechung)), 12=Cxc_frei (CM_OTP_Aussen_Temp_FStatus_Cxc_frei), 13=Cxd_frei (CM_OTP_Aussen_Temp_FStatus_Cxd_frei), 14=Cxe_frei (CM_OTP_Aussen_Temp_FStatus_Cxe_frei), 15=Cxf_frei (CM_OTP_Aussen_Temp_FStatus_Cxf_frei)
  compu method CM_UI1_KompFehlerModus4_16: 0=Cx0_TNCTOC (CM_UI1_KompFehlerModus4_16_Cx0_TNCTOC), 1=Cx1_TP_TC (CM_UI1_KompFehlerModus4_16_Cx1_TP_TC), 2=Cx2_TP_TC_WCMTL (CM_UI1_KompFehlerModus4_16_Cx2_TP_TC_WCMTL), 3=Cx3_TF_TC_Error_1 (CM_UI1_KompFehlerModus4_16_Cx3_TF_TC_Error_1), 4=Cx4_TF_TC_Error_2 (CM_UI1_KompFehlerModus4_16_Cx4_TF_TC_Error_2), 5=Cx5_TF_TC_Error_3 (CM_UI1_KompFehlerModus4_16_Cx5_TF_TC_Error_3), 6=Cx6_TF_TC_Error_4 (CM_UI1_KompFehlerModus4_16_Cx6_TF_TC_Error_4), 7=Cx7_TF_TC_Error_5 (CM_UI1_KompFehlerModus4_16_Cx7_TF_TC_Error_5)
  compu method CM_UI2_Stromintegral_Laden: phys=raw for raw 0..65533, 65534=Cxfffe_Init (CM_UI2_Stromintegral_Laden_Cxfffe_Init), 65535=Cxffff_Fehler (CM_UI2_Stromintegral_Laden_Cxffff_Fehler); unit Unit_AmperSecon
  compu method CM_CHA_ReqPrgExtrSound: 0=Cx0_no_program (CM_CHA_ReqPrgExtrSound_Cx0_no_program), 1=Cx1_program_1 (CM_CHA_ReqPrgExtrSound_Cx1_program_1), 2=Cx2_program_2 (CM_CHA_ReqPrgExtrSound_Cx2_program_2), 3=Cx3_program_3 (CM_CHA_ReqPrgExtrSound_Cx3_program_3), 4=Cx4_program_4 (CM_CHA_ReqPrgExtrSound_Cx4_program_4), 5=Cx5_program_5 (CM_CHA_ReqPrgExtrSound_Cx5_program_5), 6=Cx6_program_6 (CM_CHA_ReqPrgExtrSound_Cx6_program_6), 7=Cx7_program_7 (CM_CHA_ReqPrgExtrSound_Cx7_program_7), 8=Cx8_program_8 (CM_CHA_ReqPrgExtrSound_Cx8_program_8), 9=Cx9_program_9 (CM_CHA_ReqPrgExtrSound_Cx9_program_9), 10=Cxa_program_10 (CM_CHA_ReqPrgExtrSound_Cxa_program_10), 11=Cxb_program_11 (CM_CHA_ReqPrgExtrSound_Cxb_program_11), 12=Cxc_program_12 (CM_CHA_ReqPrgExtrSound_Cxc_program_12), 13=Cxd_program_13 (CM_CHA_ReqPrgExtrSound_Cxd_program_13), 14=Cxe_program_14 (CM_CHA_ReqPrgExtrSound_Cxe_program_14), 15=Cxf_program_15 (CM_CHA_ReqPrgExtrSound_Cxf_program_15)
  compu method CM_TME_HVHL_Verbauinfo: 0=Cx0_InitWert (CM_TME_HVHL_Verbauinfo_Cx0_InitWert), 1=Cx1_nicht_verbaut (CM_TME_HVHL_Verbauinfo_Cx1_nicht_verbaut), 2=Cx2_verbaut (CM_TME_HVHL_Verbauinfo_Cx2_verbaut)
  compu method CM_VIN_8: phys=raw for raw 0..255
  compu method CM_NM_SACID_2_NM_State: 0=Cx0_Init (CM_NM_SACID_2_NM_State_Cx0_Init), 1=Cx1_NM_RM_aus_BSM (CM_NM_SACID_2_NM_State_Cx1_NM_RM_aus_BSM), 2=Cx2_NM_RM_aus_PBSM (CM_NM_SACID_2_NM_State_Cx2_NM_RM_aus_PBSM), 4=Cx4_NM_NO_aus_RM (CM_NM_SACID_2_NM_State_Cx4_NM_NO_aus_RM), 8=Cx8_NM_NO_aus_RS (CM_NM_SACID_2_NM_State_Cx8_NM_NO_aus_RS), 16=Cx10_reserved (CM_NM_SACID_2_NM_State_Cx10_reserved), 32=Cx20_reserved (CM_NM_SACID_2_NM_State_Cx20_reserved)
  compu method CM_VIN_9: phys=raw for raw 0..255
  compu method CM_OTP_Aussen_Temp_gef: phys=raw*0.5-50 for raw 0..250, 253=Cxfd_nicht_verbaut (CM_OTP_Aussen_Temp_gef_Cxfd_nicht_verbaut), 254=Cxfe_Init (CM_OTP_Aussen_Temp_gef_Cxfe_Init), 255=Cxff_Fehler (CM_OTP_Aussen_Temp_gef_Cxff_Fehler); unit Unit_DegreCelsi
  compu method CM_TME_HVHL_verfuegbar: 0=Cx0_nicht_verfuegbar (CM_TME_HVHL_verfuegbar_Cx0_nicht_verfuegbar), 1=Cx1_verfuegbar (CM_TME_HVHL_verfuegbar_Cx1_verfuegbar)
  compu method CM_UI1_Spannung1: phys=raw*0.0625-1023 for raw 0..32763, 32764=Cx7ffc_nicht_messbar (CM_UI1_Spannung1_Cx7ffc_nicht_messbar), 32765=Cx7ffd_nicht_verfuegbar (CM_UI1_Spannung1_Cx7ffd_nicht_verfuegbar), 32766=Cx7ffe_Init (CM_UI1_Spannung1_Cx7ffe_Init), 32767=Cx7fff_Fehler (CM_UI1_Spannung1_Cx7fff_Fehler); unit Unit_Volt
  compu method CM_Waermepumpe_Status: 0=Cx0_nicht_aktiv (CM_Waermepumpe_Status_Cx0_nicht_aktiv), 1=Cx1_aktiv (CM_Waermepumpe_Status_Cx1_aktiv), 3=Cx3_nicht_verfuegbar (CM_Waermepumpe_Status_Cx3_nicht_verfuegbar)
  compu method CM_CHA_ReqPrgHdc: 0=Cx0_no_program (CM_CHA_ReqPrgHdc_Cx0_no_program), 1=Cx1_program_1 (CM_CHA_ReqPrgHdc_Cx1_program_1), 2=Cx2_program_2 (CM_CHA_ReqPrgHdc_Cx2_program_2), 3=Cx3_program_3 (CM_CHA_ReqPrgHdc_Cx3_program_3), 4=Cx4_program_4 (CM_CHA_ReqPrgHdc_Cx4_program_4), 5=Cx5_program_5 (CM_CHA_ReqPrgHdc_Cx5_program_5), 6=Cx6_program_6 (CM_CHA_ReqPrgHdc_Cx6_program_6), 7=Cx7_program_7 (CM_CHA_ReqPrgHdc_Cx7_program_7), 8=Cx8_program_8 (CM_CHA_ReqPrgHdc_Cx8_program_8), 9=Cx9_program_9 (CM_CHA_ReqPrgHdc_Cx9_program_9), 10=Cxa_program_10 (CM_CHA_ReqPrgHdc_Cxa_program_10), 11=Cxb_program_11 (CM_CHA_ReqPrgHdc_Cxb_program_11), 12=Cxc_program_12 (CM_CHA_ReqPrgHdc_Cxc_program_12), 13=Cxd_program_13 (CM_CHA_ReqPrgHdc_Cxd_program_13), 14=Cxe_program_14 (CM_CHA_ReqPrgHdc_Cxe_program_14), 15=Cxf_program_15 (CM_CHA_ReqPrgHdc_Cxf_program_15)
  compu method CM_NM_SACID_2_SNI_10: 284=Cx11c_SACID_2_SNI (CM_NM_SACID_2_SNI_10_Cx11c_SACID_2_SNI)
  compu method CM_TME_HVHW_Ansteuerung_Soll: phys=raw for raw 0..100, 254=Cxfe_Init (CM_TME_HVHW_Ansteuerung_Soll_Cxfe_Init), 255=Cxff_Fehler (CM_TME_HVHW_Ansteuerung_Soll_Cxff_Fehler); unit Unit_PerCent
  compu method CM_WFS_02_BZ: phys=raw for raw 0..15
  compu method CM_BMC_MinDyn_Entladespannung: phys=raw for raw 0..1021, 1022=Cx3fe_Init (CM_BMC_MinDyn_Entladespannung_Cx3fe_Init), 1023=Cx3ff_Fehler (CM_BMC_MinDyn_Entladespannung_Cx3ff_Fehler); unit Unit_None
  compu method CM_OTP_Aussen_Temp_OBD: 0=Cx0_gueltiger_Wert (CM_OTP_Aussen_Temp_OBD_Cx0_gueltiger_Wert), 1=Cx1_Ersatz_Init_oder_Fehlerwert (CM_OTP_Aussen_Temp_OBD_Cx1_Ersatz_Init_oder_Fehlerwert)
  compu method CM_NM_SACID_2_UDS_CC: 0=Cx0_Inaktiv (CM_NM_SACID_2_UDS_CC_Cx0_Inaktiv), 1=Cx1_CC_aktiv (CM_NM_SACID_2_UDS_CC_Cx1_CC_aktiv)
  compu method CM_TME_HVHW_HVK_EoHVL_Status: 0=Cx0_Init (CM_TME_HVHW_HVK_EoHVL_Status_Cx0_Init), 1=Cx1_Uzwkr_kleiner_UEoHVL_Schwell (CM_TME_HVHW_HVK_EoHVL_Status_Cx1_Uzwkr_kleiner_UEoHVL_Schwell), 2=Cx2_Uzwkr_groesgleich_UEoHVL_Schwell (CM_TME_HVHW_HVK_EoHVL_Status_Cx2_Uzwkr_groesgleich_UEoHVL_Schwell), 3=Cx3_Fehler (CM_TME_HVHW_HVK_EoHVL_Status_Cx3_Fehler)
  compu method CM_WFS_02_CRC: phys=raw for raw 0..255
  compu method CM_CHA_ReqPrgHdUpDisp: 0=Cx0_no_program (CM_CHA_ReqPrgHdUpDisp_Cx0_no_program), 1=Cx1_program_1 (CM_CHA_ReqPrgHdUpDisp_Cx1_program_1), 2=Cx2_program_2 (CM_CHA_ReqPrgHdUpDisp_Cx2_program_2), 3=Cx3_program_3 (CM_CHA_ReqPrgHdUpDisp_Cx3_program_3), 4=Cx4_program_4 (CM_CHA_ReqPrgHdUpDisp_Cx4_program_4), 5=Cx5_program_5 (CM_CHA_ReqPrgHdUpDisp_Cx5_program_5), 6=Cx6_program_6 (CM_CHA_ReqPrgHdUpDisp_Cx6_program_6), 7=Cx7_program_7 (CM_CHA_ReqPrgHdUpDisp_Cx7_program_7), 8=Cx8_program_8 (CM_CHA_ReqPrgHdUpDisp_Cx8_program_8), 9=Cx9_program_9 (CM_CHA_ReqPrgHdUpDisp_Cx9_program_9), 10=Cxa_program_10 (CM_CHA_ReqPrgHdUpDisp_Cxa_program_10), 11=Cxb_program_11 (CM_CHA_ReqPrgHdUpDisp_Cxb_program_11), 12=Cxc_program_12 (CM_CHA_ReqPrgHdUpDisp_Cxc_program_12), 13=Cxd_program_13 (CM_CHA_ReqPrgHdUpDisp_Cxd_program_13), 14=Cxe_program_14 (CM_CHA_ReqPrgHdUpDisp_Cxe_program_14), 15=Cxf_program_15 (CM_CHA_ReqPrgHdUpDisp_Cxf_program_15)
  compu method CM_NM_SACID_2_Wakeup_V12: 0=Cx0_Peripherie_Wakeup_Ursache_nicht_bekannt (CM_NM_SACID_2_Wakeup_V12_Cx0_Peripherie_Wakeup_Ursache_nicht_bekannt), 1=Cx1_Bus_Wakeup (CM_NM_SACID_2_Wakeup_V12_Cx1_Bus_Wakeup), 2=Cx2_KL15_HW (CM_NM_SACID_2_Wakeup_V12_Cx2_KL15_HW), 4=Cx4_Bedienung_an_Ladedose (CM_NM_SACID_2_Wakeup_V12_Cx4_Bedienung_an_Ladedose), 5=Cx5_Stecker_erkannt (CM_NM_SACID_2_Wakeup_V12_Cx5_Stecker_erkannt)
  compu method CM_TME_HVHW_HVK_Fehler_AE: 0=Cx0_kein_Fehler_AE (CM_TME_HVHW_HVK_Fehler_AE_Cx0_kein_Fehler_AE), 1=Cx1_Fehler (CM_TME_HVHW_HVK_Fehler_AE_Cx1_Fehler), 2=Cx2_Init (CM_TME_HVHW_HVK_Fehler_AE_Cx2_Init)
  compu method CM_OTP_Aussen_Temp_ungef: phys=raw*0.5-50 for raw 0..252, 253=Cxfd_nicht_verbaut (CM_OTP_Aussen_Temp_ungef_Cxfd_nicht_verbaut), 254=Cxfe_Initwert (CM_OTP_Aussen_Temp_ungef_Cxfe_Initwert), 255=Cxff_Fehler (CM_OTP_Aussen_Temp_ungef_Cxff_Fehler); unit Unit_DegreCelsi
  compu method CM_NVEM3_Absch_SCR: 0=Cx0_Init (CM_NVEM3_Absch_SCR_Cx0_Init), 1=Cx1_Abschaltung_SCR (CM_NVEM3_Absch_SCR_Cx1_Abschaltung_SCR)
  compu method CM_TME_Temp_nach_HVH_Heizk2_2: phys=raw*0.2-40 for raw 0..1021, 1022=Cx3fe_Init (CM_TME_Temp_nach_HVH_Heizk2_2_Cx3fe_Init), 1023=Cx3ff_Fehler (CM_TME_Temp_nach_HVH_Heizk2_2_Cx3ff_Fehler); unit Unit_DegreCelsi
  compu method CM_CHA_ReqPrgHsp: 0=Cx0_no_program (CM_CHA_ReqPrgHsp_Cx0_no_program), 1=Cx1_program_1 (CM_CHA_ReqPrgHsp_Cx1_program_1), 2=Cx2_program_2 (CM_CHA_ReqPrgHsp_Cx2_program_2), 3=Cx3_program_3 (CM_CHA_ReqPrgHsp_Cx3_program_3), 4=Cx4_program_4 (CM_CHA_ReqPrgHsp_Cx4_program_4), 5=Cx5_program_5 (CM_CHA_ReqPrgHsp_Cx5_program_5), 6=Cx6_program_6 (CM_CHA_ReqPrgHsp_Cx6_program_6), 7=Cx7_program_7 (CM_CHA_ReqPrgHsp_Cx7_program_7), 8=Cx8_program_8 (CM_CHA_ReqPrgHsp_Cx8_program_8), 9=Cx9_program_9 (CM_CHA_ReqPrgHsp_Cx9_program_9), 10=Cxa_program_10 (CM_CHA_ReqPrgHsp_Cxa_program_10), 11=Cxb_program_11 (CM_CHA_ReqPrgHsp_Cxb_program_11), 12=Cxc_program_12 (CM_CHA_ReqPrgHsp_Cxc_program_12), 13=Cxd_program_13 (CM_CHA_ReqPrgHsp_Cxd_program_13), 14=Cxe_program_14 (CM_CHA_ReqPrgHsp_Cxe_program_14), 15=Cxf_program_15 (CM_CHA_ReqPrgHsp_Cxf_program_15)
  compu method CM_BMC_MinDyn_Ladespannung: phys=raw for raw 0..1021, 1022=Cx3fe_Init (CM_BMC_MinDyn_Ladespannung_Cx3fe_Init), 1023=Cx3ff_Fehler (CM_BMC_MinDyn_Ladespannung_Cx3ff_Fehler); unit Unit_Volt
  compu method CM_UI2_Temperatur_1: phys=raw-40 for raw 0..252, 253=Cxfd_nicht_vorhanden (CM_UI2_Temperatur_1_Cxfd_nicht_vorhanden), 254=Cxfe_Init (CM_UI2_Temperatur_1_Cxfe_Init), 255=Cxff_Fehler (CM_UI2_Temperatur_1_Cxff_Fehler); unit Unit_DegreCelsi
  compu method CM_BMC_MMTR_Status: 0=Cx0_Nicht_verfuegbar (CM_BMC_MMTR_Status_Cx0_Nicht_verfuegbar), 1=Cx1_Inaktiv (CM_BMC_MMTR_Status_Cx1_Inaktiv), 2=Cx2_Aktiv_Vorkonditionierung (CM_BMC_MMTR_Status_Cx2_Aktiv_Vorkonditionierung), 3=Cx3_Aktiv_TrackSession (CM_BMC_MMTR_Status_Cx3_Aktiv_TrackSession), 4=Cx4_Nicht_verfuegbar_Lebensdauertimer (CM_BMC_MMTR_Status_Cx4_Nicht_verfuegbar_Lebensdauertimer), 5=Cx5_Abgeschlossen_Vorkonditionierung (CM_BMC_MMTR_Status_Cx5_Abgeschlossen_Vorkonditionierung), 6=Cx6_Aktiv_Rueckkehrstrategie (CM_BMC_MMTR_Status_Cx6_Aktiv_Rueckkehrstrategie), 14=Cxe_Init (CM_BMC_MMTR_Status_Cxe_Init), 15=Cxf_Fehler (CM_BMC_MMTR_Status_Cxf_Fehler)
  compu method CM_TME_Temp_nach_HVH_Heizk3_1: phys=raw*0.2-40 for raw 0..1021, 1022=Cx3fe_Init (CM_TME_Temp_nach_HVH_Heizk3_1_Cx3fe_Init), 1023=Cx3ff_Fehler (CM_TME_Temp_nach_HVH_Heizk3_1_Cx3ff_Fehler); unit Unit_DegreCelsi
  compu method CM_UI2_Temperatur_2: phys=raw-40 for raw 0..252, 253=Cxfd_nicht_vorhanden (CM_UI2_Temperatur_2_Cxfd_nicht_vorhanden), 254=Cxfe_Init (CM_UI2_Temperatur_2_Cxfe_Init), 255=Cxff_Fehler (CM_UI2_Temperatur_2_Cxff_Fehler); unit Unit_DegreCelsi
  compu method CM_BMC_Modus: 0=Cx0_HV_inaktiv (CM_BMC_Modus_Cx0_HV_inaktiv), 1=Cx1_HV_aktiv (CM_BMC_Modus_Cx1_HV_aktiv), 4=Cx4_AC_Laden (CM_BMC_Modus_Cx4_AC_Laden), 5=Cx5_Error_Batt (CM_BMC_Modus_Cx5_Error_Batt), 6=Cx6_DC_Laden (CM_BMC_Modus_Cx6_DC_Laden), 15=Cxf_Init (CM_BMC_Modus_Cxf_Init)
  compu method CM_TME_Temp_nach_HVH_Heizk3_2: phys=raw*0.2-40 for raw 0..1021, 1022=Cx3fe_Init (CM_TME_Temp_nach_HVH_Heizk3_2_Cx3fe_Init), 1023=Cx3ff_Fehler (CM_TME_Temp_nach_HVH_Heizk3_2_Cx3ff_Fehler); unit Unit_DegreCelsi
  compu method CM_WFS_Betrieb_Lesespule: 0=Cx0_keine_Schluesselkomm_Lesespule (CM_WFS_Betrieb_Lesespule_Cx0_keine_Schluesselkomm_Lesespule), 1=Cx1_Schluesselkomm_Lesespule (CM_WFS_Betrieb_Lesespule_Cx1_Schluesselkomm_Lesespule)
  compu method CM_UI1_Spannung1_Schalt_Status: 0=Cx0_offen (CM_UI1_Spannung1_Schalt_Status_Cx0_offen), 1=Cx1_geschlossen (CM_UI1_Spannung1_Schalt_Status_Cx1_geschlossen), 2=Cx2_defekt_geschlossen (CM_UI1_Spannung1_Schalt_Status_Cx2_defekt_geschlossen), 3=Cx3_defekt_offen (CM_UI1_Spannung1_Schalt_Status_Cx3_defekt_offen), 4=Cx4_nicht_schaltbar (CM_UI1_Spannung1_Schalt_Status_Cx4_nicht_schaltbar), 6=Cx6_Init (CM_UI1_Spannung1_Schalt_Status_Cx6_Init), 7=Cx7_Fehler (CM_UI1_Spannung1_Schalt_Status_Cx7_Fehler)
  compu method CM_UI2Sens01_CALID_Index_01: phys=raw for raw 0..255
  compu method CM_BMC_NutzbareKapazitaet: phys=raw*0.125 for raw 0..4093, 4094=Cxffe_Init (CM_BMC_NutzbareKapazitaet_Cxffe_Init), 4095=Cxfff_Fehler (CM_BMC_NutzbareKapazitaet_Cxfff_Fehler); unit Unit_AmperHour
  compu method CM_WFS_ELV_authorisiert: 0=Cx0_ELV_nicht_authorisiert (CM_WFS_ELV_authorisiert_Cx0_ELV_nicht_authorisiert), 1=Cx1_ELV_authorisiert (CM_WFS_ELV_authorisiert_Cx1_ELV_authorisiert)
  compu method CM_NVEM_12_BZ: phys=raw for raw 0..15
  compu method CM_TME_Temp_nach_HVH_Heizk4_1: phys=raw*0.2-40 for raw 0..1021, 1022=Cx3fe_Init (CM_TME_Temp_nach_HVH_Heizk4_1_Cx3fe_Init), 1023=Cx3ff_Fehler (CM_TME_Temp_nach_HVH_Heizk4_1_Cx3ff_Fehler); unit Unit_DegreCelsi
  compu method CM_TME_HVHW_HVK_Fehler_HVIL: 0=Cx0_HVIL_geschlossen (CM_TME_HVHW_HVK_Fehler_HVIL_Cx0_HVIL_geschlossen), 1=Cx1_HVIL_offen (CM_TME_HVHW_HVK_Fehler_HVIL_Cx1_HVIL_offen), 2=Cx2_Fehler (CM_TME_HVHW_HVK_Fehler_HVIL_Cx2_Fehler), 3=Cx3_Init (CM_TME_HVHW_HVK_Fehler_HVIL_Cx3_Init)
  compu method CM_WFS_Fahrerhinweise: 0=Cx0_Keine_Anzeigeanforderung (CM_WFS_Fahrerhinweise_Cx0_Keine_Anzeigeanforderung), 1=Cx1_Schuessel_Auth_niO (CM_WFS_Fahrerhinweise_Cx1_Schuessel_Auth_niO), 2=Cx2_Notlauf_aktiv (CM_WFS_Fahrerhinweise_Cx2_Notlauf_aktiv), 3=Cx3_Schluessel_Kessy_nicht_gefunden (CM_WFS_Fahrerhinweise_Cx3_Schluessel_Kessy_nicht_gefunden)
  compu method CM_NVEM_12_CRC: phys=raw for raw 0..255
  compu method CM_UI2Sens01_CALID_Index_02: phys=raw for raw 0..255
  compu method CM_WFS_ID_Geb_autorisiert: 0=Cx0_Schluessel_nicht_authorisiert (CM_WFS_ID_Geb_autorisiert_Cx0_Schluessel_nicht_authorisiert), 1=Cx1_Schluessel_authorisiert (CM_WFS_ID_Geb_autorisiert_Cx1_Schluessel_authorisiert)
  compu method CM_TME_HVHW_HVK_Fehler_intern: 0=Cx0_kein_Fehler (CM_TME_HVHW_HVK_Fehler_intern_Cx0_kein_Fehler), 1=Cx1_Fehler_aktiv (CM_TME_HVHW_HVK_Fehler_intern_Cx1_Fehler_aktiv)
  compu method CM_PCM_BMC_VTD_Freeze_Req: 0=Cx0_NoResetResponse (CM_PCM_BMC_VTD_Freeze_Req_Cx0_NoResetResponse), 1=Cx1_ResetResponse (CM_PCM_BMC_VTD_Freeze_Req_Cx1_ResetResponse), 2=Cx2_Init (CM_PCM_BMC_VTD_Freeze_Req_Cx2_Init), 3=Cx3_Fehler (CM_PCM_BMC_VTD_Freeze_Req_Cx3_Fehler)
  compu method CM_UI1_Spannung2: phys=raw*0.0625-1023 for raw 0..32763, 32764=Cx7ffc_nicht_messbar (CM_UI1_Spannung2_Cx7ffc_nicht_messbar), 32765=Cx7ffd_nicht_verfuegbar (CM_UI1_Spannung2_Cx7ffd_nicht_verfuegbar), 32766=Cx7ffe_Init (CM_UI1_Spannung2_Cx7ffe_Init), 32767=Cx7fff_Fehler (CM_UI1_Spannung2_Cx7fff_Fehler); unit Unit_Volt
  compu method CM_NVEM_Abschaltstufe: 0=Cx0_Stufe_0_keine_Einschraenkung (CM_NVEM_Abschaltstufe_Cx0_Stufe_0_keine_Einschraenkung), 1=Cx1_Stufe_1 (CM_NVEM_Abschaltstufe_Cx1_Stufe_1), 2=Cx2_Stufe_2 (CM_NVEM_Abschaltstufe_Cx2_Stufe_2), 3=Cx3_Stufe_3 (CM_NVEM_Abschaltstufe_Cx3_Stufe_3)
  compu method CM_WFS_ID_Geb_autorisiert_in_Kl15: 0=Cx0_nicht_authorisiert_in_Kl15 (CM_WFS_ID_Geb_autorisiert_in_Kl15_Cx0_nicht_authorisiert_in_Kl15), 1=Cx1_authorisiert_in_Kl15 (CM_WFS_ID_Geb_autorisiert_in_Kl15_Cx1_authorisiert_in_Kl15)
  compu method CM_TME_Temp_nach_HVH_Heizk4_2: phys=raw*0.2-40 for raw 0..1021, 1022=Cx3fe_Init (CM_TME_Temp_nach_HVH_Heizk4_2_Cx3fe_Init), 1023=Cx3ff_Fehler (CM_TME_Temp_nach_HVH_Heizk4_2_Cx3ff_Fehler); unit Unit_DegreCelsi
  compu method CM_CHA_ReqPrgIntrLight: 0=Cx0_no_program (CM_CHA_ReqPrgIntrLight_Cx0_no_program), 1=Cx1_program_1 (CM_CHA_ReqPrgIntrLight_Cx1_program_1), 2=Cx2_program_2 (CM_CHA_ReqPrgIntrLight_Cx2_program_2), 3=Cx3_program_3 (CM_CHA_ReqPrgIntrLight_Cx3_program_3), 4=Cx4_program_4 (CM_CHA_ReqPrgIntrLight_Cx4_program_4), 5=Cx5_program_5 (CM_CHA_ReqPrgIntrLight_Cx5_program_5), 6=Cx6_program_6 (CM_CHA_ReqPrgIntrLight_Cx6_program_6), 7=Cx7_program_7 (CM_CHA_ReqPrgIntrLight_Cx7_program_7), 8=Cx8_program_8 (CM_CHA_ReqPrgIntrLight_Cx8_program_8), 9=Cx9_program_9 (CM_CHA_ReqPrgIntrLight_Cx9_program_9), 10=Cxa_program_10 (CM_CHA_ReqPrgIntrLight_Cxa_program_10), 11=Cxb_program_11 (CM_CHA_ReqPrgIntrLight_Cxb_program_11), 12=Cxc_program_12 (CM_CHA_ReqPrgIntrLight_Cxc_program_12), 13=Cxd_program_13 (CM_CHA_ReqPrgIntrLight_Cxd_program_13), 14=Cxe_program_14 (CM_CHA_ReqPrgIntrLight_Cxe_program_14), 15=Cxf_program_15 (CM_CHA_ReqPrgIntrLight_Cxf_program_15)
  compu method CM_TME_HVHW_HVK_IstModus: 0=Cx0_Standby (CM_TME_HVHW_HVK_IstModus_Cx0_Standby), 1=Cx1_Regelung_aktiv (CM_TME_HVHW_HVK_IstModus_Cx1_Regelung_aktiv), 2=Cx2_Freigabe_ausgesetzt (CM_TME_HVHW_HVK_IstModus_Cx2_Freigabe_ausgesetzt), 5=Cx5_Fehler (CM_TME_HVHW_HVK_IstModus_Cx5_Fehler), 7=Cx7_Init (CM_TME_HVHW_HVK_IstModus_Cx7_Init)
  compu method CM_UI2Sens01_CALID_Index_03: phys=raw for raw 0..255
  compu method CM_NVEM_Bordnetz_Information: 0=Cx0_keine_Anzeige (CM_NVEM_Bordnetz_Information_Cx0_keine_Anzeige), 1=Cx1_NV_Batterie_iO (CM_NVEM_Bordnetz_Information_Cx1_NV_Batterie_iO), 2=Cx2_NV_Batterie_laden (CM_NVEM_Bordnetz_Information_Cx2_NV_Batterie_laden), 3=Cx3_NV_Batterie_pruefen (CM_NVEM_Bordnetz_Information_Cx3_NV_Batterie_pruefen), 4=Cx4_NV_Batterie_schwach (CM_NVEM_Bordnetz_Information_Cx4_NV_Batterie_schwach), 5=Cx5_NV_Batterie_Ab (CM_NVEM_Bordnetz_Information_Cx5_NV_Batterie_Ab), 6=Cx6_NV_Batterie_Service (CM_NVEM_Bordnetz_Information_Cx6_NV_Batterie_Service), 7=Cx7_NV_Energiesystem_unplausibel (CM_NVEM_Bordnetz_Information_Cx7_NV_Energiesystem_unplausibel), 8=Cx8_Ladekontrollleuchte (CM_NVEM_Bordnetz_Information_Cx8_Ladekontrollleuchte), 9=Cx9_Generator_defekt (CM_NVEM_Bordnetz_Information_Cx9_Generator_defekt), 10=Cxa_reserviert (CM_NVEM_Bordnetz_Information_Cxa_reserviert), 11=Cxb_reserviert (CM_NVEM_Bordnetz_Information_Cxb_reserviert), 12=Cxc_reserviert (CM_NVEM_Bordnetz_Information_Cxc_reserviert), 13=Cxd_reserviert (CM_NVEM_Bordnetz_Information_Cxd_reserviert), 14=Cxe_Init (CM_NVEM_Bordnetz_Information_Cxe_Init), 15=Cxf_Fehler (CM_NVEM_Bordnetz_Information_Cxf_Fehler)
  compu method CM_TME_HVHW_HVK_Status_Spgfreiheit: 0=Cx0_Init (CM_TME_HVHW_HVK_Status_Spgfreiheit_Cx0_Init), 1=Cx1_HV_Komponente_spannungsfrei (CM_TME_HVHW_HVK_Status_Spgfreiheit_Cx1_HV_Komponente_spannungsfrei), 2=Cx2_HV_Komp_nicht_spannungsfrei (CM_TME_HVHW_HVK_Status_Spgfreiheit_Cx2_HV_Komp_nicht_spannungsfrei), 3=Cx3_Fehler (CM_TME_HVHW_HVK_Status_Spgfreiheit_Cx3_Fehler)
  compu method CM_UI1_Spannung2_Schalt_Status: 0=Cx0_offen (CM_UI1_Spannung2_Schalt_Status_Cx0_offen), 1=Cx1_geschlossen (CM_UI1_Spannung2_Schalt_Status_Cx1_geschlossen), 2=Cx2_defekt_geschlossen (CM_UI1_Spannung2_Schalt_Status_Cx2_defekt_geschlossen), 3=Cx3_defekt_offen (CM_UI1_Spannung2_Schalt_Status_Cx3_defekt_offen), 4=Cx4_nicht_schaltbar (CM_UI1_Spannung2_Schalt_Status_Cx4_nicht_schaltbar), 6=Cx6_Init (CM_UI1_Spannung2_Schalt_Status_Cx6_Init), 7=Cx7_Fehler (CM_UI1_Spannung2_Schalt_Status_Cx7_Fehler)
  compu method CM_PCM_BMC_VTD_LifeTimeReset_Req: 0=Cx0_NoResetResponse (CM_PCM_BMC_VTD_LifeTimeReset_Req_Cx0_NoResetResponse), 1=Cx1_ResetResponse (CM_PCM_BMC_VTD_LifeTimeReset_Req_Cx1_ResetResponse), 2=Cx2_Init (CM_PCM_BMC_VTD_LifeTimeReset_Req_Cx2_Init), 3=Cx3_Fehler (CM_PCM_BMC_VTD_LifeTimeReset_Req_Cx3_Fehler)
  compu method CM_NVEM_Bordnetzdiagnose: 0=Cx0_kein_Fehler (CM_NVEM_Bordnetzdiagnose_Cx0_kein_Fehler), 1=Cx1_Warnung_1 (CM_NVEM_Bordnetzdiagnose_Cx1_Warnung_1), 2=Cx2_Warnung_2 (CM_NVEM_Bordnetzdiagnose_Cx2_Warnung_2), 3=Cx3_Warnung_3 (CM_NVEM_Bordnetzdiagnose_Cx3_Warnung_3)
  compu method CM_TME_HVHW_SollModus: 0=Cx0_Keine_Freigabe (CM_TME_HVHW_SollModus_Cx0_Keine_Freigabe), 1=Cx1_Freigabe (CM_TME_HVHW_SollModus_Cx1_Freigabe), 2=Cx2_Freigabe_ausgesetzt (CM_TME_HVHW_SollModus_Cx2_Freigabe_ausgesetzt), 3=Cx3_Init (CM_TME_HVHW_SollModus_Cx3_Init)
  compu method CM_BMC_NutzbarerSOC: phys=raw*0.05-20 for raw 0..4093, 4094=Cxffe_Init (CM_BMC_NutzbarerSOC_Cxffe_Init), 4095=Cxfff_Fehler (CM_BMC_NutzbarerSOC_Cxfff_Fehler); unit Unit_PerCent
  compu method CM_CHA_ReqPrgIntrSound: 0=Cx0_no_program (CM_CHA_ReqPrgIntrSound_Cx0_no_program), 1=Cx1_program_1 (CM_CHA_ReqPrgIntrSound_Cx1_program_1), 2=Cx2_program_2 (CM_CHA_ReqPrgIntrSound_Cx2_program_2), 3=Cx3_program_3 (CM_CHA_ReqPrgIntrSound_Cx3_program_3), 4=Cx4_program_4 (CM_CHA_ReqPrgIntrSound_Cx4_program_4), 5=Cx5_program_5 (CM_CHA_ReqPrgIntrSound_Cx5_program_5), 6=Cx6_program_6 (CM_CHA_ReqPrgIntrSound_Cx6_program_6), 7=Cx7_program_7 (CM_CHA_ReqPrgIntrSound_Cx7_program_7), 8=Cx8_program_8 (CM_CHA_ReqPrgIntrSound_Cx8_program_8), 9=Cx9_program_9 (CM_CHA_ReqPrgIntrSound_Cx9_program_9), 10=Cxa_program_10 (CM_CHA_ReqPrgIntrSound_Cxa_program_10), 11=Cxb_program_11 (CM_CHA_ReqPrgIntrSound_Cxb_program_11), 12=Cxc_program_12 (CM_CHA_ReqPrgIntrSound_Cxc_program_12), 13=Cxd_program_13 (CM_CHA_ReqPrgIntrSound_Cxd_program_13), 14=Cxe_program_14 (CM_CHA_ReqPrgIntrSound_Cxe_program_14), 15=Cxf_program_15 (CM_CHA_ReqPrgIntrSound_Cxf_program_15)
  compu method CM_WFS_ID_Geb_steckt: 0=Cx0_kein_Schluessel_im_Zuendschloss (CM_WFS_ID_Geb_steckt_Cx0_kein_Schluessel_im_Zuendschloss), 1=Cx1_Schluessel_steckt_im_Zuendschloss (CM_WFS_ID_Geb_steckt_Cx1_Schluessel_steckt_im_Zuendschloss) (Schluessel steckt im Zuendschloss)
  compu method CM_UI1_Spannung3: phys=raw*0.0625-1023 for raw 0..32763, 32764=Cx7ffc_nicht_messbar (CM_UI1_Spannung3_Cx7ffc_nicht_messbar), 32765=Cx7ffd_nicht_verfuegbar (CM_UI1_Spannung3_Cx7ffd_nicht_verfuegbar), 32766=Cx7ffe_Init (CM_UI1_Spannung3_Cx7ffe_Init), 32767=Cx7fff_Fehler (CM_UI1_Spannung3_Cx7fff_Fehler); unit Unit_Volt
  compu method CM_WFS_Klemmenfreigabe: 0=Cx0_keine_Freigabe (CM_WFS_Klemmenfreigabe_Cx0_keine_Freigabe), 1=Cx1_Freigabe (CM_WFS_Klemmenfreigabe_Cx1_Freigabe)
  compu method CM_PCM_BMC_VTD_LifeTimeReset_Resp: 0=Cx0_NoResetResponse (CM_PCM_BMC_VTD_LifeTimeReset_Resp_Cx0_NoResetResponse), 1=Cx1_ResetResponse (CM_PCM_BMC_VTD_LifeTimeReset_Resp_Cx1_ResetResponse), 2=Cx2_Init (CM_PCM_BMC_VTD_LifeTimeReset_Resp_Cx2_Init), 3=Cx3_Fehler (CM_PCM_BMC_VTD_LifeTimeReset_Resp_Cx3_Fehler)
  compu method CM_WFS_LF_Aktiv: 0=Cx0_Funktempfang_nicht_aktiv (CM_WFS_LF_Aktiv_Cx0_Funktempfang_nicht_aktiv), 1=Cx1_LF_Funkempfang_aktiv (CM_WFS_LF_Aktiv_Cx1_LF_Funkempfang_aktiv)
  compu method CM_CHA_ReqPrgKl: 0=Cx0_no_program (CM_CHA_ReqPrgKl_Cx0_no_program), 1=Cx1_program_1 (CM_CHA_ReqPrgKl_Cx1_program_1), 2=Cx2_program_2 (CM_CHA_ReqPrgKl_Cx2_program_2), 3=Cx3_program_3 (CM_CHA_ReqPrgKl_Cx3_program_3), 4=Cx4_program_4 (CM_CHA_ReqPrgKl_Cx4_program_4), 5=Cx5_program_5 (CM_CHA_ReqPrgKl_Cx5_program_5), 6=Cx6_program_6 (CM_CHA_ReqPrgKl_Cx6_program_6), 7=Cx7_program_7 (CM_CHA_ReqPrgKl_Cx7_program_7), 8=Cx8_program_8 (CM_CHA_ReqPrgKl_Cx8_program_8), 9=Cx9_program_9 (CM_CHA_ReqPrgKl_Cx9_program_9), 10=Cxa_program_10 (CM_CHA_ReqPrgKl_Cxa_program_10), 11=Cxb_program_11 (CM_CHA_ReqPrgKl_Cxb_program_11), 12=Cxc_program_12 (CM_CHA_ReqPrgKl_Cxc_program_12), 13=Cxd_program_13 (CM_CHA_ReqPrgKl_Cxd_program_13), 14=Cxe_program_14 (CM_CHA_ReqPrgKl_Cxe_program_14), 15=Cxf_program_15 (CM_CHA_ReqPrgKl_Cxf_program_15)
  compu method CM_TME_Temp_nach_Verdampfer_Front: phys=raw*0.1-20 for raw 0..900, 1022=Cx3fe_Init (CM_TME_Temp_nach_Verdampfer_Front_Cx3fe_Init), 1023=Cx3ff_Fehler (CM_TME_Temp_nach_Verdampfer_Front_Cx3ff_Fehler); unit Unit_DegreCelsi
  compu method CM_WFS_LZ_02: 0=Cx0_Lieferant_Init (CM_WFS_LZ_02_Cx0_Lieferant_Init) (Lieferant/Init), 1=Cx1_fabrikneu (CM_WFS_LZ_02_Cx1_fabrikneu), 2=Cx2_angelernt (CM_WFS_LZ_02_Cx2_angelernt), 3=Cx3_Schluessel_lernen_Kundendienst (CM_WFS_LZ_02_Cx3_Schluessel_lernen_Kundendienst), 4=Cx4_Schluessel_lernen_Produktion (CM_WFS_LZ_02_Cx4_Schluessel_lernen_Produktion), 8=Cx8_WFS_temporaer_nicht_verfuegbar (CM_WFS_LZ_02_Cx8_WFS_temporaer_nicht_verfuegbar), 9=Cx9_Fehler (CM_WFS_LZ_02_Cx9_Fehler)
  compu method CM_UI1_Spannung4: phys=raw*0.0625-1023 for raw 0..32763, 32764=Cx7ffc_nicht_messbar (CM_UI1_Spannung4_Cx7ffc_nicht_messbar), 32765=Cx7ffd_nicht_verfuegbar (CM_UI1_Spannung4_Cx7ffd_nicht_verfuegbar), 32766=Cx7ffe_Init (CM_UI1_Spannung4_Cx7ffe_Init), 32767=Cx7fff_Fehler (CM_UI1_Spannung4_Cx7fff_Fehler); unit Unit_Volt
  compu method CM_PCM_BMC_VTD_RecentReset_Req: 0=Cx0_NoResetResponse (CM_PCM_BMC_VTD_RecentReset_Req_Cx0_NoResetResponse), 1=Cx1_ResetResponse (CM_PCM_BMC_VTD_RecentReset_Req_Cx1_ResetResponse), 2=Cx2_Init (CM_PCM_BMC_VTD_RecentReset_Req_Cx2_Init), 3=Cx3_Fehler (CM_PCM_BMC_VTD_RecentReset_Req_Cx3_Fehler)
  compu method CM_BMC_Pack_SN_01: 255=Cxff_Init (CM_BMC_Pack_SN_01_Cxff_Init)
  compu method CM_WFS_Parken_Status: 0=Cx0_Limitierung_inaktiv (CM_WFS_Parken_Status_Cx0_Limitierung_inaktiv), 1=Cx1_Limitierung_aktiv (CM_WFS_Parken_Status_Cx1_Limitierung_aktiv), 2=Cx2_Abbruch (CM_WFS_Parken_Status_Cx2_Abbruch)
  compu method CM_TME_HVHW_Verbauinfo: 0=Cx0_InitWert (CM_TME_HVHW_Verbauinfo_Cx0_InitWert), 1=Cx1_nicht_verbaut (CM_TME_HVHW_Verbauinfo_Cx1_nicht_verbaut), 2=Cx2_verbaut (CM_TME_HVHW_Verbauinfo_Cx2_verbaut)
  compu method CM_CHA_ReqPrgLC: 0=Cx0_no_program (CM_CHA_ReqPrgLC_Cx0_no_program), 1=Cx1_program_1 (CM_CHA_ReqPrgLC_Cx1_program_1), 2=Cx2_program_2 (CM_CHA_ReqPrgLC_Cx2_program_2), 3=Cx3_program_3 (CM_CHA_ReqPrgLC_Cx3_program_3), 4=Cx4_program_4 (CM_CHA_ReqPrgLC_Cx4_program_4), 5=Cx5_program_5 (CM_CHA_ReqPrgLC_Cx5_program_5), 6=Cx6_program_6 (CM_CHA_ReqPrgLC_Cx6_program_6), 7=Cx7_program_7 (CM_CHA_ReqPrgLC_Cx7_program_7), 8=Cx8_program_8 (CM_CHA_ReqPrgLC_Cx8_program_8), 9=Cx9_program_9 (CM_CHA_ReqPrgLC_Cx9_program_9), 10=Cxa_program_10 (CM_CHA_ReqPrgLC_Cxa_program_10), 11=Cxb_program_11 (CM_CHA_ReqPrgLC_Cxb_program_11), 12=Cxc_program_12 (CM_CHA_ReqPrgLC_Cxc_program_12), 13=Cxd_program_13 (CM_CHA_ReqPrgLC_Cxd_program_13), 14=Cxe_program_14 (CM_CHA_ReqPrgLC_Cxe_program_14), 15=Cxf_program_15 (CM_CHA_ReqPrgLC_Cxf_program_15)
  compu method CM_TME_IPB_Status_Kuehlung: 0=Cx0_kein_Fehler (CM_TME_IPB_Status_Kuehlung_Cx0_kein_Fehler), 1=Cx1_Fehler (CM_TME_IPB_Status_Kuehlung_Cx1_Fehler)
  compu method CM_PLC_StCpbPrkLockUnit: 0=Cx0_Nicht_Verfuegbar (CM_PLC_StCpbPrkLockUnit_Cx0_Nicht_Verfuegbar) (Nicht Verfügbar), 1=Cx1_Verfuegbar (CM_PLC_StCpbPrkLockUnit_Cx1_Verfuegbar) (Verfügbar), 2=Cx2_Init (CM_PLC_StCpbPrkLockUnit_Cx2_Init), 3=Cx3_Fehler (CM_PLC_StCpbPrkLockUnit_Cx3_Fehler)
  compu method CM_BMC_Pack_SN_02: 255=Cxff_Init (CM_BMC_Pack_SN_02_Cxff_Init)
  compu method CM_TME_Klima_Heizleistung_reduziert: 0=Cx0_keine_Reduzierung (CM_TME_Klima_Heizleistung_reduziert_Cx0_keine_Reduzierung), 1=Cx1_Reduzierung_aktiv (CM_TME_Klima_Heizleistung_reduziert_Cx1_Reduzierung_aktiv)
  compu method CM_TME_Therm_IstLeistung_HVBatterie: phys=raw*100-25500 for raw 0..509, 510=Cx1fe_Init (CM_TME_Therm_IstLeistung_HVBatterie_Cx1fe_Init), 511=Cx1ff_Fehler (CM_TME_Therm_IstLeistung_HVBatterie_Cx1ff_Fehler); unit Unit_Watt
  compu method CM_CHA_ReqPrgPreCrash: 0=Cx0_no_program (CM_CHA_ReqPrgPreCrash_Cx0_no_program), 1=Cx1_program_1 (CM_CHA_ReqPrgPreCrash_Cx1_program_1), 2=Cx2_program_2 (CM_CHA_ReqPrgPreCrash_Cx2_program_2), 3=Cx3_program_3 (CM_CHA_ReqPrgPreCrash_Cx3_program_3), 4=Cx4_program_4 (CM_CHA_ReqPrgPreCrash_Cx4_program_4), 5=Cx5_program_5 (CM_CHA_ReqPrgPreCrash_Cx5_program_5), 6=Cx6_program_6 (CM_CHA_ReqPrgPreCrash_Cx6_program_6), 7=Cx7_program_7 (CM_CHA_ReqPrgPreCrash_Cx7_program_7), 8=Cx8_program_8 (CM_CHA_ReqPrgPreCrash_Cx8_program_8), 9=Cx9_program_9 (CM_CHA_ReqPrgPreCrash_Cx9_program_9), 10=Cxa_program_10 (CM_CHA_ReqPrgPreCrash_Cxa_program_10), 11=Cxb_program_11 (CM_CHA_ReqPrgPreCrash_Cxb_program_11), 12=Cxc_program_12 (CM_CHA_ReqPrgPreCrash_Cxc_program_12), 13=Cxd_program_13 (CM_CHA_ReqPrgPreCrash_Cxd_program_13), 14=Cxe_program_14 (CM_CHA_ReqPrgPreCrash_Cxe_program_14), 15=Cxf_program_15 (CM_CHA_ReqPrgPreCrash_Cxf_program_15)
  compu method CM_UI2Sens01_CALID_Index_04: phys=raw for raw 0..255
  compu method CM_TME_Klima_Red_Heizleistung_HVHL: 0=Cx0_keine_Reduzierung (CM_TME_Klima_Red_Heizleistung_HVHL_Cx0_keine_Reduzierung), 1=Cx1_Reduzierung_aktiv (CM_TME_Klima_Red_Heizleistung_HVHL_Cx1_Reduzierung_aktiv), 2=Cx2_Bankweises_Laden (CM_TME_Klima_Red_Heizleistung_HVHL_Cx2_Bankweises_Laden), 3=Cx3_Bankweises_Laden_PTC_kaltgeblasen (CM_TME_Klima_Red_Heizleistung_HVHL_Cx3_Bankweises_Laden_PTC_kaltgeblasen)
  compu method CM_BMC_Pack_SN_03: 255=Cxff_Init (CM_BMC_Pack_SN_03_Cxff_Init)
  compu method CM_TME_Verbrauch_gesamt: phys=raw for raw 0..4095; unit Unit_WattSecond
  compu method CM_TME_Klimaanforderung: 0=Cx0_keine_Anforderung_durch_TME (CM_TME_Klimaanforderung_Cx0_keine_Anforderung_durch_TME), 1=Cx1_Klimaleistungspraediktion_aktiv (CM_TME_Klimaanforderung_Cx1_Klimaleistungspraediktion_aktiv), 2=Cx2_berechnung_Vorkonditionierung_aktiv (CM_TME_Klimaanforderung_Cx2_berechnung_Vorkonditionierung_aktiv), 3=Cx3_Vorkonditionierung_aktiv (CM_TME_Klimaanforderung_Cx3_Vorkonditionierung_aktiv)
  compu method CM_NVEM_DC_iSoll_NV: phys=raw-253 for raw 0..253, 254=Cxfe_Init (CM_NVEM_DC_iSoll_NV_Cxfe_Init), 255=Cxff_Fehler (CM_NVEM_DC_iSoll_NV_Cxff_Fehler); unit Unit_Amper
  compu method CM_BMC_Pack_SN_04: 255=Cxff_Init (CM_BMC_Pack_SN_04_Cxff_Init)
  compu method CM_NVEM_DC_uMin_NV: phys=raw*0.1 for raw 0..255; unit Unit_Volt
  compu method CM_WFS_Safe: 0=Cx0_Init (CM_WFS_Safe_Cx0_Init), 1=Cx1_WFS_nicht_deaktiviert (CM_WFS_Safe_Cx1_WFS_nicht_deaktiviert) (WFS nicht deaktiviert)
  compu method CM_TME_Verbrauch_gesamt_Ueberlauf: 0=Cx0_kein_Ueberlauf (CM_TME_Verbrauch_gesamt_Ueberlauf_Cx0_kein_Ueberlauf), 1=Cx1_Ueberlauf (CM_TME_Verbrauch_gesamt_Ueberlauf_Cx1_Ueberlauf)
  compu method CM_UI1_Spannung5: phys=raw*0.0625-1023 for raw 0..32763, 32764=Cx7ffc_nicht_messbar (CM_UI1_Spannung5_Cx7ffc_nicht_messbar), 32765=Cx7ffd_nicht_verfuegbar (CM_UI1_Spannung5_Cx7ffd_nicht_verfuegbar), 32766=Cx7ffe_Init (CM_UI1_Spannung5_Cx7ffe_Init), 32767=Cx7fff_Fehler (CM_UI1_Spannung5_Cx7fff_Fehler); unit Unit_Volt
  compu method CM_UI2Sens01_CALID_Index_05: phys=raw for raw 0..255
  compu method CM_NVEM_DC_uSoll_NV: phys=raw*0.025+10.6 for raw 0..216, 255=Cxff_Fehler (CM_NVEM_DC_uSoll_NV_Cxff_Fehler); unit Unit_Volt
  compu method CM_WFS_Schluessel_Fahrberecht: 0=Cx0_kein_authorisierter_Schluessel_erkannt (CM_WFS_Schluessel_Fahrberecht_Cx0_kein_authorisierter_Schluessel_erkannt) (kein authorisierter Schluessel erkannt), 1=Cx1_aktive_Funkschluessel_Nr_01 (CM_WFS_Schluessel_Fahrberecht_Cx1_aktive_Funkschluessel_Nr_01), 2=Cx2_aktive_Funkschluessel_Nr_02 (CM_WFS_Schluessel_Fahrberecht_Cx2_aktive_Funkschluessel_Nr_02), 3=Cx3_aktive_Funkschluessel_Nr_03 (CM_WFS_Schluessel_Fahrberecht_Cx3_aktive_Funkschluessel_Nr_03), 4=Cx4_aktive_Funkschluessel_Nr_04 (CM_WFS_Schluessel_Fahrberecht_Cx4_aktive_Funkschluessel_Nr_04), 5=Cx5_aktive_Funkschluessel_Nr_05 (CM_WFS_Schluessel_Fahrberecht_Cx5_aktive_Funkschluessel_Nr_05), 6=Cx6_aktive_Funkschluessel_Nr_06 (CM_WFS_Schluessel_Fahrberecht_Cx6_aktive_Funkschluessel_Nr_06), 7=Cx7_aktive_Funkschluessel_Nr_07 (CM_WFS_Schluessel_Fahrberecht_Cx7_aktive_Funkschluessel_Nr_07), 8=Cx8_aktive_Funkschluessel_Nr_08 (CM_WFS_Schluessel_Fahrberecht_Cx8_aktive_Funkschluessel_Nr_08), 9=Cx9_ungueltig_09 (CM_WFS_Schluessel_Fahrberecht_Cx9_ungueltig_09), 10=Cxa_ungueltig_10 (CM_WFS_Schluessel_Fahrberecht_Cxa_ungueltig_10), 11=Cxb_ungueltig_11 (CM_WFS_Schluessel_Fahrberecht_Cxb_ungueltig_11), 12=Cxc_ungueltig_12 (CM_WFS_Schluessel_Fahrberecht_Cxc_ungueltig_12), 13=Cxd_ungueltig_13 (CM_WFS_Schluessel_Fahrberecht_Cxd_ungueltig_13), 14=Cxe_ungueltig_14 (CM_WFS_Schluessel_Fahrberecht_Cxe_ungueltig_14), 15=Cxf_digitaler_Schluessel_aktiv (CM_WFS_Schluessel_Fahrberecht_Cxf_digitaler_Schluessel_aktiv)
  compu method CM_WFS_Schluessel_Ist: phys=raw for raw 0..8; unit Unit_None
  compu method CM_NVEM_Freigabe_OTA: 0=Cx0_Init (CM_NVEM_Freigabe_OTA_Cx0_Init), 1=Cx1_Keine_Freigabe (CM_NVEM_Freigabe_OTA_Cx1_Keine_Freigabe), 2=Cx2_Freigabe (CM_NVEM_Freigabe_OTA_Cx2_Freigabe)
  compu method CM_TME_Vorwarn_Komp_ein: 0=Cx0_Kompressor_Aus (CM_TME_Vorwarn_Komp_ein_Cx0_Kompressor_Aus), 1=Cx1_Vorwarnung_Kompressor_Ein (CM_TME_Vorwarn_Komp_ein_Cx1_Vorwarnung_Kompressor_Ein)
  compu method CM_UI2Sens01_CALID_Index_06: phys=raw for raw 0..255
  compu method CM_UI1_Spannung6: phys=raw*0.0625-1023 for raw 0..32763, 32764=Cx7ffc_nicht_messbar (CM_UI1_Spannung6_Cx7ffc_nicht_messbar), 32765=Cx7ffd_nicht_verfuegbar (CM_UI1_Spannung6_Cx7ffd_nicht_verfuegbar), 32766=Cx7ffe_Init (CM_UI1_Spannung6_Cx7ffe_Init), 32767=Cx7fff_Fehler (CM_UI1_Spannung6_Cx7fff_Fehler); unit Unit_Volt
  compu method CM_NVEM_Last_Anf: 0=Cx0_keine_Anforderung (CM_NVEM_Last_Anf_Cx0_keine_Anforderung) (keine Anforderung), 1=Cx1_Verbraucher_Anforderung_Stufe_1 (CM_NVEM_Last_Anf_Cx1_Verbraucher_Anforderung_Stufe_1), 2=Cx2_Verbraucher_Anforderung_Stufe_2 (CM_NVEM_Last_Anf_Cx2_Verbraucher_Anforderung_Stufe_2), 3=Cx3_Verbraucher_Anforderung_Stufe_3 (CM_NVEM_Last_Anf_Cx3_Verbraucher_Anforderung_Stufe_3)
  compu method CM_TME_Kompressorlastmoment: phys=raw*0.25 for raw 0..254, 255=Cxff_Fehler (CM_TME_Kompressorlastmoment_Cxff_Fehler); unit Unit_NewtoMeter
  compu method CM_UI2Sens01_CALID_Index_07: phys=raw for raw 0..255
  compu method CM_UI1_Status: 0=Cx0_Init (CM_UI1_Status_Cx0_Init), 1=Cx1_Aktiv (CM_UI1_Status_Cx1_Aktiv)
  compu method CM_PTCfgSrv_PwrPtSysMax: phys=raw*2 for raw 0..1000; unit Unit_KiloWatt
  compu method CM_UI2Sens01_CALID_Index_08: phys=raw for raw 0..255
  compu method CM_BMC_Pack_SN_05: 255=Cxff_Init (CM_BMC_Pack_SN_05_Cxff_Init)
  compu method CM_UI1_Strom: phys=raw*0.005-2621 for raw 0..1048573, 1048574=Cxffffe_Init (CM_UI1_Strom_Cxffffe_Init), 1048575=Cxfffff_Fehler (CM_UI1_Strom_Cxfffff_Fehler); unit Unit_Amper
  compu method CM_CHA_ReqPrgRcp: 0=Cx0_no_program (CM_CHA_ReqPrgRcp_Cx0_no_program), 1=Cx1_program_1 (CM_CHA_ReqPrgRcp_Cx1_program_1), 2=Cx2_program_2 (CM_CHA_ReqPrgRcp_Cx2_program_2), 3=Cx3_program_3 (CM_CHA_ReqPrgRcp_Cx3_program_3), 4=Cx4_program_4 (CM_CHA_ReqPrgRcp_Cx4_program_4), 5=Cx5_program_5 (CM_CHA_ReqPrgRcp_Cx5_program_5), 6=Cx6_program_6 (CM_CHA_ReqPrgRcp_Cx6_program_6), 7=Cx7_program_7 (CM_CHA_ReqPrgRcp_Cx7_program_7), 8=Cx8_program_8 (CM_CHA_ReqPrgRcp_Cx8_program_8), 9=Cx9_program_9 (CM_CHA_ReqPrgRcp_Cx9_program_9), 10=Cxa_program_10 (CM_CHA_ReqPrgRcp_Cxa_program_10), 11=Cxb_program_11 (CM_CHA_ReqPrgRcp_Cxb_program_11), 12=Cxc_program_12 (CM_CHA_ReqPrgRcp_Cxc_program_12), 13=Cxd_program_13 (CM_CHA_ReqPrgRcp_Cxd_program_13), 14=Cxe_program_14 (CM_CHA_ReqPrgRcp_Cxe_program_14), 15=Cxf_program_15 (CM_CHA_ReqPrgRcp_Cxf_program_15)
  compu method CM_PTERM_MdElEgyMng: 0=Cx0_No_Hybrid (CM_PTERM_MdElEgyMng_Cx0_No_Hybrid), 1=Cx1_Depleting (CM_PTERM_MdElEgyMng_Cx1_Depleting), 2=Cx2_Soft_Depleting (CM_PTERM_MdElEgyMng_Cx2_Soft_Depleting), 3=Cx3_Sustaining (CM_PTERM_MdElEgyMng_Cx3_Sustaining), 4=Cx4_Increasing (CM_PTERM_MdElEgyMng_Cx4_Increasing), 5=Cx5_External_Control (CM_PTERM_MdElEgyMng_Cx5_External_Control)
  compu method CM_UI1_Stromintegral_Entladen: phys=raw for raw 0..65533, 65534=Cxfffe_Init (CM_UI1_Stromintegral_Entladen_Cxfffe_Init), 65535=Cxffff_Fehler (CM_UI1_Stromintegral_Entladen_Cxffff_Fehler); unit Unit_AmperSecon
  compu method CM_UI2Sens01_CALID_Index_09: phys=raw for raw 0..255
  compu method CM_BMC_Pack_SN_06: 255=Cxff_Init (CM_BMC_Pack_SN_06_Cxff_Init)
  compu method CM_CHA_ReqPrgRwb: 0=Cx0_no_program (CM_CHA_ReqPrgRwb_Cx0_no_program), 1=Cx1_program_1 (CM_CHA_ReqPrgRwb_Cx1_program_1), 2=Cx2_program_2 (CM_CHA_ReqPrgRwb_Cx2_program_2), 3=Cx3_program_3 (CM_CHA_ReqPrgRwb_Cx3_program_3), 4=Cx4_program_4 (CM_CHA_ReqPrgRwb_Cx4_program_4), 5=Cx5_program_5 (CM_CHA_ReqPrgRwb_Cx5_program_5), 6=Cx6_program_6 (CM_CHA_ReqPrgRwb_Cx6_program_6), 7=Cx7_program_7 (CM_CHA_ReqPrgRwb_Cx7_program_7), 8=Cx8_program_8 (CM_CHA_ReqPrgRwb_Cx8_program_8), 9=Cx9_program_9 (CM_CHA_ReqPrgRwb_Cx9_program_9), 10=Cxa_program_10 (CM_CHA_ReqPrgRwb_Cxa_program_10), 11=Cxb_program_11 (CM_CHA_ReqPrgRwb_Cxb_program_11), 12=Cxc_program_12 (CM_CHA_ReqPrgRwb_Cxc_program_12), 13=Cxd_program_13 (CM_CHA_ReqPrgRwb_Cxd_program_13), 14=Cxe_program_14 (CM_CHA_ReqPrgRwb_Cxe_program_14), 15=Cxf_program_15 (CM_CHA_ReqPrgRwb_Cxf_program_15)
  compu method CM_NVEM_MV_DC_iSoll_NV: phys=raw-253 for raw 0..253, 254=Cxfe_Init (CM_NVEM_MV_DC_iSoll_NV_Cxfe_Init), 255=Cxff_Fehler (CM_NVEM_MV_DC_iSoll_NV_Cxff_Fehler); unit Unit_Amper
  compu method CM_TME_ZR_Anforderung: 0=Cx0_Init (CM_TME_ZR_Anforderung_Cx0_Init), 1=Cx1_Inaktiv (CM_TME_ZR_Anforderung_Cx1_Inaktiv), 2=Cx2_Aktiv (CM_TME_ZR_Anforderung_Cx2_Aktiv), 3=Cx3_Reseviert (CM_TME_ZR_Anforderung_Cx3_Reseviert)
  compu method CM_CHA_ReqPrgTqVect: 0=Cx0_no_program (CM_CHA_ReqPrgTqVect_Cx0_no_program), 1=Cx1_program_1 (CM_CHA_ReqPrgTqVect_Cx1_program_1), 2=Cx2_program_2 (CM_CHA_ReqPrgTqVect_Cx2_program_2), 3=Cx3_program_3 (CM_CHA_ReqPrgTqVect_Cx3_program_3), 4=Cx4_program_4 (CM_CHA_ReqPrgTqVect_Cx4_program_4), 5=Cx5_program_5 (CM_CHA_ReqPrgTqVect_Cx5_program_5), 6=Cx6_program_6 (CM_CHA_ReqPrgTqVect_Cx6_program_6), 7=Cx7_program_7 (CM_CHA_ReqPrgTqVect_Cx7_program_7), 8=Cx8_program_8 (CM_CHA_ReqPrgTqVect_Cx8_program_8), 9=Cx9_program_9 (CM_CHA_ReqPrgTqVect_Cx9_program_9), 10=Cxa_program_10 (CM_CHA_ReqPrgTqVect_Cxa_program_10), 11=Cxb_program_11 (CM_CHA_ReqPrgTqVect_Cxb_program_11), 12=Cxc_program_12 (CM_CHA_ReqPrgTqVect_Cxc_program_12), 13=Cxd_program_13 (CM_CHA_ReqPrgTqVect_Cxd_program_13), 14=Cxe_program_14 (CM_CHA_ReqPrgTqVect_Cxe_program_14), 15=Cxf_program_15 (CM_CHA_ReqPrgTqVect_Cxf_program_15)
  compu method CM_BMC_Pack_SN_07: 255=Cxff_Init (CM_BMC_Pack_SN_07_Cxff_Init)
  compu method CM_UI2Sens01_CALID_Index_10: phys=raw for raw 0..255
  compu method CM_UI1_Stromintegral_Laden: phys=raw for raw 0..65533, 65534=Cxfffe_Init (CM_UI1_Stromintegral_Laden_Cxfffe_Init), 65535=Cxffff_Fehler (CM_UI1_Stromintegral_Laden_Cxffff_Fehler); unit Unit_AmperSecon
  compu method CM_CHA_ReqPrgVLim: 0=Cx0_no_program (CM_CHA_ReqPrgVLim_Cx0_no_program), 1=Cx1_program_1 (CM_CHA_ReqPrgVLim_Cx1_program_1), 2=Cx2_program_2 (CM_CHA_ReqPrgVLim_Cx2_program_2), 3=Cx3_program_3 (CM_CHA_ReqPrgVLim_Cx3_program_3), 4=Cx4_program_4 (CM_CHA_ReqPrgVLim_Cx4_program_4), 5=Cx5_program_5 (CM_CHA_ReqPrgVLim_Cx5_program_5), 6=Cx6_program_6 (CM_CHA_ReqPrgVLim_Cx6_program_6), 7=Cx7_program_7 (CM_CHA_ReqPrgVLim_Cx7_program_7), 8=Cx8_program_8 (CM_CHA_ReqPrgVLim_Cx8_program_8), 9=Cx9_program_9 (CM_CHA_ReqPrgVLim_Cx9_program_9), 10=Cxa_program_10 (CM_CHA_ReqPrgVLim_Cxa_program_10), 11=Cxb_program_11 (CM_CHA_ReqPrgVLim_Cxb_program_11), 12=Cxc_program_12 (CM_CHA_ReqPrgVLim_Cxc_program_12), 13=Cxd_program_13 (CM_CHA_ReqPrgVLim_Cxd_program_13), 14=Cxe_program_14 (CM_CHA_ReqPrgVLim_Cxe_program_14), 15=Cxf_program_15 (CM_CHA_ReqPrgVLim_Cxf_program_15)
  compu method CM_UH_Jahr: phys=raw+2000 for raw 0..127; unit Unit_Year
  compu method CM_UI2Sens01_CALID_Index_11: phys=raw for raw 0..255
  compu method CM_UI1_Temperatur_1: phys=raw-40 for raw 0..252, 253=Cxfd_nicht_vorhanden (CM_UI1_Temperatur_1_Cxfd_nicht_vorhanden), 254=Cxfe_Init (CM_UI1_Temperatur_1_Cxfe_Init), 255=Cxff_Fehler (CM_UI1_Temperatur_1_Cxff_Fehler); unit Unit_DegreCelsi
  compu method CM_CHA_ReqPrgWarnBrk: 0=Cx0_no_program (CM_CHA_ReqPrgWarnBrk_Cx0_no_program), 1=Cx1_program_1 (CM_CHA_ReqPrgWarnBrk_Cx1_program_1), 2=Cx2_program_2 (CM_CHA_ReqPrgWarnBrk_Cx2_program_2), 3=Cx3_program_3 (CM_CHA_ReqPrgWarnBrk_Cx3_program_3), 4=Cx4_program_4 (CM_CHA_ReqPrgWarnBrk_Cx4_program_4), 5=Cx5_program_5 (CM_CHA_ReqPrgWarnBrk_Cx5_program_5), 6=Cx6_program_6 (CM_CHA_ReqPrgWarnBrk_Cx6_program_6), 7=Cx7_program_7 (CM_CHA_ReqPrgWarnBrk_Cx7_program_7), 8=Cx8_program_8 (CM_CHA_ReqPrgWarnBrk_Cx8_program_8), 9=Cx9_program_9 (CM_CHA_ReqPrgWarnBrk_Cx9_program_9), 10=Cxa_program_10 (CM_CHA_ReqPrgWarnBrk_Cxa_program_10), 11=Cxb_program_11 (CM_CHA_ReqPrgWarnBrk_Cxb_program_11), 12=Cxc_program_12 (CM_CHA_ReqPrgWarnBrk_Cxc_program_12), 13=Cxd_program_13 (CM_CHA_ReqPrgWarnBrk_Cxd_program_13), 14=Cxe_program_14 (CM_CHA_ReqPrgWarnBrk_Cxe_program_14), 15=Cxf_program_15 (CM_CHA_ReqPrgWarnBrk_Cxf_program_15)
  compu method CM_UH_Minute: phys=raw for raw 0..59; unit Unit_Minut
  compu method CM_UI2Sens01_CALID_Index_12: phys=raw for raw 0..255
  compu method CM_UI1_Temperatur_2: phys=raw-40 for raw 0..252, 253=Cxfd_nicht_vorhanden (CM_UI1_Temperatur_2_Cxfd_nicht_vorhanden), 254=Cxfe_Init (CM_UI1_Temperatur_2_Cxfe_Init), 255=Cxff_Fehler (CM_UI1_Temperatur_2_Cxff_Fehler); unit Unit_DegreCelsi
  compu method CM_UH_Monat: 0=Cx0_Init (CM_UH_Monat_Cx0_Init), phys=raw for raw 1..12, 14=Cxe_Relatives_Datum (CM_UH_Monat_Cxe_Relatives_Datum), 15=Cxf_Fehler (CM_UH_Monat_Cxf_Fehler); unit Unit_Month
  compu method CM_UI2Sens01_CALID_Index_13: phys=raw for raw 0..255
  compu method CM_UI2_HW_Crashleitung_Status: 0=Cx0_Init (CM_UI2_HW_Crashleitung_Status_Cx0_Init), 1=Cx1_Fehler (CM_UI2_HW_Crashleitung_Status_Cx1_Fehler), 2=Cx2_iO (CM_UI2_HW_Crashleitung_Status_Cx2_iO), 3=Cx3_Funktion_ausgeloest (CM_UI2_HW_Crashleitung_Status_Cx3_Funktion_ausgeloest)
  compu method CM_UH_Sekunde: phys=raw for raw 0..59; unit Unit_Secon
  compu method CM_CHA_StCurProfDft: 0=Cx0_Init (CM_CHA_StCurProfDft_Cx0_Init), 1=Cx1_profile_is_not_configurable (CM_CHA_StCurProfDft_Cx1_profile_is_not_configurable), 2=Cx2_profile_is_default (CM_CHA_StCurProfDft_Cx2_profile_is_default), 3=Cx3_profile_is_not_default (CM_CHA_StCurProfDft_Cx3_profile_is_not_default)
  compu method CM_ClampControl_01_BZ: phys=raw for raw 0..15
  compu method CM_UI2Sens01_CALID_Index_14: phys=raw for raw 0..255
  compu method CM_UI2_KL30_Spannung: phys=raw*0.1 for raw 0..253, 254=Cxfe_Init (CM_UI2_KL30_Spannung_Cxfe_Init), 255=Cxff_Fehler (CM_UI2_KL30_Spannung_Cxff_Fehler); unit Unit_Volt
  compu method CM_ClampControl_01_CRC: phys=raw for raw 0..255
  compu method CM_UH_Stunde: phys=raw for raw 0..23; unit Unit_Hours
  compu method CM_CMM_FlgCHAFctDC: 0=Cx0_charisma_off (CM_CMM_FlgCHAFctDC_Cx0_charisma_off), 1=Cx1_charisma_on (CM_CMM_FlgCHAFctDC_Cx1_charisma_on)
  compu method CM_UI2Sens01_CALID_Index_15: phys=raw for raw 0..255
  compu method CM_UI2_KompFehlerModus2_01: 0=Cx0_TNCTOC (CM_UI2_KompFehlerModus2_01_Cx0_TNCTOC), 1=Cx1_TP_TC (CM_UI2_KompFehlerModus2_01_Cx1_TP_TC), 2=Cx2_TP_TC_WCMTL (CM_UI2_KompFehlerModus2_01_Cx2_TP_TC_WCMTL), 3=Cx3_TF_TC_Error (CM_UI2_KompFehlerModus2_01_Cx3_TF_TC_Error)
  compu method CM_UH_Tag: 0=Cx0_Init (CM_UH_Tag_Cx0_Init), phys=raw for raw 1..31; unit Unit_Day
  compu method CM_UI2Sens01_CALID_Index_16: phys=raw for raw 0..255
  compu method CM_UI2_KompFehlerModus2_02: 0=Cx0_TNCTOC (CM_UI2_KompFehlerModus2_02_Cx0_TNCTOC), 1=Cx1_TP_TC (CM_UI2_KompFehlerModus2_02_Cx1_TP_TC), 2=Cx2_TP_TC_WCMTL (CM_UI2_KompFehlerModus2_02_Cx2_TP_TC_WCMTL), 3=Cx3_TF_TC_Error (CM_UI2_KompFehlerModus2_02_Cx3_TF_TC_Error)
  compu method CM_UI1_Iso_Neg: phys=raw*100 for raw 0..65532, 65533=Cxfffd_nicht_verfuegbar (CM_UI1_Iso_Neg_Cxfffd_nicht_verfuegbar), 65534=Cxfffe_Init (CM_UI1_Iso_Neg_Cxfffe_Init), 65535=Cxffff_Fehler (CM_UI1_Iso_Neg_Cxffff_Fehler); unit Unit_Ohm
  compu method CM_UI2Sens01_CVN_Byte_1: phys=raw for raw 0..255
  compu method CM_UI2_KompFehlerModus2_03: 0=Cx0_TNCTOC (CM_UI2_KompFehlerModus2_03_Cx0_TNCTOC), 1=Cx1_TP_TC (CM_UI2_KompFehlerModus2_03_Cx1_TP_TC), 2=Cx2_TP_TC_WCMTL (CM_UI2_KompFehlerModus2_03_Cx2_TP_TC_WCMTL), 3=Cx3_TF_TC_Error (CM_UI2_KompFehlerModus2_03_Cx3_TF_TC_Error)
  compu method CM_UI1_Iso_Pos: phys=raw*100 for raw 0..65532, 65533=Cxfffd_nicht_verfuegbar (CM_UI1_Iso_Pos_Cxfffd_nicht_verfuegbar), 65534=Cxfffe_Init (CM_UI1_Iso_Pos_Cxfffe_Init), 65535=Cxffff_Fehler (CM_UI1_Iso_Pos_Cxffff_Fehler); unit Unit_Ohm
  compu method CM_UI2Sens01_CVN_Byte_2: phys=raw for raw 0..255
  compu method CM_UI2_KompFehlerModus2_04: 0=Cx0_TNCTOC (CM_UI2_KompFehlerModus2_04_Cx0_TNCTOC), 1=Cx1_TP_TC (CM_UI2_KompFehlerModus2_04_Cx1_TP_TC), 2=Cx2_TP_TC_WCMTL (CM_UI2_KompFehlerModus2_04_Cx2_TP_TC_WCMTL), 3=Cx3_TF_TC_Error (CM_UI2_KompFehlerModus2_04_Cx3_TF_TC_Error)
  compu method CM_UI1_Iso_Status: 0=Cx0_Init (CM_UI1_Iso_Status_Cx0_Init), 1=Cx1_Fehler (CM_UI1_Iso_Status_Cx1_Fehler), 2=Cx2_zyklisch (CM_UI1_Iso_Status_Cx2_zyklisch), 3=Cx3_Einzelmessung (CM_UI1_Iso_Status_Cx3_Einzelmessung), 4=Cx4_Schnellmessung (CM_UI1_Iso_Status_Cx4_Schnellmessung), 5=Cx5_Aus (CM_UI1_Iso_Status_Cx5_Aus)
  compu method CM_UI2_KompFehlerModus2_05: 0=Cx0_TNCTOC (CM_UI2_KompFehlerModus2_05_Cx0_TNCTOC), 1=Cx1_TP_TC (CM_UI2_KompFehlerModus2_05_Cx1_TP_TC), 2=Cx2_TP_TC_WCMTL (CM_UI2_KompFehlerModus2_05_Cx2_TP_TC_WCMTL), 3=Cx3_TF_TC_Error (CM_UI2_KompFehlerModus2_05_Cx3_TF_TC_Error)
  compu method CM_UI1_KL30_Spannung: phys=raw*0.1 for raw 0..253, 254=Cxfe_Init (CM_UI1_KL30_Spannung_Cxfe_Init), 255=Cxff_Fehler (CM_UI1_KL30_Spannung_Cxff_Fehler); unit Unit_Volt
  compu method CM_UI2Sens01_CVN_Byte_3: phys=raw for raw 0..255
  compu method CM_UI2_KompFehlerModus2_06: 0=Cx0_TNCTOC (CM_UI2_KompFehlerModus2_06_Cx0_TNCTOC), 1=Cx1_TP_TC (CM_UI2_KompFehlerModus2_06_Cx1_TP_TC), 2=Cx2_TP_TC_WCMTL (CM_UI2_KompFehlerModus2_06_Cx2_TP_TC_WCMTL), 3=Cx3_TF_TC_Error (CM_UI2_KompFehlerModus2_06_Cx3_TF_TC_Error)
  compu method CM_UI2Sens01_CVN_Byte_4: phys=raw for raw 0..255
  compu method CM_UI1_KompFehlerModus2_01: 0=Cx0_TNCTOC (CM_UI1_KompFehlerModus2_01_Cx0_TNCTOC), 1=Cx1_TP_TC (CM_UI1_KompFehlerModus2_01_Cx1_TP_TC), 2=Cx2_TP_TC_WCMTL (CM_UI1_KompFehlerModus2_01_Cx2_TP_TC_WCMTL), 3=Cx3_TF_TC_Error (CM_UI1_KompFehlerModus2_01_Cx3_TF_TC_Error)
  compu method CM_UI2_KompFehlerModus2_07: 0=Cx0_TNCTOC (CM_UI2_KompFehlerModus2_07_Cx0_TNCTOC), 1=Cx1_TP_TC (CM_UI2_KompFehlerModus2_07_Cx1_TP_TC), 2=Cx2_TP_TC_WCMTL (CM_UI2_KompFehlerModus2_07_Cx2_TP_TC_WCMTL), 3=Cx3_TF_TC_Error (CM_UI2_KompFehlerModus2_07_Cx3_TF_TC_Error)
  compu method CM_UI2Sens01_CVN_VLD: 0=Cx0_Ungueltig (CM_UI2Sens01_CVN_VLD_Cx0_Ungueltig), 1=Cx1_Gueltig (CM_UI2Sens01_CVN_VLD_Cx1_Gueltig)
  compu method CM_UI1_KompFehlerModus2_02: 0=Cx0_TNCTOC (CM_UI1_KompFehlerModus2_02_Cx0_TNCTOC), 1=Cx1_TP_TC (CM_UI1_KompFehlerModus2_02_Cx1_TP_TC), 2=Cx2_TP_TC_WCMTL (CM_UI1_KompFehlerModus2_02_Cx2_TP_TC_WCMTL), 3=Cx3_TF_TC_Error (CM_UI1_KompFehlerModus2_02_Cx3_TF_TC_Error)
  compu method CM_UI2_KompFehlerModus2_08: 0=Cx0_TNCTOC (CM_UI2_KompFehlerModus2_08_Cx0_TNCTOC), 1=Cx1_TP_TC (CM_UI2_KompFehlerModus2_08_Cx1_TP_TC), 2=Cx2_TP_TC_WCMTL (CM_UI2_KompFehlerModus2_08_Cx2_TP_TC_WCMTL), 3=Cx3_TF_TC_Error (CM_UI2_KompFehlerModus2_08_Cx3_TF_TC_Error)
  compu method CM_UI2Sens01_ErrMem_State: 1=Cx1_ErrMem_Active (CM_UI2Sens01_ErrMem_State_Cx1_ErrMem_Active), 2=Cx2_ErrMem_Init_Progress (CM_UI2Sens01_ErrMem_State_Cx2_ErrMem_Init_Progress), 3=Cx3_ErrMem_Init_Done (CM_UI2Sens01_ErrMem_State_Cx3_ErrMem_Init_Done)
  compu method CM_UI1_KompFehlerModus2_03: 0=Cx0_TNCTOC (CM_UI1_KompFehlerModus2_03_Cx0_TNCTOC), 1=Cx1_TP_TC (CM_UI1_KompFehlerModus2_03_Cx1_TP_TC), 2=Cx2_TP_TC_WCMTL (CM_UI1_KompFehlerModus2_03_Cx2_TP_TC_WCMTL), 3=Cx3_TF_TC_Error (CM_UI1_KompFehlerModus2_03_Cx3_TF_TC_Error)
  compu method CM_UI2_KompFehlerModus2_09: 0=Cx0_TNCTOC (CM_UI2_KompFehlerModus2_09_Cx0_TNCTOC), 1=Cx1_TP_TC (CM_UI2_KompFehlerModus2_09_Cx1_TP_TC), 2=Cx2_TP_TC_WCMTL (CM_UI2_KompFehlerModus2_09_Cx2_TP_TC_WCMTL), 3=Cx3_TF_TC_Error (CM_UI2_KompFehlerModus2_09_Cx3_TF_TC_Error)
  compu method CM_UI2Sens02_CALID_Index_01: phys=raw for raw 0..255
  compu method CM_UI1_KompFehlerModus2_04: 0=Cx0_TNCTOC (CM_UI1_KompFehlerModus2_04_Cx0_TNCTOC), 1=Cx1_TP_TC (CM_UI1_KompFehlerModus2_04_Cx1_TP_TC), 2=Cx2_TP_TC_WCMTL (CM_UI1_KompFehlerModus2_04_Cx2_TP_TC_WCMTL), 3=Cx3_TF_TC_Error (CM_UI1_KompFehlerModus2_04_Cx3_TF_TC_Error)
  compu method CM_UI2_KompFehlerModus2_10: 0=Cx0_TNCTOC (CM_UI2_KompFehlerModus2_10_Cx0_TNCTOC), 1=Cx1_TP_TC (CM_UI2_KompFehlerModus2_10_Cx1_TP_TC), 2=Cx2_TP_TC_WCMTL (CM_UI2_KompFehlerModus2_10_Cx2_TP_TC_WCMTL), 3=Cx3_TF_TC_Error (CM_UI2_KompFehlerModus2_10_Cx3_TF_TC_Error)
  compu method CM_UI2Sens02_CALID_Index_02: phys=raw for raw 0..255
  compu method CM_UI1_KompFehlerModus2_05: 0=Cx0_TNCTOC (CM_UI1_KompFehlerModus2_05_Cx0_TNCTOC), 1=Cx1_TP_TC (CM_UI1_KompFehlerModus2_05_Cx1_TP_TC), 2=Cx2_TP_TC_WCMTL (CM_UI1_KompFehlerModus2_05_Cx2_TP_TC_WCMTL), 3=Cx3_TF_TC_Error (CM_UI1_KompFehlerModus2_05_Cx3_TF_TC_Error)
  compu method CM_UI2Sens02_CALID_Index_03: phys=raw for raw 0..255
  compu method CM_UI2_KompFehlerModus2_11: 0=Cx0_TNCTOC (CM_UI2_KompFehlerModus2_11_Cx0_TNCTOC), 1=Cx1_TP_TC (CM_UI2_KompFehlerModus2_11_Cx1_TP_TC), 2=Cx2_TP_TC_WCMTL (CM_UI2_KompFehlerModus2_11_Cx2_TP_TC_WCMTL), 3=Cx3_TF_TC_Error (CM_UI2_KompFehlerModus2_11_Cx3_TF_TC_Error)
  compu method CM_UI1_KompFehlerModus2_06: 0=Cx0_TNCTOC (CM_UI1_KompFehlerModus2_06_Cx0_TNCTOC), 1=Cx1_TP_TC (CM_UI1_KompFehlerModus2_06_Cx1_TP_TC), 2=Cx2_TP_TC_WCMTL (CM_UI1_KompFehlerModus2_06_Cx2_TP_TC_WCMTL), 3=Cx3_TF_TC_Error (CM_UI1_KompFehlerModus2_06_Cx3_TF_TC_Error)
  compu method CM_UI2Sens02_CALID_Index_04: phys=raw for raw 0..255
  compu method CM_UI2_KompFehlerModus2_12: 0=Cx0_TNCTOC (CM_UI2_KompFehlerModus2_12_Cx0_TNCTOC), 1=Cx1_TP_TC (CM_UI2_KompFehlerModus2_12_Cx1_TP_TC), 2=Cx2_TP_TC_WCMTL (CM_UI2_KompFehlerModus2_12_Cx2_TP_TC_WCMTL), 3=Cx3_TF_TC_Error (CM_UI2_KompFehlerModus2_12_Cx3_TF_TC_Error)
  compu method CM_UI1_KompFehlerModus2_07: 0=Cx0_TNCTOC (CM_UI1_KompFehlerModus2_07_Cx0_TNCTOC), 1=Cx1_TP_TC (CM_UI1_KompFehlerModus2_07_Cx1_TP_TC), 2=Cx2_TP_TC_WCMTL (CM_UI1_KompFehlerModus2_07_Cx2_TP_TC_WCMTL), 3=Cx3_TF_TC_Error (CM_UI1_KompFehlerModus2_07_Cx3_TF_TC_Error)
  compu method CM_UI2Sens02_CALID_Index_05: phys=raw for raw 0..255
  compu method CM_UI2_KompFehlerModus2_13: 0=Cx0_TNCTOC (CM_UI2_KompFehlerModus2_13_Cx0_TNCTOC), 1=Cx1_TP_TC (CM_UI2_KompFehlerModus2_13_Cx1_TP_TC), 2=Cx2_TP_TC_WCMTL (CM_UI2_KompFehlerModus2_13_Cx2_TP_TC_WCMTL), 3=Cx3_TF_TC_Error (CM_UI2_KompFehlerModus2_13_Cx3_TF_TC_Error)
  compu method CM_UI1_KompFehlerModus2_08: 0=Cx0_TNCTOC (CM_UI1_KompFehlerModus2_08_Cx0_TNCTOC), 1=Cx1_TP_TC (CM_UI1_KompFehlerModus2_08_Cx1_TP_TC), 2=Cx2_TP_TC_WCMTL (CM_UI1_KompFehlerModus2_08_Cx2_TP_TC_WCMTL), 3=Cx3_TF_TC_Error (CM_UI1_KompFehlerModus2_08_Cx3_TF_TC_Error)
  compu method CM_UI2Sens02_CALID_Index_06: phys=raw for raw 0..255
  compu method CM_UI2_KompFehlerModus2_14: 0=Cx0_TNCTOC (CM_UI2_KompFehlerModus2_14_Cx0_TNCTOC), 1=Cx1_TP_TC (CM_UI2_KompFehlerModus2_14_Cx1_TP_TC), 2=Cx2_TP_TC_WCMTL (CM_UI2_KompFehlerModus2_14_Cx2_TP_TC_WCMTL), 3=Cx3_TF_TC_Error (CM_UI2_KompFehlerModus2_14_Cx3_TF_TC_Error)
  compu method CM_UI1_KompFehlerModus2_09: 0=Cx0_TNCTOC (CM_UI1_KompFehlerModus2_09_Cx0_TNCTOC), 1=Cx1_TP_TC (CM_UI1_KompFehlerModus2_09_Cx1_TP_TC), 2=Cx2_TP_TC_WCMTL (CM_UI1_KompFehlerModus2_09_Cx2_TP_TC_WCMTL), 3=Cx3_TF_TC_Error (CM_UI1_KompFehlerModus2_09_Cx3_TF_TC_Error)
  compu method CM_UI2Sens02_CALID_Index_07: phys=raw for raw 0..255
  compu method CM_UI2Sens02_CALID_Index_08: phys=raw for raw 0..255
  compu method CM_UI1_KompFehlerModus2_10: 0=Cx0_TNCTOC (CM_UI1_KompFehlerModus2_10_Cx0_TNCTOC), 1=Cx1_TP_TC (CM_UI1_KompFehlerModus2_10_Cx1_TP_TC), 2=Cx2_TP_TC_WCMTL (CM_UI1_KompFehlerModus2_10_Cx2_TP_TC_WCMTL), 3=Cx3_TF_TC_Error (CM_UI1_KompFehlerModus2_10_Cx3_TF_TC_Error)
  compu method CM_UI2_KompFehlerModus2_15: 0=Cx0_TNCTOC (CM_UI2_KompFehlerModus2_15_Cx0_TNCTOC), 1=Cx1_TP_TC (CM_UI2_KompFehlerModus2_15_Cx1_TP_TC), 2=Cx2_TP_TC_WCMTL (CM_UI2_KompFehlerModus2_15_Cx2_TP_TC_WCMTL), 3=Cx3_TF_TC_Error (CM_UI2_KompFehlerModus2_15_Cx3_TF_TC_Error)
  compu method CM_UI1_KompFehlerModus2_11: 0=Cx0_TNCTOC (CM_UI1_KompFehlerModus2_11_Cx0_TNCTOC), 1=Cx1_TP_TC (CM_UI1_KompFehlerModus2_11_Cx1_TP_TC), 2=Cx2_TP_TC_WCMTL (CM_UI1_KompFehlerModus2_11_Cx2_TP_TC_WCMTL), 3=Cx3_TF_TC_Error (CM_UI1_KompFehlerModus2_11_Cx3_TF_TC_Error)
  compu method CM_UI2_KompFehlerModus2_16: 0=Cx0_TNCTOC (CM_UI2_KompFehlerModus2_16_Cx0_TNCTOC), 1=Cx1_TP_TC (CM_UI2_KompFehlerModus2_16_Cx1_TP_TC), 2=Cx2_TP_TC_WCMTL (CM_UI2_KompFehlerModus2_16_Cx2_TP_TC_WCMTL), 3=Cx3_TF_TC_Error (CM_UI2_KompFehlerModus2_16_Cx3_TF_TC_Error)
  compu method CM_UI1_KompFehlerModus2_12: 0=Cx0_TNCTOC (CM_UI1_KompFehlerModus2_12_Cx0_TNCTOC), 1=Cx1_TP_TC (CM_UI1_KompFehlerModus2_12_Cx1_TP_TC), 2=Cx2_TP_TC_WCMTL (CM_UI1_KompFehlerModus2_12_Cx2_TP_TC_WCMTL), 3=Cx3_TF_TC_Error (CM_UI1_KompFehlerModus2_12_Cx3_TF_TC_Error)
  compu method CM_UI2_KompFehlerModus2_17: 0=Cx0_TNCTOC (CM_UI2_KompFehlerModus2_17_Cx0_TNCTOC), 1=Cx1_TP_TC (CM_UI2_KompFehlerModus2_17_Cx1_TP_TC), 2=Cx2_TP_TC_WCMTL (CM_UI2_KompFehlerModus2_17_Cx2_TP_TC_WCMTL), 3=Cx3_TF_TC_Error (CM_UI2_KompFehlerModus2_17_Cx3_TF_TC_Error)
  compu method CM_UI1_KompFehlerModus2_13: 0=Cx0_TNCTOC (CM_UI1_KompFehlerModus2_13_Cx0_TNCTOC), 1=Cx1_TP_TC (CM_UI1_KompFehlerModus2_13_Cx1_TP_TC), 2=Cx2_TP_TC_WCMTL (CM_UI1_KompFehlerModus2_13_Cx2_TP_TC_WCMTL), 3=Cx3_TF_TC_Error (CM_UI1_KompFehlerModus2_13_Cx3_TF_TC_Error)
  compu method CM_UI2_KompFehlerModus2_18: 0=Cx0_TNCTOC (CM_UI2_KompFehlerModus2_18_Cx0_TNCTOC), 1=Cx1_TP_TC (CM_UI2_KompFehlerModus2_18_Cx1_TP_TC), 2=Cx2_TP_TC_WCMTL (CM_UI2_KompFehlerModus2_18_Cx2_TP_TC_WCMTL), 3=Cx3_TF_TC_Error (CM_UI2_KompFehlerModus2_18_Cx3_TF_TC_Error)
  compu method CM_UI1_KompFehlerModus2_14: 0=Cx0_TNCTOC (CM_UI1_KompFehlerModus2_14_Cx0_TNCTOC), 1=Cx1_TP_TC (CM_UI1_KompFehlerModus2_14_Cx1_TP_TC), 2=Cx2_TP_TC_WCMTL (CM_UI1_KompFehlerModus2_14_Cx2_TP_TC_WCMTL), 3=Cx3_TF_TC_Error (CM_UI1_KompFehlerModus2_14_Cx3_TF_TC_Error)
  compu method CM_UI2_KompFehlerModus2_19: 0=Cx0_TNCTOC (CM_UI2_KompFehlerModus2_19_Cx0_TNCTOC), 1=Cx1_TP_TC (CM_UI2_KompFehlerModus2_19_Cx1_TP_TC), 2=Cx2_TP_TC_WCMTL (CM_UI2_KompFehlerModus2_19_Cx2_TP_TC_WCMTL), 3=Cx3_TF_TC_Error (CM_UI2_KompFehlerModus2_19_Cx3_TF_TC_Error)
  compu method CM_UI1_KompFehlerModus2_15: 0=Cx0_TNCTOC (CM_UI1_KompFehlerModus2_15_Cx0_TNCTOC), 1=Cx1_TP_TC (CM_UI1_KompFehlerModus2_15_Cx1_TP_TC), 2=Cx2_TP_TC_WCMTL (CM_UI1_KompFehlerModus2_15_Cx2_TP_TC_WCMTL), 3=Cx3_TF_TC_Error (CM_UI1_KompFehlerModus2_15_Cx3_TF_TC_Error)
  compu method CM_UI2_KompFehlerModus2_20: 0=Cx0_TNCTOC (CM_UI2_KompFehlerModus2_20_Cx0_TNCTOC), 1=Cx1_TP_TC (CM_UI2_KompFehlerModus2_20_Cx1_TP_TC), 2=Cx2_TP_TC_WCMTL (CM_UI2_KompFehlerModus2_20_Cx2_TP_TC_WCMTL), 3=Cx3_TF_TC_Error (CM_UI2_KompFehlerModus2_20_Cx3_TF_TC_Error)
  compu method CM_UI1_KompFehlerModus2_16: 0=Cx0_TNCTOC (CM_UI1_KompFehlerModus2_16_Cx0_TNCTOC), 1=Cx1_TP_TC (CM_UI1_KompFehlerModus2_16_Cx1_TP_TC), 2=Cx2_TP_TC_WCMTL (CM_UI1_KompFehlerModus2_16_Cx2_TP_TC_WCMTL), 3=Cx3_TF_TC_Error (CM_UI1_KompFehlerModus2_16_Cx3_TF_TC_Error)
  compu method CM_UI2_KompFehlerModus2_21: 0=Cx0_TNCTOC (CM_UI2_KompFehlerModus2_21_Cx0_TNCTOC), 1=Cx1_TP_TC (CM_UI2_KompFehlerModus2_21_Cx1_TP_TC), 2=Cx2_TP_TC_WCMTL (CM_UI2_KompFehlerModus2_21_Cx2_TP_TC_WCMTL), 3=Cx3_TF_TC_Error (CM_UI2_KompFehlerModus2_21_Cx3_TF_TC_Error)
  compu method CM_UI1_KompFehlerModus2_17: 0=Cx0_TNCTOC (CM_UI1_KompFehlerModus2_17_Cx0_TNCTOC), 1=Cx1_TP_TC (CM_UI1_KompFehlerModus2_17_Cx1_TP_TC), 2=Cx2_TP_TC_WCMTL (CM_UI1_KompFehlerModus2_17_Cx2_TP_TC_WCMTL), 3=Cx3_TF_TC_Error (CM_UI1_KompFehlerModus2_17_Cx3_TF_TC_Error)
  compu method CM_UI2_KompFehlerModus2_22: 0=Cx0_TNCTOC (CM_UI2_KompFehlerModus2_22_Cx0_TNCTOC), 1=Cx1_TP_TC (CM_UI2_KompFehlerModus2_22_Cx1_TP_TC), 2=Cx2_TP_TC_WCMTL (CM_UI2_KompFehlerModus2_22_Cx2_TP_TC_WCMTL), 3=Cx3_TF_TC_Error (CM_UI2_KompFehlerModus2_22_Cx3_TF_TC_Error)
  compu method CM_UI2_KompFehlerModus2_23: 0=Cx0_TNCTOC (CM_UI2_KompFehlerModus2_23_Cx0_TNCTOC), 1=Cx1_TP_TC (CM_UI2_KompFehlerModus2_23_Cx1_TP_TC), 2=Cx2_TP_TC_WCMTL (CM_UI2_KompFehlerModus2_23_Cx2_TP_TC_WCMTL), 3=Cx3_TF_TC_Error (CM_UI2_KompFehlerModus2_23_Cx3_TF_TC_Error)
  compu method CM_Airbag_10_BZ: phys=raw for raw 0..15
  compu method CM_Airbag_10_CRC: phys=raw for raw 0..255
  compu method CM_Anzeige_SOC: phys=raw*0.1 for raw 0..1000, 1001=Cx3e9_reserviert (CM_Anzeige_SOC_Cx3e9_reserviert), 1002=Cx3ea_reserviert (CM_Anzeige_SOC_Cx3ea_reserviert), 1003=Cx3eb_reserviert (CM_Anzeige_SOC_Cx3eb_reserviert), 1004=Cx3ec_reserviert (CM_Anzeige_SOC_Cx3ec_reserviert), 1005=Cx3ed_reserviert (CM_Anzeige_SOC_Cx3ed_reserviert), 1006=Cx3ee_reserviert (CM_Anzeige_SOC_Cx3ee_reserviert), 1007=Cx3ef_reserviert (CM_Anzeige_SOC_Cx3ef_reserviert), 1008=Cx3f0_reserviert (CM_Anzeige_SOC_Cx3f0_reserviert), 1009=Cx3f1_reserviert (CM_Anzeige_SOC_Cx3f1_reserviert), 1010=Cx3f2_reserviert (CM_Anzeige_SOC_Cx3f2_reserviert), 1011=Cx3f3_reserviert (CM_Anzeige_SOC_Cx3f3_reserviert), 1012=Cx3f4_reserviert (CM_Anzeige_SOC_Cx3f4_reserviert), 1013=Cx3f5_reserviert (CM_Anzeige_SOC_Cx3f5_reserviert), 1014=Cx3f6_reserviert (CM_Anzeige_SOC_Cx3f6_reserviert), 1015=Cx3f7_reserviert (CM_Anzeige_SOC_Cx3f7_reserviert), 1016=Cx3f8_reserviert (CM_Anzeige_SOC_Cx3f8_reserviert), 1017=Cx3f9_reserviert (CM_Anzeige_SOC_Cx3f9_reserviert), 1018=Cx3fa_reserviert (CM_Anzeige_SOC_Cx3fa_reserviert), 1019=Cx3fb_reserviert (CM_Anzeige_SOC_Cx3fb_reserviert), 1020=Cx3fc_reserviert (CM_Anzeige_SOC_Cx3fc_reserviert), 1021=Cx3fd_reserviert (CM_Anzeige_SOC_Cx3fd_reserviert), 1022=Cx3fe_Init (CM_Anzeige_SOC_Cx3fe_Init), 1023=Cx3ff_Fehler (CM_Anzeige_SOC_Cx3ff_Fehler); unit Unit_PerCent
  compu method CM_BEM_Batt_Ab: 0=Cx0_verbunden (CM_BEM_Batt_Ab_Cx0_verbunden), 1=Cx1_nicht_verbunden (CM_BEM_Batt_Ab_Cx1_nicht_verbunden)
  compu method CM_BEM_Generatordiagnose: 0=Cx0_keine_Anzeige (CM_BEM_Generatordiagnose_Cx0_keine_Anzeige) (keine Anzeige), 1=Cx1_Ladekontrollanzeige_ein_Vorhalt (CM_BEM_Generatordiagnose_Cx1_Ladekontrollanzeige_ein_Vorhalt) (Ladekontrollanzeige ein (Vorhalt)), 2=Cx2_rotes_Batteriesymbol_und_Text_Generator_defekt (CM_BEM_Generatordiagnose_Cx2_rotes_Batteriesymbol_und_Text_Generator_defekt) (rotes Batteriesymbol und Text (Generator defekt)), 3=Cx3_Hybrid_DCDC_Wandler_defekt (CM_BEM_Generatordiagnose_Cx3_Hybrid_DCDC_Wandler_defekt)
  compu method CM_BEM_HL_Regelung_Status: 0=Cx0_HL_Regelung_inaktiv_vor_und_waehrend_Motorstart (CM_BEM_HL_Regelung_Status_Cx0_HL_Regelung_inaktiv_vor_und_waehrend_Motorstart) (HL_Regelung_inaktiv_(vor_und_waehrend_Motorstart)), 1=Cx1_HL_Regelung_Stufe_1 (CM_BEM_HL_Regelung_Status_Cx1_HL_Regelung_Stufe_1), 2=Cx2_HL_Regelung_Stufe_2 (CM_BEM_HL_Regelung_Status_Cx2_HL_Regelung_Stufe_2), 3=Cx3_HL_Regelung_Stufe_3 (CM_BEM_HL_Regelung_Status_Cx3_HL_Regelung_Stufe_3), 4=Cx4_Verbrauchernotabschaltung_VNA (CM_BEM_HL_Regelung_Status_Cx4_Verbrauchernotabschaltung_VNA) (Verbrauchernotabschaltung_(VNA)), 5=Cx5_HL_Regelung_Stufe_5 (CM_BEM_HL_Regelung_Status_Cx5_HL_Regelung_Stufe_5), 7=Cx7_Default (CM_BEM_HL_Regelung_Status_Cx7_Default)
  compu method CM_BEM_Red_Innengeblaese: 0=Cx0_keine_Reduzierung (CM_BEM_Red_Innengeblaese_Cx0_keine_Reduzierung) (keine Reduzierung), 1=Cx1_Reduzierung_Stufe_1 (CM_BEM_Red_Innengeblaese_Cx1_Reduzierung_Stufe_1) (Reduzierung Stufe 1), 2=Cx2_Reduzierung_Stufe_2 (CM_BEM_Red_Innengeblaese_Cx2_Reduzierung_Stufe_2) (Reduzierung Stufe 2), 3=Cx3_Reduzierung_Stufe_2_und_Abschaltung_Kompressor (CM_BEM_Red_Innengeblaese_Cx3_Reduzierung_Stufe_2_und_Abschaltung_Kompressor) (Reduzierung Stufe 2 und Abschaltung Kompressor)
  compu method CM_BEM_STH_Einschaltverbot: 0=Cx0_volle_Verfuegbarkeit_Standheizung_lueftung (CM_BEM_STH_Einschaltverbot_Cx0_volle_Verfuegbarkeit_Standheizung_lueftung) (volle Verfuegbarkeit Standheizung/-lueftung), 1=Cx1_Standheizung_lueftung_nicht_aktivierbar (CM_BEM_STH_Einschaltverbot_Cx1_Standheizung_lueftung_nicht_aktivierbar) (Standheizung/-lueftung nicht aktivierbar)
  compu method CM_BEM_STH_Zielzeit: phys=raw*5 for raw 0..12, 14=Cxe_Init (CM_BEM_STH_Zielzeit_Cxe_Init), 15=Cxf_Fehler (CM_BEM_STH_Zielzeit_Cxf_Fehler); unit Unit_Minut
  compu method CM_BJB_CALID_Index_01: 0=Cx0_Init (CM_BJB_CALID_Index_01_Cx0_Init)
package /Interfaces/Types
  impl type DEV_Hybrid_01_Req_00_FD_Data: category=ARRAY
    element DEV_Hybrid_01_Req_00_FD_DataBase: array-size=64, array-size-semantics=FIXED-SIZE, implementation-data-type=ImplementationDataTypes/uint8
    symbol props SymbolProps: symbol=DEV_Hybrid_01_Req_00_FD_Data
  impl type DEV_Hybrid_01_Resp_FF_FD_Data: category=ARRAY
    element DEV_Hybrid_01_Resp_FF_FD_DataBase: array-size=64, array-size-semantics=FIXED-SIZE, implementation-data-type=ImplementationDataTypes/uint8
    symbol props SymbolProps: symbol=DEV_Hybrid_01_Resp_FF_FD_Data
package /Constraints
  range DC_AB_Gurtwarn_Reihe3_FA: raw 0..3
  range DC_BMC_CMC_Temperatur_018: phys -40..86 Unit_DegreCelsi, raw 0..255
  range DC_AB_Gurtwarn_Reihe3_MI: raw 0..3
  range DC_BMC_CMC_Temperatur_019: phys -40..86 Unit_DegreCelsi, raw 0..255
  range DC_BMC_CMC_Zellspannung_044: phys 1000..5091 Unit_MilliVolt, raw 0..4095
  range DC_AB_Gurtwarn_VB: raw 0..1
  range DC_BMC_CMC_Temperatur_01_Messzeit: phys 0..253 Unit_None, raw 0..255
  range DC_BMC_CMC_Temperatur_020: phys -40..86 Unit_DegreCelsi, raw 0..255
  range DC_BMC_CMC_Temperatur_021: phys -40..86 Unit_DegreCelsi, raw 0..255
  range DC_AB_Gurtwarn_VF: raw 0..1
  range DC_BMC_CMC_Zellspannung_045: phys 1000..5091 Unit_MilliVolt, raw 0..4095
  range DC_BMC_CMC_Temperatur_022: phys -40..86 Unit_DegreCelsi, raw 0..255
  range DC_BMC_CMC_Zellspannung_046: phys 1000..5091 Unit_MilliVolt, raw 0..4095
  range DC_BMC_CMC_Temperatur_023: phys -40..86 Unit_DegreCelsi, raw 0..255
  range DC_BMC_CMC_Zellspannung_047: phys 1000..5091 Unit_MilliVolt, raw 0..4095
  range DC_AB_Heck_Crash: raw 0..1
  range DC_BMC_CMC_Zellspannung_048: phys 1000..5091 Unit_MilliVolt, raw 0..4095
  range DC_BMC_CMC_Temperatur_024: phys -40..86 Unit_DegreCelsi, raw 0..255
  range DC_BMC_CMC_Zellspannung_049: phys 1000..5091 Unit_MilliVolt, raw 0..4095
  range DC_AB_Lampe: raw 0..1
  range DC_BMC_CMC_Temperatur_025: phys -40..86 Unit_DegreCelsi, raw 0..255
  range DC_BMC_CMC_Zellspannung_04_Messzeit: phys 0..253 Unit_None, raw 0..255
  range DC_BMC_CMC_Temperatur_026: phys -40..86 Unit_DegreCelsi, raw 0..255
  range DC_BMC_CMC_Zellspannung_050: phys 1000..5091 Unit_MilliVolt, raw 0..4095
  range DC_AB_PSS_SollZustand: raw 0..1
  range DC_BMC_CMC_Temperatur_027: phys -40..86 Unit_DegreCelsi, raw 0..255
  range DC_BMC_CMC_Zellspannung_051: phys 1000..5091 Unit_MilliVolt, raw 0..4095
  range DC_BMC_CMC_Zellspannung_074: phys 1000..5091 Unit_MilliVolt, raw 0..4095
  range DC_BMC_CMC_Zellspannung_052: phys 1000..5091 Unit_MilliVolt, raw 0..4095
  range DC_BMC_CMC_Temperatur_028: phys -40..86 Unit_DegreCelsi, raw 0..255
  range DC_AB_Rollover_Crash: raw 0..1
  range DC_BMC_CMC_Zellspannung_053: phys 1000..5091 Unit_MilliVolt, raw 0..4095
  range DC_BMC_CMC_Temperatur_029: phys -40..86 Unit_DegreCelsi, raw 0..255
  range DC_BMC_CMC_Zellspannung_138: phys 1000..5091 Unit_MilliVolt, raw 0..4095
  range DC_BMC_CMC_Zellspannung_054: phys 1000..5091 Unit_MilliVolt, raw 0..4095
  range DC_BMC_CMC_Temperatur_02_Messzeit: phys 0..253 Unit_None, raw 0..255
  range DC_BMC_CMC_Zellspannung_075: phys 1000..5091 Unit_MilliVolt, raw 0..4095
  range DC_AB_SB_Crash: raw 0..1
  range DC_BMC_CMC_Zellspannung_055: phys 1000..5091 Unit_MilliVolt, raw 0..4095
  range DC_BMC_CMC_Temperatur_079: phys -40..86 Unit_DegreCelsi, raw 0..255
  range DC_BMC_CMC_Temperatur_030: phys -40..86 Unit_DegreCelsi, raw 0..255
  range DC_BMC_CMC_Zellspannung_056: phys 1000..5091 Unit_MilliVolt, raw 0..4095
  range DC_BMC_CMC_Zellspannung_076: phys 1000..5091 Unit_MilliVolt, raw 0..4095
  range DC_BMC_CMC_Temperatur_031: phys -40..86 Unit_DegreCelsi, raw 0..255
  range DC_AB_SBR_hinten_verbau: raw 0..3
  range DC_BMC_CMC_Zellspannung_057: phys 1000..5091 Unit_MilliVolt, raw 0..4095
  range DC_BMC_CMC_Temperatur_032: phys -40..86 Unit_DegreCelsi, raw 0..255
  range DC_BMC_CMC_Zellspannung_077: phys 1000..5091 Unit_MilliVolt, raw 0..4095
  range DC_BMC_CMC_Zellspannung_139: phys 1000..5091 Unit_MilliVolt, raw 0..4095
  range DC_BMC_CMC_Temperatur_033: phys -40..86 Unit_DegreCelsi, raw 0..255
  range DC_BMC_CMC_Temperatur_080: phys -40..86 Unit_DegreCelsi, raw 0..255
  range DC_AB_SF_Crash: raw 0..1
  range DC_BMC_CMC_Zellspannung_078: phys 1000..5091 Unit_MilliVolt, raw 0..4095
  range DC_BMC_CMC_Zellspannung_058: phys 1000..5091 Unit_MilliVolt, raw 0..4095
  range DC_BMC_CMC_Zellspannung_140: phys 1000..5091 Unit_MilliVolt, raw 0..4095
  range DC_BMC_CMC_Temperatur_034: phys -40..86 Unit_DegreCelsi, raw 0..255
  range DC_BMC_CMC_Temperatur_081: phys -40..86 Unit_DegreCelsi, raw 0..255
  range DC_BMC_CMC_Zellspannung_079: phys 1000..5091 Unit_MilliVolt, raw 0..4095
  range DC_BMC_CMC_Zellspannung_141: phys 1000..5091 Unit_MilliVolt, raw 0..4095
  range DC_BMC_CMC_Zellspannung_059: phys 1000..5091 Unit_MilliVolt, raw 0..4095
  range DC_BMC_CMC_Temperatur_035: phys -40..86 Unit_DegreCelsi, raw 0..255
  range DC_AB_Sitzpos_Sens_BF: raw 0..3
  range DC_BMC_CMC_Temperatur_082: phys -40..86 Unit_DegreCelsi, raw 0..255
  range DC_BMC_CMC_Zellspannung_080: phys 1000..5091 Unit_MilliVolt, raw 0..4095
  range DC_BMC_CMC_Temperatur_036: phys -40..86 Unit_DegreCelsi, raw 0..255
  range DC_BMC_CMC_Zellspannung_05_Messzeit: phys 0..253 Unit_None, raw 0..255
  range DC_BMC_CMC_Zellspannung_142: phys 1000..5091 Unit_MilliVolt, raw 0..4095
  range DC_BMC_CMC_Temperatur_083: phys -40..86 Unit_DegreCelsi, raw 0..255
  range DC_AB_Sitzpos_Sens_FA: raw 0..3
  range DC_BMC_CMC_Temperatur_037: phys -40..86 Unit_DegreCelsi, raw 0..255
  range DC_BMC_CMC_Zellspannung_060: phys 1000..5091 Unit_MilliVolt, raw 0..4095
  range DC_BMC_CMC_Zellspannung_143: phys 1000..5091 Unit_MilliVolt, raw 0..4095
  range DC_BMC_CMC_Zellspannung_081: phys 1000..5091 Unit_MilliVolt, raw 0..4095
  range DC_BMC_CMC_Temperatur_038: phys -40..86 Unit_DegreCelsi, raw 0..255
  range DC_BMC_CMC_Temperatur_084: phys -40..86 Unit_DegreCelsi, raw 0..255
  range DC_BMC_CMC_Zellspannung_061: phys 1000..5091 Unit_MilliVolt, raw 0..4095
  range DC_BMC_CMC_Zellspannung_082: phys 1000..5091 Unit_MilliVolt, raw 0..4095
  range DC_BMC_CMC_Temperatur_039: phys -40..86 Unit_DegreCelsi, raw 0..255
  range DC_BMC_CMC_Zellspannung_144: phys 1000..5091 Unit_MilliVolt, raw 0..4095
  range DC_BMC_CMC_Temperatur_085: phys -40..86 Unit_DegreCelsi, raw 0..255
  range DC_AB_Stellgliedtest: raw 0..1
  range DC_BMC_CMC_Zellspannung_062: phys 1000..5091 Unit_MilliVolt, raw 0..4095
  range DC_BMC_CMC_Zellspannung_083: phys 1000..5091 Unit_MilliVolt, raw 0..4095
  range DC_BMC_CMC_Temperatur_03_Messzeit: phys 0..253 Unit_None, raw 0..255
  range DC_BMC_CMC_Zellspannung_145: phys 1000..5091 Unit_MilliVolt, raw 0..4095
  range DC_BMC_CMC_Temperatur_086: phys -40..86 Unit_DegreCelsi, raw 0..255
  range DC_BMC_CMC_Temperatur_040: phys -40..86 Unit_DegreCelsi, raw 0..255
  range DC_BMC_CMC_Zellspannung_170: phys 1000..5091 Unit_MilliVolt, raw 0..4095
  range DC_BMC_CMC_Zellspannung_084: phys 1000..5091 Unit_MilliVolt, raw 0..4095
  range DC_BMC_CMC_Zellspannung_063: phys 1000..5091 Unit_MilliVolt, raw 0..4095
  range DC_BMC_CMC_Zellspannung_146: phys 1000..5091 Unit_MilliVolt, raw 0..4095
  range DC_BMC_CMC_Temperatur_041: phys -40..86 Unit_DegreCelsi, raw 0..255
  range DC_BMC_CMC_Temperatur_087: phys -40..86 Unit_DegreCelsi, raw 0..255
  range DC_AB_Systemfehler: raw 0..1
  range DC_BMC_CMC_Temperatur_042: phys -40..86 Unit_DegreCelsi, raw 0..255
  range DC_BMC_CMC_Zellspannung_064: phys 1000..5091 Unit_MilliVolt, raw 0..4095
  range DC_BMC_CMC_Zellspannung_085: phys 1000..5091 Unit_MilliVolt, raw 0..4095
  range DC_BMC_CMC_Zellspannung_147: phys 1000..5091 Unit_MilliVolt, raw 0..4095
  range DC_BMC_CMC_Temperatur_088: phys -40..86 Unit_DegreCelsi, raw 0..255
  range DC_BMC_CMC_Temperatur_043: phys -40..86 Unit_DegreCelsi, raw 0..255
  range DC_BMC_CMC_Zellspannung_065: phys 1000..5091 Unit_MilliVolt, raw 0..4095
  range DC_AB_Versorgungsspannung: raw 0..1
  range DC_BMC_CMC_Zellspannung_171: phys 1000..5091 Unit_MilliVolt, raw 0..4095
  range DC_BMC_CMC_Zellspannung_148: phys 1000..5091 Unit_MilliVolt, raw 0..4095
  range DC_BMC_CMC_Zellspannung_086: phys 1000..5091 Unit_MilliVolt, raw 0..4095
  range DC_BMC_CMC_Temperatur_089: phys -40..86 Unit_DegreCelsi, raw 0..255
  range DC_BMC_CMC_Temperatur_044: phys -40..86 Unit_DegreCelsi, raw 0..255
  range DC_BMC_CMC_Zellspannung_066: phys 1000..5091 Unit_MilliVolt, raw 0..4095
  range DC_BMC_CMC_Zellspannung_087: phys 1000..5091 Unit_MilliVolt, raw 0..4095
  range DC_BMC_CMC_Zellspannung_172: phys 1000..5091 Unit_MilliVolt, raw 0..4095
  range DC_BMC_CMC_Temperatur_045: phys -40..86 Unit_DegreCelsi, raw 0..255
  range DC_BMC_CMC_Temperatur_090: phys -40..86 Unit_DegreCelsi, raw 0..255
  range DC_AB_VRU_Crash: raw 0..1
  range DC_BMC_CMC_Zellspannung_067: phys 1000..5091 Unit_MilliVolt, raw 0..4095
  range DC_BMC_CMC_Temperatur_046: phys -40..86 Unit_DegreCelsi, raw 0..255
  range DC_BMC_CMC_Zellspannung_088: phys 1000..5091 Unit_MilliVolt, raw 0..4095
  range DC_BMC_CMC_Zellspannung_173: phys 1000..5091 Unit_MilliVolt, raw 0..4095
  range DC_BMC_CMC_Temperatur_091: phys -40..86 Unit_DegreCelsi, raw 0..255
  range DC_BMC_CMC_Temperatur_047: phys -40..86 Unit_DegreCelsi, raw 0..255
  range DC_BMC_CMC_Zellspannung_174: phys 1000..5091 Unit_MilliVolt, raw 0..4095
  range DC_BMC_CMC_Zellspannung_068: phys 1000..5091 Unit_MilliVolt, raw 0..4095
  range DC_BMC_CMC_Zellspannung_089: phys 1000..5091 Unit_MilliVolt, raw 0..4095
  range DC_Airbag_10_BZ: phys 0..15, raw 0..15
  range DC_BMC_CMC_Temperatur_092: phys -40..86 Unit_DegreCelsi, raw 0..255
  range DC_BMC_CMC_Temperatur_048: phys -40..86 Unit_DegreCelsi, raw 0..255
  range DC_BMC_CMC_Zellspannung_175: phys 1000..5091 Unit_MilliVolt, raw 0..4095
  range DC_BMC_CMC_Zellspannung_069: phys 1000..5091 Unit_MilliVolt, raw 0..4095
  range DC_BMC_CMC_Zellspannung_090: phys 1000..5091 Unit_MilliVolt, raw 0..4095
  range DC_BMC_CMC_Temperatur_093: phys -40..86 Unit_DegreCelsi, raw 0..255
  range DC_BMC_CMC_Temperatur_049: phys -40..86 Unit_DegreCelsi, raw 0..255
  range DC_BMC_CMC_Zellspannung_176: phys 1000..5091 Unit_MilliVolt, raw 0..4095
  range DC_BMC_CMC_Temperatur_050: phys -40..86 Unit_DegreCelsi, raw 0..255
  range DC_BMC_CMC_Zellspannung_070: phys 1000..5091 Unit_MilliVolt, raw 0..4095
  range DC_BMC_CMC_Temperatur_094: phys -40..86 Unit_DegreCelsi, raw 0..255
  range DC_BMC_CMC_Zellspannung_091: phys 1000..5091 Unit_MilliVolt, raw 0..4095
  range DC_Airbag_10_CRC: phys 0..255, raw 0..255
  range DC_BMC_CMC_Zellspannung_177: phys 1000..5091 Unit_MilliVolt, raw 0..4095
  range DC_BMC_CMC_Temperatur_051: phys -40..86 Unit_DegreCelsi, raw 0..255
  range DC_BMC_CMC_Zellspannung_071: phys 1000..5091 Unit_MilliVolt, raw 0..4095
  range DC_BMC_CMC_Temperatur_052: phys -40..86 Unit_DegreCelsi, raw 0..255
  range DC_BMC_CMC_Zellspannung_178: phys 1000..5091 Unit_MilliVolt, raw 0..4095
  range DC_BMC_CMC_Zellspannung_092: phys 1000..5091 Unit_MilliVolt, raw 0..4095
  range DC_BMC_CMC_Temperatur_095: phys -40..86 Unit_DegreCelsi, raw 0..255
  range DC_BMC_CMC_Zellspannung_072: phys 1000..5091 Unit_MilliVolt, raw 0..4095
  range DC_BMC_KundenWarnung: raw 0..2
  range DC_BMC_CMC_Temperatur_053: phys -40..86 Unit_DegreCelsi, raw 0..255
  range DC_Anzeige_SOC: phys 0..100 Unit_PerCent, raw 0..1023
  range DC_BMC_CMC_Zellspannung_179: phys 1000..5091 Unit_MilliVolt, raw 0..4095
  range DC_BMC_CMC_Zellspannung_093: phys 1000..5091 Unit_MilliVolt, raw 0..4095
  range DC_BMC_CMC_Temperatur_096: phys -40..86 Unit_DegreCelsi, raw 0..255
  range DC_BMC_CMC_Zellspannung_180: phys 1000..5091 Unit_MilliVolt, raw 0..4095
  range DC_BMC_CMC_Temperatur_054: phys -40..86 Unit_DegreCelsi, raw 0..255
  range DC_BMC_CMC_Zellspannung_073: phys 1000..5091 Unit_MilliVolt, raw 0..4095
  range DC_BMC_CMC_Zellspannung_094: phys 1000..5091 Unit_MilliVolt, raw 0..4095
  range DC_BMC_CMC_Zellspannung_001: phys 1000..5091 Unit_MilliVolt, raw 0..4095
  range DC_BMC_CMC_Zellspannung_181: phys 1000..5091 Unit_MilliVolt, raw 0..4095
  range DC_BEM_Batt_Ab: raw 0..1
  range DC_BMC_CMC_Temperatur_055: phys -40..86 Unit_DegreCelsi, raw 0..255
  range DC_BMC_CMC_Zellspannung_095: phys 1000..5091 Unit_MilliVolt, raw 0..4095
  range DC_BMC_CMC_Temperatur_056: phys -40..86 Unit_DegreCelsi, raw 0..255
  range DC_BMC_CMC_Zellspannung_002: phys 1000..5091 Unit_MilliVolt, raw 0..4095
  range DC_BMC_CMC_Zellspannung_182: phys 1000..5091 Unit_MilliVolt, raw 0..4095
  range DC_DC_IstModus_02: raw 0..7
  range DC_BJB_CALID_Index_07: raw 0
  range DC_BMC_CMC_Temperatur_057: phys -40..86 Unit_DegreCelsi, raw 0..255
  range DC_BMC_CMC_Zellspannung_183: phys 1000..5091 Unit_MilliVolt, raw 0..4095
  range DC_BMC_CMC_Zellspannung_003: phys 1000..5091 Unit_MilliVolt, raw 0..4095
  range DC_BEM_Generatordiagnose: raw 0..3
  range DC_BMC_CMC_Zellspannung_096: phys 1000..5091 Unit_MilliVolt, raw 0..4095
  range DC_DC_Vorladung_Status: raw 0..1
  range DC_BMC_CMC_Temperatur_058: phys -40..86 Unit_DegreCelsi, raw 0..255
  range DC_BMC_CMC_Zellspannung_184: phys 1000..5091 Unit_MilliVolt, raw 0..4095
  range DC_BMC_Lebensdauer_Trennelemente: phys 0..100000 Unit_None, raw 0..131071
  range DC_BMC_CMC_Zellspannung_004: phys 1000..5091 Unit_MilliVolt, raw 0..4095
  range DC_BMC_CMC_Zellspannung_097: phys 1000..5091 Unit_MilliVolt, raw 0..4095
  range DC_BMC_CMC_Zellspannung_185: phys 1000..5091 Unit_MilliVolt, raw 0..4095
  range DC_BMC_CMC_Temperatur_059: phys -40..86 Unit_DegreCelsi, raw 0..255
  range DC_DCDC_HVK_EoHVL_Status: raw 0..3
  range DC_BEM_HL_Regelung_Status: raw 0..7
  range DC_BMC_Leerlaufspannung: phys 0..1021 Unit_Volt, raw 0..1023
  range DC_BMC_CMC_Zellspannung_005: phys 1000..5091 Unit_MilliVolt, raw 0..4095
  range DC_BMC_CMC_Zellspannung_186: phys 1000..5091 Unit_MilliVolt, raw 0..4095
  range DC_BMC_CMC_Temperatur_060: phys -40..86 Unit_DegreCelsi, raw 0..255
  range DC_BMC_RtmWarnTZelleMin: raw 0..7
  range DC_BMC_CMC_Zellspannung_098: phys 1000..5091 Unit_MilliVolt, raw 0..4095
  range DC_DCDC_HVK_Fehler_AE: raw 0..3
  range DC_BMC_CMC_Temperatur_061: phys -40..86 Unit_DegreCelsi, raw 0..255
  range DC_DCDC_NV_Komponentenfehler_07: raw 0..3
  range DC_BMC_CMC_Zellspannung_006: phys 1000..5091 Unit_MilliVolt, raw 0..4095
  range DC_BMC_Max_Entladeleistung: phys 0..818900 Unit_Watt, raw 0..8191
  range DC_BMC_CMC_Zellspannung_187: phys 1000..5091 Unit_MilliVolt, raw 0..4095
  range DC_BMC_CMC_Zellspannung_099: phys 1000..5091 Unit_MilliVolt, raw 0..4095
  range DC_BMC_CMC_Temperatur_062: phys -40..86 Unit_DegreCelsi, raw 0..255
  range DC_BJB_CALID_Index_08: raw 0
  range DC_DCDC_HVK_Fehler_SD: raw 0..3
  range DC_BMC_CMC_Zellspannung_188: phys 1000..5091 Unit_MilliVolt, raw 0..4095
  range DC_BEM_Red_Innengeblaese: raw 0..3
  range DC_BMC_CMC_Zellspannung_015: phys 1000..5091 Unit_MilliVolt, raw 0..4095
  range DC_DCDC_NV_Komponentenfehler_08: raw 0..3
  range DC_BMC_CMC_Temperatur_063: phys -40..86 Unit_DegreCelsi, raw 0..255
  range DC_BMC_CMC_Zellspannung_100: phys 1000..5091 Unit_MilliVolt, raw 0..4095
  range DC_BMC_CMC_Zellspannung_007: phys 1000..5091 Unit_MilliVolt, raw 0..4095
  range DC_BMC_Max_Entladeleistung_02: phys 0..3250000 Unit_Watt, raw 0..32767
  range DC_BMC_CMC_Zellspannung_189: phys 1000..5091 Unit_MilliVolt, raw 0..4095
  range DC_BMC_RtmWarnUeberstrom: raw 0..7
  range DC_DCDC_NV_CALID_Index_01: phys 0..255, raw 0..255
  range DC_DCDC_NV_Komponentenfehler_09: raw 0..3
  range DC_BMC_CMC_Temperatur_064: phys -40..86 Unit_DegreCelsi, raw 0..255
  range DC_BMC_CMC_Zellspannung_190: phys 1000..5091 Unit_MilliVolt, raw 0..4095
  range DC_BMC_CMC_Zellspannung_008: phys 1000..5091 Unit_MilliVolt, raw 0..4095
  range DC_BJB_CALID_Index_09: raw 0
  range DC_BMC_Max_Entladestrom: phys 0..1637.8 Unit_Amper, raw 0..8191
  range DC_BMC_RtmWarnUPackMax: raw 0..7
  range DC_BMC_CMC_Zellspannung_101: phys 1000..5091 Unit_MilliVolt, raw 0..4095
  range DC_BEM_STH_Einschaltverbot: raw 0..1
  range DC_DCDC_NV_CALID_Index_02: phys 0..255, raw 0..255
  range DC_BMC_CMC_Temperatur_065: phys -40..86 Unit_DegreCelsi, raw 0..255
  range DC_BMC_CMC_Zellspannung_191: phys 1000..5091 Unit_MilliVolt, raw 0..4095
  range DC_DCDC_NV_Komponentenfehler_10: raw 0..3
  range DC_BMC_RtmWarnUPackMin: raw 0..7
  range DC_BMC_CMC_Zellspannung_009: phys 1000..5091 Unit_MilliVolt, raw 0..4095
  range DC_BMC_CMC_Temperatur_066: phys -40..86 Unit_DegreCelsi, raw 0..255
  range DC_BMC_Max_Entladestrom_02: phys 0..3250 Unit_Amper, raw 0..16383
  range DC_BMC_CMC_Zellspannung_102: phys 1000..5091 Unit_MilliVolt, raw 0..4095
  range DC_DCDC_NV_CALID_Index_03: phys 0..255, raw 0..255
  range DC_BMC_CMC_Zellspannung_192: phys 1000..5091 Unit_MilliVolt, raw 0..4095
  range DC_BJB_CALID_Index_10: raw 0
  range DC_BMC_RtmWarnUZelleMax: raw 0..7
  range DC_BMC_CMC_Temperatur_067: phys -40..86 Unit_DegreCelsi, raw 0..255
  range DC_DCDC_NV_Komponentenfehler_11: raw 0..3
  range DC_BEM_STH_Zielzeit: phys 0..60 Unit_Minut, raw 0..15
  range DC_BMC_CMC_Zellspannung_010: phys 1000..5091 Unit_MilliVolt, raw 0..4095
  range DC_BMC_Max_Ladeleistung: phys 0..818900 Unit_Watt, raw 0..8191
  range DC_BMC_CMC_Zellspannung_103: phys 1000..5091 Unit_MilliVolt, raw 0..4095
  range DC_BMC_Datenuebernahme_Anf: raw 0..1
  range DC_BMC_CMC_Zellspannung_016: phys 1000..5091 Unit_MilliVolt, raw 0..4095
  range DC_DCDC_NV_CALID_Index_04: phys 0..255, raw 0..255
  range DC_BMC_CMC_Temperatur_068: phys -40..86 Unit_DegreCelsi, raw 0..255
  range DC_BMC_RtmWarnUZelleMin: raw 0..7
  range DC_DCDC_NV_Komponentenfehler_12: raw 0..3
  range DC_BMC_CMC_Zellspannung_011: phys 1000..5091 Unit_MilliVolt, raw 0..4095
  range DC_BMC_Dauer_Entladeleistung: phys 0..818600 Unit_Watt, raw 0..4095
  range DC_BMC_Max_Ladeleistung_02: phys 0..3250000 Unit_Watt, raw 0..32767
  range DC_BMC_CMC_Zellspannung_104: phys 1000..5091 Unit_MilliVolt, raw 0..4095
  range DC_BMC_RtmWarnZelleZustand: raw 0..7
  range DC_BJB_CALID_Index_01: raw 0
  range DC_DCDC_NV_CALID_Index_05: phys 0..255, raw 0..255
  range DC_BMC_CMC_Temperatur_069: phys -40..86 Unit_DegreCelsi, raw 0..255
  range DC_BJB_CALID_Index_11: raw 0
  range DC_BMC_Dauer_Entladeleistung_02: phys 0..3250000 Unit_Watt, raw 0..16383
  range DC_DCDC_NV_Komponentenfehler_13: raw 0..3
  range DC_BMC_CMC_Zellspannung_012: phys 1000..5091 Unit_MilliVolt, raw 0..4095
  range DC_BMC_Max_Ladestrom: phys 0..1637.8 Unit_Amper, raw 0..8191
  range DC_BMC_CMC_Zellspannung_105: phys 1000..5091 Unit_MilliVolt, raw 0..4095
  range DC_BMC_RuecklaufTemperatur: phys -40..87.5 Unit_DegreCelsi, raw 0..1023
  range DC_BMC_CMC_Zellspannung_017: phys 1000..5091 Unit_MilliVolt, raw 0..4095
  range DC_BMC_CMC_Temperatur_070: phys -40..86 Unit_DegreCelsi, raw 0..255
  range DC_BMC_Dauer_Ladeleistung: phys 0..818600 Unit_Watt, raw 0..4095
  range DC_DCDC_NV_CALID_Index_06: phys 0..255, raw 0..255
  range DC_BMC_Max_Ladestrom_02: phys 0..3250 Unit_Amper, raw 0..16383
  range DC_DCDC_NV_Komponentenfehler_14: raw 0..3
  range DC_BMC_Spannung: phys 0..1023.75 Unit_Volt, raw 0..16383
  range DC_BMC_CMC_Zellspannung_013: phys 1000..5091 Unit_MilliVolt, raw 0..4095
  range DC_BJB_CALID_Index_02: raw 0
  range DC_DCDC_NV_CALID_Index_07: phys 0..255, raw 0..255
  range DC_BJB_CALID_Index_12: raw 0
  range DC_BMC_CMC_Zellspannung_106: phys 1000..5091 Unit_MilliVolt, raw 0..4095
  range DC_BMC_CMC_Temperatur_071: phys -40..86 Unit_DegreCelsi, raw 0..255
  range DC_BMC_Dauer_Ladeleistung_02: phys 0..3250000 Unit_Watt, raw 0..16383
  range DC_BMC_Spannung_DC_Ladesaeule: phys -1023..1024.75 Unit_Volt, raw 0..32767
  range DC_BMC_CMC_Zellspannung_018: phys 1000..5091 Unit_MilliVolt, raw 0..4095
  range DC_BMC_Max_Spannung: phys 0..1021 Unit_Volt, raw 0..1023
  range DC_DCDC_NV_Komponentenfehler_15: raw 0..3
  range DC_BMC_CMC_Zellspannung_014: phys 1000..5091 Unit_MilliVolt, raw 0..4095
  range DC_BMC_DC_Laden: raw 0..3
  range DC_BMC_CMC_Temperatur_072: phys -40..86 Unit_DegreCelsi, raw 0..255
  range DC_DCDC_NV_CALID_Index_08: phys 0..255, raw 0..255
  range DC_BMC_CMC_Zellspannung_107: phys 1000..5091 Unit_MilliVolt, raw 0..4095
  range DC_BMC_Spannung_Messzeit: phys 0..253 Unit_None, raw 0..255
  range DC_BMC_MaxEnergieinhalt: phys 0..262132 Unit_WattHour, raw 0..65535
  range DC_DCDC_NV_Komponentenfehler_16: raw 0..3
  range DC_BMC_Dev_Freigabe: raw 0..1
  range DC_BMC_CMC_Temperatur_073: phys -40..86 Unit_DegreCelsi, raw 0..255
  range DC_BJB_CALID_Index_03: raw 0
  range DC_BJB_CALID_Index_13: raw 0
  range DC_BMC_CMC_Zellspannung_019: phys 1000..5091 Unit_MilliVolt, raw 0..4095
  range DC_BMC_Spannung_ZwischenKreis: phys 0..1023.75 Unit_Volt, raw 0..16383
  range DC_BMC_Min_Spannung: phys 0..1021 Unit_Volt, raw 0..1023
  range DC_DCDC_NV_CALID_Index_09: phys 0..255, raw 0..255
  range DC_BMC_CMC_Zellspannung_108: phys 1000..5091 Unit_MilliVolt, raw 0..4095
  range DC_BMC_Energie_Entladen: phys 0..655.33 Unit_KiloWattHour, raw 0..65535
  range DC_DCDC_NV_Komponentenfehler_17: raw 0..3
  range DC_DCDC_NV_Komponentenfehler_55: raw 0..3
  range DC_BMC_CMC_Temperatur_074: phys -40..86 Unit_DegreCelsi, raw 0..255
  range DC_BMC_Spannung_ZwischenKreis_2: phys 0..1023.75 Unit_Volt, raw 0..16383
  range DC_BMC_Energie_Laden: phys 0..655.33 Unit_KiloWattHour, raw 0..65535
  range DC_BMC_MinDyn_Entladespannung: phys 0..1021 Unit_None, raw 0..1023
  range DC_BMC_CMC_Zellspannung_109: phys 1000..5091 Unit_MilliVolt, raw 0..4095
  range DC_DCDC_NV_Komponentenfehler_18: raw 0..3
  range DC_DCDC_NV_Komponentenfehler_56: raw 0..3
  range DC_BMC_CMC_Temperatur_075: phys -40..86 Unit_DegreCelsi, raw 0..255
  range DC_DCDC_NV_CALID_Index_10: phys 0..255, raw 0..255
  range DC_BMC_Sperrung_Ueberspannung: raw 0..3
  range DC_BJB_CALID_Index_14: raw 0
  range DC_BJB_CALID_Index_04: raw 0
  range DC_AB_Abschaltanf_SIH_BF: raw 0..1
  range DC_BMC_CMC_Zellspannung_01_Messzeit: phys 0..253 Unit_None, raw 0..255
  range DC_BMC_CMC_Temperatur_076: phys -40..86 Unit_DegreCelsi, raw 0..255
  range DC_BMC_Sperrung_Uebertemperatur: raw 0..3
  range DC_BMC_MinDyn_Ladespannung: phys 0..1021 Unit_Volt, raw 0..1023
  range DC_BMC_CMC_Zellspannung_110: phys 1000..5091 Unit_MilliVolt, raw 0..4095
  range DC_BMC_Energie_Sockel_SoC: phys 0..100 Unit_PerCent, raw 0..1023
  range DC_DCDC_NV_CALID_Index_11: phys 0..255, raw 0..255
  range DC_DCDC_NV_Komponentenfehler_19: raw 0..3
  range DC_DCDC_NV_Komponentenfehler_57: raw 0..3
  range DC_BMC_CMC_Temperatur_077: phys -40..86 Unit_DegreCelsi, raw 0..255
  range DC_BMC_Energieinhalt: phys 0..262132 Unit_WattHour, raw 0..65535
  range DC_BJB_CALID_Index_15: raw 0
  range DC_BMC_Sperrung_Unterspannung: raw 0..3
  range DC_BJB_CALID_Index_05: raw 0
  range DC_BMC_MMTR_Status: raw 0..15
  range DC_BMC_CMC_Temperatur_078: phys -40..86 Unit_DegreCelsi, raw 0..255
  range DC_DCDC_NV_CALID_Index_12: phys 0..255, raw 0..255
  range DC_DCDC_NV_Komponentenfehler_58: raw 0..3
  range DC_BMC_CMC_Zellspannung_111: phys 1000..5091 Unit_MilliVolt, raw 0..4095
  range DC_BMC_CMC_Zellspannung_020: phys 1000..5091 Unit_MilliVolt, raw 0..4095
  range DC_DCDC_NV_Komponentenfehler_20: raw 0..3
  range DC_BMC_EnergieVorhalt: phys 0..6553.2 Unit_KiloWattHour, raw 0..65535
  range DC_BMC_Status_DCLS: raw 0..3
  range DC_BMC_Modus: raw 0..15
  range DC_DCDC_NV_CALID_Index_13: phys 0..255, raw 0..255
  range DC_BMC_CMC_Zellspannung_112: phys 1000..5091 Unit_MilliVolt, raw 0..4095
  range DC_BMC_ExtLadeleistung: phys 0..3276.65 Unit_KiloWatt, raw 0..65535
  range DC_BMC_Status_HV_Spannungssensorik: raw 0..1
  range DC_DCDC_NV_Komponentenfehler_21: raw 0..3
  range DC_DCDC_NV_Komponentenfehler_59: raw 0..3
  range DC_BJB_CALID_Index_06: raw 0
  range DC_HVEM_IstLeistung_HVVerbraucher: phys -102300..102350 Unit_Watt, raw 0..4095
  range DC_BMC_NutzbareKapazitaet: phys 0..511.625 Unit_AmperHour, raw 0..4095
  range DC_BMC_Fehler_Leistungsred: raw 0..1
  range DC_DCDC_NV_CALID_Index_14: phys 0..255, raw 0..255
  range DC_BMC_Status_Spgfreiheit: raw 0..3
  range DC_BMC_CMC_Zellspannung_021: phys 1000..5091 Unit_MilliVolt, raw 0..4095
  range DC_BJB_CALID_Index_16: raw 0
  range DC_BMC_CMC_Zellspannung_113: phys 1000..5091 Unit_MilliVolt, raw 0..4095
  range DC_AB_Anzeige_Fussg: raw 0..2
  range DC_HVEM_IstStrom_HVVerbraucher: phys -204.7..204.6 Unit_Amper, raw 0..4095
  range DC_DCDC_NV_Komponentenfehler_22: raw 0..3
  range DC_DCDC_NV_Komponentenfehler_60: raw 0..3
  range DC_BMC_NutzbarerSOC: phys -20..184.65 Unit_PerCent, raw 0..4095
  range DC_BMC_Status_Trennelemente: raw 0..7
  range DC_BMC_CMC_Zellspannung_114: phys 1000..5091 Unit_MilliVolt, raw 0..4095
  range DC_HVEM_Leistungsvorhalt_Entladen: phys -51100..51150 Unit_Watt, raw 0..2047
  range DC_BMC_Fehler_Warnung: raw 0..2
  range DC_BMC_Pack_SN_01: raw 255
  range DC_DCDC_NV_CALID_Index_15: phys 0..255, raw 0..255
  range DC_DCDC_NV_Komponentenfehler_61: raw 0..3
  range DC_DCDC_NV_Komponentenfehler_23: raw 0..3
  range DC_BMC_Strom: phys -2047..2048.8125 Unit_Amper, raw 0..65535
  range DC_HVEM_Leistungsvorhalt_Laden: phys -51100..51150 Unit_Watt, raw 0..2047
  range DC_BMC_CMC_Zellspannung_022: phys 1000..5091 Unit_MilliVolt, raw 0..4095
  range DC_BMC_Flash_Freigabe: raw 0..1
  range DC_BJB_CVN_Byte_1: phys 0..255, raw 0..255
  range DC_BMC_CMC_Zellspannung_115: phys 1000..5091 Unit_MilliVolt, raw 0..4095
  range DC_AB_Belegung_VB: raw 0..3
  range DC_DCDC_NV_CALID_Index_16: phys 0..255, raw 0..255
  range DC_HVLM_13_BZ: phys 0..15, raw 0..15
  range DC_BMC_Strom_02: phys -3250..3250 Unit_Amper, raw 0..131071
  range DC_HVEM_MMTR_State: raw 0..15
  range DC_DCDC_NV_Komponentenfehler_62: raw 0..3
  range DC_DCDC_NV_Komponentenfehler_24: raw 0..3
  range DC_BMC_Pack_SN_02: raw 255
  range DC_BMC_HV_01_BZ: phys 0..15, raw 0..15
  range DC_BMC_CMC_Zellspannung_116: phys 1000..5091 Unit_MilliVolt, raw 0..4095
  range DC_BMC_Strom_Messzeit: phys 0..253 Unit_None, raw 0..255
  range DC_BMC_HV_01_CRC: phys 0..255, raw 0..255
  range DC_DCDC_NV_CVN_Byte_1: phys 0..255, raw 0..255
  range DC_HVEM_Nachlad_Status: raw 0..3
  range DC_BMC_Pack_SN_03: raw 255
  range DC_BMC_CMC_Zellspannung_023: phys 1000..5091 Unit_MilliVolt, raw 0..4095
  range DC_BJB_CVN_Byte_2: phys 0..255, raw 0..255
  range DC_DCDC_NV_Komponentenfehler_63: raw 0..3
  range DC_AB_Belegung_VF: raw 0..3
  range DC_DCDC_NV_Komponentenfehler_25: raw 0..3
  range DC_BMC_TechnischerSOC: phys 0..100 Unit_PerCent, raw 0..2047
  range DC_BMC_HV_02_BZ: phys 0..15, raw 0..15
  range DC_BMC_CMC_Zellspannung_117: phys 1000..5091 Unit_MilliVolt, raw 0..4095
  range DC_HVLM_13_CRC: phys 0..255, raw 0..255
  range DC_HVEM_Nachladen_Anf: raw 0..1
  range DC_DCDC_NV_CVN_Byte_2: phys 0..255, raw 0..255
  range DC_BMC_Pack_SN_04: raw 255
  range DC_BMC_Temperatur: phys -40..87.625 Unit_DegreCelsi, raw 0..1023
  range DC_DCDC_NV_Komponentenfehler_64: raw 0..3
  range DC_HVEM_StCpbDrv: raw 0..5
  range DC_DCDC_NV_Komponentenfehler_26: raw 0..3
  range DC_BMC_HV_02_CRC: phys 0..255, raw 0..255
  range DC_BMC_CMC_Zellspannung_118: phys 1000..5091 Unit_MilliVolt, raw 0..4095
  range DC_BJB_CVN_Byte_3: phys 0..255, raw 0..255
  range DC_DCDC_NV_CVN_Byte_3: phys 0..255, raw 0..255
  range DC_BMC_Pack_SN_05: raw 255
  range DC_HVEM_StCpbElAcy: raw 0..1
  range DC_BMC_CMC_Zellspannung_024: phys 1000..5091 Unit_MilliVolt, raw 0..4095
  range DC_BMC_HV_04_BZ: phys 0..15, raw 0..15
  range DC_BMC_Temperatur_hoechste: phys -40..87.625 Unit_DegreCelsi, raw 0..1023
  range DC_HVLM_14_BZ: phys 0..15, raw 0..15
  range DC_DCDC_NV_Komponentenfehler_65: raw 0..3
  range DC_DCDC_NV_Komponentenfehler_27: raw 0..3
  range DC_BMC_CMC_Zellspannung_119: phys 1000..5091 Unit_MilliVolt, raw 0..4095
  range DC_AB_Belegung_VF_ext: raw 0..7
  range DC_HVEM_STK_Leistung_verfuegbar: phys 0..12650 Unit_Watt, raw 0..255
  range DC_BMC_Pack_SN_06: raw 255
  range DC_BMC_HV_04_CRC: phys 0..255, raw 0..255
  range DC_BMC_Temperatur_niedrigste: phys -40..87.625 Unit_DegreCelsi, raw 0..1023
  range DC_DCDC_NV_CVN_Byte_4: phys 0..255, raw 0..255
  range DC_DCDC_NV_Komponentenfehler_66: raw 0..3
  range DC_BMC_CMC_Zellspannung_120: phys 1000..5091 Unit_MilliVolt, raw 0..4095
  range DC_DCDC_NV_Komponentenfehler_28: raw 0..3
  range DC_BJB_CVN_Byte_4: phys 0..255, raw 0..255
  range DC_BMC_HVK_EoHVL_Status: raw 0..3
  range DC_BMC_ThermAuslastung: phys 0..100 Unit_PerCent, raw 0..127
  range DC_HVEM_StLimElAcy: raw 0..1
  range DC_BMC_CMC_Zellspannung_025: phys 1000..5091 Unit_MilliVolt, raw 0..4095
  range DC_HVLM_14_CRC: phys 0..255, raw 0..255
  range DC_DCDC_NV_CVN_VLD: raw 0..1
  range DC_BMC_Pack_SN_07: raw 255
  range DC_BMC_HVK_Fehler_HVIL: raw 0..3
  range DC_BMC_ThermSpreizung: phys 0..100 Unit_PerCent, raw 0..15
  range DC_AB_Belegung_VF_ext_aktiv: raw 0..1
  range DC_HVEM_SystemMinLeistungsgrenze: phys 0..125000 Unit_Watt, raw 0..127
  range DC_DCDC_NV_Komponentenfehler_67: raw 0..3
  range DC_DCDC_NV_Komponentenfehler_29: raw 0..3
  range DC_BMC_CMC_Zellspannung_121: phys 1000..5091 Unit_MilliVolt, raw 0..4095
  range DC_DCDC_NV_Komponentenfehler_01: raw 0..3
  range DC_BMC_UBE_Indik_last_update_km: phys 0..1048573 Unit_KiloMeter, raw 0..1048575
  range DC_BMC_Pack_SN_08: raw 255
  range DC_HVEM_TME_Energie_Vorgabe: phys 0..20450 Unit_WattHour, raw 0..2047
  range DC_BMC_HVK_Fehler_Intern: raw 0..3
  range DC_BMC_CMC_Zellspannung_026: phys 1000..5091 Unit_MilliVolt, raw 0..4095
  range DC_DCDC_NV_Komponentenfehler_68: raw 0..3
  range DC_HVLM_Aktive_Ladeart: raw 0..7
  range DC_BJB_CVN_VLD: raw 0..1
  range DC_BMC_CMC_Zellspannung_122: phys 1000..5091 Unit_MilliVolt, raw 0..4095
  range DC_DCDC_NV_Komponentenfehler_30: raw 0..3
  range DC_HVEM_TME_Leistung_Vorgabe: phys 0..51050 Unit_Watt, raw 0..1023
  range DC_BMC_HVK_Fehler_SD: raw 0..3
  range DC_DCDC_NV_Komponentenfehler_02: raw 0..3
  range DC_AB_Crash_Int: raw 0..7
  range DC_BMC_Pack_SN_09: raw 255
  range DC_BMC_UBE_Indikator: phys 0..100 Unit_PerCent, raw 0..2047
  range DC_HVEM_TME_MSF_aktiv: raw 0..1
  range DC_BMC_CMC_Zellspannung_123: phys 1000..5091 Unit_MilliVolt, raw 0..4095
  range DC_BMC_Iso_Mode_Anf: raw 0..7
  range DC_DCDC_NV_Komponentenfehler_69: raw 0..3
  range DC_DCDC_NV_Komponentenfehler_31: raw 0..3
  range DC_BMC_Ueberspannungszaehler_CMC01: phys 0..400 Unit_None, raw 0..511
  range DC_DCDC_NV_Komponentenfehler_03: raw 0..3
  range DC_BMC_IstTemperaturMax_Modul_ID: phys 1..254 Unit_None, raw 1..255
  range DC_BJB_ErrMem_State: raw 1..3
  range DC_BMC_Pack_SN_10: raw 255
  range DC_BMC_CMC_Zellspannung_027: phys 1000..5091 Unit_MilliVolt, raw 0..4095
  range DC_BMC_CMC_Zellspannung_124: phys 1000..5091 Unit_MilliVolt, raw 0..4095
  range DC_HVLM_ALF_AktiverLadeniveauwunsch: raw 0..1
  range DC_HVEM_TME_Sollstatus: raw 0..3
  range DC_BMC_Ueberspannungszaehler_CMC02: phys 0..400 Unit_None, raw 0..511
  range DC_AB_Deaktivierung_HV: raw 0..7
  range DC_DCDC_NV_Komponentenfehler_70: raw 0..3
  range DC_DCDC_NV_Komponentenfehler_32: raw 0..3
  range DC_BMC_IstTemperaturMax_Sensor_ID: phys 1..30 Unit_None, raw 1..31
  range DC_BMC_Pack_SN_11: raw 255
  range DC_HVHL_HVK_EoHVL_Status: raw 0..3
  range DC_BMC_Ueberspannungszaehler_CMC03: phys 0..400 Unit_None, raw 0..511
  range DC_DCDC_NV_Komponentenfehler_04: raw 0..3
  range DC_BMC_CMC_Zellspannung_125: phys 1000..5091 Unit_MilliVolt, raw 0..4095
  range DC_DCDC_NV_Komponentenfehler_71: raw 0..3
  range DC_DCDC_NV_Komponentenfehler_33: raw 0..3
  range DC_HVHL_HVK_Fehler_intern: raw 0..1
  range DC_BMC_Ueberspannungszaehler_CMC04: phys 0..400 Unit_None, raw 0..511
  range DC_BMC_CMC_Zellspannung_028: phys 1000..5091 Unit_MilliVolt, raw 0..4095
  range DC_BJB_Lebensdauer_Trennelemente: phys 0..100000 Unit_None, raw 0..131071
  range DC_BMC_IstTemperaturMin_Modul_ID: phys 1..254 Unit_None, raw 1..255
  range DC_DCDC_NV_Komponentenfehler_05: raw 0..3
  range DC_HVLM_ALF_Ladestatus_Niveau: raw 0..7
  range DC_AB_DeltaV_X_eCall: phys -126..126 Unit_KiloMeterPerHour, raw 0..255
  range DC_BMC_Pack_SN_12: raw 255
  range DC_BMC_CMC_Zellspannung_126: phys 1000..5091 Unit_MilliVolt, raw 0..4095
  range DC_HVHL_HVK_Status_Spgfreiheit: raw 0..3
  range DC_DCDC_NV_Komponentenfehler_72: raw 0..3
  range DC_DCDC_NV_Komponentenfehler_34: raw 0..3
  range DC_BMC_IstTemperaturMin_Sensor_ID: phys 1..30 Unit_None, raw 1..31
  range DC_BMC_Uebertemperaturzaehler_CMC01: phys 0..604800 Unit_None, raw 0..65535
  range DC_DCDC_NV_Komponentenfehler_06: raw 0..3
  range DC_BMC_Pack_SN_13: raw 255
  range DC_HVK_03_BZ: phys 0..15, raw 0..15
  range DC_BMC_CMC_Zellspannung_127: phys 1000..5091 Unit_MilliVolt, raw 0..4095
  range DC_DCDC_NV_Komponentenfehler_73: raw 0..3
  range DC_BMC_IstZellspannungMax: phys 1000..5091 Unit_MilliVolt, raw 0..4095
  range DC_BJB_Sperrung_Ueberspannung: raw 0..3
  range DC_BMC_Uebertemperaturzaehler_CMC02: phys 0..604800 Unit_None, raw 0..65535
  range DC_BMC_CMC_Zellspannung_029: phys 1000..5091 Unit_MilliVolt, raw 0..4095
  range DC_HVLM_ALF_PosAnforderung: raw 0..7
  range DC_DCDC_NV_Komponentenfehler_35: raw 0..3
  range DC_BMC_Pack_SN_14: raw 255
  range DC_HVK_03_CRC: phys 0..255, raw 0..255
  range DC_BMC_Uebertemperaturzaehler_CMC03: phys 0..604800 Unit_Ohm, raw 0..65535
  range DC_AB_DeltaV_Y_eCall: phys -126..126 Unit_KiloMeterPerHour, raw 0..255
  range DC_BMC_IstZellSpannungMax_Modul_ID: phys 1..254 Unit_None, raw 1..255
  range DC_BMC_CMC_Zellspannung_128: phys 1000..5091 Unit_MilliVolt, raw 0..4095
  range DC_HVLM_Laden_ISO_Messung_Anf: raw 0..1
  range DC_DCDC_NV_Komponentenfehler_74: raw 0..3
  range DC_HVK_AIAD_Sollmodus: raw 0..3
  range DC_DCDC_NV_Komponentenfehler_36: raw 0..3
  range DC_BMC_Pack_SN_15: raw 255
  range DC_BMC_IstZellSpannungMax_Zell_ID: phys 1..254 Unit_None, raw 1..255
  range DC_BMC_Uebertemperaturzaehler_CMC04: phys 0..604800 Unit_None, raw 0..65535
  range DC_BJB_Sperrung_Uebertemperatur: raw 0..3
  range DC_BMC_CMC_Zellspannung_129: phys 1000..5091 Unit_MilliVolt, raw 0..4095
  range DC_HVLM_ALF_PosLadeart: raw 0..7
  range DC_BMC_CMC_Zellspannung_02_Messzeit: phys 0..253 Unit_None, raw 0..255
  range DC_HVK_AktiveEntladung_Anf: raw 0..1
  range DC_BMC_UI1_Spannung1_Schalt_Anf: raw 0..1
  range DC_HVLM_Ladenaktiv_Standzyklus: raw 0..1
  range DC_DCDC_NV_Komponentenfehler_75: raw 0..3
  range DC_DCDC_NV_Komponentenfehler_37: raw 0..3
  range DC_BMC_Pack_SN_16: raw 255
  range DC_AB_EDR_Trigger: raw 0..3
  range DC_BMC_IstZellspannungMin: phys 1000..5091 Unit_MilliVolt, raw 0..4095
  range DC_HVK_BMC_Sollmodus: raw 0..7
  range DC_BMC_CMC_Zellspannung_130: phys 1000..5091 Unit_MilliVolt, raw 0..4095
  range DC_BMC_IstZellSpannungMin_Modul_ID: phys 1..254 Unit_None, raw 1..255
  range DC_HVLM_Ladeniveau_Anf: raw 0..7
  range DC_BMC_UI1_Spannung2_Schalt_Anf: raw 0..1
  range DC_HVK_BMC_Spannung_Anf: raw 0..3
  range DC_DCDC_NV_Komponentenfehler_76: raw 0..3
  range DC_DCDC_NV_Komponentenfehler_38: raw 0..3
  range DC_HVLM_ALF_PosStatus: raw 0..7
  range DC_BMC_Pack_SN_17: raw 255
  range DC_BMC_CMC_Zellspannung_030: phys 1000..5091 Unit_MilliVolt, raw 0..4095
  range DC_BJB_Sperrung_Unterspannung: raw 0..3
  range DC_BMC_IstZellSpannungMin_Zell_ID: phys 1..254 Unit_None, raw 1..255
  range DC_BMC_CMC_Zellspannung_131: phys 1000..5091 Unit_MilliVolt, raw 0..4095
  range DC_BMC_UI2_Spannung1_Schalt_Anf: raw 0..1
  range DC_AB_Erh_Auf_VB: raw 0..3
  range DC_HVLM_Ladeszenario: raw 0..31
  range DC_HVK_DCDC_Sollmodus: raw 0..7
  range DC_DCDC_NV_Komponentenfehler_77: raw 0..3
  range DC_BMC_Pack_SN_18: raw 255
  range DC_DCDC_NV_Komponentenfehler_39: raw 0..3
  range DC_BMC_IWU_Status: raw 0..6
  range DC_BMC_UI2_Spannung2_Schalt_Anf: raw 0..1
  range DC_BMC_CMC_Zellspannung_132: phys 1000..5091 Unit_MilliVolt, raw 0..4095
  range DC_HVK_eKAT_Sollmodus: raw 0..3
  range DC_HVLM_Ladevorgang_Anf: raw 0..7
  range DC_BMC_IWU_Wert_neg: phys 0..6553200 Unit_Ohm, raw 0..65535
  range DC_BMC_CMC_Zellspannung_031: phys 1000..5091 Unit_MilliVolt, raw 0..4095
  range DC_DCDC_NV_Komponentenfehler_78: raw 0..3
  range DC_BJB_Status_HV_Spannungssensorik: raw 0..1
  range DC_BMC_Unterboden_Warnung: raw 0..7
  range DC_BMC_Pack_SN_19: raw 255
  range DC_HVLM_BCAM_Aktiv: raw 0..1
  range DC_HVK_EKK_Sollmodus: raw 0..7
  range DC_DCDC_NV_Komponentenfehler_3_1: raw 0..7
  range DC_AB_Front_Crash: raw 0..1
  range DC_BMC_CMC_Zellspannung_133: phys 1000..5091 Unit_MilliVolt, raw 0..4095
  range DC_BMC_Unterspannungszaehler_CMC01: phys 0..400 Unit_None, raw 0..511
  range DC_BMC_IWU_Wert_pos: phys 0..6553200 Unit_Ohm, raw 0..65535
  range DC_HVLM_Max_Strom_Netz_L1: phys 0..63 Unit_Amper, raw 0..1023
  range DC_HVK_ETM_Freigabe: raw 0..3
  range DC_BMC_Pack_SN_20: raw 255
  range DC_DCDC_NV_Komponentenfehler_79: raw 0..3
  range DC_DCDC_NV_Komponentenfehler_3_10: raw 0..7
  range DC_BMC_CMC_Zellspannung_134: phys 1000..5091 Unit_MilliVolt, raw 0..4095
  range DC_BMC_Konditionierung_Anf: raw 0..1
  range DC_BMC_CMC_Zellspannung_032: phys 1000..5091 Unit_MilliVolt, raw 0..4095
  range DC_HVK_Gesamtst_Spgfreiheit: raw 0..3
  range DC_BJB_Status_Trennelemente: raw 0..7
  range DC_HVLM_BidiLadeModus: raw 0..2
  range DC_BMC_Unterspannungszaehler_CMC02: phys 0..400 Unit_None, raw 0..511
  range DC_AB_Gurtschloss_BF: raw 0..3
  range DC_BMC_Pack_SN_21: raw 255
  range DC_BMC_CMC_Zellspannung_135: phys 1000..5091 Unit_MilliVolt, raw 0..4095
  range DC_DCDC_NV_Komponentenfehler_80: raw 0..3
  range DC_DCDC_NV_Komponentenfehler_3_11: raw 0..7
  range DC_BMC_Unterspannungszaehler_CMC03: phys 0..400 Unit_None, raw 0..511
  range DC_HVLM_WLAN_Aktivieren: raw 0..1
  range DC_BMC_Unterspannungszaehler_CMC04: phys 0..400 Unit_None, raw 0..511
  range DC_BJB_Ueberspannungszaehler_CMC01: phys 0..400 Unit_None, raw 0..511
  range DC_DCDC_NV_Komponentenfehler_VLD: raw 0..1
  range DC_DCDC_NV_Komponentenfehler_3_12: raw 0..7
  range DC_HVLM_CP_Fehlerzustand_A: raw 0..5
  range DC_HVLM_WLAN_Verbinden: raw 0..3
  range DC_BMC_Verbauinfo_ACSchuetz: raw 0..2
  range DC_HVLM_ZustandLadeablauf: raw 0..8
  range DC_DGN_Verlernzaehler: phys 0..254, raw 0..255
  range DC_DCDC_NV_Komponentenfehler_3_13: raw 0..7
  range DC_BMC_Verbauinfo_Bank: raw 0..2
  range DC_BJB_Ueberspannungszaehler_CMC02: phys 0..400 Unit_None, raw 0..511
  range DC_HVLM_CP_Fehlerzustand_B: raw 0..5
  range DC_DS_Hybrid_01_ConfDTCChanged: phys 0..1, raw 0..1
  range DC_HVLM_Max_Strom_Netz_L2: phys 0..63 Unit_Amper, raw 0..1023
  range DC_HVLM_CP_KommProtokoll_A: raw 0..3
  range DC_HVK_HV_Netz_Warnungen: raw 0..3
  range DC_HVLM_Max_Strom_Netz_L3: phys 0..63 Unit_Amper, raw 0..1023
  range DC_HVK_HV_Netz_Zustand: raw 0..15
  range DC_HVLM_MaxSpannung_OBG_HV: phys 0..1021 Unit_Volt, raw 0..1023
  range DC_CHA_ReqPrgBms: raw 0..15
  range DC_HVK_HVHL_Sollmodus: raw 0..3
  range DC_HVLM_OBG_SollModus: raw 0..4
  range DC_HVK_HVHW_Sollmodus: raw 0..3
  range DC_HVLM_PrkCtl_StAlyReq: raw 0..7
  range DC_BMC_CMC_Zellspannung_136: phys 1000..5091 Unit_MilliVolt, raw 0..4095
  range DC_CHA_ReqPrgCMM: raw 0..15
  range DC_BMC_CMC_Zellspannung_137: phys 1000..5091 Unit_MilliVolt, raw 0..4095
  range DC_KST_Warn_P2_ZAT_def: raw 0..1
  range DC_KST_WFS_Fahrfreigabe_Anforderung: raw 0..2
  range DC_KST_ZAT_betaetigt: raw 0..1
  range DC_BMC_CMC_Zellspannung_033: phys 1000..5091 Unit_MilliVolt, raw 0..4095
  range DC_AB_Gurtschloss_FA: raw 0..3
  range DC_DS_Hybrid_01_DiagAdr: phys 0..65535, raw 0..65535
  range DC_DS_Hybrid_01_IdentValid: raw 0..1
  range DC_DS_Hybrid_01_Lokalaktiv: raw 0..1
  range DC_BMC_CMC_Zellspannung_034: phys 1000..5091 Unit_MilliVolt, raw 0..4095
  range DC_AB_Gurtschloss_FA_ext: raw 0..7
  range DC_DS_Hybrid_01_MemSel10Changed: phys 0..1, raw 0..1
  range DC_DS_Hybrid_01_MemSelChanged: phys 0..1, raw 0..1
  range DC_BMC_CMC_Zellspannung_035: phys 1000..5091 Unit_MilliVolt, raw 0..4095
  range DC_AB_Gurtschloss_FA_ext_aktiv: raw 0..1
  range DC_BMC_Verbrauch: phys 0..655350 Unit_WattSecond, raw 0..65535
  range DC_BMC_Verbrauch_Ueberlauf: raw 0..1
  range DC_BMC_CMC_Zellspannung_036: phys 1000..5091 Unit_MilliVolt, raw 0..4095
  range DC_AB_Gurtschloss_Reihe2_BF: raw 0..3
  range DC_BMC_VerlustEnergie: phys 0..32756 Unit_WattHour, raw 0..8191
  range DC_HVLM_CP_KommProtokoll_B: raw 0..3
  range DC_BMC_Vorlade_Zielspannung: phys 0..1021 Unit_Volt, raw 0..1023
  range DC_BMC_Pack_SN_22: raw 255
  range DC_BMC_CMC_Zellspannung_037: phys 1000..5091 Unit_MilliVolt, raw 0..4095
  range DC_BMC_VorlaufTemperatur: phys -40..87.5 Unit_DegreCelsi, raw 0..1023
  range DC_AB_Gurtschloss_Reihe2_FA: raw 0..3
  range DC_BMC_Pack_SN_23: raw 255
  range DC_BJB_Ueberspannungszaehler_CMC03: phys 0..400 Unit_None, raw 0..511
  range DC_BMC_Pack_SN_24: raw 255
  range DC_HVLM_CP_MaxStrom_A: phys 0..80 Unit_Amper, raw 0..1022
  range DC_BMC_Pack_SN_25: raw 255
  range DC_BJB_Ueberspannungszaehler_CMC04: phys 0..400 Unit_None, raw 0..511
  range DC_CHA_ReqPrgDC: raw 0..15
  range DC_HVK_HVLM_Sollmodus: raw 0..7
  range DC_BMC_Pack_SN_26: raw 255
  range DC_HVLM_CP_MaxStrom_B: phys 0..80 Unit_Amper, raw 0..1022
  range DC_DS_Hybrid_01_StMemChanged: phys 0..1, raw 0..1
  range DC_HVK_Iso_Messung_Start: raw 0..4
  range DC_HVLM_PrkCtl_StPrkLockReq: raw 0..3
  range DC_BJB_Uebertemperaturzaehler_CMC01: phys 0..604800 Unit_None, raw 0..65535
  range DC_Hybrid_01_Abschaltstufe: raw 0..1
  range DC_DS_Hybrid_01_Subsystemaktiv: raw 0..1
  range DC_HVK_Istmodus_Anf: raw 0..1
  range DC_LR_StDiagPrcd: raw 0..7
  range DC_HVLM_Pulsierstufe: raw 0..7
  range DC_HVLM_CP_State_A: raw 0..8
  range DC_Hybrid_01_Indc_StChk: raw 0..1
  range DC_HVK_Vorladung_aktiv: raw 0..1
  range DC_LVB_Ladegeschw: phys 0..5000 Unit_None, raw 0..8190
  range DC_DS_Hybrid_01_TestFailedChanged: phys 0..1, raw 0..1
  range DC_HVLM_S2SchliessenAnf_A: raw 0..1
  range DC_Hybrid_01_Indc_StFail: raw 0..1
  range DC_HVLE_AnzahlVerwendeterPhasen: raw 0..3
  range DC_CHA_ReqPrgDispSetup: raw 0..15
  range DC_BJB_Uebertemperaturzaehler_CMC02: phys 0..604800 Unit_None, raw 0..65535
  range DC_DS_Hybrid_01_WIRChanged: phys 0..1, raw 0..1
  range DC_LVB_Ladegeschw_VZ: raw 0..1
  range DC_Hybrid_01_KD_Fehler: raw 0..1
  range DC_HVLM_CP_State_B: raw 0..8
  range DC_HVLM_S2SchliessenAnf_B: raw 0..1
  range DC_BMC_ZellTemp_virtuell_max: phys -40..87.5 Unit_DegreCelsi, raw 0..1023
  range DC_DW_Kilometerstand: phys 0..1048573 Unit_KiloMeter, raw 0..1048575
  range DC_Hybrid_01_KompSchutz: raw 0..1
  range DC_LVB_LadegeschwEinheit: raw 0..4
  range DC_BMC_ZellTemp_virtuell_min: phys -40..87.5 Unit_DegreCelsi, raw 0..1023
  range DC_HVLM_Schluessel_Anfrage: raw 0..3
  range DC_CHA_ReqPrgDt: raw 0..15
  range DC_BJB_Uebertemperaturzaehler_CMC03: phys 0..604800 Unit_None, raw 0..65535
  range DC_BMC_CMC_Zellspannung_038: phys 1000..5091 Unit_MilliVolt, raw 0..4095
  range DC_CHA_CurProf: raw 0..31
  range DC_LVB_Restladezeit: phys 0..3000 Unit_Minut, raw 0..4095
  range DC_CHA_FlgEndOfList: raw 0..2
  range DC_CHA_ReqPrgDynTqCtrl: raw 0..15
  range DC_AB_Gurtschloss_Reihe2_MI: raw 0..3
  range DC_HVLE_AsymmetrischLadenMoeglich: raw 0..1
  range DC_BMC_CMC_Zellspannung_039: phys 1000..5091 Unit_MilliVolt, raw 0..4095
  range DC_CHA_ReqPrgEps: raw 0..15
  range DC_HVLE_Derating_Temperatur: raw 0..1
  range DC_AB_Gurtschloss_Reihe3_BF: raw 0..3
  range DC_HVLE_Energiemenge_Laden: phys 0..654800 Unit_WattHour, raw 0..16370
  range DC_BMC_PCM_VTD_Freeze_Req: raw 0..3
  range DC_BMC_CMC_Zellspannung_03_Messzeit: phys 0..253 Unit_None, raw 0..255
  range DC_HVLE_I_istAC_Netz_L1: phys 0..50.8 Unit_Amper, raw 0..511
  range DC_BMC_PCM_VTD_LifeTimeReset_Req: raw 0..3
  range DC_HVLE_I_istAC_Netz_L2: phys 0..50.8 Unit_Amper, raw 0..511
  range DC_AB_Gurtschloss_Reihe3_FA: raw 0..3
  range DC_BMC_PCM_VTD_LifeTimeReset_Resp: raw 0..3
  range DC_BMC_CMC_Zellspannung_040: phys 1000..5091 Unit_MilliVolt, raw 0..4095
  range DC_BMC_PCM_VTD_RecentReset_Req: raw 0..3
  range DC_AB_Gurtschloss_Reihe3_MI: raw 0..3
  range DC_Hybrid_01_Nachlauftyp: raw 0..2
  range DC_EKK_HVK_EoHVL_Status: raw 0..3
  range DC_NM_AWC_CBV_CRI: raw 0..1
  range DC_BMC_PerfInd_Entladen: phys 0..204.2 Unit_PerCent, raw 0..1023
  range DC_BMC_CMC_Zellspannung_041: phys 1000..5091 Unit_MilliVolt, raw 0..4095
  range DC_Hybrid_01_OBD_Lampe_Anf: raw 0..1
  range DC_EKK_HVK_Fehler_intern: raw 0..1
  range DC_NM_AWC_FCAB: raw 0..36028797018963968
  range DC_Hybrid_01_SNI_10: phys 0..1023 Unit_None, raw 0..1023
  range DC_AB_Gurtschloss_Reihe4_BF: raw 0..3
  range DC_Hybrid_01_Transport_Mode: raw 0..1
  range DC_EKK_HVK_Status_Spgfreiheit: raw 0..3
  range DC_NM_AWC_NM_aktiv_Diag: raw 0..1
  range DC_IMMO_ClampPermStatus: raw 0..15
  range DC_ELF_GeplEndeLadevorgangJahr: phys 0..4094 Unit_Year, raw 0..4095
  range DC_NM_AWC_NM_aktiv_KL15: raw 0..1
  range DC_ELF_GeplEndeLadevorgangMinute: phys 0..59 Unit_Minut, raw 0..63
  range DC_NM_AWC_NM_aktiv_Tmin: raw 0..1
  range DC_HVLM_DC_Aufstartmodus: raw 0..3
  range DC_HVLM_DC_SollStrom: phys 0..160 Unit_Amper, raw 0..2047
  range DC_BJB_Uebertemperaturzaehler_CMC04: phys 0..604800 Unit_None, raw 0..65535
  range DC_HVLM_SF4OeffnenAnf_A: raw 0..1
  range DC_LVB_StatusLadegeschw: raw 0..2
  range DC_CHA_FlgGlbFallBkIdc: raw 0..1
  range DC_BMC_CMC_Zellspannung_149: phys 1000..5091 Unit_MilliVolt, raw 0..4095
  range DC_HVLE_I_istAC_Netz_L3: phys 0..50.8 Unit_Amper, raw 0..511
  range DC_HVLM_GAFrequenz: phys 0..163800 Unit_Hertz, raw 0..16383
  range DC_BMC_PerfInd_Laden: phys 0..204.2 Unit_PerCent, raw 0..1023
  range DC_HVLM_SF4OeffnenAnf_B: raw 0..1
  range DC_CHA_ProfChanged: raw 0..1
  range DC_LVB_StatusRestladezeit: raw 0..2
  range DC_HVLE_Ist_Wirkungsgrad: phys 0..100 Unit_PerCent, raw 0..127
  range DC_BMC_PredLeistung_StuetzungNV: phys 0..818400 Unit_Watt, raw 0..4095
  range DC_HVLM_SpannungsModusDc_Anf: raw 0..2
  range DC_CHA_ReqPrgAcc: raw 0..15
  range DC_HVLE_IstSpannung_HV: phys 0..1021 Unit_Volt, raw 0..1023
  range DC_MKB_ScndCllsnMtgtn_StAbo: raw 0..1
  range DC_HVLM_GASpulenstrom: phys 0..102 Unit_Amper, raw 0..1023
  range DC_BMC_Range_Indikator: phys 0..100 Unit_PerCent, raw 0..2047
  range DC_CHA_ReqPrgAcvChassis: raw 0..15
  range DC_HVLE_Netzfrequenz_EVU: phys 40..80 Unit_Hertz, raw 0..511
  range DC_HVLM_Start_Pulserkennung: raw 0..1
  range DC_BJB_Unterspannungszaehler_CMC01: phys 0..400 Unit_None, raw 0..511
  range DC_MKB_ScndCllsnMtgtn_StReq: raw 0..1
  range DC_HVLE_Netzmodus: raw 0..15
  range DC_CHA_ReqPrgAcvStg: raw 0..15
  range DC_BMC_Rekuperation: phys 0..655350 Unit_WattSecond, raw 0..65535
  range DC_BMC_CMC_Zellspannung_150: phys 1000..5091 Unit_MilliVolt, raw 0..4095
  range DC_HVLM_Stecker_Notentriegeln_Anf_A: raw 0..2
  range DC_HVLM_Grundladen_Anf: raw 0..1
  range DC_MM_PropulsionSystemActive: raw 0..1
  range DC_BMC_Rekuperation_Ueberlauf: raw 0..1
  range DC_BMC_CMC_Zellspannung_151: phys 1000..5091 Unit_MilliVolt, raw 0..4095
  range DC_BJB_Unterspannungszaehler_CMC02: phys 0..400 Unit_None, raw 0..511
  range DC_BMC_CMC_Zellspannung_152: phys 1000..5091 Unit_MilliVolt, raw 0..4095
  range DC_BMC_CMC_Zellspannung_153: phys 1000..5091 Unit_MilliVolt, raw 0..4095
  range DC_BJB_Unterspannungszaehler_CMC03: phys 0..400 Unit_None, raw 0..511
  range DC_BMC_CMC_Zellspannung_042: phys 1000..5091 Unit_MilliVolt, raw 0..4095
  range DC_BJB_Unterspannungszaehler_CMC04: phys 0..400 Unit_None, raw 0..511
  range DC_HVLE_OBG_AC_maxSpannung: phys 0..1000 Unit_Volt, raw 0..1023
  range DC_BMC_CMC_Zellspannung_043: phys 1000..5091 Unit_MilliVolt, raw 0..4095
  range DC_HVLE_OBG_AC_maxStrom: phys 0..100 Unit_Amper, raw 0..1023
  range DC_AB_Gurtschloss_Reihe4_FA: raw 0..3
  range DC_HVLE_OBG_ACDC_IstLeistung: phys 0..45000 Unit_Watt, raw 0..2047
  range DC_NM_HVZB_UDS_CC: raw 0..1
  range DC_HVLE_OBG_ACDC_MaxLeistung: phys 0..45000 Unit_Watt, raw 0..2047
  range DC_OBD_Abs_Pedal_Pos: phys 0..100 Unit_PerCent, raw 0..255
  range DC_NM_HVZB_Wakeup_V12: raw 0..2
  range DC_NM_aktiv_AutomotiveEdge_1: raw 0..1
  range DC_HVLE_OBG_DC_IstStrom: phys 0..204.5 Unit_Amper, raw 0..2047
  range DC_HVLM_Stecker_Notentriegeln_Anf_B: raw 0..2
  range DC_NM_Hybrid_01_CAB_V12: raw 0..4
  range DC_AB_Gurtschloss_Reihe4_MI: raw 0..3
  range DC_NM_aktiv_AutomotiveEdge_2: raw 0..1
  range DC_NM_Hybrid_01_CBV_AWB: raw 0..1
  range DC_HVLM_Stecker_Notentriegeln_Anf_C: raw 0..2
  range DC_OBD_Aussen_Temp_gef: phys -40..213 Unit_DegreCelsi, raw 0..255
  range DC_NM_Hybrid_01_CBV_CRI: raw 0..1
  range DC_NM_aktiv_AutomotiveEdge_3: raw 0..1
  range DC_HVLM_Stecker_VerEntriegelnAnf_A: raw 0..3
  range DC_AB_Gurtwarn_Reihe2_BF: raw 0..3
  range DC_BMC_RtmWarnBattUnautorisiert: raw 0..7
  range DC_NM_aktiv_AutomotiveEdge_4: raw 0..1
  range DC_OBD_Barometric_Pressure: phys 0..255 Unit_KiloPascal, raw 0..255
  range DC_HVLM_Stecker_VerEntriegelnAnf_B: raw 0..3
  range DC_BMC_RtmWarnPackKommunikation: raw 0..7
  range DC_NM_aktiv_AutomotiveEdge_5: raw 0..1
  range DC_AB_Gurtwarn_Reihe2_FA: raw 0..3
  range DC_HVLM_Stecker_VerEntriegelnAnf_C: raw 0..2
  range DC_BMC_RtmWarnPackUeberladen: raw 0..7
  range DC_IMMO_Display: raw 0..2
  range DC_BMC_RtmWarnSocHoch: raw 0..7
  range DC_KL_Verdampfertemperatur: phys -20..70 Unit_DegreCelsi, raw 0..1023
  range DC_BMC_RtmWarnSocNiedrig: raw 0..7
  range DC_AB_Gurtwarn_Reihe2_MI: raw 0..3
  range DC_KN_Hybrid_01_BusKnockOut: raw 0..3
  range DC_NM_Hybrid_01_FCAB: raw 0..36028797018963968
  range DC_HVLE_OBG_DC_MaxStrom: phys 0..204.5 Unit_Amper, raw 0..2047
  range DC_KN_Hybrid_01_BusKnockOutTimer: phys 0..254, raw 0..255
  range DC_NM_Hybrid_01_FCIB: raw 1..36028797018963968
  range DC_HVLE_OBG_Fehlerstatus: raw 0..1
  range DC_HVLM_Intensitaet_Lk1: phys 0..100 Unit_PerCent, raw 0..127
  range DC_NM_Hybrid_01_Lokalaktiv: raw 0..1
  range DC_HVLE_OBG_Fehlerstrom: raw 0..1
  range DC_NM_Hybrid_01_NM_aktiv_Diag: raw 0..1
  range DC_HVLE_OBG_IstModus: raw 0..7
  range DC_ELF_GeplEndeLadevorgangMonat: phys 1..12 Unit_Month, raw 1..15
  range DC_BMC_Abschaltankuendigung: phys 0..510.5 Unit_Secon, raw 0..1023
  range DC_NM_Hybrid_01_NM_aktiv_KL15: raw 0..1
  range DC_HVLE_OBG_Typ_verbaut: raw 0..7
  range DC_ELF_GeplEndeLadevorgangStatus: raw 0..1
  range DC_ELF_GeplEndeLadevorgangStunde: phys 0..23 Unit_Hours, raw 0..31
  range DC_HVLM_Intensitaet_Lk2: phys 0..100 Unit_PerCent, raw 0..127
  range DC_ELF_GeplEndeLadevorgangTag: phys 1..31 Unit_Day, raw 0..31
  range DC_HCP1_Indc_StChk: raw 0..1
  range DC_BMC_AC_Laden: raw 0..3
  range DC_NM_AWC_NM_State: raw 0..32
  range DC_HVLM_Intensitaet_Lk3: phys 0..100 Unit_PerCent, raw 0..127
  range DC_NM_AWC_SNI_10: raw 143
  range DC_BMC_Bank_Notlauf_erlaubt: raw 0..1
  range DC_NM_AWC_UDS_CC: raw 0..1
  range DC_HVLM_LadedosenSuchlicht: raw 0..2
  range DC_NM_AWC_Wakeup_V12: raw 0..128
  range DC_BMC_CMC_Zellspannung_154: phys 1000..5091 Unit_MilliVolt, raw 0..4095
  range DC_BMC_Bank_parallel_erlaubt: raw 0..1
  range DC_NM_Dummy01_CAB: raw 0..8388608
  range DC_AB_Gurtwarn_Reihe3_BF: raw 0..3
  range DC_BMC_CMC_Zellspannung_155: phys 1000..5091 Unit_MilliVolt, raw 0..4095
  range DC_HVLM_Ladeklappe_VerEntriegeAnf_1: raw 0..3
  range DC_HVLM_Steckerstatus: raw 0..3
  range DC_NM_Hybrid_01_NM_aktiv_KondAnf: raw 0..1
  range DC_BMC_CMC_Zellspannung_156: phys 1000..5091 Unit_MilliVolt, raw 0..4095
  range DC_BMC_Bank_seriell_erlaubt: raw 0..1
  range DC_OBD_Calc_Load_Val: phys 0..100 Unit_PerCent, raw 0..255
  range DC_HVLM_VA_Sollmodus: raw 0..3
  range DC_NM_Hybrid_01_NM_aktiv_Tmin: raw 0..1
  range DC_BMC_CMC_Zellspannung_157: phys 1000..5091 Unit_MilliVolt, raw 0..4095
  range DC_KN_Hybrid_01_DiagPfad_V12: raw 0..1
  range DC_HVLE_OBG_Warnzustand: raw 0..9
  range DC_BMC_RtmWarnSocSprung: raw 0..7
  range DC_HVLM_VALeistungFzg: phys 0..40920 Unit_Watt, raw 0..4095
  range DC_NM_Hybrid_01_NM_State: raw 0..32
  range DC_OruControlReleaseA: phys 0..65535 Unit_None, raw 0..65535
  range DC_NM_aktiv_Backend_KomGW: raw 0..1
  range DC_KN_Hybrid_01_ECUKnockOut: raw 0..3
  range DC_HVLE_PE_Monitor: raw 0..7
  range DC_BMC_CMC_Zellspannung_158: phys 1000..5091 Unit_MilliVolt, raw 0..4095
  range DC_BMC_RtmWarnTZelleDiff: raw 0..7
  range DC_NM_Hybrid_01_SNI_10: raw 123
  range DC_HVLM_VASpannungFzg: phys 0..1020 Unit_Volt, raw 0..1023
  range DC_HVLE_U_istAC_Netz_L1: phys 0..508 Unit_Volt, raw 0..511
  range DC_KN_Hybrid_01_ECUKnockOutTimer: phys 0..62, raw 0..63
  range DC_NM_aktiv_Batteriekonditionierung: raw 0..1
  range DC_NM_Hybrid_01_Subsystemaktiv: raw 0..1
  range DC_BMC_RtmWarnTZelleMax: raw 0..7
  range DC_HVLM_VAStromFzg: phys 0..102 Unit_Amper, raw 0..1023
  range DC_HVLE_U_istAC_Netz_L2: phys 0..508 Unit_Volt, raw 0..511
  range DC_OBD_ClearMem_Inhibit: raw 0..1
  range DC_Kompressor_Status: raw 0..3
  range DC_OruControlReleaseD: phys 0..65535 Unit_None, raw 0..65535
  range DC_NM_aktiv_Bedienung_an_Ladedose_1: raw 0..1
  range DC_HVLE_U_istAC_Netz_L3: phys 0..508 Unit_Volt, raw 0..511
  range DC_KS_Hybrid_01_ChK: phys 0..18446744073709551615 Unit_None, raw 0..18446744073709551615
  range DC_NM_aktiv_Bedienung_an_Ladedose_2: raw 0..1
  range DC_SI_P_Mode: raw 0..1
  range DC_OBD_Driving_Cycle: raw 0..1
  range DC_OruControlStateA: raw 0..129
  range DC_NM_aktiv_Call: raw 0..1
  range DC_NM_Dummy01_CBV_AWB: raw 0..1
  range DC_SI_P_Mode_gueltig: raw 0..1
  range DC_NM_Dummy01_CBV_CRI: raw 0..1
  range DC_HVLM_Ladeklappe_VerEntriegeAnf_2: raw 0..3
  range DC_OBD_Eng_Cool_Temp: phys -40..215 Unit_DegreCelsi, raw 0..255
  range DC_OruControlStateD: raw 0..129
  range DC_NM_Dummy01_NM_State: raw 0..32
  range DC_NM_Hybrid_01_UDS_CC: raw 0..1
  range DC_NM_Gateway_CBV_AWB: raw 0..1
  range DC_NM_Hybrid_01_Wakeup_V12: raw 0..128
  range DC_HVLM_WakeUpZaehlerResetAnf: raw 0..1
  range DC_OBD_Engine_RPM: phys 0..16383.75 Unit_MinutInver, raw 0..65535
  range DC_HCP1_Indc_StFail: raw 0..1
  range DC_NM_Gateway_CBV_CRI: raw 0..1
  range DC_NM_Ladegeraet_CBV_AWB: raw 0..1
  range DC_BMC_CMC_Zellspannung_159: phys 1000..5091 Unit_MilliVolt, raw 0..4095
  range DC_HV_Bordnetz_aktiv: raw 0..1
  range DC_NM_Ladegeraet_CBV_CRI: raw 0..1
  range DC_UI1_KompFehlerModus2_23: raw 0..3
  range DC_HVLM_Ladeklappe_VerEntriegeAnf_3: raw 0..3
  range DC_BMC_Bankstatus: raw 0..15
  range DC_BMC_CMC_Zellspannung_160: phys 1000..5091 Unit_MilliVolt, raw 0..4095
  range DC_NM_Ladegeraet_FCAB: raw 0..36028797018963968
  range DC_HV_Bordnetz_Fehler: raw 0..1
  range DC_BMC_CMC_Zellspannung_161: phys 1000..5091 Unit_MilliVolt, raw 0..4095
  range DC_UI1_KompFehlerModus2_24: raw 0..3
  range DC_HV_Heizer_Status: raw 0..3
  range DC_BMC_CMC_Zellspannung_162: phys 1000..5091 Unit_MilliVolt, raw 0..4095
  range DC_UI1_KompFehlerModus2_25: raw 0..3
  range DC_BMC_CMC_Zellspannung_163: phys 1000..5091 Unit_MilliVolt, raw 0..4095
  range DC_UI1_KompFehlerModus2_26: raw 0..3
  range DC_UI2_KompFehlerModus4_03: raw 0..7
  range DC_BMC_Bidi_Energie_Absolut: phys 0..65533 Unit_KiloWattHour, raw 0..65535
  range DC_UI2_KompFehlerModus4_04: raw 0..7
  range DC_BMC_Bidi_Freigabe: raw 0..3
  range DC_TME_Min_Leerlaufdrehzahl: phys 500..1750 Unit_MinutInver, raw 0..127
  range DC_UI2_KompFehlerModus4_05: raw 0..7
  range DC_TME_MSF_Stufe: raw 0..3
  range DC_NM_Ladegeraet_NM_aktiv_Diag: raw 0..1
  range DC_BMC_Bidi_GenutzteEnergie: phys 0..65533 Unit_KiloWattHour, raw 0..65535
  range DC_TME_MVEM_MinLeistung: phys 0..12650 Unit_Watt, raw 0..255
  range DC_NM_Ladegeraet_NM_aktiv_KL15: raw 0..1
  range DC_UI2Sens02_CALID_Index_14: phys 0..255, raw 0..255
  range DC_OruHostUpdateA: raw 0..4
  range DC_TME_MVEM_Wunschleistung: phys 0..12650 Unit_Watt, raw 0..255
  range DC_NM_Ladegeraet_NM_aktiv_Tmin: raw 0..1
  range DC_BMC_Bidi_Max_SoC: phys 0..100 Unit_PerCent, raw 0..127
  range DC_TME_MVH_L_Istmodus: raw 0..7
  range DC_NM_Ladegeraet_NM_State: raw 0..32
  range DC_UI2Sens02_CALID_Index_15: phys 0..255, raw 0..255
  range DC_NM_Ladegeraet_SNI_10: raw 68
  range DC_OBD_Kaltstart_Denominator: raw 0..1
  range DC_NM_aktiv_ConnectVerbund_UseCase1: raw 0..1
  range DC_OruHostUpdateD: raw 0..4
  range DC_SI_QRS_Mode: raw 0..1
  range DC_NM_aktiv_ConnectVerbund_UseCase2: raw 0..1
  range DC_SI_T_Mode: raw 0..1
  range DC_NM_aktiv_ConnectVerbund_UseCase3: raw 0..1
  range DC_OruIntegrityCheckActiveA: raw 0..3
  range DC_CHA_ReqPrgEsc: raw 0..15
  range DC_NM_Gateway_FCAB: raw 0..36028797018963968
  range DC_SI_T_Schutz: raw 0..1
  range DC_NM_aktiv_ConnectVerbund_UseCase4: raw 0..1
  range DC_CHA_ReqPrgExtrLight: raw 0..15
  range DC_OBD_MIL: raw 0..1
  range DC_SOK_ungeschuetzte_Zeit: phys 1..72057594037927935 Unit_None, raw 0..72057594037927935
  range DC_NM_Gateway_NM_aktiv_CABaktiv: raw 0..1
  range DC_NM_aktiv_ConnectVerbund_UseCase5: raw 0..1
  range DC_OruIntegrityCheckActiveD: raw 0..3
  range DC_CHA_ReqPrgExtrSound: raw 0..15
  range DC_SOK_Zeit_Hybrid_01_Challenge: phys 0..18446744073709551615 Unit_None, raw 0..18446744073709551615
  range DC_NM_Gateway_NM_aktiv_Diag: raw 0..1
  range DC_CHA_ReqPrgHdc: raw 0..15
  range DC_NM_Gateway_NM_aktiv_KL15: raw 0..1
  range DC_OBD_Minimum_Trip: raw 0..1
  range DC_CHA_ReqPrgHdUpDisp: raw 0..15
  range DC_OruReleasePartitionSwitchA: raw 0..3
  range DC_NM_Gateway_NM_aktiv_Tmin: raw 0..1
  range DC_BMC_CMC_Zellspannung_164: phys 1000..5091 Unit_MilliVolt, raw 0..4095
  range DC_NM_Gateway_NM_State: raw 0..32
  range DC_BMC_Bidi_Min_SoC: phys 0..100 Unit_PerCent, raw 0..127
  range DC_BMC_CMC_Zellspannung_165: phys 1000..5091 Unit_MilliVolt, raw 0..4095
  range DC_NM_Gateway_SNI_10: raw 16
  range DC_UI1_KompFehlerModus4_01: raw 0..7
  range DC_SOK_Zeit_Hybrid_01_Zeit: phys 0..72057594037927935 Unit_None, raw 0..72057594037927935
  range DC_BMC_CMC_Zellspannung_166: phys 1000..5091 Unit_MilliVolt, raw 0..4095
  range DC_NM_aktiv_ConnectVerbund_UseCase6: raw 0..1
  range DC_NM_Gateway_UDS_CC: raw 0..1
  range DC_UI1_KompFehlerModus4_02: raw 0..7
  range DC_KS_Hybrid_01_ChK_IKACtr: phys 0..255 Unit_None, raw 0..255
  range DC_NM_Gateway_Wakeup_V12: raw 0..183
  range DC_NM_Ladegeraet_UDS_CC: raw 0..1
  range DC_Thermo_Verbrauch_BTL: phys 0..8191 Unit_WattSecond, raw 0..8191
  range DC_UI2Sens02_CALID_Index_16: phys 0..255, raw 0..255
  range DC_NM_aktiv_E3_SW_Plattform_1: raw 0..1
  range DC_BMC_CMC_Zellspannung_167: phys 1000..5091 Unit_MilliVolt, raw 0..4095
  range DC_UI1_KompFehlerModus4_03: raw 0..7
  range DC_KS_Hybrid_01_ChK_SID: phys 0..65535 Unit_None, raw 0..65535
  range DC_NM_Ladegeraet_Wakeup_V12: raw 0..2
  range DC_BMC_Bidi_Veto_Energie: raw 0..1
  range DC_Thermo_Verbrauch_BTL_Ueberlauf: raw 0..1
  range DC_NM_aktiv_E3_SW_Plattform_2: raw 0..1
  range DC_OBD_Normed_Trip: raw 0..1
  range DC_BMC_CMC_Zellspannung_168: phys 1000..5091 Unit_MilliVolt, raw 0..4095
  range DC_KS_Hybrid_01_ChM: phys 0..18446744073709551615 Unit_None, raw 0..18446744073709551615
  range DC_NM_SACID_1_CBV_AWB: raw 0..1
  range DC_UI1_KompFehlerModus4_04: raw 0..7
  range DC_KS_Hybrid_01_ChM_IKACtr: phys 0..255 Unit_None, raw 0..255
  range DC_Thermo_Verbrauch_Innen: phys 0..8191 Unit_WattSecond, raw 0..8191
  range DC_NM_aktiv_E3_SW_Plattform_3: raw 0..1
  range DC_NM_SACID_1_CBV_CRI: raw 0..1
  range DC_DCDC_NV_Komponentenfehler_3_14: raw 0..7
  range DC_NM_HVZB_CBV_AWB: raw 0..1
  range DC_OruReleasePartitionSwitchD: raw 0..3
  range DC_UI1_KompFehlerModus4_05: raw 0..7
  range DC_KS_Hybrid_01_ChM_SID: phys 0..65535 Unit_None, raw 0..65535
  range DC_OBD_Normed_Trip_Wout_Fu_Cdn: raw 0..1
  range DC_BMC_Bidi_Veto_Temp: raw 0..1
  range DC_NM_SACID_1_FCAB: raw 0..36028797018963968
  range DC_Thermo_Verbrauch_Innen_Ueberlauf: raw 0..1
  range DC_UI2Sens02_CVN_Byte_1: phys 0..255, raw 0..255
  range DC_NM_HVZB_CBV_CRI: raw 0..1
  range DC_HVEM_Abschaltstufe: raw 0..7
  range DC_TME_MVH_L_Spannung: phys 0..63.25 Unit_Volt, raw 0..255
  range DC_NM_HVZB_FCAB: raw 0..36028797018963968
  range DC_BMC_CMC_Zellspannung_169: phys 1000..5091 Unit_MilliVolt, raw 0..4095
  range DC_TME_MVH_L_Strom: phys 0..127.25 Unit_Amper, raw 0..511
  range DC_BMC_CMC_Temperatur_001: phys -40..86 Unit_DegreCelsi, raw 0..255
  range DC_OruVehicleLockRequestA: raw 0..3
  range DC_HVEM_AIAD_Energieinhalt: phys 0..102250 Unit_WattHour, raw 0..2047
  range DC_DCDC_NV_Komponentenfehler_3_15: raw 0..7
  range DC_NM_HVZB_NM_aktiv_Diag: raw 0..1
  range DC_UI2Sens02_CVN_Byte_2: phys 0..255, raw 0..255
  range DC_NM_aktiv_E3_SW_Plattform_4: raw 0..1
  range DC_TME_MVH_L_Verbauinfo: raw 0..2
  range DC_UISensorPyro_02_CRC: phys 0..255, raw 0..255
  range DC_NM_HVZB_NM_aktiv_KL15: raw 0..1
  range DC_HVEM_AIAD_Leistungsvorgabe: phys 0..25450 Unit_Watt, raw 0..511
  range DC_TME_Notbelueftung_Aktivierung: raw 0..1
  range DC_NM_aktiv_E3_SW_Plattform_5: raw 0..1
  range DC_UISensorPyro_03_BZ: phys 0..15, raw 0..15
  range DC_BMC_CMC_Temperatur_002: phys -40..86 Unit_DegreCelsi, raw 0..255
  range DC_OruVehicleLockRequestD: raw 0..3
  range DC_UI2Sens02_CVN_Byte_3: phys 0..255, raw 0..255
  range DC_DCDC_NV_Komponentenfehler_3_16: raw 0..7
  range DC_TME_NT_Kreis_Status: raw 0..1
  range DC_HVEM_AIAD_RekuVerbot: raw 0..3
  range DC_NM_aktiv_Erw_HV_Ladefunktion: raw 0..1
  range DC_UISensorPyro_03_CRC: phys 0..255, raw 0..255
  range DC_HVEM_BMC_CHA_Wunschleistung: phys 0..818900 Unit_Watt, raw 0..8191
  range DC_NM_aktiv_Gefahreninfo: raw 0..1
  range DC_VDSO_05_BZ: phys 0..15, raw 0..15
  range DC_OTAMC_D_01_BZ: phys 0..15, raw 0..15
  range DC_UI2Sens02_CVN_Byte_4: phys 0..255, raw 0..255
  range DC_DCDC_NV_Komponentenfehler_3_2: raw 0..7
  range DC_NM_aktiv_HV_Laden: raw 0..1
  range DC_DCDC_NV_Komponentenfehler_3_3: raw 0..7
  range DC_OTAMC_D_01_CRC: phys 0..255, raw 0..255
  range DC_UI1_KompFehlerModus4_06: raw 0..7
  range DC_UI1_KompFehlerModus4_07: raw 0..7
  range DC_NM_SACID_1_NM_aktiv_Diag: raw 0..1
  range DC_TME_Anforderung_Heizkreispumpe: phys 0..100 Unit_PerCent, raw 0..127
  range DC_UI1_KompFehlerModus4_08: raw 0..7
  range DC_NM_HVZB_NM_aktiv_Tmin: raw 0..1
  range DC_NM_SACID_1_NM_aktiv_KL15: raw 0..1
  range DC_TME_Antriebszustand_Anf: raw 0..7
  range DC_UI1_KompFehlerModus4_09: raw 0..7
  range DC_NM_HVZB_NM_State: raw 0..32
  range DC_NM_SACID_1_NM_aktiv_Tmin: raw 0..1
  range DC_TME_NT_Kuehlmittel_Sensor_02: raw 0..1
  range DC_UI1_KompFehlerModus4_10: raw 0..7
  range DC_TME_Batt_Kond_status: raw 0..1
  range DC_NM_HVZB_SNI_10: raw 285
  range DC_NM_SACID_1_NM_State: raw 0..32
  range DC_TME_OBD_Lampe_Anf: raw 0..1
  range DC_TME_Batt_Kond_Verf: raw 0..4
  range DC_NM_SACID_1_SNI_10: raw 283
  range DC_TME_PTC_Leistung_Ist: phys 0..5090 Unit_Watt, raw 0..511
  range DC_TME_DCDC_HV_Status_Kuehlung: raw 0..2
  range DC_TME_PTC_stufig_Status: raw 0..7
  range DC_OBD_NumDcyMilOnReq: phys 0..255 Unit_None, raw 0..255
  range DC_TME_PTC_Verbauinfo: raw 0..3
  range DC_BMC_CMC_Temperatur_003: phys -40..86 Unit_DegreCelsi, raw 0..255
  range DC_HVEM_BMC_CHA_Wunschleistung_02: phys 0..3250000 Unit_Watt, raw 0..32767
  range DC_HVEM_ETM_Max_Entladeleistung: phys 0..818900 Unit_Watt, raw 0..8191
  range DC_KS_Hybrid_01_ReK: phys 0..18446744073709551615 Unit_None, raw 0..18446744073709551615
  range DC_BMC_CMC_Temperatur_004: phys -40..86 Unit_DegreCelsi, raw 0..255
  range DC_OBD_QBit_Aussen_Temp: raw 0..1
  range DC_NM_aktiv_HVEM: raw 0..1
  range DC_HVEM_ETM_Max_Entladeleistung_02: phys 0..3250000 Unit_Watt, raw 0..32767
  range DC_KS_Hybrid_01_ReK_IKACtr: phys 0..255 Unit_None, raw 0..255
  range DC_NM_aktiv_HVK: raw 0..1
  range DC_HVEM_ETM_Max_Ladeleistung: phys 0..818900 Unit_Watt, raw 0..8191
  range DC_VDSO_05_CRC: phys 0..255, raw 0..255
  range DC_KS_Hybrid_01_ReK_SID: phys 0..65535 Unit_None, raw 0..65535
  range DC_NM_SACID_1_UDS_CC: raw 0..1
  range DC_BMC_CMC_Temperatur_005: phys -40..86 Unit_DegreCelsi, raw 0..255
  range DC_OBD_Sperrung_IUMPR: raw 0..1
  range DC_NM_aktiv_HVLM: raw 0..1
  range DC_UI1_KompFehlerModus4_11: raw 0..7
  range DC_HVEM_ETM_Max_Ladeleistung_02: phys 0..3250000 Unit_Watt, raw 0..32767
  range DC_KS_Hybrid_01_ReM: phys 0..18446744073709551615 Unit_None, raw 0..18446744073709551615
  range DC_VDSO_BasTi200_NumClc_05: phys 0..15 Unit_None, raw 0..15
  range DC_NM_SACID_1_Wakeup_V12: raw 0..6
  range DC_UI1_KompFehlerModus4_12: raw 0..7
  range DC_KS_Hybrid_01_ReM_IKACtr: phys 0..255 Unit_None, raw 0..255
  range DC_NM_aktiv_Key_Authentifiz_SMS: raw 0..1
  range DC_VDSO_Vx3d: phys -127.7874..127.7913 Unit_MeterPerSecon, raw 0..65535
  range DC_NM_SACID_2_CBV_AWB: raw 0..1
  range DC_OBD_Sperrung_Kaltstart_Denom: raw 0..1
  range DC_BMC_CMC_Temperatur_006: phys -40..86 Unit_DegreCelsi, raw 0..255
  range DC_NM_SACID_2_CBV_CRI: raw 0..1
  range DC_VDSO_Vx3dDisp: phys -127.7874..127.7913 Unit_MeterPerSecon, raw 0..65535
  range DC_UI1_KompFehlerModus4_13: raw 0..7
  range DC_NM_aktiv_Konditionierung_Track: raw 0..1
  range DC_NM_SACID_2_FCAB: raw 0..36028797018963968
  range DC_VDSO_Vx3dKmph: phys -458.724..458.738 Unit_KiloMeterPerHour, raw 0..65535
  range DC_UI1_KompFehlerModus4_14: raw 0..7
  range DC_OBD_Typ: raw 0..1
  range DC_BMC_CMC_Temperatur_007: phys -40..86 Unit_DegreCelsi, raw 0..255
  range DC_UI1_KompFehlerModus4_15: raw 0..7
  range DC_TME_Temp_KM_vor_LE: phys -48..141.75 Unit_DegreCelsi, raw 0..255
  range DC_TME_EKK_HVK_Fehler_AE: raw 0..3
  range DC_TME_Temp_nach_Heizregister: phys -20..82 Unit_DegreCelsi, raw 0..1023
  range DC_TME_EKK_Istmodus: raw 0..7
  range DC_TME_Temp_nach_Heizung_Front: phys -20..82.1 Unit_DegreCelsi, raw 0..1023
  range DC_HVEM_ETM_Max_Leistung_Verteiler: phys 0..51050 Unit_Watt, raw 0..1023
  range DC_TME_eKMV_Istmodus: raw 0..7
  range DC_TME_Temp_nach_HVH_Heizk1_1: phys -40..164.2 Unit_DegreCelsi, raw 0..1023
  range DC_TME_Temp_nach_HVH_Heizk1_2: phys -40..164.2 Unit_DegreCelsi, raw 0..1023
  range DC_TME_eKMV_Spannung: phys 0..101.8 Unit_Volt, raw 0..511
  range DC_TME_eKMV_Strom: phys 0..189.75 Unit_Amper, raw 0..255
  range DC_NM_SACID_2_NM_aktiv_Diag: raw 0..1
  range DC_NM_SACID_2_NM_aktiv_KL15: raw 0..1
  range DC_NM_SACID_2_NM_aktiv_Tmin: raw 0..1
  range DC_NM_SACID_2_NM_State: raw 0..32
  range DC_NM_SACID_2_SNI_10: raw 284
  range DC_VehicleProtectedEnvironment_D: raw 0..2
  range DC_NM_aktiv_Konditionierungsbedarf: raw 0..1
  range DC_KS_Hybrid_01_ReM_SID: phys 0..65535 Unit_None, raw 0..65535
  range DC_VIN_1: phys 0..255, raw 0..255
  range DC_NM_aktiv_Ladestecker_erkannt_1: raw 0..1
  range DC_KS_Hybrid_01_Req_ErrCtr: phys 0..255 Unit_None, raw 0..255
  range DC_VIN_10: phys 0..255, raw 0..255
  range DC_KS_Hybrid_01_Req_IKA_Retry: raw 0..1
  range DC_NM_aktiv_Ladestecker_erkannt_2: raw 0..1
  range DC_VIN_11: phys 0..255, raw 0..255
  range DC_KS_Hybrid_01_Req_Prio: raw 0..1
  range DC_NM_aktiv_Ladezustand: raw 0..1
  range DC_KS_Hybrid_01_Req_SID: phys 0..65535 Unit_None, raw 0..65535
  range DC_VIN_12: phys 0..255, raw 0..255
  range DC_NM_aktiv_MVEM_Fremdladung: raw 0..1
  range DC_UI2Sens02_CVN_VLD: raw 0..1
  range DC_OTP_01_BZ: phys 0..15, raw 0..15
  range DC_NM_SACID_2_UDS_CC: raw 0..1
  range DC_OTP_01_CRC: phys 0..255, raw 0..255
  range DC_NM_SACID_2_Wakeup_V12: raw 0..5
  range DC_DCDC_NV_Komponentenfehler_3_4: raw 0..7
  range DC_OBD_Warm_Up_Cycle: raw 0..1
  range DC_UI2Sens02_ErrMem_State: raw 1..3
  range DC_NVEM3_Absch_SCR: raw 0..1
  range DC_UI1_KompFehlerModus4_16: raw 0..7
  range DC_NVEM_12_BZ: phys 0..15, raw 0..15
  range DC_TME_ELM1_IstVolumenstrom: phys 0..14.5 Unit_LiterPerMinut, raw 0..31
  range DC_OTP_Aussen_Temp_FStatus: raw 0..15
  range DC_UI1_Spannung1: phys -1023..1024.6875 Unit_Volt, raw 0..32767
  range DC_NVEM_12_CRC: phys 0..255, raw 0..255
  range DC_TME_Temp_nach_HVH_Heizk2_1: phys -40..164.2 Unit_DegreCelsi, raw 0..1023
  range DC_UISensorIso_01_BZ: phys 0..15, raw 0..15
  range DC_TME_ELM2_IstVolumenstrom: phys 0..14.5 Unit_LiterPerMinut, raw 0..31
  range DC_UI1_Spannung1_Schalt_Status: raw 0..7
  range DC_DCDC_NV_Komponentenfehler_3_5: raw 0..7
  range DC_TME_Temp_nach_HVH_Heizk2_2: phys -40..164.2 Unit_DegreCelsi, raw 0..1023
  range DC_OTP_Aussen_Temp_gef: phys -50..75 Unit_DegreCelsi, raw 0..255
  range DC_TME_ELM3_IstVolumenstrom: phys 0..14.5 Unit_LiterPerMinut, raw 0..31
  range DC_UI1_Spannung2: phys -1023..1024.6875 Unit_Volt, raw 0..32767
  range DC_OBDProtocol_Hybrid_01: raw 0..15
  range DC_TME_Temp_nach_HVH_Heizk3_1: phys -40..164.2 Unit_DegreCelsi, raw 0..1023
  range DC_UISensorIso_01_CRC: phys 0..255, raw 0..255
  range DC_TME_ETV_IstVolumenstrom: phys 0..30 Unit_LiterPerMinut, raw 0..511
  range DC_UI1_Spannung2_Schalt_Status: raw 0..7
  range DC_TME_Temp_nach_HVH_Heizk3_2: phys -40..164.2 Unit_DegreCelsi, raw 0..1023
  range DC_DCDC_NV_Komponentenfehler_3_6: raw 0..7
  range DC_VIN_13: phys 0..255, raw 0..255
  range DC_OTP_Aussen_Temp_OBD: raw 0..1
  range DC_BMC_CMC_Temperatur_008: phys -40..86 Unit_DegreCelsi, raw 0..255
  range DC_TME_Temp_nach_HVH_Heizk4_1: phys -40..164.2 Unit_DegreCelsi, raw 0..1023
  range DC_TME_Heizanforderung_Innenraum: raw 0..3
  range DC_OBDProtocol_req: raw 0..15
  range DC_KS_Hybrid_01_Req_SWMaj: phys 0..255 Unit_None, raw 0..255
  range DC_UISensorIso_02_BZ: phys 0..15, raw 0..15
  range DC_VIN_14: phys 0..255, raw 0..255
  range DC_DCDC_NV_Komponentenfehler_3_7: raw 0..7
  range DC_KS_Hybrid_01_Req_SWMin: phys 0..255 Unit_None, raw 0..255
  range DC_NVEM_Abschaltstufe: raw 0..3
  range DC_VIN_15: phys 0..255, raw 0..255
  range DC_KS_Hybrid_01_Req_SWPat: phys 0..255 Unit_None, raw 0..255
  range DC_OBG_01_BZ: phys 0..15, raw 0..15
  range DC_NVEM_Bordnetz_Information: raw 0..15
  range DC_BMC_CMC_Temperatur_009: phys -40..86 Unit_DegreCelsi, raw 0..255
  range DC_VIN_16: phys 0..255, raw 0..255
  range DC_KS_Hybrid_01_Req_VKMS_Err: raw 0..1
  range DC_DCDC_NV_Komponentenfehler_3_8: raw 0..7
  range DC_NVEM_Bordnetzdiagnose: raw 0..3
  range DC_VIN_17: phys 0..255, raw 0..255
  range DC_TME_Temp_nach_HVH_Heizk4_2: phys -40..164.2 Unit_DegreCelsi, raw 0..1023
  range DC_KST_Anf_Klemmenfreigabe_ELV: raw 0..1
  range DC_NVEM_DC_iSoll_NV: phys -253..0 Unit_Amper, raw 0..255
  range DC_UI1_Spannung3: phys -1023..1024.6875 Unit_Volt, raw 0..32767
  range DC_OnlineRemoteUpdateControlA: raw 0..15
  range DC_TME_Temp_nach_Verdampfer_Front: phys -20..70 Unit_DegreCelsi, raw 0..1023
  range DC_BMC_CMC_Temperatur_010: phys -40..86 Unit_DegreCelsi, raw 0..255
  range DC_NVEM_DC_uMin_NV: phys 0..25.5 Unit_Volt, raw 0..255
  range DC_NM_aktiv_MVEM_Pos_RSG: raw 0..1
  range DC_TME_Therm_IstLeistung_HVBatterie: phys -25500..25400 Unit_Watt, raw 0..511
  range DC_UI1_Spannung4: phys -1023..1024.6875 Unit_Volt, raw 0..32767
  range DC_TME_Verbrauch_gesamt: phys 0..4095 Unit_WattSecond, raw 0..4095
  range DC_NM_aktiv_NVEM: raw 0..1
  range DC_BMC_CMC_Temperatur_011: phys -40..86 Unit_DegreCelsi, raw 0..255
  range DC_TME_HT_Kuehlmittel_Sensor: raw 0..1
  range DC_UI1_Spannung5: phys -1023..1024.6875 Unit_Volt, raw 0..32767
  range DC_OTP_Aussen_Temp_ungef: phys -50..76 Unit_DegreCelsi, raw 0..255
  range DC_TME_Verbrauch_gesamt_Ueberlauf: raw 0..1
  range DC_NM_aktiv_NVEM2: raw 0..1
  range DC_TME_HV_Anf: raw 0..3
  range DC_UI1_Spannung6: phys -1023..1024.6875 Unit_Volt, raw 0..32767
  range DC_TME_HV_IstLeistung: phys 0..25450 Unit_Watt, raw 0..511
  range DC_BMC_CMC_Temperatur_012: phys -40..86 Unit_DegreCelsi, raw 0..255
  range DC_NM_aktiv_OnlineRemoteUpdate: raw 0..1
  range DC_UI1_Status: raw 0..1
  range DC_TME_HV_IstLeistung_BTL: phys 0..25450 Unit_Watt, raw 0..511
  range DC_PCM_BMC_VTD_Freeze_Req: raw 0..3
  range DC_NM_aktiv_Remote_Repair: raw 0..1
  range DC_TME_HV_IstLeistung_EKK: phys 0..12500 Unit_Watt, raw 0..127
  range DC_PCM_BMC_VTD_LifeTimeReset_Req: raw 0..3
  range DC_PCM_BMC_VTD_LifeTimeReset_Resp: raw 0..3
  range DC_PCM_BMC_VTD_RecentReset_Req: raw 0..3
  range DC_TME_Vorwarn_Komp_ein: raw 0..1
  range DC_VIN_2: phys 0..255, raw 0..255
  range DC_TME_ZR_Anforderung: raw 0..3
  range DC_NVEM_DC_uSoll_NV: phys 10.6..16 Unit_Volt, raw 0..255
  range DC_VIN_3: phys 0..255, raw 0..255
  range DC_UH_Jahr: phys 2000..2127 Unit_Year, raw 0..127
  range DC_OnlineRemoteUpdateControlD: raw 0..15
  range DC_NVEM_Freigabe_OTA: raw 0..2
  range DC_VIN_4: phys 0..255, raw 0..255
  range DC_UH_Minute: phys 0..59 Unit_Minut, raw 0..59
  range DC_NVEM_Last_Anf: raw 0..3
  range DC_UISensorIso_02_CRC: phys 0..255, raw 0..255
  range DC_VIN_5: phys 0..255, raw 0..255
  range DC_UH_Monat: phys 1..12 Unit_Month, raw 0..15
  range DC_NVEM_MV_DC_iSoll_NV: phys -253..0 Unit_Amper, raw 0..255
  range DC_VIN_6: phys 0..255, raw 0..255
  range DC_OnlineRemoteUpdateControlOldA: raw 0..15
  range DC_DCDC_NV_Komponentenfehler_3_9: raw 0..7
  range DC_UISensorPyro_01_BZ: phys 0..15, raw 0..15
  range DC_DCDC_NV_Komponentenfehler_40: raw 0..3
  range DC_UISensorPyro_01_CRC: phys 0..255, raw 0..255
  range DC_DCDC_NV_Komponentenfehler_41: raw 0..3
  range DC_UISensorPyro_02_BZ: phys 0..15, raw 0..15
  range DC_DCDC_NV_Komponentenfehler_42: raw 0..3
  range DC_DCDC_NV_Komponentenfehler_43: raw 0..3
  range DC_OnlineRemoteUpdateControlOldD: raw 0..15
  range DC_ORU_AgLgtSdsl: phys -100..100 Unit_PerCent, raw 0..2002
  range DC_ORU_Control_A_01_BZ: phys 0..15, raw 0..15
  range DC_NVEM_MV_DC_uMinLV: phys 3.5..16 Unit_Volt, raw 0..127
  range DC_VIN_7: phys 0..255, raw 0..255
  range DC_UI1_Strom: phys -2621..2621.865 Unit_Amper, raw 0..1048575
  range DC_VIN_8: phys 0..255, raw 0..255
  range DC_UI1_Stromintegral_Entladen: phys 0..65533 Unit_AmperSecon, raw 0..65535
  range DC_VIN_9: phys 0..255, raw 0..255
  range DC_UH_Sekunde: phys 0..59 Unit_Secon, raw 0..59
  range DC_Waermepumpe_Status: raw 0..3
  range DC_UI1_Stromintegral_Laden: phys 0..65533 Unit_AmperSecon, raw 0..65535
  range DC_WFS_02_BZ: phys 0..15, raw 0..15
  range DC_UH_Stunde: phys 0..23 Unit_Hours, raw 0..23
  range DC_WFS_02_CRC: phys 0..255, raw 0..255
  range DC_UI1_Temperatur_1: phys -40..212 Unit_DegreCelsi, raw 0..255
  range DC_UH_Tag: phys 1..31 Unit_Day, raw 0..31
  range DC_WFS_Betrieb_Lesespule: raw 0..1
  range DC_WFS_ELV_authorisiert: raw 0..1
  range DC_UI1_Iso_Neg: phys 0..6553200 Unit_Ohm, raw 0..65535
  range DC_UI1_Temperatur_2: phys -40..212 Unit_DegreCelsi, raw 0..255
  range DC_WFS_Fahrerhinweise: raw 0..3
  range DC_UI1_Iso_Pos: phys 0..6553200 Unit_Ohm, raw 0..65535
  range DC_WFS_ID_Geb_autorisiert: raw 0..1
  range DC_UI1_Iso_Status: raw 0..5
  range DC_WFS_ID_Geb_autorisiert_in_Kl15: raw 0..1
  range DC_UI2_HW_Crashleitung_Status: raw 0..3
  range DC_UI1_KL30_Spannung: phys 0..25.3 Unit_Volt, raw 0..255
  range DC_WFS_ID_Geb_steckt: raw 0..1
  range DC_UI1_KompFehlerModus2_01: raw 0..3
  range DC_WFS_Klemmenfreigabe: raw 0..1
  range DC_UI2_KL30_Spannung: phys 0..25.3 Unit_Volt, raw 0..255
  range DC_UI1_KompFehlerModus2_02: raw 0..3
  range DC_WFS_LF_Aktiv: raw 0..1
  range DC_WFS_LZ_02: raw 0..9
  range DC_UI1_KompFehlerModus2_03: raw 0..3
  range DC_UI2_KompFehlerModus2_01: raw 0..3
  range DC_WFS_Parken_Status: raw 0..2
  range DC_UI1_KompFehlerModus2_04: raw 0..3
  range DC_WFS_Safe: raw 0..1
  range DC_UI1_KompFehlerModus2_05: raw 0..3
  range DC_UI2_KompFehlerModus2_02: raw 0..3
  range DC_WFS_Schluessel_Fahrberecht: raw 0..15
  range DC_UI1_KompFehlerModus2_06: raw 0..3
  range DC_WFS_Schluessel_Ist: phys 0..8 Unit_None, raw 0..8
  range DC_UI1_KompFehlerModus2_07: raw 0..3
  range DC_WFS_Schluessel_Soll: phys 0..8 Unit_None, raw 0..8
  range DC_UI1_KompFehlerModus2_08: raw 0..3
  range DC_UI2_KompFehlerModus2_03: raw 0..3
  range DC_ZM_Fahrzeugabstellzeit: phys 0..16372 Unit_Minut, raw 0..4095
  range DC_UI1_KompFehlerModus2_09: raw 0..3
  range DC_ZM_Fahrzeugabstellzeit_HiRes: phys 0..653300 Unit_Secon, raw 0..65535
  range DC_UI1_KompFehlerModus2_10: raw 0..3
  range DC_UI2_KompFehlerModus2_04: raw 0..3
  range DC_ZM_Fahrzeugabstellzeit_Status: raw 0..3
  range DC_UI1_KompFehlerModus2_11: raw 0..3
  range DC_ZM_HV_Auszeit: phys 0..16372 Unit_Minut, raw 0..4095
  range DC_UI1_KompFehlerModus2_12: raw 0..3
  range DC_UI2_KompFehlerModus2_05: raw 0..3
  range DC_ZM_HV_Auszeit_HiRes: phys 0..32766.5 Unit_Minut, raw 0..65535
  range DC_UI1_KompFehlerModus2_13: raw 0..3
  range DC_UI2_KompFehlerModus2_06: raw 0..3
  range DC_ZM_HV_Auszeit_Status: raw 0..3
  range DC_UI1_KompFehlerModus2_14: raw 0..3
  range DC_ZM_Standzeit: phys 0..131068 Unit_Secon, raw 0..131071
  range DC_UI1_KompFehlerModus2_15: raw 0..3
  range DC_UI2_KompFehlerModus2_07: raw 0..3
  range DC_UI1_KompFehlerModus2_16: raw 0..3
  range DC_UI1_KompFehlerModus2_17: raw 0..3
  range DC_UI2_KompFehlerModus2_08: raw 0..3
  range DC_UI1_KompFehlerModus2_{18..20}: raw 0..3
  range DC_UI2_KompFehlerModus2_09: raw 0..3
  range DC_UI1_KompFehlerModus2_21: raw 0..3
  range DC_UI1_KompFehlerModus2_22: raw 0..3
  range DC_UI2_KompFehlerModus2_{10..12}: raw 0..3
  range DC_ORU_Control_A_01_CRC: phys 0..255, raw 0..255
  range DC_UI2_KompFehlerModus2_13: raw 0..3
  range DC_UI2_KompFehlerModus2_14: raw 0..3
  range DC_NVEM_MV_DC_uSollLV: phys 10.6..16 Unit_Volt, raw 0..127
  range DC_UI2_KompFehlerModus2_15: raw 0..3
  range DC_ORU_Control_D_01_BZ: phys 0..15, raw 0..15
  range DC_NVEM_NV_BAT_ZellStatus_Index_Anf: raw 0..15
  range DC_UI2_KompFehlerModus2_16: raw 0..3
  range DC_ORU_Control_D_01_CRC: phys 0..255, raw 0..255
  range DC_NVEM_NV_BAT_ZellStatus_Typ_Anf: raw 0..7
  range DC_UI2_KompFehlerModus2_17: raw 0..3
  range DC_ORU_Status: raw 0..7
  range DC_NVEM_Verbraucher_Information: raw 0..7
  range DC_UI2_KompFehlerModus2_{18..26}: raw 0..3
  range DC_UI2_KompFehlerModus4_01: raw 0..7
  range DC_UI2_KompFehlerModus4_02: raw 0..7
  range DC_CHA_ReqPrgHsp: raw 0..15
  range DC_DCDC_NV_Komponentenfehler_44: raw 0..3
  range DC_CHA_ReqPrgIntrLight: raw 0..15
  range DC_DCDC_NV_Komponentenfehler_45: raw 0..3
  range DC_CHA_ReqPrgIntrSound: raw 0..15
  range DC_DCDC_NV_Komponentenfehler_46: raw 0..3
  range DC_CHA_ReqPrgKl: raw 0..15
  range DC_DCDC_NV_Komponentenfehler_47: raw 0..3
  range DC_CHA_ReqPrgLC: raw 0..15
  range DC_DCDC_NV_Komponentenfehler_48: raw 0..3
  range DC_BMC_CMC_Temperatur_013: phys -40..86 Unit_DegreCelsi, raw 0..255
  range DC_UI2_KompFehlerModus4_06: raw 0..7
  range DC_KST_Ausparken_Betrieb: raw 0..1
  range DC_CHA_ReqPrgPreCrash: raw 0..15
  range DC_DCDC_NV_Komponentenfehler_49: raw 0..3
  range DC_TME_HV_IstLeistung_HVHL: phys 0..12500 Unit_Watt, raw 0..127
  range DC_CHA_ReqPrgRcp: raw 0..15
  range DC_DCDC_NV_Komponentenfehler_50: raw 0..3
  range DC_UI2_KompFehlerModus4_07: raw 0..7
  range DC_CHA_ReqPrgRwb: raw 0..15
  range DC_PLC_StCpbPrkLockUnit: raw 0..3
  range DC_TME_HV_IstLeistung_HVHW: phys 0..12500 Unit_Watt, raw 0..127
  range DC_DCDC_NV_Komponentenfehler_51: raw 0..3
  range DC_UI2_KompFehlerModus4_08: raw 0..7
  range DC_KST_Ausstiegswunsch_Status: raw 0..1
  range DC_BMC_CMC_Temperatur_014: phys -40..86 Unit_DegreCelsi, raw 0..255
  range DC_TME_HV_IstLeistung_Komfort: phys 0..25450 Unit_Watt, raw 0..511
  range DC_CHA_ReqPrgTqVect: raw 0..15
  range DC_UI2_KompFehlerModus4_09: raw 0..7
  range DC_DCDC_NV_Komponentenfehler_52: raw 0..3
  range DC_TME_HVEM_Abschaltleistung: phys 0..25450 Unit_Watt, raw 0..511
  range DC_KST_aut_Abschaltung_Zuendung: raw 0..1
  range DC_BMC_CMC_Temperatur_015: phys -40..86 Unit_DegreCelsi, raw 0..255
  range DC_UI2_KompFehlerModus4_10: raw 0..7
  range DC_PTCfgSrv_PwrPtSysMax: phys 0..2000 Unit_KiloWatt, raw 0..1000
  range DC_CHA_ReqPrgVLim: raw 0..15
  range DC_TME_HVEM_HV_Anf: raw 0..3
  range DC_DCDC_NV_Komponentenfehler_53: raw 0..3
  range DC_BMC_CMC_Temperatur_016: phys -40..86 Unit_DegreCelsi, raw 0..255
  range DC_KST_BulbCheckReq: raw 0..1
  range DC_PTERM_MdElEgyMng: raw 0..5
  range DC_UI2_KompFehlerModus4_11: raw 0..7
  range DC_TME_HVEM_Minleistung: phys 0..50900 Unit_Watt, raw 0..511
  range DC_BMC_CMC_Temperatur_017: phys -40..86 Unit_DegreCelsi, raw 0..255
  range DC_KST_ComfortReadyStatus: raw 0..1
  range DC_PTOVeh_FlgTqWhlPos: raw 0..1
  range DC_UI2_KompFehlerModus4_12: raw 0..7
  range DC_CHA_ReqPrgWarnBrk: raw 0..15
  range DC_TME_HVEM_Rekuleistung: phys 0..50900 Unit_Watt, raw 0..511
  range DC_DCDC_NV_Komponentenfehler_54: raw 0..3
  range DC_SI_Diagnose_Aktiv: raw 0..1
  range DC_UI2_KompFehlerModus4_13: raw 0..7
  range DC_TME_HVEM_Vorhaltleistung: phys 0..102100 Unit_Watt, raw 0..1023
  range DC_KST_Deaktivierungs_Trigger: raw 0..2
  range DC_CHA_StCurProfDft: raw 0..3
  range DC_UI2_KompFehlerModus4_14: raw 0..7
  range DC_TME_HVEM_Wunschleistung: phys 0..50900 Unit_Watt, raw 0..511
  range DC_SI_NWDF: raw 0..1
  range DC_KST_Fahrerhinweis_1: raw 0..1
  range DC_UI2_KompFehlerModus4_15: raw 0..7
  range DC_TME_HVHL_Istmodus: raw 0..7
  range DC_SI_NWDF_30: raw 0..1
  range DC_KST_Fahrerhinweis_2: raw 0..1
  range DC_ClampControl_01_BZ: phys 0..15, raw 0..15
  range DC_SI_NWDF_gueltig: raw 0..1
  range DC_UI2_KompFehlerModus4_16: raw 0..7
  range DC_TME_HVHL_NTC_Warnung: raw 0..1
  range DC_KST_Fahrerhinweis_3: raw 0..1
  range DC_ClampControl_01_CRC: phys 0..255, raw 0..255
  range DC_UI2_Pyro_Status: raw 0..4
  range DC_TME_HVHL_Verbauinfo: raw 0..2
  range DC_KST_Fahrerhinweis_4: raw 0..1
  range DC_UI2_Spannung1: phys -1023..1024.6875 Unit_Volt, raw 0..32767
  range DC_TME_HVHL_verfuegbar: raw 0..1
  range DC_KST_Fahrerhinweis_5: raw 0..1
  range DC_CMM_FlgCHAFctDC: raw 0..1
  range DC_UI2_Spannung1_Schalt_Status: raw 0..7
  range DC_TME_HVHW_Ansteuerung_Soll: phys 0..100 Unit_PerCent, raw 0..255
  range DC_KST_Fahrerhinweis_6: raw 0..1
  range DC_UI2_Spannung2: phys -1023..1024.6875 Unit_Volt, raw 0..32767
  range DC_TME_HVHW_HVK_EoHVL_Status: raw 0..3
  range DC_KST_KL_15: raw 0..1
  range DC_CMM_FlgCHAFctLC: raw 0..1
  range DC_UI2_Spannung2_Schalt_Status: raw 0..7
  range DC_TME_HVHW_HVK_Fehler_AE: raw 0..2
  range DC_KST_Kl_50_Startanforderung: raw 0..1
  range DC_UI2_Spannung3: phys -1023..1024.6875 Unit_Volt, raw 0..32767
  range DC_TME_HVHW_HVK_Fehler_HVIL: raw 0..3
  range DC_CMM_FlgGlbFallBkIdc: raw 0..1
  range DC_KST_Kl_S: raw 0..1
  range DC_TME_HVHW_HVK_Fehler_intern: raw 0..1
  range DC_UI2_Spannung4: phys -1023..1024.6875 Unit_Volt, raw 0..32767
  range DC_KST_Kl_X: raw 0..1
  range DC_DC_Fehler_extern: raw 0..1
  range DC_TME_HVHW_HVK_IstModus: raw 0..7
  range DC_KST_Sonderzustand_Anforderung: raw 0..31
  range DC_UI2_Spannung5: phys -1023..1024.6875 Unit_Volt, raw 0..32767
  range DC_KST_Sonderzustand_Status: raw 0..3
  range DC_DC_Fehler_intern: raw 0..1
  range DC_TME_HVHW_HVK_Status_Spgfreiheit: raw 0..3
  range DC_UI2_Spannung6: phys -1023..1024.6875 Unit_Volt, raw 0..32767
  range DC_KST_StPtAcvReq: raw 0..2
  range DC_TME_HVHW_SollModus: raw 0..3
  range DC_UI2_Status: raw 0..1
  range DC_DC_IstLeistung_HV: phys -4000..6210 Unit_Watt, raw 0..1023
  range DC_KST_StPtDeacReq: raw 0..1
  range DC_TME_HVHW_Verbauinfo: raw 0..2
  range DC_UI2_Strom: phys -2621..2621.865 Unit_Amper, raw 0..1048575
  range DC_KST_Txt_Panikabschaltung: raw 0..1
  range DC_TME_IPB_Status_Kuehlung: raw 0..1
  range DC_UI2_Stromintegral_Entladen: phys 0..65533 Unit_AmperSecon, raw 0..65535
  range DC_KST_Warn_P1_ZAT_def: raw 0..1
  range DC_TME_Klima_Heizleistung_reduziert: raw 0..1
  range DC_UI2_Stromintegral_Laden: phys 0..65533 Unit_AmperSecon, raw 0..65535
  range DC_UI2_Temperatur_1: phys -40..212 Unit_DegreCelsi, raw 0..255
  range DC_TME_Klima_Red_Heizleistung_HVHL: raw 0..3
  range DC_UI2_Temperatur_2: phys -40..212 Unit_DegreCelsi, raw 0..255
  range DC_TME_Klimaanforderung: raw 0..3
  range DC_UI2Sens01_CALID_Index_01: phys 0..255, raw 0..255
  range DC_TME_Kompressorlastmoment: phys 0..63.5 Unit_NewtoMeter, raw 0..255
  range DC_UI2Sens01_CALID_Index_02: phys 0..255, raw 0..255
  range DC_TME_Kuehlerjalousie_Ausfall: raw 0..1
  range DC_TME_Kuehlerluefter_Totalausfall: raw 0..1
  range DC_UI2Sens01_CALID_Index_03: phys 0..255, raw 0..255
  range DC_TME_LED_STK: raw 0..6
  range DC_UI2Sens01_CALID_Index_04: phys 0..255, raw 0..255
  range DC_TME_LED_STK_Timer: raw 0..6
  range DC_UI2Sens01_CALID_Index_05: phys 0..255, raw 0..255
  range DC_TME_Min_Fahrdrehzahl: phys 500..1750 Unit_MinutInver, raw 0..127
  range DC_UI2Sens01_CALID_Index_{06..16}: phys 0..255, raw 0..255
  range DC_UI2Sens01_CVN_Byte_{1..4}: phys 0..255, raw 0..255
  range DC_UI2Sens01_CVN_VLD: raw 0..1
  range DC_UI2Sens01_ErrMem_State: raw 1..3
  range DC_UI2Sens02_CALID_Index_{01..13}: phys 0..255, raw 0..255
  range DC_NM_aktiv_Remote_Unlock_Lock: raw 0..1
  range DC_NM_aktiv_RemoteDiensteGW: raw 0..1
  range DC_NM_aktiv_RemoteStart: raw 0..1
  range DC_NM_aktiv_RemoteVehicleTracking: raw 0..1
  range DC_NM_aktiv_RequestWirelessCharging: raw 0..1
  range DC_NM_aktiv_SmartCharging_Aktiv: raw 0..1
  range DC_NM_aktiv_SubbusSteuerung_BMC_HV: raw 0..1
  range DC_NM_aktiv_SubbusSteuerung_HCP5: raw 0..1
  range DC_NM_aktiv_Timer_abgelaufen: raw 0..1
  range DC_NM_aktiv_VehicleStatReport_Main: raw 0..1
  range DC_NM_aktiv_WarnblinkerInfo: raw 0..1
  range DC_NM_AWC_CBV_AWB: raw 0..1
package /RecDataType
  102 x impl type:
    AT_SG_BJB_10: category=STRUCTURE
      6 x element, all with category=TYPE_REFERENCE:
        BJB_10_BZ: implementation-data-type=SG_BJB_10_BJB_10_BZ_type
        BJB_10_CRC: implementation-data-type=SG_BJB_10_BJB_10_CRC_type
        BJB_Lebensdauer_Trennelemente: implementation-data-type=SG_BJB_10_BJB_Lebensdauer_Trennelemente_type
        BJB_Sperrung_Unterspannung: implementation-data-type=SG_BJB_10_BJB_Sperrung_Unterspannung_type
        BJB_Status_HV_Spannungssensorik: implementation-data-type=SG_BJB_10_BJB_Status_HV_Spannungssensorik_type
        BJB_Status_Trennelemente: implementation-data-type=SG_BJB_10_BJB_Status_Trennelemente_type
    SG_BJB_10_BJB_10_BZ_type: implementation-data-type=ImplementationDataTypes/uint8
    SG_BJB_10_BJB_10_CRC_type: implementation-data-type=ImplementationDataTypes/uint8
    SG_BJB_10_BJB_Lebensdauer_Trennelemente_type: implementation-data-type=ImplementationDataTypes/uint32
    SG_BJB_10_BJB_Sperrung_Unterspannung_type: implementation-data-type=ImplementationDataTypes/uint8
    SG_BJB_10_BJB_Status_HV_Spannungssensorik_type: implementation-data-type=ImplementationDataTypes/boolean
    SG_BJB_10_BJB_Status_Trennelemente_type: implementation-data-type=ImplementationDataTypes/uint8
    AT_SG_BJB_11: category=STRUCTURE
      7 x element, all with category=TYPE_REFERENCE:
        BJB_11_BZ: implementation-data-type=SG_BJB_11_BJB_11_BZ_type
        BJB_11_CRC: implementation-data-type=SG_BJB_11_BJB_11_CRC_type
        BJB_Sperrung_Ueberspannung: implementation-data-type=SG_BJB_11_BJB_Sperrung_Ueberspannung_type
        BJB_Ueberspannungszaehler_CMC01: implementation-data-type=SG_BJB_11_BJB_Ueberspannungszaehler_CMC01_type
        BJB_Ueberspannungszaehler_CMC02: implementation-data-type=SG_BJB_11_BJB_Ueberspannungszaehler_CMC02_type
        BJB_Uebertemperaturzaehler_CMC01: implementation-data-type=SG_BJB_11_BJB_Uebertemperaturzaehler_CMC01_type
        BJB_Uebertemperaturzaehler_CMC02: implementation-data-type=SG_BJB_11_BJB_Uebertemperaturzaehler_CMC02_type
    SG_BJB_11_BJB_11_BZ_type: implementation-data-type=ImplementationDataTypes/uint8
    SG_BJB_11_BJB_11_CRC_type: implementation-data-type=ImplementationDataTypes/uint8
    SG_BJB_11_BJB_Sperrung_Ueberspannung_type: implementation-data-type=ImplementationDataTypes/uint8
    SG_BJB_11_BJB_Ueberspannungszaehler_CMC01_type: implementation-data-type=ImplementationDataTypes/uint16
    SG_BJB_11_BJB_Ueberspannungszaehler_CMC02_type: implementation-data-type=ImplementationDataTypes/uint16
    SG_BJB_11_BJB_Uebertemperaturzaehler_CMC01_type: implementation-data-type=ImplementationDataTypes/uint16
    SG_BJB_11_BJB_Uebertemperaturzaehler_CMC02_type: implementation-data-type=ImplementationDataTypes/uint16
    AT_SG_BJB_12: category=STRUCTURE
      7 x element, all with category=TYPE_REFERENCE:
        BJB_12_BZ: implementation-data-type=SG_BJB_12_BJB_12_BZ_type
        BJB_12_CRC: implementation-data-type=SG_BJB_12_BJB_12_CRC_type
        BJB_Sperrung_Uebertemperatur: implementation-data-type=SG_BJB_12_BJB_Sperrung_Uebertemperatur_type
        BJB_Ueberspannungszaehler_CMC03: implementation-data-type=SG_BJB_12_BJB_Ueberspannungszaehler_CMC03_type
        BJB_Ueberspannungszaehler_CMC04: implementation-data-type=SG_BJB_12_BJB_Ueberspannungszaehler_CMC04_type
        BJB_Uebertemperaturzaehler_CMC03: implementation-data-type=SG_BJB_12_BJB_Uebertemperaturzaehler_CMC03_type
        BJB_Uebertemperaturzaehler_CMC04: implementation-data-type=SG_BJB_12_BJB_Uebertemperaturzaehler_CMC04_type
    SG_BJB_12_BJB_12_BZ_type: implementation-data-type=ImplementationDataTypes/uint8
    SG_BJB_12_BJB_12_CRC_type: implementation-data-type=ImplementationDataTypes/uint8
    SG_BJB_12_BJB_Sperrung_Uebertemperatur_type: implementation-data-type=ImplementationDataTypes/uint8
    SG_BJB_12_BJB_Ueberspannungszaehler_CMC03_type: implementation-data-type=ImplementationDataTypes/uint16
    SG_BJB_12_BJB_Ueberspannungszaehler_CMC04_type: implementation-data-type=ImplementationDataTypes/uint16
    SG_BJB_12_BJB_Uebertemperaturzaehler_CMC03_type: implementation-data-type=ImplementationDataTypes/uint16
    SG_BJB_12_BJB_Uebertemperaturzaehler_CMC04_type: implementation-data-type=ImplementationDataTypes/uint16
    AT_SG_BJB_13: category=STRUCTURE
      6 x element, all with category=TYPE_REFERENCE:
        BJB_13_BZ: implementation-data-type=SG_BJB_13_BJB_13_BZ_type
        BJB_13_CRC: implementation-data-type=SG_BJB_13_BJB_13_CRC_type
        BJB_Unterspannungszaehler_CMC{01..04}: implementation-data-type=SG_BJB_13_BJB_Unterspannungszaehler_CMC{01..04}_type
    SG_BJB_13_BJB_13_BZ_type: implementation-data-type=ImplementationDataTypes/uint8
    SG_BJB_13_BJB_13_CRC_type: implementation-data-type=ImplementationDataTypes/uint8
    SG_BJB_13_BJB_Unterspannungszaehler_CMC{01..04}_type: implementation-data-type=ImplementationDataTypes/uint16
    AT_SG_HVK_03: category=STRUCTURE
      6 x element, all with category=TYPE_REFERENCE:
        HVK_03_BZ: implementation-data-type=SG_HVK_03_HVK_03_BZ_type
        HVK_03_CRC: implementation-data-type=SG_HVK_03_HVK_03_CRC_type
        HVK_BMC_Sollmodus: implementation-data-type=SG_HVK_03_HVK_BMC_Sollmodus_type
        HVK_BMC_Spannung_Anf: implementation-data-type=SG_HVK_03_HVK_BMC_Spannung_Anf_type
        HVK_Iso_Messung_Start: implementation-data-type=SG_HVK_03_HVK_Iso_Messung_Start_type
        HVK_Istmodus_Anf: implementation-data-type=SG_HVK_03_HVK_Istmodus_Anf_type
    SG_HVK_03_HVK_03_BZ_type: implementation-data-type=ImplementationDataTypes/uint8
    SG_HVK_03_HVK_03_CRC_type: implementation-data-type=ImplementationDataTypes/uint8
    SG_HVK_03_HVK_BMC_Sollmodus_type: implementation-data-type=ImplementationDataTypes/uint8
    SG_HVK_03_HVK_BMC_Spannung_Anf_type: implementation-data-type=ImplementationDataTypes/uint8
    SG_HVK_03_HVK_Iso_Messung_Start_type: implementation-data-type=ImplementationDataTypes/uint8
    SG_HVK_03_HVK_Istmodus_Anf_type: implementation-data-type=ImplementationDataTypes/boolean
    AT_SG_HVLM_14: category=STRUCTURE
      6 x element, all with category=TYPE_REFERENCE:
        HVLM_14_BZ: implementation-data-type=SG_HVLM_14_HVLM_14_BZ_type
        HVLM_14_CRC: implementation-data-type=SG_HVLM_14_HVLM_14_CRC_type
        HVLM_DC_Aufstartmodus: implementation-data-type=SG_HVLM_14_HVLM_DC_Aufstartmodus_type
        HVLM_Start_Pulserkennung: implementation-data-type=SG_HVLM_14_HVLM_Start_Pulserkennung_type
        HVLM_Steckerstatus: implementation-data-type=SG_HVLM_14_HVLM_Steckerstatus_type
        HVLM_ZustandLadeablauf: implementation-data-type=SG_HVLM_14_HVLM_ZustandLadeablauf_type
    SG_HVLM_14_HVLM_14_BZ_type: implementation-data-type=ImplementationDataTypes/uint8
    SG_HVLM_14_HVLM_14_CRC_type: implementation-data-type=ImplementationDataTypes/uint8
    SG_HVLM_14_HVLM_DC_Aufstartmodus_type: implementation-data-type=ImplementationDataTypes/uint8
    SG_HVLM_14_HVLM_Start_Pulserkennung_type: implementation-data-type=ImplementationDataTypes/boolean
    SG_HVLM_14_HVLM_Steckerstatus_type: implementation-data-type=ImplementationDataTypes/uint8
    SG_HVLM_14_HVLM_ZustandLadeablauf_type: implementation-data-type=ImplementationDataTypes/uint8
    AT_SG_KS_Hybrid_01_Challenge_M: category=STRUCTURE
      element KS_Hybrid_01_ChM: implementation-data-type=SG_KS_Hybrid_01_Challenge_M_KS_Hybrid_01_ChM_type
      element KS_Hybrid_01_ChM_IKACtr: implementation-data-type=SG_KS_Hybrid_01_Challenge_M_KS_Hybrid_01_ChM_IKACtr_type
      element KS_Hybrid_01_ChM_SID: implementation-data-type=SG_KS_Hybrid_01_Challenge_M_KS_Hybrid_01_ChM_SID_type
    SG_KS_Hybrid_01_Challenge_M_KS_Hybrid_01_ChM_type: category=ARRAY
      element SG_KS_Hybrid_01_Challenge_M_KS_Hybrid_01_ChM_typeBase: array-size=8, array-size-semantics=FIXED-SIZE, implementation-data-type=ImplementationDataTypes/uint8
      symbol props SymbolProps: symbol=SG_KS_Hybrid_01_Challenge_M_KS_Hybrid_01_ChM_type
    SG_KS_Hybrid_01_Challenge_M_KS_Hybrid_01_ChM_IKACtr_type: implementation-data-type=ImplementationDataTypes/uint8
    SG_KS_Hybrid_01_Challenge_M_KS_Hybrid_01_ChM_SID_type: implementation-data-type=ImplementationDataTypes/uint16
    AT_SG_KS_Hybrid_01_Response_M: category=STRUCTURE
      element KS_Hybrid_01_ReM: implementation-data-type=SG_KS_Hybrid_01_Response_M_KS_Hybrid_01_ReM_type
      element KS_Hybrid_01_ReM_IKACtr: implementation-data-type=SG_KS_Hybrid_01_Response_M_KS_Hybrid_01_ReM_IKACtr_type
      element KS_Hybrid_01_ReM_SID: implementation-data-type=SG_KS_Hybrid_01_Response_M_KS_Hybrid_01_ReM_SID_type
    SG_KS_Hybrid_01_Response_M_KS_Hybrid_01_ReM_type: category=ARRAY
      element SG_KS_Hybrid_01_Response_M_KS_Hybrid_01_ReM_typeBase: array-size=8, array-size-semantics=FIXED-SIZE, implementation-data-type=ImplementationDataTypes/uint8
      symbol props SymbolProps: symbol=SG_KS_Hybrid_01_Response_M_KS_Hybrid_01_ReM_type
    SG_KS_Hybrid_01_Response_M_KS_Hybrid_01_ReM_IKACtr_type: implementation-data-type=ImplementationDataTypes/uint8
    SG_KS_Hybrid_01_Response_M_KS_Hybrid_01_ReM_SID_type: implementation-data-type=ImplementationDataTypes/uint16
    AT_SG_ORU_Control_A_01: category=STRUCTURE
      5 x element, all with category=TYPE_REFERENCE:
        ORU_Control_A_01_BZ: implementation-data-type=SG_ORU_Control_A_01_ORU_Control_A_01_BZ_type
        ORU_Control_A_01_CRC: implementation-data-type=SG_ORU_Control_A_01_ORU_Control_A_01_CRC_type
        OnlineRemoteUpdateControlA: implementation-data-type=SG_ORU_Control_A_01_OnlineRemoteUpdateControlA_type
        OnlineRemoteUpdateControlOldA: implementation-data-type=SG_ORU_Control_A_01_OnlineRemoteUpdateControlOldA_type
        OruControlReleaseA: implementation-data-type=SG_ORU_Control_A_01_OruControlReleaseA_type
    SG_ORU_Control_A_01_ORU_Control_A_01_BZ_type: implementation-data-type=ImplementationDataTypes/uint8
    SG_ORU_Control_A_01_ORU_Control_A_01_CRC_type: implementation-data-type=ImplementationDataTypes/uint8
    SG_ORU_Control_A_01_OnlineRemoteUpdateControlA_type: implementation-data-type=ImplementationDataTypes/uint8
    SG_ORU_Control_A_01_OnlineRemoteUpdateControlOldA_type: implementation-data-type=ImplementationDataTypes/uint8
    SG_ORU_Control_A_01_OruControlReleaseA_type: implementation-data-type=ImplementationDataTypes/uint16
    AT_SG_ORU_Control_D_01: category=STRUCTURE
      5 x element, all with category=TYPE_REFERENCE:
        ORU_Control_D_01_BZ: implementation-data-type=SG_ORU_Control_D_01_ORU_Control_D_01_BZ_type
        ORU_Control_D_01_CRC: implementation-data-type=SG_ORU_Control_D_01_ORU_Control_D_01_CRC_type
        OnlineRemoteUpdateControlD: implementation-data-type=SG_ORU_Control_D_01_OnlineRemoteUpdateControlD_type
        OnlineRemoteUpdateControlOldD: implementation-data-type=SG_ORU_Control_D_01_OnlineRemoteUpdateControlOldD_type
        OruControlReleaseD: implementation-data-type=SG_ORU_Control_D_01_OruControlReleaseD_type
    SG_ORU_Control_D_01_ORU_Control_D_01_BZ_type: implementation-data-type=ImplementationDataTypes/uint8
    SG_ORU_Control_D_01_ORU_Control_D_01_CRC_type: implementation-data-type=ImplementationDataTypes/uint8
    SG_ORU_Control_D_01_OnlineRemoteUpdateControlD_type: implementation-data-type=ImplementationDataTypes/uint8
    SG_ORU_Control_D_01_OnlineRemoteUpdateControlOldD_type: implementation-data-type=ImplementationDataTypes/uint8
    SG_ORU_Control_D_01_OruControlReleaseD_type: implementation-data-type=ImplementationDataTypes/uint16
    AT_SG_OTAMC_D_01: category=STRUCTURE
      element OTAMC_D_01_BZ: implementation-data-type=SG_OTAMC_D_01_OTAMC_D_01_BZ_type
      element OTAMC_D_01_CRC: implementation-data-type=SG_OTAMC_D_01_OTAMC_D_01_CRC_type
      element VehicleProtectedEnvironment_D: implementation-data-type=SG_OTAMC_D_01_VehicleProtectedEnvironment_D_type
    SG_OTAMC_D_01_OTAMC_D_01_BZ_type: implementation-data-type=ImplementationDataTypes/uint8
    SG_OTAMC_D_01_OTAMC_D_01_CRC_type: implementation-data-type=ImplementationDataTypes/uint8
    SG_OTAMC_D_01_VehicleProtectedEnvironment_D_type: implementation-data-type=ImplementationDataTypes/uint8
    AT_SG_UI1_01: category=STRUCTURE
      4 x element, all with category=TYPE_REFERENCE:
        UI1_KL30_Spannung: implementation-data-type=SG_UI1_01_UI1_KL30_Spannung_type
        UI1_Strom: implementation-data-type=SG_UI1_01_UI1_Strom_type
        UISensorIso_01_BZ: implementation-data-type=SG_UI1_01_UISensorIso_01_BZ_type
        UISensorIso_01_CRC: implementation-data-type=SG_UI1_01_UISensorIso_01_CRC_type
    SG_UI1_01_UI1_KL30_Spannung_type: implementation-data-type=ImplementationDataTypes/uint8
    SG_UI1_01_UI1_Strom_type: implementation-data-type=ImplementationDataTypes/uint32
    SG_UI1_01_UISensorIso_01_BZ_type: implementation-data-type=ImplementationDataTypes/uint8
    SG_UI1_01_UISensorIso_01_CRC_type: implementation-data-type=ImplementationDataTypes/uint8
    AT_SG_UI1_02: category=STRUCTURE
      7 x element, all with category=TYPE_REFERENCE:
        UI1_Spannung1: implementation-data-type=SG_UI1_02_UI1_Spannung1_type
        UI1_Spannung1_Schalt_Status: implementation-data-type=SG_UI1_02_UI1_Spannung1_Schalt_Status_type
        UI1_Spannung2: implementation-data-type=SG_UI1_02_UI1_Spannung2_type
        UI1_Spannung2_Schalt_Status: implementation-data-type=SG_UI1_02_UI1_Spannung2_Schalt_Status_type
        UI1_Spannung3: implementation-data-type=SG_UI1_02_UI1_Spannung3_type
        UISensorIso_02_BZ: implementation-data-type=SG_UI1_02_UISensorIso_02_BZ_type
        UISensorIso_02_CRC: implementation-data-type=SG_UI1_02_UISensorIso_02_CRC_type
    SG_UI1_02_UI1_Spannung1_type: implementation-data-type=ImplementationDataTypes/uint16
    SG_UI1_02_UI1_Spannung1_Schalt_Status_type: implementation-data-type=ImplementationDataTypes/uint8
    SG_UI1_02_UI1_Spannung2_type: implementation-data-type=ImplementationDataTypes/uint16
    SG_UI1_02_UI1_Spannung2_Schalt_Status_type: implementation-data-type=ImplementationDataTypes/uint8
    SG_UI1_02_UI1_Spannung3_type: implementation-data-type=ImplementationDataTypes/uint16
    SG_UI1_02_UISensorIso_02_BZ_type: implementation-data-type=ImplementationDataTypes/uint8
    SG_UI1_02_UISensorIso_02_CRC_type: implementation-data-type=ImplementationDataTypes/uint8
    AT_SG_UI2_01: category=STRUCTURE
      4 x element, all with category=TYPE_REFERENCE:
        UI2_KL30_Spannung: implementation-data-type=SG_UI2_01_UI2_KL30_Spannung_type
        UI2_Strom: implementation-data-type=SG_UI2_01_UI2_Strom_type
        UISensorPyro_01_BZ: implementation-data-type=SG_UI2_01_UISensorPyro_01_BZ_type
        UISensorPyro_01_CRC: implementation-data-type=SG_UI2_01_UISensorPyro_01_CRC_type
    SG_UI2_01_UI2_KL30_Spannung_type: implementation-data-type=ImplementationDataTypes/uint8
    SG_UI2_01_UI2_Strom_type: implementation-data-type=ImplementationDataTypes/uint32
    SG_UI2_01_UISensorPyro_01_BZ_type: implementation-data-type=ImplementationDataTypes/uint8
    SG_UI2_01_UISensorPyro_01_CRC_type: implementation-data-type=ImplementationDataTypes/uint8
    AT_SG_UI2_02: category=STRUCTURE
      7 x element, all with category=TYPE_REFERENCE:
        UI2_Spannung1: implementation-data-type=SG_UI2_02_UI2_Spannung1_type
        UI2_Spannung1_Schalt_Status: implementation-data-type=SG_UI2_02_UI2_Spannung1_Schalt_Status_type
        UI2_Spannung2: implementation-data-type=SG_UI2_02_UI2_Spannung2_type
        UI2_Spannung2_Schalt_Status: implementation-data-type=SG_UI2_02_UI2_Spannung2_Schalt_Status_type
        UI2_Spannung3: implementation-data-type=SG_UI2_02_UI2_Spannung3_type
        UISensorPyro_02_BZ: implementation-data-type=SG_UI2_02_UISensorPyro_02_BZ_type
        UISensorPyro_02_CRC: implementation-data-type=SG_UI2_02_UISensorPyro_02_CRC_type
    SG_UI2_02_UI2_Spannung1_type: implementation-data-type=ImplementationDataTypes/uint16
    SG_UI2_02_UI2_Spannung1_Schalt_Status_type: implementation-data-type=ImplementationDataTypes/uint8
    SG_UI2_02_UI2_Spannung2_type: implementation-data-type=ImplementationDataTypes/uint16
    SG_UI2_02_UI2_Spannung2_Schalt_Status_type: implementation-data-type=ImplementationDataTypes/uint8
    SG_UI2_02_UI2_Spannung3_type: implementation-data-type=ImplementationDataTypes/uint16
    SG_UI2_02_UISensorPyro_02_BZ_type: implementation-data-type=ImplementationDataTypes/uint8
    SG_UI2_02_UISensorPyro_02_CRC_type: implementation-data-type=ImplementationDataTypes/uint8
    AT_SG_UI2_03: category=STRUCTURE
      7 x element, all with category=TYPE_REFERENCE:
        UI2_HW_Crashleitung_Status: implementation-data-type=SG_UI2_03_UI2_HW_Crashleitung_Status_type
        UI2_Pyro_Status: implementation-data-type=SG_UI2_03_UI2_Pyro_Status_type
        UI2_Spannung{4..6}: implementation-data-type=SG_UI2_03_UI2_Spannung{4..6}_type
        UISensorPyro_03_BZ: implementation-data-type=SG_UI2_03_UISensorPyro_03_BZ_type
        UISensorPyro_03_CRC: implementation-data-type=SG_UI2_03_UISensorPyro_03_CRC_type
    SG_UI2_03_UI2_HW_Crashleitung_Status_type: implementation-data-type=ImplementationDataTypes/uint8
    SG_UI2_03_UI2_Pyro_Status_type: implementation-data-type=ImplementationDataTypes/uint8
    SG_UI2_03_UI2_Spannung{4..6}_type: implementation-data-type=ImplementationDataTypes/uint16
    SG_UI2_03_UISensorPyro_03_BZ_type: implementation-data-type=ImplementationDataTypes/uint8
    SG_UI2_03_UISensorPyro_03_CRC_type: implementation-data-type=ImplementationDataTypes/uint8
package /AUTOSAR_PlatformTypes/CompuMethods
  compu method CompuMethod_boolean: 0=false (CompuMethod_boolean_false), 1=true (CompuMethod_boolean_true)
package /AUTOSAR_PlatformTypes/DataConstraints
  range DataConstr_boolean: raw 0..1
  range DataConstr_sint16: phys -32768..32767, raw -32768..32767
  range DataConstr_sint32: phys -2147483648..2147483647, raw -2147483648..2147483647
  range DataConstr_sint64: phys -9223372036854775808..9223372036854775807, raw -9223372036854775808..9223372036854775807
  range DataConstr_sint8: phys -128..127, raw -128..127
  range DataConstr_uint16: phys 0..65535, raw 0..65535
  range DataConstr_uint32: phys 0..4294967295, raw 0..4294967295
  range DataConstr_uint64: phys 0..18446744073709551615, raw 0..18446744073709551615
  range DataConstr_uint8: phys 0..255, raw 0..255
package /Ivd/DataTypes
  5 x impl type:
    Dcm_Data4096ByteType: category=ARRAY, sw-calibration-access=READ-ONLY
      element Dcm_Data4096ByteTypeElement: array-size=4096, array-size-semantics=FIXED-SIZE, implementation-data-type=uint8
    Dcm_Data32ByteType: category=ARRAY, sw-calibration-access=READ-ONLY
      element Dcm_Data32ByteTypeElement: array-size=32, array-size-semantics=FIXED-SIZE, implementation-data-type=uint8
    Dcm_OpStatusType: compu {0=DCM_INITIAL, 1=DCM_PENDING, 2=DCM_CANCEL, 3=DCM_FORCE_RCRRP_OK, 64=DCM_FORCE_RCRRP_NOT_OK}, range raw 0..64, implementation-data-type=uint8
    Dcm_NegativeResponseCodeType:
      compu {0=DCM_E_POSITIVERESPONSE, 16=DCM_E_GENERALREJECT, 17=DCM_E_SERVICENOTSUPPORTED, 18=DCM_E_SUBFUNCTIONNOTSUPPORTED, 19=DCM_E_INCORRECTMESSAGELENGTHORINVALIDFORMAT, 20=DCM_E_RESPONSETOOLONG, 33=DCM_E_BUSYREPEATREQUEST, 34=DCM_E_CONDITIONSNOTCORRECT, 36=DCM_E_REQUESTSEQUENCEERROR, 37=DCM_E_NORESPONSEFROMSUBNETCOMPONENT, 38=DCM_E_FAILUREPREVENTSEXECUTIONOFREQUESTEDACTION, 49=DCM_E_REQUESTOUTOFRANGE, 51=DCM_E_SECURITYACCESSDENIED, 53=DCM_E_INVALIDKEY, 54=DCM_E_EXCEEDNUMBEROFATTEMPTS, 55=DCM_E_REQUIREDTIMEDELAYNOTEXPIRED, 112=DCM_E_UPLOADDOWNLOADNOTACCEPTED, 113=DCM_E_TRANSFERDATASUSPENDED, 114=DCM_E_GENERALPROGRAMMINGFAILURE, 115=DCM_E_WRONGBLOCKSEQUENCECOUNTER, 120=DCM_E_REQUESTCORRECTLYRECEIVEDRESPONSEPENDING, 126=DCM_E_SUBFUNCTIONNOTSUPPORTEDINACTIVESESSION, 127=DCM_E_SERVICENOTSUPPORTEDINACTIVESESSION, 129=DCM_E_RPMTOOHIGH, 130=DCM_E_RPMTOOLOW, 131=DCM_E_ENGINEISRUNNING, 132=DCM_E_ENGINEISNOTRUNNING, 133=DCM_E_ENGINERUNTIMETOOLOW, 134=DCM_E_TEMPERATURETOOHIGH, 135=DCM_E_TEMPERATURETOOLOW, 136=DCM_E_VEHICLESPEEDTOOHIGH, 137=DCM_E_VEHICLESPEEDTOOLOW, 138=DCM_E_THROTTLE_PEDALTOOHIGH, 139=DCM_E_THROTTLE_PEDALTOOLOW, 140=DCM_E_TRANSMISSIONRANGENOTINNEUTRAL, 141=DCM_E_TRANSMISSIONRANGENOTINGEAR, 143=DCM_E_BRAKESWITCH_NOTCLOSED, 144=DCM_E_SHIFTERLEVERNOTINPARK, 145=DCM_E_TORQUECONVERTERCLUTCHLOCKED, 146=DCM_E_VOLTAGETOOHIGH, 147=DCM_E_VOLTAGETOOLOW, 240..249=DCM_E_VMSCNC_0..DCM_E_VMSCNC_9, 250=DCM_E_VMSCNC_A, 251=DCM_E_VMSCNC_B, 252=DCM_E_VMSCNC_C, 253=DCM_E_VMSCNC_D, 254=DCM_E_VMSCNC_E}
      range raw 0..254
      implementation-data-type=uint8
    Dcm_Data2ByteType: category=ARRAY, sw-calibration-access=READ-ONLY
      element Dcm_Data2ByteTypeElement: array-size=2, array-size-semantics=FIXED-SIZE, implementation-data-type=uint8
