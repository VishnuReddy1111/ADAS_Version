[part 1 of 5: packages /ComponentTypes/DataTypeMappingSets to /Unit]
AUTOSAR XML (schema 00048)
standard types defined: boolean, uint16, uint32, uint8, UInt8, UInt16, UInt32, Boolean, float32, sint32, sint16, sint8, float64, sint64, uint64
package /ComponentTypes/DataTypeMappingSets
  data type mapping set DTMS_ShA: mode-request-type-map{implementation-data-type=uint8, mode-group=EcuM_Mode}
  data type mapping set defaultDataTypeMappingSet_CPFS
    data-type-maps:
      application-data-type=SG_BMC_HV_13_adt, implementation-data-type=SG_BMC_HV_13
      application-data-type=SG_UI1_01_adt, implementation-data-type=SG_UI1_01
      application-data-type=Vishnu_Appl_DT, implementation-data-type=Vishnu_Imp_DT
      application-data-type=Door_Status, implementation-data-type=Door_Status_Imp
      application-data-type=SG_BMC_HV_12_adt, implementation-data-type=SG_BMC_HV_12
      application-data-type=SG_BMC_HV_11_adt, implementation-data-type=SG_BMC_HV_11
      application-data-type=SG_BMC_HV_10_adt, implementation-data-type=SG_BMC_HV_10
      application-data-type=SG_BMC_HV_04_adt, implementation-data-type=SG_BMC_HV_04
      application-data-type=SG_BMC_HV_01_adt, implementation-data-type=SG_BMC_HV_01
      application-data-type=SG_BMC_HV_02_adt, implementation-data-type=SG_BMC_HV_02
      application-data-type=SG_KS_Hybrid_01_Challenge_K_adt, implementation-data-type=SG_KS_Hybrid_01_Challenge_K
      application-data-type=SG_KS_Hybrid_01_ReqFrame_adt, implementation-data-type=SG_KS_Hybrid_01_ReqFrame
      application-data-type=SG_KS_Hybrid_01_Response_K_adt, implementation-data-type=SG_KS_Hybrid_01_Response_K
      application-data-type=SG_BJB_11_adt, implementation-data-type=SG_BJB_11
      application-data-type=SG_BMC_HV_10_adt_1, implementation-data-type=SG_BMC_HV_14
      application-data-type=SG_BJB_10_adt, implementation-data-type=SG_BJB_10
      application-data-type=SG_BJB_11_adt_1, implementation-data-type=SG_BJB_12
      application-data-type=SG_BJB_11_adt_2, implementation-data-type=SG_BJB_13
      application-data-type=SG_BJB_11_adt_3, implementation-data-type=SG_BJB_14
      application-data-type=SG_BJB_12_adt, implementation-data-type=SG_BJB_15
      application-data-type=SG_BJB_13_adt, implementation-data-type=SG_BJB_16
      application-data-type=SG_BMC_HV_04_adt_1, implementation-data-type=SG_BMC_HV_5
      application-data-type=SG_BMC_HV_10_adt_2, implementation-data-type=SG_BMC_HV_15
      application-data-type=SG_BMC_HV_11_adt_1, implementation-data-type=SG_BMC_HV_16
      application-data-type=SG_BMC_HV_12_adt_1, implementation-data-type=SG_BMC_HV_17
      application-data-type=SG_BMC_HV_13_adt_1, implementation-data-type=SG_BMC_HV_18
  data type mapping set RT_COM
package /VAG/Services/BAP
  4 x impl type, all with category=TYPE_REFERENCE, implementation-data-type=UInt8:
    BapReq_et: compu {0=BapReq_DataSetGet, 1=BapReq_DataSet, 2=BapReq_DataGet, 5=BapReq_Start, 6=BapReq_StartResult, 7=BapReq_Abort, 11=BapReq_Ack, 31=BapReq_Invalid}, range raw 0..255
    BapInd_et: compu {0=BapInd_Data, 1=BapInd_Reset, 2=BapInd_DataAck, 3=BapInd_Result, 4=BapInd_Processing, 5=BapInd_Changed, 31=BapInd_Invalid}, range raw 0..255
    fctId_t
    BapAck_et: compu {0=BapAck_Property_DataSetGet, 1=BapAck_Array_DataSetGet, 2=BapAck_Property_DataSet, 3=BapAck_Array_DataSet, 4=BapAck_Method_Start, 5=BapAck_Method_StartResult, 6=BapAck_Method_Abort, 7=BapAck_Property_DataGet, 8=BapAck_Array_DataGet, 9=BapAck_Cache_DataGet, 10=BapAck_Property_Ack, 20=BapAck_Nothing}, range raw 0..255
  5 x impl type:
    BapError_et:
      compu {0=BapErr_OK, 18=BapErr_IllegalSequence, 19=BapErr_SequenceNumber, 20=BapErr_TimeoutSegmentation, 21=BapErr_OversizeSegmentation, 22=BapErr_BadDataLength, 23=BapErr_ReceivedDataLost, 33=BapErr_TimeoutHeartbeat, 34=BapErr_RetryNotSuccessful, 56=BapErr_ProcessingTimeout, 35=BapErr_Busy, 36=BapErr_ReqTimeout, 50=BapErr_IncompatibleProtocolVersion, 51=BapErr_IncompatibleDataSpecification, 52=BapErr_CacheInvalid, 57=BapErr_GetAllMessageCorrupted, 53=BapErr_InvalidState, 54=BapErr_CacheNotAvailable, 55=BapErr_InvalidArg, 80=BapErr_Aborted}
      range raw 0..255
      implementation-data-type=UInt8
    bs6_t: category=DATA_REFERENCE, sw-pointer-target-props={target-category=TYPE_REFERENCE, implementation-data-type=UInt8}, type-emitter=RTE
    bs8_t: category=DATA_REFERENCE, sw-pointer-target-props={target-category=TYPE_REFERENCE, implementation-data-type=UInt8}, type-emitter=RTE
    bs1_t: category=DATA_REFERENCE, sw-pointer-target-props={target-category=TYPE_REFERENCE, implementation-data-type=UInt8}, type-emitter=RTE
    bs250_t: category=DATA_REFERENCE, sw-pointer-target-props={target-category=TYPE_REFERENCE, implementation-data-type=UInt8}, type-emitter=RTE
  impl type lsgId_t: implementation-data-type=UInt8
  base type u8_bt: category=FIXED_LENGTH, base-type-size=8, base-type-encoding=NONE
  range lsgId_t_Constraints: raw 0..255
  range fctId_t_Constraints: raw 0..255
  range BapEt_Constraints_Constraints: phys 0..255
package /Predefined_DEV/ImplementationDataTypes
  impl type NvM_RequestResultType: compu {0=NVM_REQ_OK, 1=NVM_REQ_NOT_OK, 2=NVM_REQ_PENDING, 3=NVM_REQ_INTEGRITY_FAILED, 4=NVM_REQ_BLOCK_SKIPPED, 5=NVM_REQ_NV_INVALIDATED, 6=NVM_REQ_CANCELED, 7=NVM_REQ_REDUNDANCY_FAILED, 8=NVM_REQ_RESTORED_FROM_ROM}, implementation-data-type=uint8
  impl type NvM_ServiceIdType: compu {6=NVM_READ_BLOCK, 7=NVM_WRITE_BLOCK, 8=NVM_RESTORE_BLOCK_DEFAULTS, 9=NVM_ERASE_BLOCK, 11=NVM_INVALIDATE_NV_BLOCK, 12=NVM_READ_ALL}, implementation-data-type=uint8
  impl type Dem_UdsStatusByteType: compu {mask 1: 1=DEM_UDS_STATUS_TF, mask 2: 2=DEM_UDS_STATUS_TFTOC, mask 4: 4=DEM_UDS_STATUS_PDTC, mask 8: 8=DEM_UDS_STATUS_CDTC, mask 16: 16=DEM_UDS_STATUS_TNCSLC, mask 32: 32=DEM_UDS_STATUS_TFSLC, mask 64: 64=DEM_UDS_STATUS_TNCTOC, mask 128: 128=DEM_UDS_STATUS_WIR}, range raw 0..255, implementation-data-type=uint8
package /DataType
  10 x base type, all with category=FIXED_LENGTH:
    uint8_4_iso_8859_1: base-type-size=32, base-type-encoding=ISO-8859-1
    uint8_5_iso_8859_1: base-type-size=40, base-type-encoding=ISO-8859-1
    uint8_6_iso_8859_1: base-type-size=48, base-type-encoding=ISO-8859-1
    uint8_7_iso_8859_1: base-type-size=56, base-type-encoding=ISO-8859-1
    uint8_100_iso_8859_1: base-type-size=800, base-type-encoding=ISO-8859-1
    uint8_100_none: base-type-size=8, base-type-encoding=NONE
    uint8_{4..7}_none: base-type-size=8, base-type-encoding=NONE
package /DataType/Semantics
  compu method CM_NmUd_MyECU_16bit: identical
  compu method CM_NmUd_MyECU_32bit: identical
  compu method CM_Sig_ErrBit_Slave3: identical
  compu method CM_Sig_LinTr_MyECU2_0: identical
  compu method CM_Sig_LinTr_MyECU2_1: identical
  compu method CM_Sig_LinTr_Slave3_0: identical
  compu method CM_Sig_LinTr_Slave3_1: identical
  compu method CM_Sig_StartAppl_LinData_Rx: identical
  compu method CM_Sig_StartAppl_LinData_Tx: identical
  compu method CM_Signal_MyECU_SecOC_Rx1: identical
  compu method CM_Signal_MyECU_SecOC_Rx2: identical
  compu method CM_Signal_MyECU_SecOC_Tx1: identical
  compu method CM_Signal_MyECU_SecOC_Tx2: identical
  compu method CM_Signal_RearInteriorLight: identical
  compu method CM_Signal_RearLeftDoor: identical
  compu method CM_Signal_RearRightDoor: identical
  compu method CM_Signal_Rx11bit_OnWrite: identical
  compu method CM_Signal_Rx15bit_OnWrite: identical
  compu method CM_Signal_Rx16bit_Cyclic: identical
  compu method CM_Signal_Rx20bit_Cyclic: identical
  compu method CM_Signal_Rx8bit_Cyclic: identical
  compu method CM_Signal_StartAppl_RxCtrl_MyECU: identical
  compu method CM_Signal_StartAppl_RxData_MyECU: identical
  compu method CM_Signal_StartAppl_TxCtrl_MyECU: identical
  compu method CM_Signal_StartAppl_TxData_MyECU: identical
  compu method CM_Signal_Tx10bit_Cyclic: identical
  compu method CM_Signal_Tx24bit_Cyclic: identical
  compu method CM_Signal_Tx24bit_OnWrite: identical
  compu method CM_Signal_Tx32bit_Cyclic: identical
  compu method CM_Signal_Tx32bit_OnWrite: identical
  compu method CM_Signal_Tx4bit_Cyclic: identical
  compu method CM_SigRx_Prof1C_CRC: identical
  compu method CM_SigRx_Prof1C_DataId_HiByte_LoNib: identical
  compu method CM_SigRx_Prof1C_Sig32Bit: identical
  compu method CM_SigRx_Prof1C_Sig3Bit: identical
  compu method CM_SigRx_Prof1C_Sig4Bit: identical
  compu method CM_SigRx_Prof1C_SQ: identical
  compu method CM_SigTx_Prof1C_CRC: identical
  compu method CM_SigTx_Prof1C_DataId_HiByte_LoNib: identical
  compu method CM_SigTx_Prof1C_Sig16Bit: identical
  compu method CM_SigTx_Prof1C_Sig2Bit: identical
  compu method CM_SigTx_Prof1C_Sig4Bit: identical
  compu method CM_SigTx_Prof1C_Sig8Bit: identical
  compu method CM_SigTx_Prof1C_SQ: identical
package /DataType/Constraint
  range DC_NmUd_MyECU_16bit: raw 0..65535
  range DC_NmUd_MyECU_32bit: raw 0..4294967295
  range DC_Sig_ErrBit_Slave3: raw 0..1
  range DC_Sig_LinTr_MyECU2_0: raw 0..63
  range DC_Sig_LinTr_MyECU2_1: raw 0..16383
  range DC_Sig_LinTr_Slave3_0: raw 0..15
  range DC_Sig_LinTr_Slave3_1: raw 0..4095
  range DC_Sig_StartAppl_LinData_Rx: raw 0..127
  range DC_Sig_StartAppl_LinData_Tx: raw 0..255
  range DC_Signal_MyECU_SecOC_Rx1: raw 0..255
  range DC_Signal_MyECU_SecOC_Rx2: raw 0..255
  range DC_Signal_MyECU_SecOC_Tx1: raw 0..255
  range DC_Signal_MyECU_SecOC_Tx2: raw 0..255
  range DC_Signal_RearInteriorLight: raw 0..1
  range DC_Signal_RearLeftDoor: raw 0..1
  range DC_Signal_RearRightDoor: raw 0..1
  range DC_Signal_Rx11bit_OnWrite: raw 0..2047
  range DC_Signal_Rx15bit_OnWrite: raw 0..32767
  range DC_Signal_Rx16bit_Cyclic: raw 0..65535
  range DC_Signal_Rx20bit_Cyclic: raw 0..1048575
  range DC_Signal_Rx8bit_Cyclic: raw 0..255
  range DC_Signal_StartAppl_RxCtrl_MyECU: raw 0..255
  range DC_Signal_StartAppl_RxData_MyECU: raw 0..255
  range DC_Signal_StartAppl_TxCtrl_MyECU: raw 0..255
  range DC_Signal_StartAppl_TxData_MyECU: raw 0..255
  range DC_Signal_Tx10bit_Cyclic: raw 0..1023
  range DC_Signal_Tx24bit_Cyclic: raw 0..16777215
  range DC_Signal_Tx24bit_OnWrite: raw 0..16777215
  range DC_Signal_Tx32bit_Cyclic: raw 0..4294967295
  range DC_Signal_Tx32bit_OnWrite: raw 0..4294967295
  range DC_Signal_Tx4bit_Cyclic: raw 0..15
  range DC_SigRx_Prof1C_CRC: raw 0..255
  range DC_SigRx_Prof1C_DataId_HiByte_LoNib: raw 0..15
  range DC_SigRx_Prof1C_Sig32Bit: raw 0..4294967295
  range DC_SigRx_Prof1C_Sig3Bit: raw 0..7
  range DC_SigRx_Prof1C_Sig4Bit: raw 0..15
  range DC_SigRx_Prof1C_SQ: raw 0..15
  range DC_SigTx_Prof1C_CRC: raw 0..255
  range DC_SigTx_Prof1C_DataId_HiByte_LoNib: raw 0..15
  range DC_SigTx_Prof1C_Sig16Bit: raw 0..65535
  range DC_SigTx_Prof1C_Sig2Bit: raw 0..3
  range DC_SigTx_Prof1C_Sig4Bit: raw 0..15
  range DC_SigTx_Prof1C_Sig8Bit: raw 0..255
  range DC_SigTx_Prof1C_SQ: raw 0..15
package /DataTypes
  11 x impl type:
    Signal_MyECU_SecOC_Tx1: data-constr=Signal_MyECU_SecOC_Tx1, implementation-data-type=uint8
    Signal_MyECU_SecOC_Tx2: data-constr=Signal_MyECU_SecOC_Tx2, implementation-data-type=uint8
    Signal_MyECU_SecOC_Rx2: data-constr=Signal_MyECU_SecOC_Rx2, implementation-data-type=uint8
    Ivd_RequestPostRun: compu {0=IVD_REQUESTPOSTRUN_REQUESTED, 1=IVD_REQUESTPOSTRUN_RELEASED}, range raw 0..1, implementation-data-type=uint8, type-emitter=RTE
    Ivd_Data128Byte: category=ARRAY, sw-calibration-access=READ-ONLY, type-emitter=RTE
      element Element: array-size=128, array-size-semantics=FIXED-SIZE, implementation-data-type=uint8
    Ivd_32ByteHash: category=ARRAY, sw-calibration-access=READ-ONLY, type-emitter=RTE
      element Element: array-size=32, array-size-semantics=FIXED-SIZE, implementation-data-type=uint8
    Sfd2_32ByteHash_Type: category=ARRAY, sw-calibration-access=READ-ONLY, type-emitter=RTE
      element Element: array-size=32, array-size-semantics=FIXED-SIZE, implementation-data-type=uint8
    Sfd2_DidArray_Type: category=ARRAY, sw-calibration-access=READ-ONLY, type-emitter=RTE
      element Element: array-size=64, array-size-semantics=FIXED-SIZE, implementation-data-type=uint16
    AppData_Data128Byte: category=ARRAY, sw-calibration-access=READ-ONLY, type-emitter=RTE
      element Element: array-size=128, array-size-semantics=FIXED-SIZE, implementation-data-type=uint8
    AppData_Dsdl1InfoList_Type: category=ARRAY, sw-calibration-access=READ-ONLY, type-emitter=RTE
      element Element: array-size=120, array-size-semantics=FIXED-SIZE, implementation-data-type=uint8
    SG_BMC_HV_13: category=STRUCTURE
      8 x element, all with category=TYPE_REFERENCE:
        BMC_HV_13_BZ: range phys 0..15, raw 0..15, implementation-data-type=uint8
        BMC_HV_13_CRC: range phys 0..255, raw 0..255, implementation-data-type=uint8
        BMC_Unterspannungszaehler_CMC{01..04}: compu-method=CM_BMC_Unterspannungszaehler_CMC{01..04}, range phys 0..400 Unit_None, raw 0..511, implementation-data-type=uint16, invalid-value=Invalid_BMC_Unterspannungszaehler_CMC{01..04}_XIX_BMC_HV_13_XIX_BMC_CAN01:511
        SignalVoid_BMC_HV_13_0: range phys 0..255, raw 0..255, implementation-data-type=uint8
        SignalVoid_BMC_HV_13_1: range phys 0..255, raw 0..255, implementation-data-type=uint8
  application record data type SG_BMC_HV_13_adt: category=STRUCTURE
    8 x application record element, all with category=VALUE:
      BMC_HV_13_BZ: type=BMC_HV_13_BZ_adt
      BMC_HV_13_CRC: type=BMC_HV_13_CRC_adt
      BMC_Unterspannungszaehler_CMC{01..04}: type=BMC_Unterspannungszaehler_CMC{01..04}_adt
      SignalVoid_BMC_HV_13_0: type=SignalVoid_BMC_HV_13_0_adt
      SignalVoid_BMC_HV_13_1: type=SignalVoid_BMC_HV_13_1_adt
  8 x app type, all with category=VALUE:
    BMC_HV_13_BZ_adt: range phys 0..15, raw 0..15
    BMC_HV_13_CRC_adt: range phys 0..255, raw 0..255
    BMC_Unterspannungszaehler_CMC{01..04}_adt: compu-method=CM_BMC_Unterspannungszaehler_CMC{01..04}, range phys 0..400 Unit_None, raw 0..511, invalid-value=511
    SignalVoid_BMC_HV_13_0_adt: range phys 0..255, raw 0..255
    SignalVoid_BMC_HV_13_1_adt: range phys 0..255, raw 0..255
  impl type SG_UI1_01: category=STRUCTURE
    7 x element, all with category=TYPE_REFERENCE:
      SignalVoid_UI1_01_{0..2}: range phys 0..255, raw 0..255, implementation-data-type=uint8
      UI1_KL30_Spannung: compu-method=CM_UI1_KL30_Spannung, range phys 0..25.3 Unit_Volt, raw 0..255, implementation-data-type=uint8, invalid-value=Invalid_UI1_KL30_Spannung_XIX_UI1_01_XIX_BMC_CAN01:255
      UI1_Strom: compu-method=CM_UI1_Strom, range phys -2621..2621.865 Unit_Amper, raw 0..1048575, implementation-data-type=uint32, invalid-value=Invalid_UI1_Strom_XIX_UI1_01_XIX_BMC_CAN01:1048575
      UISensorIso_01_BZ: range phys 0..15, raw 0..15, implementation-data-type=uint8
      UISensorIso_01_CRC: range phys 0..255, raw 0..255, implementation-data-type=uint8
  application record data type SG_UI1_01_adt: category=STRUCTURE
    7 x application record element, all with category=VALUE:
      SignalVoid_UI1_01_{0..2}: type=SignalVoid_UI1_01_{0..2}_adt
      UI1_KL30_Spannung: type=UI1_KL30_Spannung_adt
      UI1_Strom: type=UI1_Strom_adt
      UISensorIso_01_BZ: type=UISensorIso_01_BZ_adt
      UISensorIso_01_CRC: type=UISensorIso_01_CRC_adt
  7 x app type, all with category=VALUE:
    SignalVoid_UI1_01_{0..2}_adt: range phys 0..255, raw 0..255
    UI1_KL30_Spannung_adt: compu-method=CM_UI1_KL30_Spannung, range phys 0..25.3 Unit_Volt, raw 0..255, invalid-value=255
    UI1_Strom_adt: compu-method=CM_UI1_Strom, range phys -2621..2621.865 Unit_Amper, raw 0..1048575, invalid-value=1048575
    UISensorIso_01_BZ_adt: compu {phys=raw for raw 0..15}, range phys 0..15, raw 0..15
    UISensorIso_01_CRC_adt: compu {phys=raw for raw 0..255}, range phys 0..255, raw 0..255
  impl type BJB_ErrMem_State: compu {1=Cx1_ErrMem_Active (CM_BJB_ErrMem_State_Cx1_ErrMem_Active), 2=Cx2_ErrMem_Init_Progress (CM_BJB_ErrMem_State_Cx2_ErrMem_Init_Progress), 3=Cx3_ErrMem_Init_Done (CM_BJB_ErrMem_State_Cx3_ErrMem_Init_Done)}, range raw 1..3, implementation-data-type=uint8
  application record data type Vishnu_Appl_DT: category=STRUCTURE, sw-calibration-access=READ-ONLY
    application record element Vishnu_ID: category=VALUE, type=uint8_DT
    application record element Vishnu_Sal: category=VALUE, type=uint8_DT
  impl type Vishnu_Imp_DT: category=STRUCTURE, sw-calibration-access=READ-ONLY, type-emitter=RTE
    element Vishnu_ID: implementation-data-type=ImplementationDataTypes/uint8
    element Vishnu_Sal: implementation-data-type=ImplementationDataTypes/uint8
  app type Door_Status: category=BOOLEAN, sw-calibration-access=READ-ONLY
  impl type Door_Status_Imp: implementation-data-type=boolean, type-emitter=RTE
  impl type SG_BMC_HV_12: category=STRUCTURE
    7 x element, all with category=TYPE_REFERENCE:
      BMC_HV_12_BZ: range phys 0..15, raw 0..15, implementation-data-type=uint8
      BMC_HV_12_CRC: range phys 0..255, raw 0..255, implementation-data-type=uint8
      BMC_Sperrung_Uebertemperatur: compu-method=CM_BMC_Sperrung_Uebertemperatur, range raw 0..3, implementation-data-type=uint8, invalid-value=Invalid_BMC_Sperrung_Uebertemperatur_XIX_BMC_HV_12_XIX_BMC_CAN01:3
      BMC_Ueberspannungszaehler_CMC03: compu-method=CM_BMC_Ueberspannungszaehler_CMC03, range phys 0..400 Unit_None, raw 0..511, implementation-data-type=uint16, invalid-value=Invalid_BMC_Ueberspannungszaehler_CMC03_XIX_BMC_HV_12_XIX_BMC_CAN01:511
      BMC_Ueberspannungszaehler_CMC04: compu-method=CM_BMC_Ueberspannungszaehler_CMC04, range phys 0..400 Unit_None, raw 0..511, implementation-data-type=uint16, invalid-value=Invalid_BMC_Ueberspannungszaehler_CMC04_XIX_BMC_HV_12_XIX_BMC_CAN01:511
      BMC_Uebertemperaturzaehler_CMC03: compu-method=CM_BMC_Uebertemperaturzaehler_CMC03, range phys 0..604800 Unit_Ohm, raw 0..65535, implementation-data-type=uint16, invalid-value=Invalid_BMC_Uebertemperaturzaehler_CMC03_XIX_BMC_HV_12_XIX_BMC_CAN01:65535
      BMC_Uebertemperaturzaehler_CMC04: compu-method=CM_BMC_Uebertemperaturzaehler_CMC04, range phys 0..604800 Unit_None, raw 0..65535, implementation-data-type=uint16, invalid-value=Invalid_BMC_Uebertemperaturzaehler_CMC04_XIX_BMC_HV_12_XIX_BMC_CAN01:65535
  application record data type SG_BMC_HV_12_adt: category=STRUCTURE
    7 x application record element, all with category=VALUE:
      BMC_HV_12_BZ: type=BMC_HV_12_BZ_adt
      BMC_HV_12_CRC: type=BMC_HV_12_CRC_adt
      BMC_Sperrung_Uebertemperatur: type=BMC_Sperrung_Uebertemperatur_adt
      BMC_Ueberspannungszaehler_CMC03: type=BMC_Ueberspannungszaehler_CMC03_adt
      BMC_Ueberspannungszaehler_CMC04: type=BMC_Ueberspannungszaehler_CMC04_adt
      BMC_Uebertemperaturzaehler_CMC03: type=BMC_Uebertemperaturzaehler_CMC03_adt
      BMC_Uebertemperaturzaehler_CMC04: type=BMC_Uebertemperaturzaehler_CMC04_adt
  7 x app type, all with category=VALUE:
    BMC_HV_12_BZ_adt: range phys 0..15, raw 0..15
    BMC_HV_12_CRC_adt: range phys 0..255, raw 0..255
    BMC_Sperrung_Uebertemperatur_adt: compu-method=CM_BMC_Sperrung_Uebertemperatur, range raw 0..3, invalid-value=3
    BMC_Ueberspannungszaehler_CMC03_adt: compu-method=CM_BMC_Ueberspannungszaehler_CMC03, range phys 0..400 Unit_None, raw 0..511, invalid-value=511
    BMC_Ueberspannungszaehler_CMC04_adt: compu-method=CM_BMC_Ueberspannungszaehler_CMC04, range phys 0..400 Unit_None, raw 0..511, invalid-value=511
    BMC_Uebertemperaturzaehler_CMC03_adt: compu-method=CM_BMC_Uebertemperaturzaehler_CMC03, range phys 0..604800 Unit_Ohm, raw 0..65535, invalid-value=65535
    BMC_Uebertemperaturzaehler_CMC04_adt: compu-method=CM_BMC_Uebertemperaturzaehler_CMC04, range phys 0..604800 Unit_None, raw 0..65535, invalid-value=65535
  impl type AB_Deaktivierung_HV:
    compu {0=Cx0_keine_Deaktivierung (CM_AB_Deaktivierung_HV_Cx0_keine_Deaktivierung), 1=Cx1_Deaktivierung_1 (CM_AB_Deaktivierung_HV_Cx1_Deaktivierung_1), 2=Cx2_Deaktivierung_2 (CM_AB_Deaktivierung_HV_Cx2_Deaktivierung_2), 3=Cx3_Deaktivierung_3 (CM_AB_Deaktivierung_HV_Cx3_Deaktivierung_3), 4=Cx4_Deaktivierung_4 (CM_AB_Deaktivierung_HV_Cx4_Deaktivierung_4), 5=Cx5_Deaktivierung_5 (CM_AB_Deaktivierung_HV_Cx5_Deaktivierung_5), 6=Cx6_Deaktivierung_6 (CM_AB_Deaktivierung_HV_Cx6_Deaktivierung_6), 7=Cx7_Fehler (CM_AB_Deaktivierung_HV_Cx7_Fehler)}
    range raw 0..7
    implementation-data-type=uint8
    invalid-value=Invalid_AB_Deaktivierung_HV_XIX_Airbag_10_XIX_HCP5_CANFD01:7
  impl type SG_BMC_HV_11: category=STRUCTURE
    7 x element, all with category=TYPE_REFERENCE:
      BMC_HV_11_BZ: range phys 0..15, raw 0..15, implementation-data-type=uint8
      BMC_HV_11_CRC: range phys 0..255, raw 0..255, implementation-data-type=uint8
      BMC_Sperrung_Ueberspannung: compu-method=CM_BMC_Sperrung_Ueberspannung, range raw 0..3, implementation-data-type=uint8, invalid-value=Invalid_BMC_Sperrung_Ueberspannung_XIX_BMC_HV_11_XIX_BMC_CAN01:3
      BMC_Ueberspannungszaehler_CMC01: compu-method=CM_BMC_Ueberspannungszaehler_CMC01, range phys 0..400 Unit_None, raw 0..511, implementation-data-type=uint16, invalid-value=Invalid_BMC_Ueberspannungszaehler_CMC01_XIX_BMC_HV_11_XIX_BMC_CAN01:511
      BMC_Ueberspannungszaehler_CMC02: compu-method=CM_BMC_Ueberspannungszaehler_CMC02, range phys 0..400 Unit_None, raw 0..511, implementation-data-type=uint16, invalid-value=Invalid_BMC_Ueberspannungszaehler_CMC02_XIX_BMC_HV_11_XIX_BMC_CAN01:511
      BMC_Uebertemperaturzaehler_CMC01: compu-method=CM_BMC_Uebertemperaturzaehler_CMC01, range phys 0..604800 Unit_None, raw 0..65535, implementation-data-type=uint16, invalid-value=Invalid_BMC_Uebertemperaturzaehler_CMC01_XIX_BMC_HV_11_XIX_BMC_CAN01:65535
      BMC_Uebertemperaturzaehler_CMC02: compu-method=CM_BMC_Uebertemperaturzaehler_CMC02, range phys 0..604800 Unit_None, raw 0..65535, implementation-data-type=uint16, invalid-value=Invalid_BMC_Uebertemperaturzaehler_CMC02_XIX_BMC_HV_11_XIX_BMC_CAN01:65535
  application record data type SG_BMC_HV_11_adt: category=STRUCTURE
    7 x application record element, all with category=VALUE:
      BMC_HV_11_BZ: type=BMC_HV_11_BZ_adt
      BMC_HV_11_CRC: type=BMC_HV_11_CRC_adt
      BMC_Sperrung_Ueberspannung: type=BMC_Sperrung_Ueberspannung_adt
      BMC_Ueberspannungszaehler_CMC01: type=BMC_Ueberspannungszaehler_CMC01_adt
      BMC_Ueberspannungszaehler_CMC02: type=BMC_Ueberspannungszaehler_CMC02_adt
      BMC_Uebertemperaturzaehler_CMC01: type=BMC_Uebertemperaturzaehler_CMC01_adt
      BMC_Uebertemperaturzaehler_CMC02: type=BMC_Uebertemperaturzaehler_CMC02_adt
  7 x app type, all with category=VALUE:
    BMC_HV_11_BZ_adt: range phys 0..15, raw 0..15
    BMC_HV_11_CRC_adt: range phys 0..255, raw 0..255
    BMC_Sperrung_Ueberspannung_adt: compu-method=CM_BMC_Sperrung_Ueberspannung, range phys 0..400, raw 0..511, invalid-value=3
    BMC_Ueberspannungszaehler_CMC01_adt: compu-method=CM_BMC_Ueberspannungszaehler_CMC01, range phys 0..400, raw 0..511, invalid-value=511
    BMC_Ueberspannungszaehler_CMC02_adt: compu-method=CM_BMC_Ueberspannungszaehler_CMC02, range phys 0..400, raw 0..511, invalid-value=511
    BMC_Uebertemperaturzaehler_CMC01_adt: compu-method=CM_BMC_Uebertemperaturzaehler_CMC01, range phys 0..400, raw 0..511, invalid-value=65535
    BMC_Uebertemperaturzaehler_CMC02_adt: compu-method=CM_BMC_Uebertemperaturzaehler_CMC02, range phys 0..400, raw 0..511, invalid-value=65535
  impl type SG_BMC_HV_10: category=STRUCTURE
    11 x element, all with category=TYPE_REFERENCE:
      BMC_Datenuebernahme_Anf: compu-method=CM_BMC_Datenuebernahme_Anf, range raw 0..1, implementation-data-type=boolean
      BMC_HV_10_BZ: range phys 0..15, raw 0..15, implementation-data-type=uint8
      BMC_HV_10_CRC: range phys 0..255, raw 0..255, implementation-data-type=uint8
      BMC_Lebensdauer_Trennelemente: compu-method=CM_BMC_Lebensdauer_Trennelemente, range phys 0..100000 Unit_None, raw 0..131071, implementation-data-type=uint32, invalid-value=Invalid_BMC_Lebensdauer_Trennelemente_XIX_BMC_HV_10_XIX_BMC_CAN01:131071
      BMC_Sperrung_Unterspannung: compu-method=CM_BMC_Sperrung_Unterspannung, range raw 0..3, implementation-data-type=uint8, invalid-value=Invalid_BMC_Sperrung_Unterspannung_XIX_BMC_HV_10_XIX_BMC_CAN01:3
      BMC_Status_HV_Spannungssensorik: compu-method=CM_BMC_Status_HV_Spannungssensorik, range raw 0..1, implementation-data-type=boolean, invalid-value=Invalid_BMC_Status_HV_Spannungssensorik_XIX_BMC_HV_10_XIX_BMC_CAN01:1
      BMC_Status_Trennelemente: compu-method=CM_BMC_Status_Trennelemente, range raw 0..7, implementation-data-type=uint8, invalid-value=Invalid_BMC_Status_Trennelemente_XIX_BMC_HV_10_XIX_BMC_CAN01:7
      SignalVoid_BMC_HV_10_0: range phys 0..15, raw 0..15, implementation-data-type=uint8
      SignalVoid_BMC_HV_10_{1..3}: range phys 0..255, raw 0..255, implementation-data-type=uint8
  application record data type SG_BMC_HV_10_adt: category=STRUCTURE
    11 x application record element:
      BMC_Datenuebernahme_Anf: category=BOOLEAN, type=BMC_Datenuebernahme_Anf_adt
      BMC_HV_10_BZ: category=VALUE, type=BMC_HV_10_BZ_adt
      BMC_HV_10_CRC: category=VALUE, type=BMC_HV_10_CRC_adt
      BMC_Lebensdauer_Trennelemente: category=VALUE, type=BMC_Lebensdauer_Trennelemente_adt
      BMC_Sperrung_Unterspannung: category=VALUE, type=BMC_Sperrung_Unterspannung_adt
      BMC_Status_HV_Spannungssensorik: category=BOOLEAN, type=BMC_Status_HV_Spannungssensorik_adt
      BMC_Status_Trennelemente: category=VALUE, type=BMC_Status_Trennelemente_adt
      SignalVoid_BMC_HV_10_{0..3}: category=VALUE, type=SignalVoid_BMC_HV_10_{0..3}_adt
  11 x app type:
    BMC_Datenuebernahme_Anf_adt: category=BOOLEAN, compu-method=CM_BMC_Datenuebernahme_Anf, range raw 0..1
    BMC_HV_10_BZ_adt: category=VALUE, range phys 0..15, raw 0..15
    BMC_HV_10_CRC_adt: category=VALUE, range phys 0..255, raw 0..255
    BMC_Lebensdauer_Trennelemente_adt: category=VALUE, compu-method=CM_BMC_Lebensdauer_Trennelemente, range phys 0..100000 Unit_None, raw 0..131071, invalid-value=131071
    BMC_Sperrung_Unterspannung_adt: category=VALUE, compu-method=CM_BMC_Sperrung_Unterspannung, range raw 0..3, invalid-value=3
    BMC_Status_HV_Spannungssensorik_adt: category=BOOLEAN, compu-method=CM_BMC_Status_HV_Spannungssensorik, range raw 0..1, invalid-value=1
    BMC_Status_Trennelemente_adt: category=VALUE, compu-method=CM_BMC_Status_Trennelemente, range raw 0..7, invalid-value=7
    SignalVoid_BMC_HV_10_0_adt: category=VALUE, range phys 0..15, raw 0..15
    SignalVoid_BMC_HV_10_{1..3}_adt: category=VALUE, range phys 0..255, raw 0..255
  impl type SG_BMC_HV_04: category=STRUCTURE
    15 x element, all with category=TYPE_REFERENCE:
      BMC_Dev_Freigabe: compu-method=CM_BMC_Dev_Freigabe, range raw 0..1, implementation-data-type=boolean
      BMC_Flash_Freigabe: compu-method=CM_BMC_Flash_Freigabe, range raw 0..1, implementation-data-type=boolean
      BMC_HV_04_BZ: range phys 0..15, raw 0..15, implementation-data-type=uint8
      BMC_HV_04_CRC: range phys 0..255, raw 0..255, implementation-data-type=uint8
      BMC_Iso_Mode_Anf: compu-method=CM_BMC_Iso_Mode_Anf, range raw 0..7, implementation-data-type=uint8
      BMC_UI1_Spannung1_Schalt_Anf: compu-method=CM_BMC_UI1_Spannung1_Schalt_Anf, range raw 0..1, implementation-data-type=boolean
      BMC_UI1_Spannung2_Schalt_Anf: compu-method=CM_BMC_UI1_Spannung2_Schalt_Anf, range raw 0..1, implementation-data-type=boolean
      BMC_UI2_Spannung1_Schalt_Anf: compu-method=CM_BMC_UI2_Spannung1_Schalt_Anf, range raw 0..1, implementation-data-type=boolean
      BMC_UI2_Spannung2_Schalt_Anf: compu-method=CM_BMC_UI2_Spannung2_Schalt_Anf, range raw 0..1, implementation-data-type=boolean
      SignalVoid_BMC_HV_04_0: range phys 0..7, raw 0..7, implementation-data-type=uint8
      SignalVoid_BMC_HV_04_{1..5}: range phys 0..255, raw 0..255, implementation-data-type=uint8
  application record data type SG_BMC_HV_04_adt: category=STRUCTURE
    15 x application record element:
      BMC_Dev_Freigabe: category=BOOLEAN, type=BMC_Dev_Freigabe_adt
      BMC_Flash_Freigabe: category=BOOLEAN, type=BMC_Flash_Freigabe_adt
      BMC_HV_04_BZ: category=VALUE, type=BMC_HV_04_BZ_adt
      BMC_HV_04_CRC: category=VALUE, type=BMC_HV_04_CRC_adt
      BMC_Iso_Mode_Anf: category=VALUE, type=BMC_Iso_Mode_Anf_adt
      BMC_UI1_Spannung1_Schalt_Anf: category=BOOLEAN, type=BMC_UI1_Spannung1_Schalt_Anf_adt
      BMC_UI1_Spannung2_Schalt_Anf: category=BOOLEAN, type=BMC_UI1_Spannung2_Schalt_Anf_adt
      BMC_UI2_Spannung1_Schalt_Anf: category=BOOLEAN, type=BMC_UI2_Spannung1_Schalt_Anf_adt
      BMC_UI2_Spannung2_Schalt_Anf: category=BOOLEAN, type=BMC_UI2_Spannung2_Schalt_Anf_adt
      SignalVoid_BMC_HV_04_{0..5}: category=VALUE, type=SignalVoid_BMC_HV_04_{0..5}_adt
  15 x app type:
    BMC_Dev_Freigabe_adt: category=BOOLEAN, compu-method=CM_BMC_Dev_Freigabe, range raw 0..1
    BMC_Flash_Freigabe_adt: category=BOOLEAN, compu-method=CM_BMC_Flash_Freigabe, range raw 0..1
    BMC_HV_04_BZ_adt: category=VALUE, compu {phys=raw for raw 0..15}, range phys 0..15, raw 0..15
    BMC_HV_04_CRC_adt: category=VALUE, compu {phys=raw for raw 0..255}, range phys 0..255, raw 0..255
    BMC_Iso_Mode_Anf_adt: category=VALUE, compu-method=CM_BMC_Iso_Mode_Anf, range raw 0..7
    BMC_UI1_Spannung1_Schalt_Anf_adt: category=BOOLEAN, compu-method=CM_BMC_UI1_Spannung1_Schalt_Anf, range raw 0..1
    BMC_UI1_Spannung2_Schalt_Anf_adt: category=BOOLEAN, compu-method=CM_BMC_UI1_Spannung2_Schalt_Anf, range raw 0..1
    BMC_UI2_Spannung1_Schalt_Anf_adt: category=BOOLEAN, compu-method=CM_BMC_UI2_Spannung1_Schalt_Anf, range raw 0..1
    BMC_UI2_Spannung2_Schalt_Anf_adt: category=BOOLEAN, compu-method=CM_BMC_UI2_Spannung2_Schalt_Anf, range raw 0..1
    SignalVoid_BMC_HV_04_0_adt: category=VALUE, range phys 0..7, raw 0..7
    SignalVoid_BMC_HV_04_{1..5}_adt: category=VALUE, range phys 0..255, raw 0..255
  impl type SG_BMC_HV_01: category=STRUCTURE
    17 x element, all with category=TYPE_REFERENCE:
      BMC_Bankstatus: compu-method=CM_BMC_Bankstatus, range raw 0..15, implementation-data-type=uint8, invalid-value=Invalid_BMC_Bankstatus_XIX_BMC_HV_01_XIX_HCP5_CANFD01:15
      BMC_HV_01_BZ: range phys 0..15, raw 0..15, implementation-data-type=uint8
      BMC_HV_01_CRC: range phys 0..255, raw 0..255, implementation-data-type=uint8
      BMC_HVK_EoHVL_Status: compu-method=CM_BMC_HVK_EoHVL_Status, range raw 0..3, implementation-data-type=uint8, invalid-value=Invalid_BMC_HVK_EoHVL_Status_XIX_BMC_HV_01_XIX_HCP5_CANFD01:3
      BMC_HVK_Fehler_HVIL: compu-method=CM_BMC_HVK_Fehler_HVIL, range raw 0..3, implementation-data-type=uint8, invalid-value=Invalid_BMC_HVK_Fehler_HVIL_XIX_BMC_HV_01_XIX_HCP5_CANFD01:2
      BMC_HVK_Fehler_Intern: compu-method=CM_BMC_HVK_Fehler_Intern, range raw 0..3, implementation-data-type=uint8, invalid-value=Invalid_BMC_HVK_Fehler_Intern_XIX_BMC_HV_01_XIX_HCP5_CANFD01:2
      BMC_HVK_Fehler_SD: compu-method=CM_BMC_HVK_Fehler_SD, range raw 0..3, implementation-data-type=uint8, invalid-value=Invalid_BMC_HVK_Fehler_SD_XIX_BMC_HV_01_XIX_HCP5_CANFD01:2
      BMC_Modus: compu-method=CM_BMC_Modus, range raw 0..15, implementation-data-type=uint8
      BMC_Spannung: compu-method=CM_BMC_Spannung, range phys 0..1023.75 Unit_Volt, raw 0..16383, implementation-data-type=uint16, invalid-value=Invalid_BMC_Spannung_XIX_BMC_HV_01_XIX_HCP5_CANFD01:16383
      BMC_Spannung_Messzeit: compu-method=CM_BMC_Spannung_Messzeit, range phys 0..253 Unit_None, raw 0..255, implementation-data-type=uint8, invalid-value=Invalid_BMC_Spannung_Messzeit_XIX_BMC_HV_01_XIX_HCP5_CANFD01:255
      BMC_Spannung_ZwischenKreis: compu-method=CM_BMC_Spannung_ZwischenKreis, range phys 0..1023.75 Unit_Volt, raw 0..16383, implementation-data-type=uint16, invalid-value=Invalid_BMC_Spannung_ZwischenKreis_XIX_BMC_HV_01_XIX_HCP5_CANFD01:16383
      BMC_Spannung_ZwischenKreis_2: compu-method=CM_BMC_Spannung_ZwischenKreis_2, range phys 0..1023.75 Unit_Volt, raw 0..16383, implementation-data-type=uint16, invalid-value=Invalid_BMC_Spannung_ZwischenKreis_2_XIX_BMC_HV_01_XIX_HCP5_CANFD01:16383
      BMC_Status_Spgfreiheit: compu-method=CM_BMC_Status_Spgfreiheit, range raw 0..3, implementation-data-type=uint8
      BMC_Strom: compu-method=CM_BMC_Strom, range phys -2047..2048.8125 Unit_Amper, raw 0..65535, implementation-data-type=uint16, invalid-value=Invalid_BMC_Strom_XIX_BMC_HV_01_XIX_HCP5_CANFD01:65535
      BMC_Strom_02: compu-method=CM_BMC_Strom_02, range phys -3250..3250 Unit_Amper, raw 0..131071, implementation-data-type=uint32, invalid-value=Invalid_BMC_Strom_02_XIX_BMC_HV_01_XIX_HCP5_CANFD01:131071
      BMC_Strom_Messzeit: compu-method=CM_BMC_Strom_Messzeit, range phys 0..253 Unit_None, raw 0..255, implementation-data-type=uint8, invalid-value=Invalid_BMC_Strom_Messzeit_XIX_BMC_HV_01_XIX_HCP5_CANFD01:255
      SignalVoid_BMC_HV_01_0: range phys 0..127, raw 0..127, implementation-data-type=uint8
  application record data type SG_BMC_HV_01_adt: category=STRUCTURE
    17 x application record element, all with category=VALUE:
      BMC_Bankstatus: type=BMC_Bankstatus_adt
      BMC_HV_01_BZ: type=BMC_HV_01_BZ_adt
      BMC_HV_01_CRC: type=BMC_HV_01_CRC_adt
      BMC_HVK_EoHVL_Status: type=BMC_HVK_EoHVL_Status_adt
      BMC_HVK_Fehler_HVIL: type=BMC_HVK_Fehler_HVIL_adt
      BMC_HVK_Fehler_Intern: type=BMC_HVK_Fehler_Intern_adt
      BMC_HVK_Fehler_SD: type=BMC_HVK_Fehler_SD_adt
      BMC_Modus: type=BMC_Modus_adt
      BMC_Spannung: type=BMC_Spannung_adt
      BMC_Spannung_Messzeit: type=BMC_Spannung_Messzeit_adt
      BMC_Spannung_ZwischenKreis: type=BMC_Spannung_ZwischenKreis_adt
      BMC_Spannung_ZwischenKreis_2: type=BMC_Spannung_ZwischenKreis_2_adt
      BMC_Status_Spgfreiheit: type=BMC_Status_Spgfreiheit_adt
      BMC_Strom: type=BMC_Strom_adt
      BMC_Strom_02: type=BMC_Strom_02_adt
      BMC_Strom_Messzeit: type=BMC_Strom_Messzeit_adt
      SignalVoid_BMC_HV_01_0: type=SignalVoid_BMC_HV_01_0_adt
  17 x app type, all with category=VALUE:
    BMC_Bankstatus_adt: compu-method=CM_BMC_Bankstatus, range raw 0..15, invalid-value=15
    BMC_HV_01_BZ_adt: compu {phys=raw for raw 0..15}, range phys 0..15, raw 0..15
    BMC_HV_01_CRC_adt: compu {phys=raw for raw 0..255}, range phys 0..255, raw 0..255
    BMC_HVK_EoHVL_Status_adt: compu-method=CM_BMC_HVK_EoHVL_Status, range raw 0..3, invalid-value=3
    BMC_HVK_Fehler_HVIL_adt: compu-method=CM_BMC_HVK_Fehler_HVIL, range raw 0..3, invalid-value=2
    BMC_HVK_Fehler_Intern_adt: compu-method=CM_BMC_HVK_Fehler_Intern, range raw 0..3, invalid-value=2
    BMC_HVK_Fehler_SD_adt: compu-method=CM_BMC_HVK_Fehler_SD, range raw 0..3, invalid-value=2
    BMC_Modus_adt: compu-method=CM_BMC_Modus, range raw 0..15
    BMC_Spannung_adt: compu-method=CM_BMC_Spannung, range phys 0..1023.75 Unit_Volt, raw 0..16383, invalid-value=16383
    BMC_Spannung_Messzeit_adt: compu-method=CM_BMC_Spannung_Messzeit, range phys 0..253 Unit_None, raw 0..255, invalid-value=255
    BMC_Spannung_ZwischenKreis_adt: compu-method=CM_BMC_Spannung_ZwischenKreis, range phys 0..1023.75 Unit_Volt, raw 0..16383, invalid-value=16383
    BMC_Spannung_ZwischenKreis_2_adt: compu-method=CM_BMC_Spannung_ZwischenKreis_2, range phys 0..1023.75 Unit_Volt, raw 0..16383, invalid-value=16383
    BMC_Status_Spgfreiheit_adt: compu-method=CM_BMC_Status_Spgfreiheit, range raw 0..3
    BMC_Strom_adt: compu-method=CM_BMC_Strom, range phys -2047..2048.8125 Unit_Amper, raw 0..65535, invalid-value=65535
    BMC_Strom_02_adt: compu-method=CM_BMC_Strom_02, range phys -3250..3250 Unit_Amper, raw 0..131071, invalid-value=131071
    BMC_Strom_Messzeit_adt: compu-method=CM_BMC_Strom_Messzeit, range phys 0..253 Unit_None, raw 0..255, invalid-value=255
    SignalVoid_BMC_HV_01_0_adt: range phys 0..127, raw 0..127
  impl type SG_BMC_HV_02: category=STRUCTURE
    45 x element, all with category=TYPE_REFERENCE:
      Anzeige_SOC: compu-method=CM_Anzeige_SOC, range phys 0..100 Unit_PerCent, raw 0..1023, implementation-data-type=uint16, invalid-value=Invalid_Anzeige_SOC_XIX_BMC_HV_02_XIX_HCP5_CANFD01:1023
      BMC_AC_Laden: compu-method=CM_BMC_AC_Laden, range raw 0..3, implementation-data-type=uint8, invalid-value=Invalid_BMC_AC_Laden_XIX_BMC_HV_02_XIX_HCP5_CANFD01:3
      BMC_Bank_Notlauf_erlaubt: compu-method=CM_BMC_Bank_Notlauf_erlaubt, range raw 0..1, implementation-data-type=boolean
      BMC_Bank_parallel_erlaubt: compu-method=CM_BMC_Bank_parallel_erlaubt, range raw 0..1, implementation-data-type=boolean
      BMC_Bank_seriell_erlaubt: compu-method=CM_BMC_Bank_seriell_erlaubt, range raw 0..1, implementation-data-type=boolean
      BMC_DC_Laden: compu-method=CM_BMC_DC_Laden, range raw 0..3, implementation-data-type=uint8, invalid-value=Invalid_BMC_DC_Laden_XIX_BMC_HV_02_XIX_HCP5_CANFD01:3
      BMC_Energie_Sockel_SoC: compu-method=CM_BMC_Energie_Sockel_SoC, range phys 0..100 Unit_PerCent, raw 0..1023, implementation-data-type=uint16, invalid-value=Invalid_BMC_Energie_Sockel_SoC_XIX_BMC_HV_02_XIX_HCP5_CANFD01:1023
      BMC_Energieinhalt: compu-method=CM_BMC_Energieinhalt, range phys 0..262132 Unit_WattHour, raw 0..65535, implementation-data-type=uint16, invalid-value=Invalid_BMC_Energieinhalt_XIX_BMC_HV_02_XIX_HCP5_CANFD01:65535
      BMC_Fehler_Leistungsred: compu-method=CM_BMC_Fehler_Leistungsred, range raw 0..1, implementation-data-type=boolean
      BMC_Fehler_Warnung: compu-method=CM_BMC_Fehler_Warnung, range raw 0..2, implementation-data-type=uint8
      BMC_HV_02_BZ: range phys 0..15, raw 0..15, implementation-data-type=uint8
      BMC_HV_02_CRC: range phys 0..255, raw 0..255, implementation-data-type=uint8
      BMC_IstZellspannungMax: compu-method=CM_BMC_IstZellspannungMax, range phys 1000..5091 Unit_MilliVolt, raw 0..4095, implementation-data-type=uint16, invalid-value=Invalid_BMC_IstZellspannungMax_XIX_BMC_HV_02_XIX_HCP5_CANFD01:4095
      BMC_IstZellspannungMin: compu-method=CM_BMC_IstZellspannungMin, range phys 1000..5091 Unit_MilliVolt, raw 0..4095, implementation-data-type=uint16, invalid-value=Invalid_BMC_IstZellspannungMin_XIX_BMC_HV_02_XIX_HCP5_CANFD01:4095
      BMC_IWU_Status: compu-method=CM_BMC_IWU_Status, range raw 0..6, implementation-data-type=uint8
      BMC_IWU_Wert_neg: compu-method=CM_BMC_IWU_Wert_neg, range phys 0..6553200 Unit_Ohm, raw 0..65535, implementation-data-type=uint16, invalid-value=Invalid_BMC_IWU_Wert_neg_XIX_BMC_HV_02_XIX_HCP5_CANFD01:65535
      BMC_IWU_Wert_pos: compu-method=CM_BMC_IWU_Wert_pos, range phys 0..6553200 Unit_Ohm, raw 0..65535, implementation-data-type=uint16, invalid-value=Invalid_BMC_IWU_Wert_pos_XIX_BMC_HV_02_XIX_HCP5_CANFD01:65535
      BMC_Leerlaufspannung: compu-method=CM_BMC_Leerlaufspannung, range phys 0..1021 Unit_Volt, raw 0..1023, implementation-data-type=uint16, invalid-value=Invalid_BMC_Leerlaufspannung_XIX_BMC_HV_02_XIX_HCP5_CANFD01:1023
      BMC_Max_Entladeleistung: compu-method=CM_BMC_Max_Entladeleistung, range phys 0..818900 Unit_Watt, raw 0..8191, implementation-data-type=uint16, invalid-value=Invalid_BMC_Max_Entladeleistung_XIX_BMC_HV_02_XIX_HCP5_CANFD01:8191
      BMC_Max_Entladestrom: compu-method=CM_BMC_Max_Entladestrom, range phys 0..1637.8 Unit_Amper, raw 0..8191, implementation-data-type=uint16, invalid-value=Invalid_BMC_Max_Entladestrom_XIX_BMC_HV_02_XIX_HCP5_CANFD01:8191
      BMC_Max_Ladeleistung: compu-method=CM_BMC_Max_Ladeleistung, range phys 0..818900 Unit_Watt, raw 0..8191, implementation-data-type=uint16, invalid-value=Invalid_BMC_Max_Ladeleistung_XIX_BMC_HV_02_XIX_HCP5_CANFD01:8191
      BMC_Max_Ladestrom: compu-method=CM_BMC_Max_Ladestrom, range phys 0..1637.8 Unit_Amper, raw 0..8191, implementation-data-type=uint16, invalid-value=Invalid_BMC_Max_Ladestrom_XIX_BMC_HV_02_XIX_HCP5_CANFD01:8191
      BMC_MinDyn_Entladespannung: compu-method=CM_BMC_MinDyn_Entladespannung, range phys 0..1021 Unit_None, raw 0..1023, implementation-data-type=uint16, invalid-value=Invalid_BMC_MinDyn_Entladespannung_XIX_BMC_HV_02_XIX_HCP5_CANFD01:1023
      BMC_MinDyn_Ladespannung: compu-method=CM_BMC_MinDyn_Ladespannung, range phys 0..1021 Unit_Volt, raw 0..1023, implementation-data-type=uint16, invalid-value=Invalid_BMC_MinDyn_Ladespannung_XIX_BMC_HV_02_XIX_HCP5_CANFD01:1023
      BMC_MMTR_Status: compu-method=CM_BMC_MMTR_Status, range raw 0..15, implementation-data-type=uint8, invalid-value=Invalid_BMC_MMTR_Status_XIX_BMC_HV_02_XIX_HCP5_CANFD01:15
      BMC_NutzbarerSOC: compu-method=CM_BMC_NutzbarerSOC, range phys -20..184.65 Unit_PerCent, raw 0..4095, implementation-data-type=uint16, invalid-value=Invalid_BMC_NutzbarerSOC_XIX_BMC_HV_02_XIX_HCP5_CANFD01:4095
      BMC_PerfInd_Entladen: compu-method=CM_BMC_PerfInd_Entladen, range phys 0..204.2 Unit_PerCent, raw 0..1023, implementation-data-type=uint16, invalid-value=Invalid_BMC_PerfInd_Entladen_XIX_BMC_HV_02_XIX_HCP5_CANFD01:1023
      BMC_PerfInd_Laden: compu-method=CM_BMC_PerfInd_Laden, range phys 0..204.2 Unit_PerCent, raw 0..1023, implementation-data-type=uint16, invalid-value=Invalid_BMC_PerfInd_Laden_XIX_BMC_HV_02_XIX_HCP5_CANFD01:1023
      BMC_PredLeistung_StuetzungNV: compu-method=CM_BMC_PredLeistung_StuetzungNV, range phys 0..818400 Unit_Watt, raw 0..4095, implementation-data-type=uint16, invalid-value=Invalid_BMC_PredLeistung_StuetzungNV_XIX_BMC_HV_02_XIX_HCP5_CANFD01:4095
      BMC_Spannung_DC_Ladesaeule: compu-method=CM_BMC_Spannung_DC_Ladesaeule, range phys -1023..1024.75 Unit_Volt, raw 0..32767, implementation-data-type=uint16, invalid-value=Invalid_BMC_Spannung_DC_Ladesaeule_XIX_BMC_HV_02_XIX_HCP5_CANFD01:32767
      BMC_Status_DCLS: compu-method=CM_BMC_Status_DCLS, range raw 0..3, implementation-data-type=uint8
      BMC_TechnischerSOC: compu-method=CM_BMC_TechnischerSOC, range phys 0..100 Unit_PerCent, raw 0..2047, implementation-data-type=uint16, invalid-value=Invalid_BMC_TechnischerSOC_XIX_BMC_HV_02_XIX_HCP5_CANFD01:2047
      BMC_Unterboden_Warnung: compu-method=CM_BMC_Unterboden_Warnung, range raw 0..7, implementation-data-type=uint8, invalid-value=Invalid_BMC_Unterboden_Warnung_XIX_BMC_HV_02_XIX_HCP5_CANFD01:7
      BMC_Verbauinfo_ACSchuetz: compu-method=CM_BMC_Verbauinfo_ACSchuetz, range raw 0..2, implementation-data-type=uint8
      BMC_Verbauinfo_Bank: compu-method=CM_BMC_Verbauinfo_Bank, range raw 0..2, implementation-data-type=uint8
      BMC_Vorlade_Zielspannung: compu-method=CM_BMC_Vorlade_Zielspannung, range phys 0..1021 Unit_Volt, raw 0..1023, implementation-data-type=uint16, invalid-value=Invalid_BMC_Vorlade_Zielspannung_XIX_BMC_HV_02_XIX_HCP5_CANFD01:1023
      BMC_ZellTemp_virtuell_max: compu-method=CM_BMC_ZellTemp_virtuell_max, range phys -40..87.5 Unit_DegreCelsi, raw 0..1023, implementation-data-type=uint16, invalid-value=Invalid_BMC_ZellTemp_virtuell_max_XIX_BMC_HV_02_XIX_HCP5_CANFD01:1023
      BMC_ZellTemp_virtuell_min: compu-method=CM_BMC_ZellTemp_virtuell_min, range phys -40..87.5 Unit_DegreCelsi, raw 0..1023, implementation-data-type=uint16, invalid-value=Invalid_BMC_ZellTemp_virtuell_min_XIX_BMC_HV_02_XIX_HCP5_CANFD01:1023
      Hybrid_01_OBD_Lampe_Anf: compu-method=CM_Hybrid_01_OBD_Lampe_Anf, range raw 0..1, implementation-data-type=boolean
      SignalVoid_BMC_HV_02_0: range phys 0..3, raw 0..3, implementation-data-type=uint8
      SignalVoid_BMC_HV_02_1: range phys 0..31, raw 0..31, implementation-data-type=uint8
      SignalVoid_BMC_HV_02_{2..5}: range phys 0..255, raw 0..255, implementation-data-type=uint8
  application record data type SG_BMC_HV_02_adt: category=STRUCTURE
    45 x application record element:
      Anzeige_SOC: category=VALUE, type=Anzeige_SOC_adt
      BMC_AC_Laden: category=VALUE, type=BMC_AC_Laden_adt
      BMC_Bank_Notlauf_erlaubt: category=BOOLEAN, type=BMC_Bank_Notlauf_erlaubt_adt
      BMC_Bank_parallel_erlaubt: category=BOOLEAN, type=BMC_Bank_parallel_erlaubt_adt
      BMC_Bank_seriell_erlaubt: category=BOOLEAN, type=BMC_Bank_seriell_erlaubt_adt
      BMC_DC_Laden: category=VALUE, type=BMC_DC_Laden_adt
      BMC_Energie_Sockel_SoC: category=VALUE, type=BMC_Energie_Sockel_SoC_adt
      BMC_Energieinhalt: category=VALUE, type=BMC_Energieinhalt_adt
      BMC_Fehler_Leistungsred: category=BOOLEAN, type=BMC_Fehler_Leistungsred_adt
      BMC_Fehler_Warnung: category=VALUE, type=BMC_Fehler_Warnung_adt
      BMC_HV_02_BZ: category=VALUE, type=BMC_HV_02_BZ_adt
      BMC_HV_02_CRC: category=VALUE, type=BMC_HV_02_CRC_adt
      BMC_IstZellspannungMax: category=VALUE, type=BMC_IstZellspannungMax_adt
      BMC_IstZellspannungMin: category=VALUE, type=BMC_IstZellspannungMin_adt
      BMC_IWU_Status: category=VALUE, type=BMC_IWU_Status_adt
      BMC_IWU_Wert_neg: category=VALUE, type=BMC_IWU_Wert_neg_adt
      BMC_IWU_Wert_pos: category=VALUE, type=BMC_IWU_Wert_pos_adt
      BMC_Leerlaufspannung: category=VALUE, type=BMC_Leerlaufspannung_adt
      BMC_Max_Entladeleistung: category=VALUE, type=BMC_Max_Entladeleistung_adt
      BMC_Max_Entladestrom: category=VALUE, type=BMC_Max_Entladestrom_adt
      BMC_Max_Ladeleistung: category=VALUE, type=BMC_Max_Ladeleistung_adt
      BMC_Max_Ladestrom: category=VALUE, type=BMC_Max_Ladestrom_adt
      BMC_MinDyn_Entladespannung: category=VALUE, type=BMC_MinDyn_Entladespannung_adt
      BMC_MinDyn_Ladespannung: category=VALUE, type=BMC_MinDyn_Ladespannung_adt
      BMC_MMTR_Status: category=VALUE, type=BMC_MMTR_Status_adt
      BMC_NutzbarerSOC: category=VALUE, type=BMC_NutzbarerSOC_adt
      BMC_PerfInd_Entladen: category=VALUE, type=BMC_PerfInd_Entladen_adt
      BMC_PerfInd_Laden: category=VALUE, type=BMC_PerfInd_Laden_adt
      BMC_PredLeistung_StuetzungNV: category=VALUE, type=BMC_PredLeistung_StuetzungNV_adt
      BMC_Spannung_DC_Ladesaeule: category=VALUE, type=BMC_Spannung_DC_Ladesaeule_adt
      BMC_Status_DCLS: category=VALUE, type=BMC_Status_DCLS_adt
      BMC_TechnischerSOC: category=VALUE, type=BMC_TechnischerSOC_adt
      BMC_Unterboden_Warnung: category=VALUE, type=BMC_Unterboden_Warnung_adt
      BMC_Verbauinfo_ACSchuetz: category=VALUE, type=BMC_Verbauinfo_ACSchuetz_adt
      BMC_Verbauinfo_Bank: category=VALUE, type=BMC_Verbauinfo_Bank_adt
      BMC_Vorlade_Zielspannung: category=VALUE, type=BMC_Vorlade_Zielspannung_adt
      BMC_ZellTemp_virtuell_max: category=VALUE, type=BMC_ZellTemp_virtuell_max_adt
      BMC_ZellTemp_virtuell_min: category=VALUE, type=BMC_ZellTemp_virtuell_min_adt
      Hybrid_01_OBD_Lampe_Anf: category=BOOLEAN, type=Hybrid_01_OBD_Lampe_Anf_adt
      SignalVoid_BMC_HV_02_{0..5}: category=VALUE, type=SignalVoid_BMC_HV_02_{0..5}_adt
  45 x app type:
    Anzeige_SOC_adt: category=VALUE, compu-method=CM_Anzeige_SOC, range phys 0..100 Unit_PerCent, raw 0..1023, invalid-value=1023
    BMC_AC_Laden_adt: category=VALUE, compu-method=CM_BMC_AC_Laden, range raw 0..3, invalid-value=3
    BMC_Bank_Notlauf_erlaubt_adt: category=BOOLEAN, compu-method=CM_BMC_Bank_Notlauf_erlaubt, range raw 0..1
    BMC_Bank_parallel_erlaubt_adt: category=BOOLEAN, compu-method=CM_BMC_Bank_parallel_erlaubt, range raw 0..1
    BMC_Bank_seriell_erlaubt_adt: category=BOOLEAN, compu-method=CM_BMC_Bank_seriell_erlaubt, range raw 0..1
    BMC_DC_Laden_adt: category=VALUE, compu-method=CM_BMC_DC_Laden, range raw 0..3, invalid-value=3
    BMC_Energie_Sockel_SoC_adt: category=VALUE, compu-method=CM_BMC_Energie_Sockel_SoC, range phys 0..100 Unit_PerCent, raw 0..1023, invalid-value=1023
    BMC_Energieinhalt_adt: category=VALUE, compu-method=CM_BMC_Energieinhalt, range phys 0..262132 Unit_WattHour, raw 0..65535, invalid-value=65535
    BMC_Fehler_Leistungsred_adt: category=BOOLEAN, compu-method=CM_BMC_Fehler_Leistungsred, range raw 0..1
    BMC_Fehler_Warnung_adt: category=VALUE, compu-method=CM_BMC_Fehler_Warnung, range raw 0..2
    BMC_HV_02_BZ_adt: category=VALUE, compu {phys=raw for raw 0..15}, range phys 0..15, raw 0..15
    BMC_HV_02_CRC_adt: category=VALUE, compu {phys=raw for raw 0..255}, range phys 0..255, raw 0..255
    BMC_IstZellspannungMax_adt: category=VALUE, compu-method=CM_BMC_IstZellspannungMax, range phys 1000..5091 Unit_MilliVolt, raw 0..4095, invalid-value=4095
    BMC_IstZellspannungMin_adt: category=VALUE, compu-method=CM_BMC_IstZellspannungMin, range phys 1000..5091 Unit_MilliVolt, raw 0..4095, invalid-value=4095
    BMC_IWU_Status_adt: category=VALUE, compu-method=CM_BMC_IWU_Status, range raw 0..6
    BMC_IWU_Wert_neg_adt: category=VALUE, compu-method=CM_BMC_IWU_Wert_neg, range phys 0..6553200 Unit_Ohm, raw 0..65535, invalid-value=65535
    BMC_IWU_Wert_pos_adt: category=VALUE, compu-method=CM_BMC_IWU_Wert_pos, range phys 0..6553200 Unit_Ohm, raw 0..65535, invalid-value=65535
    BMC_Leerlaufspannung_adt: category=VALUE, compu-method=CM_BMC_Leerlaufspannung, range phys 0..1021 Unit_Volt, raw 0..1023, invalid-value=1023
    BMC_Max_Entladeleistung_adt: category=VALUE, compu-method=CM_BMC_Max_Entladeleistung, range phys 0..818900 Unit_Watt, raw 0..8191, invalid-value=8191
    BMC_Max_Entladestrom_adt: category=VALUE, compu-method=CM_BMC_Max_Entladestrom, range phys 0..1637.8 Unit_Amper, raw 0..8191, invalid-value=8191
    BMC_Max_Ladeleistung_adt: category=VALUE, compu-method=CM_BMC_Max_Ladeleistung, range phys 0..818900 Unit_Watt, raw 0..8191, invalid-value=8191
    BMC_Max_Ladestrom_adt: category=VALUE, compu-method=CM_BMC_Max_Ladestrom, range phys 0..1637.8 Unit_Amper, raw 0..8191, invalid-value=8191
    BMC_MinDyn_Entladespannung_adt: category=VALUE, compu-method=CM_BMC_MinDyn_Entladespannung, range phys 0..1021 Unit_None, raw 0..1023, invalid-value=1023
    BMC_MinDyn_Ladespannung_adt: category=VALUE, compu-method=CM_BMC_MinDyn_Ladespannung, range phys 0..1021 Unit_Volt, raw 0..1023, invalid-value=1023
    BMC_MMTR_Status_adt: category=VALUE, compu-method=CM_BMC_MMTR_Status, range raw 0..15, invalid-value=15
    BMC_NutzbarerSOC_adt: category=VALUE, compu-method=CM_BMC_NutzbarerSOC, range phys -20..184.65 Unit_PerCent, raw 0..4095, invalid-value=4095
    BMC_PerfInd_Entladen_adt: category=VALUE, compu-method=CM_BMC_PerfInd_Entladen, range phys 0..204.2 Unit_PerCent, raw 0..1023, invalid-value=1023
    BMC_PerfInd_Laden_adt: category=VALUE, compu-method=CM_BMC_PerfInd_Laden, range phys 0..204.2 Unit_PerCent, raw 0..1023, invalid-value=1023
    BMC_PredLeistung_StuetzungNV_adt: category=VALUE, compu-method=CM_BMC_PredLeistung_StuetzungNV, range phys 0..818400 Unit_Watt, raw 0..4095, invalid-value=4095
    BMC_Spannung_DC_Ladesaeule_adt: category=VALUE, compu-method=CM_BMC_Spannung_DC_Ladesaeule, range phys -1023..1024.75 Unit_Volt, raw 0..32767, invalid-value=32767
    BMC_Status_DCLS_adt: category=VALUE, compu-method=CM_BMC_Status_DCLS, range raw 0..3
    BMC_TechnischerSOC_adt: category=VALUE, compu-method=CM_BMC_TechnischerSOC, range phys 0..100 Unit_PerCent, raw 0..2047, invalid-value=2047
    BMC_Unterboden_Warnung_adt: category=VALUE, compu-method=CM_BMC_Unterboden_Warnung, range raw 0..7, invalid-value=7
    BMC_Verbauinfo_ACSchuetz_adt: category=VALUE, compu-method=CM_BMC_Verbauinfo_ACSchuetz, range raw 0..2
    BMC_Verbauinfo_Bank_adt: category=VALUE, compu-method=CM_BMC_Verbauinfo_Bank, range raw 0..2
    BMC_Vorlade_Zielspannung_adt: category=VALUE, compu-method=CM_BMC_Vorlade_Zielspannung, range phys 0..1021 Unit_Volt, raw 0..1023, invalid-value=1023
    BMC_ZellTemp_virtuell_max_adt: category=VALUE, compu-method=CM_BMC_ZellTemp_virtuell_max, range phys -40..87.5 Unit_DegreCelsi, raw 0..1023, invalid-value=1023
    BMC_ZellTemp_virtuell_min_adt: category=VALUE, compu-method=CM_BMC_ZellTemp_virtuell_min, range phys -40..87.5 Unit_DegreCelsi, raw 0..1023, invalid-value=1023
    Hybrid_01_OBD_Lampe_Anf_adt: category=BOOLEAN, compu-method=CM_Hybrid_01_OBD_Lampe_Anf, range raw 0..1
    SignalVoid_BMC_HV_02_0_adt: category=VALUE, range phys 0..3, raw 0..3
    SignalVoid_BMC_HV_02_1_adt: category=VALUE, range phys 0..31, raw 0..31
    SignalVoid_BMC_HV_02_{2..5}_adt: category=VALUE, range phys 0..255, raw 0..255
  impl type SG_KS_Hybrid_01_Challenge_K: category=STRUCTURE
    element KS_Hybrid_01_ChK: implementation-data-type=KS_Hybrid_01_ChK
    element KS_Hybrid_01_ChK_IKACtr: range phys 0..255 Unit_None, raw 0..255, implementation-data-type=uint8
    element KS_Hybrid_01_ChK_SID: range phys 0..65535 Unit_None, raw 0..65535, implementation-data-type=uint16
  impl type KS_Hybrid_01_ChK: category=ARRAY
    element Element: array-size=8, array-size-semantics=FIXED-SIZE, range phys 0..18446744073709551615 Unit_None, raw 0..18446744073709551615, implementation-data-type=uint8
  application record data type SG_KS_Hybrid_01_Challenge_K_adt: category=STRUCTURE
    application record element KS_Hybrid_01_ChK: category=ARRAY, type=KS_Hybrid_01_ChK_adt
    application record element KS_Hybrid_01_ChK_IKACtr: category=VALUE, type=KS_Hybrid_01_ChK_IKACtr_adt
    application record element KS_Hybrid_01_ChK_SID: category=VALUE, type=KS_Hybrid_01_ChK_SID_adt
  application array data type KS_Hybrid_01_ChK_adt: category=ARRAY
    element Element: category=ARRAY, type=KS_Hybrid_01_ChK_adt_int_array, array-size-semantics=FIXED-SIZE, max-number-of-elements=8
  application array data type KS_Hybrid_01_ChK_adt_int_array: category=ARRAY
    element Element: category=VALUE, type=KS_Hybrid_01_ChK_adt_int, array-size-semantics=FIXED-SIZE, max-number-of-elements=8
  app type KS_Hybrid_01_ChK_adt_int: category=VALUE, compu {phys=raw for raw 0..18446744073709551615; unit Unit_None}, range phys 0..18446744073709551615 Unit_None, raw 0..18446744073709551615
  app type KS_Hybrid_01_ChK_IKACtr_adt: category=VALUE, compu {phys=raw for raw 0..255; unit Unit_None}, range phys 0..255 Unit_None, raw 0..255
  app type KS_Hybrid_01_ChK_SID_adt: category=VALUE, compu {phys=raw for raw 0..65535; unit Unit_None}, range phys 0..65535 Unit_None, raw 0..65535
  impl type SG_KS_Hybrid_01_ReqFrame: category=STRUCTURE
    8 x element, all with category=TYPE_REFERENCE:
      KS_Hybrid_01_Req_ErrCtr: range phys 0..255 Unit_None, raw 0..255, implementation-data-type=uint8
      KS_Hybrid_01_Req_IKA_Retry: compu-method=CM_KS_Hybrid_01_Req_IKA_Retry, range raw 0..1, implementation-data-type=boolean
      KS_Hybrid_01_Req_Prio: compu-method=CM_KS_Hybrid_01_Req_Prio, range raw 0..1, implementation-data-type=boolean
      KS_Hybrid_01_Req_SID: range phys 0..65535 Unit_None, raw 0..65535, implementation-data-type=uint16
      KS_Hybrid_01_Req_SWMaj: range phys 0..255 Unit_None, raw 0..255, implementation-data-type=uint8
      KS_Hybrid_01_Req_SWMin: range phys 0..255 Unit_None, raw 0..255, implementation-data-type=uint8
      KS_Hybrid_01_Req_SWPat: range phys 0..255 Unit_None, raw 0..255, implementation-data-type=uint8
      KS_Hybrid_01_Req_VKMS_Err: compu-method=CM_KS_Hybrid_01_Req_VKMS_Err, range raw 0..1, implementation-data-type=boolean
  application record data type SG_KS_Hybrid_01_ReqFrame_adt: category=STRUCTURE
    8 x application record element:
      KS_Hybrid_01_Req_ErrCtr: category=VALUE, type=KS_Hybrid_01_Req_ErrCtr_adt
      KS_Hybrid_01_Req_IKA_Retry: category=BOOLEAN, type=KS_Hybrid_01_Req_IKA_Retry_adt
      KS_Hybrid_01_Req_Prio: category=BOOLEAN, type=KS_Hybrid_01_Req_Prio_adt
      KS_Hybrid_01_Req_SID: category=VALUE, type=KS_Hybrid_01_Req_SID_adt
      KS_Hybrid_01_Req_SWMaj: category=VALUE, type=KS_Hybrid_01_Req_SWMaj_adt
      KS_Hybrid_01_Req_SWMin: category=VALUE, type=KS_Hybrid_01_Req_SWMin_adt
      KS_Hybrid_01_Req_SWPat: category=VALUE, type=KS_Hybrid_01_Req_SWPat_adt
      KS_Hybrid_01_Req_VKMS_Err: category=BOOLEAN, type=KS_Hybrid_01_Req_VKMS_Err_adt
  8 x app type:
    KS_Hybrid_01_Req_ErrCtr_adt: category=VALUE, compu {phys=raw for raw 0..255; unit Unit_None}, range phys 0..255 Unit_None, raw 0..255
    KS_Hybrid_01_Req_IKA_Retry_adt: category=BOOLEAN, compu-method=CM_KS_Hybrid_01_Req_IKA_Retry, range raw 0..1
    KS_Hybrid_01_Req_Prio_adt: category=BOOLEAN, compu-method=CM_KS_Hybrid_01_Req_Prio, range raw 0..1
    KS_Hybrid_01_Req_SID_adt: category=VALUE, compu {phys=raw for raw 0..65535; unit Unit_None}, range phys 0..65535 Unit_None, raw 0..65535
    KS_Hybrid_01_Req_SWMaj_adt: category=VALUE, compu {phys=raw for raw 0..255; unit Unit_None}, range phys 0..255 Unit_None, raw 0..255
    KS_Hybrid_01_Req_SWMin_adt: category=VALUE, compu {phys=raw for raw 0..255; unit Unit_None}, range phys 0..255 Unit_None, raw 0..255
    KS_Hybrid_01_Req_SWPat_adt: category=VALUE, compu {phys=raw for raw 0..255; unit Unit_None}, range phys 0..255 Unit_None, raw 0..255
    KS_Hybrid_01_Req_VKMS_Err_adt: category=BOOLEAN, compu-method=CM_KS_Hybrid_01_Req_VKMS_Err, range raw 0..1
  impl type SG_KS_Hybrid_01_Response_K: category=STRUCTURE
    element KS_Hybrid_01_ReK: implementation-data-type=KS_Hybrid_01_ReK
    element KS_Hybrid_01_ReK_IKACtr: range phys 0..255 Unit_None, raw 0..255, implementation-data-type=uint8
    element KS_Hybrid_01_ReK_SID: range phys 0..65535 Unit_None, raw 0..65535, implementation-data-type=uint16
  impl type KS_Hybrid_01_ReK: category=ARRAY
    element Element: array-size=8, array-size-semantics=FIXED-SIZE, range phys 0..18446744073709551615 Unit_None, raw 0..18446744073709551615, implementation-data-type=uint8
  application record data type SG_KS_Hybrid_01_Response_K_adt: category=STRUCTURE
    application record element KS_Hybrid_01_ReK: category=ARRAY, type=KS_Hybrid_01_ReK_adt
    application record element KS_Hybrid_01_ReK_IKACtr: category=VALUE, type=KS_Hybrid_01_ReK_IKACtr_adt
    application record element KS_Hybrid_01_ReK_SID: category=VALUE, type=KS_Hybrid_01_ReK_SID_adt
  application array data type KS_Hybrid_01_ReK_adt: category=ARRAY
    element Element: category=ARRAY, type=KS_Hybrid_01_ReK_adt_int_array, array-size-semantics=FIXED-SIZE, max-number-of-elements=8
  application array data type KS_Hybrid_01_ReK_adt_int_array: category=ARRAY
    element Element: category=VALUE, type=KS_Hybrid_01_ReK_adt_int, array-size-semantics=FIXED-SIZE, max-number-of-elements=8
  app type KS_Hybrid_01_ReK_adt_int: category=VALUE, compu {phys=raw for raw 0..18446744073709551615; unit Unit_None}, range phys 0..18446744073709551615 Unit_None, raw 0..18446744073709551615
  app type KS_Hybrid_01_ReK_IKACtr_adt: category=VALUE, compu {phys=raw for raw 0..255; unit Unit_None}, range phys 0..255 Unit_None, raw 0..255
  app type KS_Hybrid_01_ReK_SID_adt: category=VALUE, compu {phys=raw for raw 0..65535; unit Unit_None}, range phys 0..65535 Unit_None, raw 0..65535
  impl type SG_BJB_11: category=STRUCTURE
    7 x element, all with category=TYPE_REFERENCE:
      BJB_11_BZ: range phys 0..15, raw 0..15, implementation-data-type=uint8
      BJB_11_CRC: range phys 0..255, raw 0..255, implementation-data-type=uint8
      BJB_Sperrung_Ueberspannung: compu-method=CM_BJB_Sperrung_Ueberspannung, range raw 0..3, implementation-data-type=uint8, invalid-value=Invalid_BJB_Sperrung_Ueberspannung_XIX_BJB_11_XIX_BMC_CAN01:3
      BJB_Ueberspannungszaehler_CMC01: compu-method=CM_BJB_Ueberspannungszaehler_CMC01, range phys 0..400 Unit_None, raw 0..511, implementation-data-type=uint16, invalid-value=Invalid_BJB_Ueberspannungszaehler_CMC01_XIX_BJB_11_XIX_BMC_CAN01:511
      BJB_Ueberspannungszaehler_CMC02: compu-method=CM_BJB_Ueberspannungszaehler_CMC02, range phys 0..400 Unit_None, raw 0..511, implementation-data-type=uint16, invalid-value=Invalid_BJB_Ueberspannungszaehler_CMC02_XIX_BJB_11_XIX_BMC_CAN01:511
      BJB_Uebertemperaturzaehler_CMC01: compu-method=CM_BJB_Uebertemperaturzaehler_CMC01, range phys 0..604800 Unit_None, raw 0..65535, implementation-data-type=uint16, invalid-value=Invalid_BJB_Uebertemperaturzaehler_CMC01_XIX_BJB_11_XIX_BMC_CAN01:65535
      BJB_Uebertemperaturzaehler_CMC02: compu-method=CM_BJB_Uebertemperaturzaehler_CMC02, range phys 0..604800 Unit_None, raw 0..65535, implementation-data-type=uint16, invalid-value=Invalid_BJB_Uebertemperaturzaehler_CMC02_XIX_BJB_11_XIX_BMC_CAN01:65535
  application record data type SG_BJB_11_adt: category=STRUCTURE
    7 x application record element, all with category=VALUE:
      BJB_11_BZ: type=BJB_11_BZ_adt
      BJB_11_CRC: type=BJB_11_CRC_adt
      BJB_Sperrung_Ueberspannung: type=BJB_Sperrung_Ueberspannung_adt
      BJB_Ueberspannungszaehler_CMC01: type=BJB_Ueberspannungszaehler_CMC01_adt
      BJB_Ueberspannungszaehler_CMC02: type=BJB_Ueberspannungszaehler_CMC02_adt
      BJB_Uebertemperaturzaehler_CMC01: type=BJB_Uebertemperaturzaehler_CMC01_adt
      BJB_Uebertemperaturzaehler_CMC02: type=BJB_Uebertemperaturzaehler_CMC02_adt
  7 x app type, all with category=VALUE:
    BJB_11_BZ_adt: range phys 0..15, raw 0..15
    BJB_11_CRC_adt: range phys 0..255, raw 0..255
    BJB_Sperrung_Ueberspannung_adt: compu-method=CM_BJB_Sperrung_Ueberspannung, range raw 0..3, invalid-value=3
    BJB_Ueberspannungszaehler_CMC01_adt: compu-method=CM_BJB_Ueberspannungszaehler_CMC01, range phys 0..400 Unit_None, raw 0..511, invalid-value=511
    BJB_Ueberspannungszaehler_CMC02_adt: compu-method=CM_BJB_Ueberspannungszaehler_CMC02, range phys 0..400 Unit_None, raw 0..511, invalid-value=511
    BJB_Uebertemperaturzaehler_CMC01_adt: compu-method=CM_BJB_Uebertemperaturzaehler_CMC01, range phys 0..604800 Unit_None, raw 0..65535, invalid-value=65535
    BJB_Uebertemperaturzaehler_CMC02_adt: compu-method=CM_BJB_Uebertemperaturzaehler_CMC02, range phys 0..604800 Unit_None, raw 0..65535, invalid-value=65535
  impl type SG_BMC_HV_14: category=STRUCTURE
    11 x element, all with category=TYPE_REFERENCE:
      BMC_Datenuebernahme_Anf: compu-method=CM_BMC_Datenuebernahme_Anf, range raw 0..1, implementation-data-type=boolean
      BMC_HV_10_BZ: range phys 0..15, raw 0..15, implementation-data-type=uint8
      BMC_HV_10_CRC: range phys 0..255, raw 0..255, implementation-data-type=uint8
      BMC_Lebensdauer_Trennelemente: compu-method=CM_BMC_Lebensdauer_Trennelemente, range phys 0..100000 Unit_None, raw 0..131071, implementation-data-type=uint32, invalid-value=Invalid_BMC_Lebensdauer_Trennelemente_XIX_BMC_HV_10_XIX_BMC_CAN01:131071
      BMC_Sperrung_Unterspannung: compu-method=CM_BMC_Sperrung_Unterspannung, range raw 0..3, implementation-data-type=uint8, invalid-value=Invalid_BMC_Sperrung_Unterspannung_XIX_BMC_HV_10_XIX_BMC_CAN01:3
      BMC_Status_HV_Spannungssensorik: compu-method=CM_BMC_Status_HV_Spannungssensorik, range raw 0..1, implementation-data-type=boolean, invalid-value=Invalid_BMC_Status_HV_Spannungssensorik_XIX_BMC_HV_10_XIX_BMC_CAN01:1
      BMC_Status_Trennelemente: compu-method=CM_BMC_Status_Trennelemente, range raw 0..7, implementation-data-type=uint8, invalid-value=Invalid_BMC_Status_Trennelemente_XIX_BMC_HV_10_XIX_BMC_CAN01:7
      SignalVoid_BMC_HV_10_0: range phys 0..15, raw 0..15, implementation-data-type=uint8
      SignalVoid_BMC_HV_10_{1..3}: range phys 0..255, raw 0..255, implementation-data-type=uint8
  application record data type SG_BMC_HV_10_adt_1: category=STRUCTURE
    11 x application record element:
      BMC_Datenuebernahme_Anf: category=BOOLEAN, type=BMC_Datenuebernahme_Anf_adt_1
      BMC_HV_10_BZ: category=VALUE, type=BMC_HV_10_BZ_adt_1
      BMC_HV_10_CRC: category=VALUE, type=BMC_HV_10_CRC_adt_1
      BMC_Lebensdauer_Trennelemente: category=VALUE, type=BMC_Lebensdauer_Trennelemente_adt_1
      BMC_Sperrung_Unterspannung: category=VALUE, type=BMC_Sperrung_Unterspannung_adt_1
      BMC_Status_HV_Spannungssensorik: category=BOOLEAN, type=BMC_Status_HV_Spannungssensorik_adt_1
      BMC_Status_Trennelemente: category=VALUE, type=BMC_Status_Trennelemente_adt_1
      SignalVoid_BMC_HV_10_{0..3}: category=VALUE, type=SignalVoid_BMC_HV_10_{0..3}_adt_1
  11 x app type:
    BMC_Datenuebernahme_Anf_adt_1: category=BOOLEAN, compu-method=CM_BMC_Datenuebernahme_Anf, range raw 0..1
    BMC_HV_10_BZ_adt_1: category=VALUE, range phys 0..15, raw 0..15
    BMC_HV_10_CRC_adt_1: category=VALUE, range phys 0..255, raw 0..255
    BMC_Lebensdauer_Trennelemente_adt_1: category=VALUE, compu-method=CM_BMC_Lebensdauer_Trennelemente, range phys 0..100000 Unit_None, raw 0..131071, invalid-value=131071
    BMC_Sperrung_Unterspannung_adt_1: category=VALUE, compu-method=CM_BMC_Sperrung_Unterspannung, range raw 0..3, invalid-value=3
    BMC_Status_HV_Spannungssensorik_adt_1: category=BOOLEAN, compu-method=CM_BMC_Status_HV_Spannungssensorik, range raw 0..1, invalid-value=1
    BMC_Status_Trennelemente_adt_1: category=VALUE, compu-method=CM_BMC_Status_Trennelemente, range raw 0..7, invalid-value=7
    SignalVoid_BMC_HV_10_0_adt_1: category=VALUE, range phys 0..15, raw 0..15
    SignalVoid_BMC_HV_10_{1..3}_adt_1: category=VALUE, range phys 0..255, raw 0..255
  impl type SG_BJB_10: category=STRUCTURE
    10 x element, all with category=TYPE_REFERENCE:
      BJB_10_BZ: range phys 0..15, raw 0..15, implementation-data-type=uint8
      BJB_10_CRC: range phys 0..255, raw 0..255, implementation-data-type=uint8
      BJB_Lebensdauer_Trennelemente: compu-method=CM_BJB_Lebensdauer_Trennelemente, range phys 0..100000 Unit_None, raw 0..131071, implementation-data-type=uint32, invalid-value=Invalid_BJB_Lebensdauer_Trennelemente_XIX_BJB_10_XIX_BMC_CAN01:131071
      BJB_Sperrung_Unterspannung: compu-method=CM_BJB_Sperrung_Unterspannung, range raw 0..3, implementation-data-type=uint8, invalid-value=Invalid_BJB_Sperrung_Unterspannung_XIX_BJB_10_XIX_BMC_CAN01:3
      BJB_Status_HV_Spannungssensorik: compu-method=CM_BJB_Status_HV_Spannungssensorik, range raw 0..1, implementation-data-type=boolean, invalid-value=Invalid_BJB_Status_HV_Spannungssensorik_XIX_BJB_10_XIX_BMC_CAN01:1
      BJB_Status_Trennelemente: compu-method=CM_BJB_Status_Trennelemente, range raw 0..7, implementation-data-type=uint8, invalid-value=Invalid_BJB_Status_Trennelemente_XIX_BJB_10_XIX_BMC_CAN01:7
      SignalVoid_BJB_10_0: range phys 0..31, raw 0..31, implementation-data-type=uint8
      SignalVoid_BJB_10_{1..3}: range phys 0..255, raw 0..255, implementation-data-type=uint8
  application record data type SG_BJB_10_adt: category=STRUCTURE
    10 x application record element:
      BJB_10_BZ: category=VALUE, type=BJB_10_BZ_adt
      BJB_10_CRC: category=VALUE, type=BJB_10_CRC_adt
      BJB_Lebensdauer_Trennelemente: category=VALUE, type=BJB_Lebensdauer_Trennelemente_adt
      BJB_Sperrung_Unterspannung: category=VALUE, type=BJB_Sperrung_Unterspannung_adt
      BJB_Status_HV_Spannungssensorik: category=BOOLEAN, type=BJB_Status_HV_Spannungssensorik_adt
      BJB_Status_Trennelemente: category=VALUE, type=BJB_Status_Trennelemente_adt
      SignalVoid_BJB_10_{0..3}: category=VALUE, type=SignalVoid_BJB_10_{0..3}_adt
  10 x app type:
    BJB_10_BZ_adt: category=VALUE, range phys 0..15, raw 0..15
    BJB_10_CRC_adt: category=VALUE, range phys 0..255, raw 0..255
    BJB_Lebensdauer_Trennelemente_adt: category=VALUE, compu-method=CM_BJB_Lebensdauer_Trennelemente, range phys 0..100000 Unit_None, raw 0..131071, invalid-value=131071
    BJB_Sperrung_Unterspannung_adt: category=VALUE, compu-method=CM_BJB_Sperrung_Unterspannung, range raw 0..3, invalid-value=3
    BJB_Status_HV_Spannungssensorik_adt: category=BOOLEAN, compu-method=CM_BJB_Status_HV_Spannungssensorik, range raw 0..1, invalid-value=1
    BJB_Status_Trennelemente_adt: category=VALUE, compu-method=CM_BJB_Status_Trennelemente, range raw 0..7, invalid-value=7
    SignalVoid_BJB_10_0_adt: category=VALUE, range phys 0..31, raw 0..31
    SignalVoid_BJB_10_{1..3}_adt: category=VALUE, range phys 0..255, raw 0..255
  impl type SG_BJB_12: category=STRUCTURE
    7 x element, all with category=TYPE_REFERENCE:
      BJB_11_BZ: range phys 0..15, raw 0..15, implementation-data-type=uint8
      BJB_11_CRC: range phys 0..255, raw 0..255, implementation-data-type=uint8
      BJB_Sperrung_Ueberspannung: compu-method=CM_BJB_Sperrung_Ueberspannung, range raw 0..3, implementation-data-type=uint8, invalid-value=Invalid_BJB_Sperrung_Ueberspannung_XIX_BJB_11_XIX_BMC_CAN01:3
      BJB_Ueberspannungszaehler_CMC01: compu-method=CM_BJB_Ueberspannungszaehler_CMC01, range phys 0..400 Unit_None, raw 0..511, implementation-data-type=uint16, invalid-value=Invalid_BJB_Ueberspannungszaehler_CMC01_XIX_BJB_11_XIX_BMC_CAN01:511
      BJB_Ueberspannungszaehler_CMC02: compu-method=CM_BJB_Ueberspannungszaehler_CMC02, range phys 0..400 Unit_None, raw 0..511, implementation-data-type=uint16, invalid-value=Invalid_BJB_Ueberspannungszaehler_CMC02_XIX_BJB_11_XIX_BMC_CAN01:511
      BJB_Uebertemperaturzaehler_CMC01: compu-method=CM_BJB_Uebertemperaturzaehler_CMC01, range phys 0..604800 Unit_None, raw 0..65535, implementation-data-type=uint16, invalid-value=Invalid_BJB_Uebertemperaturzaehler_CMC01_XIX_BJB_11_XIX_BMC_CAN01:65535
      BJB_Uebertemperaturzaehler_CMC02: compu-method=CM_BJB_Uebertemperaturzaehler_CMC02, range phys 0..604800 Unit_None, raw 0..65535, implementation-data-type=uint16, invalid-value=Invalid_BJB_Uebertemperaturzaehler_CMC02_XIX_BJB_11_XIX_BMC_CAN01:65535
  application record data type SG_BJB_11_adt_1: category=STRUCTURE
    7 x application record element, all with category=VALUE:
      BJB_11_BZ: type=BJB_11_BZ_adt_1
      BJB_11_CRC: type=BJB_11_CRC_adt_1
      BJB_Sperrung_Ueberspannung: type=BJB_Sperrung_Ueberspannung_adt_1
      BJB_Ueberspannungszaehler_CMC01: type=BJB_Ueberspannungszaehler_CMC01_adt_1
      BJB_Ueberspannungszaehler_CMC02: type=BJB_Ueberspannungszaehler_CMC02_adt_1
      BJB_Uebertemperaturzaehler_CMC01: type=BJB_Uebertemperaturzaehler_CMC01_adt_1
      BJB_Uebertemperaturzaehler_CMC02: type=BJB_Uebertemperaturzaehler_CMC02_adt_1
  7 x app type, all with category=VALUE:
    BJB_11_BZ_adt_1: range phys 0..15, raw 0..15
    BJB_11_CRC_adt_1: range phys 0..255, raw 0..255
    BJB_Sperrung_Ueberspannung_adt_1: compu-method=CM_BJB_Sperrung_Ueberspannung, range raw 0..3, invalid-value=3
    BJB_Ueberspannungszaehler_CMC01_adt_1: compu-method=CM_BJB_Ueberspannungszaehler_CMC01, range phys 0..400 Unit_None, raw 0..511, invalid-value=511
    BJB_Ueberspannungszaehler_CMC02_adt_1: compu-method=CM_BJB_Ueberspannungszaehler_CMC02, range phys 0..400 Unit_None, raw 0..511, invalid-value=511
    BJB_Uebertemperaturzaehler_CMC01_adt_1: compu-method=CM_BJB_Uebertemperaturzaehler_CMC01, range phys 0..604800 Unit_None, raw 0..65535, invalid-value=65535
    BJB_Uebertemperaturzaehler_CMC02_adt_1: compu-method=CM_BJB_Uebertemperaturzaehler_CMC02, range phys 0..604800 Unit_None, raw 0..65535, invalid-value=65535
  impl type SG_BJB_13: category=STRUCTURE
    7 x element, all with category=TYPE_REFERENCE:
      BJB_11_BZ: range phys 0..15, raw 0..15, implementation-data-type=uint8
      BJB_11_CRC: range phys 0..255, raw 0..255, implementation-data-type=uint8
      BJB_Sperrung_Ueberspannung: compu-method=CM_BJB_Sperrung_Ueberspannung, range raw 0..3, implementation-data-type=uint8, invalid-value=Invalid_BJB_Sperrung_Ueberspannung_XIX_BJB_11_XIX_BMC_CAN01:3
      BJB_Ueberspannungszaehler_CMC01: compu-method=CM_BJB_Ueberspannungszaehler_CMC01, range phys 0..400 Unit_None, raw 0..511, implementation-data-type=uint16, invalid-value=Invalid_BJB_Ueberspannungszaehler_CMC01_XIX_BJB_11_XIX_BMC_CAN01:511
      BJB_Ueberspannungszaehler_CMC02: compu-method=CM_BJB_Ueberspannungszaehler_CMC02, range phys 0..400 Unit_None, raw 0..511, implementation-data-type=uint16, invalid-value=Invalid_BJB_Ueberspannungszaehler_CMC02_XIX_BJB_11_XIX_BMC_CAN01:511
      BJB_Uebertemperaturzaehler_CMC01: compu-method=CM_BJB_Uebertemperaturzaehler_CMC01, range phys 0..604800 Unit_None, raw 0..65535, implementation-data-type=uint16, invalid-value=Invalid_BJB_Uebertemperaturzaehler_CMC01_XIX_BJB_11_XIX_BMC_CAN01:65535
      BJB_Uebertemperaturzaehler_CMC02: compu-method=CM_BJB_Uebertemperaturzaehler_CMC02, range phys 0..604800 Unit_None, raw 0..65535, implementation-data-type=uint16, invalid-value=Invalid_BJB_Uebertemperaturzaehler_CMC02_XIX_BJB_11_XIX_BMC_CAN01:65535
  application record data type SG_BJB_11_adt_2: category=STRUCTURE
    7 x application record element, all with category=VALUE:
      BJB_11_BZ: type=BJB_11_BZ_adt_2
      BJB_11_CRC: type=BJB_11_CRC_adt_2
      BJB_Sperrung_Ueberspannung: type=BJB_Sperrung_Ueberspannung_adt_2
      BJB_Ueberspannungszaehler_CMC01: type=BJB_Ueberspannungszaehler_CMC01_adt_2
      BJB_Ueberspannungszaehler_CMC02: type=BJB_Ueberspannungszaehler_CMC02_adt_2
      BJB_Uebertemperaturzaehler_CMC01: type=BJB_Uebertemperaturzaehler_CMC01_adt_2
      BJB_Uebertemperaturzaehler_CMC02: type=BJB_Uebertemperaturzaehler_CMC02_adt_2
  7 x app type, all with category=VALUE:
    BJB_11_BZ_adt_2: range phys 0..15, raw 0..15
    BJB_11_CRC_adt_2: range phys 0..255, raw 0..255
    BJB_Sperrung_Ueberspannung_adt_2: compu-method=CM_BJB_Sperrung_Ueberspannung, range raw 0..3, invalid-value=3
    BJB_Ueberspannungszaehler_CMC01_adt_2: compu-method=CM_BJB_Ueberspannungszaehler_CMC01, range phys 0..400 Unit_None, raw 0..511, invalid-value=511
    BJB_Ueberspannungszaehler_CMC02_adt_2: compu-method=CM_BJB_Ueberspannungszaehler_CMC02, range phys 0..400 Unit_None, raw 0..511, invalid-value=511
    BJB_Uebertemperaturzaehler_CMC01_adt_2: compu-method=CM_BJB_Uebertemperaturzaehler_CMC01, range phys 0..604800 Unit_None, raw 0..65535, invalid-value=65535
    BJB_Uebertemperaturzaehler_CMC02_adt_2: compu-method=CM_BJB_Uebertemperaturzaehler_CMC02, range phys 0..604800 Unit_None, raw 0..65535, invalid-value=65535
  impl type SG_BJB_14: category=STRUCTURE
    7 x element, all with category=TYPE_REFERENCE:
      BJB_11_BZ: range phys 0..15, raw 0..15, implementation-data-type=uint8
      BJB_11_CRC: range phys 0..255, raw 0..255, implementation-data-type=uint8
      BJB_Sperrung_Ueberspannung: compu-method=CM_BJB_Sperrung_Ueberspannung, range raw 0..3, implementation-data-type=uint8, invalid-value=Invalid_BJB_Sperrung_Ueberspannung_XIX_BJB_11_XIX_BMC_CAN01:3
      BJB_Ueberspannungszaehler_CMC01: compu-method=CM_BJB_Ueberspannungszaehler_CMC01, range phys 0..400 Unit_None, raw 0..511, implementation-data-type=uint16, invalid-value=Invalid_BJB_Ueberspannungszaehler_CMC01_XIX_BJB_11_XIX_BMC_CAN01:511
      BJB_Ueberspannungszaehler_CMC02: compu-method=CM_BJB_Ueberspannungszaehler_CMC02, range phys 0..400 Unit_None, raw 0..511, implementation-data-type=uint16, invalid-value=Invalid_BJB_Ueberspannungszaehler_CMC02_XIX_BJB_11_XIX_BMC_CAN01:511
      BJB_Uebertemperaturzaehler_CMC01: compu-method=CM_BJB_Uebertemperaturzaehler_CMC01, range phys 0..604800 Unit_None, raw 0..65535, implementation-data-type=uint16, invalid-value=Invalid_BJB_Uebertemperaturzaehler_CMC01_XIX_BJB_11_XIX_BMC_CAN01:65535
      BJB_Uebertemperaturzaehler_CMC02: compu-method=CM_BJB_Uebertemperaturzaehler_CMC02, range phys 0..604800 Unit_None, raw 0..65535, implementation-data-type=uint16, invalid-value=Invalid_BJB_Uebertemperaturzaehler_CMC02_XIX_BJB_11_XIX_BMC_CAN01:65535
  application record data type SG_BJB_11_adt_3: category=STRUCTURE
    7 x application record element, all with category=VALUE:
      BJB_11_BZ: type=BJB_11_BZ_adt_3
      BJB_11_CRC: type=BJB_11_CRC_adt_3
      BJB_Sperrung_Ueberspannung: type=BJB_Sperrung_Ueberspannung_adt_3
      BJB_Ueberspannungszaehler_CMC01: type=BJB_Ueberspannungszaehler_CMC01_adt_3
      BJB_Ueberspannungszaehler_CMC02: type=BJB_Ueberspannungszaehler_CMC02_adt_3
      BJB_Uebertemperaturzaehler_CMC01: type=BJB_Uebertemperaturzaehler_CMC01_adt_3
      BJB_Uebertemperaturzaehler_CMC02: type=BJB_Uebertemperaturzaehler_CMC02_adt_3
  7 x app type, all with category=VALUE:
    BJB_11_BZ_adt_3: range phys 0..15, raw 0..15
    BJB_11_CRC_adt_3: range phys 0..255, raw 0..255
    BJB_Sperrung_Ueberspannung_adt_3: compu-method=CM_BJB_Sperrung_Ueberspannung, range raw 0..3, invalid-value=3
    BJB_Ueberspannungszaehler_CMC01_adt_3: compu-method=CM_BJB_Ueberspannungszaehler_CMC01, range phys 0..400 Unit_None, raw 0..511, invalid-value=511
    BJB_Ueberspannungszaehler_CMC02_adt_3: compu-method=CM_BJB_Ueberspannungszaehler_CMC02, range phys 0..400 Unit_None, raw 0..511, invalid-value=511
    BJB_Uebertemperaturzaehler_CMC01_adt_3: compu-method=CM_BJB_Uebertemperaturzaehler_CMC01, range phys 0..604800 Unit_None, raw 0..65535, invalid-value=65535
    BJB_Uebertemperaturzaehler_CMC02_adt_3: compu-method=CM_BJB_Uebertemperaturzaehler_CMC02, range phys 0..604800 Unit_None, raw 0..65535, invalid-value=65535
  impl type SG_BJB_15: category=STRUCTURE
    7 x element, all with category=TYPE_REFERENCE:
      BJB_12_BZ: range phys 0..15, raw 0..15, implementation-data-type=uint8
      BJB_12_CRC: range phys 0..255, raw 0..255, implementation-data-type=uint8
      BJB_Sperrung_Uebertemperatur: compu-method=CM_BJB_Sperrung_Uebertemperatur, range raw 0..3, implementation-data-type=uint8, invalid-value=Invalid_BJB_Sperrung_Uebertemperatur_XIX_BJB_12_XIX_BMC_CAN01:3
      BJB_Ueberspannungszaehler_CMC03: compu-method=CM_BJB_Ueberspannungszaehler_CMC03, range phys 0..400 Unit_None, raw 0..511, implementation-data-type=uint16, invalid-value=Invalid_BJB_Ueberspannungszaehler_CMC03_XIX_BJB_12_XIX_BMC_CAN01:511
      BJB_Ueberspannungszaehler_CMC04: compu-method=CM_BJB_Ueberspannungszaehler_CMC04, range phys 0..400 Unit_None, raw 0..511, implementation-data-type=uint16, invalid-value=Invalid_BJB_Ueberspannungszaehler_CMC04_XIX_BJB_12_XIX_BMC_CAN01:511
      BJB_Uebertemperaturzaehler_CMC03: compu-method=CM_BJB_Uebertemperaturzaehler_CMC03, range phys 0..604800 Unit_None, raw 0..65535, implementation-data-type=uint16, invalid-value=Invalid_BJB_Uebertemperaturzaehler_CMC03_XIX_BJB_12_XIX_BMC_CAN01:65535
      BJB_Uebertemperaturzaehler_CMC04: compu-method=CM_BJB_Uebertemperaturzaehler_CMC04, range phys 0..604800 Unit_None, raw 0..65535, implementation-data-type=uint16, invalid-value=Invalid_BJB_Uebertemperaturzaehler_CMC04_XIX_BJB_12_XIX_BMC_CAN01:65535
  application record data type SG_BJB_12_adt: category=STRUCTURE
    7 x application record element, all with category=VALUE:
      BJB_12_BZ: type=BJB_12_BZ_adt
      BJB_12_CRC: type=BJB_12_CRC_adt
      BJB_Sperrung_Uebertemperatur: type=BJB_Sperrung_Uebertemperatur_adt
      BJB_Ueberspannungszaehler_CMC03: type=BJB_Ueberspannungszaehler_CMC03_adt
      BJB_Ueberspannungszaehler_CMC04: type=BJB_Ueberspannungszaehler_CMC04_adt
      BJB_Uebertemperaturzaehler_CMC03: type=BJB_Uebertemperaturzaehler_CMC03_adt
      BJB_Uebertemperaturzaehler_CMC04: type=BJB_Uebertemperaturzaehler_CMC04_adt
  7 x app type, all with category=VALUE:
    BJB_12_BZ_adt: range phys 0..15, raw 0..15
    BJB_12_CRC_adt: range phys 0..255, raw 0..255
    BJB_Sperrung_Uebertemperatur_adt: compu-method=CM_BJB_Sperrung_Uebertemperatur, range raw 0..3, invalid-value=3
    BJB_Ueberspannungszaehler_CMC03_adt: compu-method=CM_BJB_Ueberspannungszaehler_CMC03, range phys 0..400 Unit_None, raw 0..511, invalid-value=511
    BJB_Ueberspannungszaehler_CMC04_adt: compu-method=CM_BJB_Ueberspannungszaehler_CMC04, range phys 0..400 Unit_None, raw 0..511, invalid-value=511
    BJB_Uebertemperaturzaehler_CMC03_adt: compu-method=CM_BJB_Uebertemperaturzaehler_CMC03, range phys 0..604800 Unit_None, raw 0..65535, invalid-value=65535
    BJB_Uebertemperaturzaehler_CMC04_adt: compu-method=CM_BJB_Uebertemperaturzaehler_CMC04, range phys 0..604800 Unit_None, raw 0..65535, invalid-value=65535
  impl type SG_BJB_16: category=STRUCTURE
    8 x element, all with category=TYPE_REFERENCE:
      BJB_13_BZ: range phys 0..15, raw 0..15, implementation-data-type=uint8
      BJB_13_CRC: range phys 0..255, raw 0..255, implementation-data-type=uint8
      BJB_Unterspannungszaehler_CMC{01..04}: compu-method=CM_BJB_Unterspannungszaehler_CMC{01..04}, range phys 0..400 Unit_None, raw 0..511, implementation-data-type=uint16, invalid-value=Invalid_BJB_Unterspannungszaehler_CMC{01..04}_XIX_BJB_13_XIX_BMC_CAN01:511
      SignalVoid_BJB_13_0: range phys 0..255, raw 0..255, implementation-data-type=uint8
      SignalVoid_BJB_13_1: range phys 0..255, raw 0..255, implementation-data-type=uint8
  application record data type SG_BJB_13_adt: category=STRUCTURE
    8 x application record element, all with category=VALUE:
      BJB_13_BZ: type=BJB_13_BZ_adt
      BJB_13_CRC: type=BJB_13_CRC_adt
      BJB_Unterspannungszaehler_CMC{01..04}: type=BJB_Unterspannungszaehler_CMC{01..04}_adt
      SignalVoid_BJB_13_0: type=SignalVoid_BJB_13_0_adt
      SignalVoid_BJB_13_1: type=SignalVoid_BJB_13_1_adt
  8 x app type, all with category=VALUE:
    BJB_13_BZ_adt: range phys 0..15, raw 0..15
    BJB_13_CRC_adt: range phys 0..255, raw 0..255
    BJB_Unterspannungszaehler_CMC{01..04}_adt: compu-method=CM_BJB_Unterspannungszaehler_CMC{01..04}, range phys 0..400 Unit_None, raw 0..511, invalid-value=511
    SignalVoid_BJB_13_0_adt: range phys 0..255, raw 0..255
    SignalVoid_BJB_13_1_adt: range phys 0..255, raw 0..255
  impl type SG_BMC_HV_5: category=STRUCTURE
    15 x element, all with category=TYPE_REFERENCE:
      BMC_Dev_Freigabe: compu-method=CM_BMC_Dev_Freigabe, range raw 0..1, implementation-data-type=boolean
      BMC_Flash_Freigabe: compu-method=CM_BMC_Flash_Freigabe, range raw 0..1, implementation-data-type=boolean
      BMC_HV_04_BZ: range phys 0..15, raw 0..15, implementation-data-type=uint8
      BMC_HV_04_CRC: range phys 0..255, raw 0..255, implementation-data-type=uint8
      BMC_Iso_Mode_Anf: compu-method=CM_BMC_Iso_Mode_Anf, range raw 0..7, implementation-data-type=uint8
      BMC_UI1_Spannung1_Schalt_Anf: compu-method=CM_BMC_UI1_Spannung1_Schalt_Anf, range raw 0..1, implementation-data-type=boolean
      BMC_UI1_Spannung2_Schalt_Anf: compu-method=CM_BMC_UI1_Spannung2_Schalt_Anf, range raw 0..1, implementation-data-type=boolean
      BMC_UI2_Spannung1_Schalt_Anf: compu-method=CM_BMC_UI2_Spannung1_Schalt_Anf, range raw 0..1, implementation-data-type=boolean
      BMC_UI2_Spannung2_Schalt_Anf: compu-method=CM_BMC_UI2_Spannung2_Schalt_Anf, range raw 0..1, implementation-data-type=boolean
      SignalVoid_BMC_HV_04_0: range phys 0..7, raw 0..7, implementation-data-type=uint8
      SignalVoid_BMC_HV_04_{1..5}: range phys 0..255, raw 0..255, implementation-data-type=uint8
  application record data type SG_BMC_HV_04_adt_1: category=STRUCTURE
    15 x application record element:
      BMC_Dev_Freigabe: category=BOOLEAN, type=BMC_Dev_Freigabe_adt_1
      BMC_Flash_Freigabe: category=BOOLEAN, type=BMC_Flash_Freigabe_adt_1
      BMC_HV_04_BZ: category=VALUE, type=BMC_HV_04_BZ_adt_1
      BMC_HV_04_CRC: category=VALUE, type=BMC_HV_04_CRC_adt_1
      BMC_Iso_Mode_Anf: category=VALUE, type=BMC_Iso_Mode_Anf_adt_1
      BMC_UI1_Spannung1_Schalt_Anf: category=BOOLEAN, type=BMC_UI1_Spannung1_Schalt_Anf_adt_1
      BMC_UI1_Spannung2_Schalt_Anf: category=BOOLEAN, type=BMC_UI1_Spannung2_Schalt_Anf_adt_1
      BMC_UI2_Spannung1_Schalt_Anf: category=BOOLEAN, type=BMC_UI2_Spannung1_Schalt_Anf_adt_1
      BMC_UI2_Spannung2_Schalt_Anf: category=BOOLEAN, type=BMC_UI2_Spannung2_Schalt_Anf_adt_1
      SignalVoid_BMC_HV_04_{0..5}: category=VALUE, type=SignalVoid_BMC_HV_04_{0..5}_adt_1
  15 x app type:
    BMC_Dev_Freigabe_adt_1: category=BOOLEAN, compu-method=CM_BMC_Dev_Freigabe, range raw 0..1
    BMC_Flash_Freigabe_adt_1: category=BOOLEAN, compu-method=CM_BMC_Flash_Freigabe, range raw 0..1
    BMC_HV_04_BZ_adt_1: category=VALUE, compu {phys=raw for raw 0..15}, range phys 0..15, raw 0..15
    BMC_HV_04_CRC_adt_1: category=VALUE, compu {phys=raw for raw 0..255}, range phys 0..255, raw 0..255
    BMC_Iso_Mode_Anf_adt_1: category=VALUE, compu-method=CM_BMC_Iso_Mode_Anf, range raw 0..7
    BMC_UI1_Spannung1_Schalt_Anf_adt_1: category=BOOLEAN, compu-method=CM_BMC_UI1_Spannung1_Schalt_Anf, range raw 0..1
    BMC_UI1_Spannung2_Schalt_Anf_adt_1: category=BOOLEAN, compu-method=CM_BMC_UI1_Spannung2_Schalt_Anf, range raw 0..1
    BMC_UI2_Spannung1_Schalt_Anf_adt_1: category=BOOLEAN, compu-method=CM_BMC_UI2_Spannung1_Schalt_Anf, range raw 0..1
    BMC_UI2_Spannung2_Schalt_Anf_adt_1: category=BOOLEAN, compu-method=CM_BMC_UI2_Spannung2_Schalt_Anf, range raw 0..1
    SignalVoid_BMC_HV_04_0_adt_1: category=VALUE, range phys 0..7, raw 0..7
    SignalVoid_BMC_HV_04_{1..5}_adt_1: category=VALUE, range phys 0..255, raw 0..255
  impl type SG_BMC_HV_15: category=STRUCTURE
    11 x element, all with category=TYPE_REFERENCE:
      BMC_Datenuebernahme_Anf: compu-method=CM_BMC_Datenuebernahme_Anf, range raw 0..1, implementation-data-type=boolean
      BMC_HV_10_BZ: range phys 0..15, raw 0..15, implementation-data-type=uint8
      BMC_HV_10_CRC: range phys 0..255, raw 0..255, implementation-data-type=uint8
      BMC_Lebensdauer_Trennelemente: compu-method=CM_BMC_Lebensdauer_Trennelemente, range phys 0..100000 Unit_None, raw 0..131071, implementation-data-type=uint32, invalid-value=Invalid_BMC_Lebensdauer_Trennelemente_XIX_BMC_HV_10_XIX_BMC_CAN01:131071
      BMC_Sperrung_Unterspannung: compu-method=CM_BMC_Sperrung_Unterspannung, range raw 0..3, implementation-data-type=uint8, invalid-value=Invalid_BMC_Sperrung_Unterspannung_XIX_BMC_HV_10_XIX_BMC_CAN01:3
      BMC_Status_HV_Spannungssensorik: compu-method=CM_BMC_Status_HV_Spannungssensorik, range raw 0..1, implementation-data-type=boolean, invalid-value=Invalid_BMC_Status_HV_Spannungssensorik_XIX_BMC_HV_10_XIX_BMC_CAN01:1
      BMC_Status_Trennelemente: compu-method=CM_BMC_Status_Trennelemente, range raw 0..7, implementation-data-type=uint8, invalid-value=Invalid_BMC_Status_Trennelemente_XIX_BMC_HV_10_XIX_BMC_CAN01:7
      SignalVoid_BMC_HV_10_0: range phys 0..15, raw 0..15, implementation-data-type=uint8
      SignalVoid_BMC_HV_10_{1..3}: range phys 0..255, raw 0..255, implementation-data-type=uint8
  application record data type SG_BMC_HV_10_adt_2: category=STRUCTURE
    11 x application record element:
      BMC_Datenuebernahme_Anf: category=BOOLEAN, type=BMC_Datenuebernahme_Anf_adt_2
      BMC_HV_10_BZ: category=VALUE, type=BMC_HV_10_BZ_adt_2
      BMC_HV_10_CRC: category=VALUE, type=BMC_HV_10_CRC_adt_2
      BMC_Lebensdauer_Trennelemente: category=VALUE, type=BMC_Lebensdauer_Trennelemente_adt_2
      BMC_Sperrung_Unterspannung: category=VALUE, type=BMC_Sperrung_Unterspannung_adt_2
      BMC_Status_HV_Spannungssensorik: category=BOOLEAN, type=BMC_Status_HV_Spannungssensorik_adt_2
      BMC_Status_Trennelemente: category=VALUE, type=BMC_Status_Trennelemente_adt_2
      SignalVoid_BMC_HV_10_{0..3}: category=VALUE, type=SignalVoid_BMC_HV_10_{0..3}_adt_2
  11 x app type:
    BMC_Datenuebernahme_Anf_adt_2: category=BOOLEAN, compu-method=CM_BMC_Datenuebernahme_Anf, range raw 0..1
    BMC_HV_10_BZ_adt_2: category=VALUE, range phys 0..15, raw 0..15
    BMC_HV_10_CRC_adt_2: category=VALUE, range phys 0..255, raw 0..255
    BMC_Lebensdauer_Trennelemente_adt_2: category=VALUE, compu-method=CM_BMC_Lebensdauer_Trennelemente, range phys 0..100000 Unit_None, raw 0..131071, invalid-value=131071
    BMC_Sperrung_Unterspannung_adt_2: category=VALUE, compu-method=CM_BMC_Sperrung_Unterspannung, range raw 0..3, invalid-value=3
    BMC_Status_HV_Spannungssensorik_adt_2: category=BOOLEAN, compu-method=CM_BMC_Status_HV_Spannungssensorik, range raw 0..1, invalid-value=1
    BMC_Status_Trennelemente_adt_2: category=VALUE, compu-method=CM_BMC_Status_Trennelemente, range raw 0..7, invalid-value=7
    SignalVoid_BMC_HV_10_0_adt_2: category=VALUE, range phys 0..15, raw 0..15
    SignalVoid_BMC_HV_10_{1..3}_adt_2: category=VALUE, range phys 0..255, raw 0..255
  impl type SG_BMC_HV_16: category=STRUCTURE
    7 x element, all with category=TYPE_REFERENCE:
      BMC_HV_11_BZ: range phys 0..15, raw 0..15, implementation-data-type=uint8
      BMC_HV_11_CRC: range phys 0..255, raw 0..255, implementation-data-type=uint8
      BMC_Sperrung_Ueberspannung: compu-method=CM_BMC_Sperrung_Ueberspannung, range raw 0..3, implementation-data-type=uint8, invalid-value=Invalid_BMC_Sperrung_Ueberspannung_XIX_BMC_HV_11_XIX_BMC_CAN01:3
      BMC_Ueberspannungszaehler_CMC01: compu-method=CM_BMC_Ueberspannungszaehler_CMC01, range phys 0..400 Unit_None, raw 0..511, implementation-data-type=uint16, invalid-value=Invalid_BMC_Ueberspannungszaehler_CMC01_XIX_BMC_HV_11_XIX_BMC_CAN01:511
      BMC_Ueberspannungszaehler_CMC02: compu-method=CM_BMC_Ueberspannungszaehler_CMC02, range phys 0..400 Unit_None, raw 0..511, implementation-data-type=uint16, invalid-value=Invalid_BMC_Ueberspannungszaehler_CMC02_XIX_BMC_HV_11_XIX_BMC_CAN01:511
      BMC_Uebertemperaturzaehler_CMC01: compu-method=CM_BMC_Uebertemperaturzaehler_CMC01, range phys 0..604800 Unit_None, raw 0..65535, implementation-data-type=uint16, invalid-value=Invalid_BMC_Uebertemperaturzaehler_CMC01_XIX_BMC_HV_11_XIX_BMC_CAN01:65535
      BMC_Uebertemperaturzaehler_CMC02: compu-method=CM_BMC_Uebertemperaturzaehler_CMC02, range phys 0..604800 Unit_None, raw 0..65535, implementation-data-type=uint16, invalid-value=Invalid_BMC_Uebertemperaturzaehler_CMC02_XIX_BMC_HV_11_XIX_BMC_CAN01:65535
  application record data type SG_BMC_HV_11_adt_1: category=STRUCTURE
    7 x application record element, all with category=VALUE:
      BMC_HV_11_BZ: type=BMC_HV_11_BZ_adt_1
      BMC_HV_11_CRC: type=BMC_HV_11_CRC_adt_1
      BMC_Sperrung_Ueberspannung: type=BMC_Sperrung_Ueberspannung_adt_1
      BMC_Ueberspannungszaehler_CMC01: type=BMC_Ueberspannungszaehler_CMC01_adt_1
      BMC_Ueberspannungszaehler_CMC02: type=BMC_Ueberspannungszaehler_CMC02_adt_1
      BMC_Uebertemperaturzaehler_CMC01: type=BMC_Uebertemperaturzaehler_CMC01_adt_1
      BMC_Uebertemperaturzaehler_CMC02: type=BMC_Uebertemperaturzaehler_CMC02_adt_1
  7 x app type, all with category=VALUE:
    BMC_HV_11_BZ_adt_1: range phys 0..15, raw 0..15
    BMC_HV_11_CRC_adt_1: range phys 0..255, raw 0..255
    BMC_Sperrung_Ueberspannung_adt_1: compu-method=CM_BMC_Sperrung_Ueberspannung, range raw 0..3, invalid-value=3
    BMC_Ueberspannungszaehler_CMC01_adt_1: compu-method=CM_BMC_Ueberspannungszaehler_CMC01, range phys 0..400 Unit_None, raw 0..511, invalid-value=511
    BMC_Ueberspannungszaehler_CMC02_adt_1: compu-method=CM_BMC_Ueberspannungszaehler_CMC02, range phys 0..400 Unit_None, raw 0..511, invalid-value=511
    BMC_Uebertemperaturzaehler_CMC01_adt_1: compu-method=CM_BMC_Uebertemperaturzaehler_CMC01, range phys 0..604800 Unit_None, raw 0..65535, invalid-value=65535
    BMC_Uebertemperaturzaehler_CMC02_adt_1: compu-method=CM_BMC_Uebertemperaturzaehler_CMC02, range phys 0..604800 Unit_None, raw 0..65535, invalid-value=65535
  impl type SG_BMC_HV_17: category=STRUCTURE
    7 x element, all with category=TYPE_REFERENCE:
      BMC_HV_12_BZ: range phys 0..15, raw 0..15, implementation-data-type=uint8
      BMC_HV_12_CRC: range phys 0..255, raw 0..255, implementation-data-type=uint8
      BMC_Sperrung_Uebertemperatur: compu-method=CM_BMC_Sperrung_Uebertemperatur, range raw 0..3, implementation-data-type=uint8, invalid-value=Invalid_BMC_Sperrung_Uebertemperatur_XIX_BMC_HV_12_XIX_BMC_CAN01:3
      BMC_Ueberspannungszaehler_CMC03: compu-method=CM_BMC_Ueberspannungszaehler_CMC03, range phys 0..400 Unit_None, raw 0..511, implementation-data-type=uint16, invalid-value=Invalid_BMC_Ueberspannungszaehler_CMC03_XIX_BMC_HV_12_XIX_BMC_CAN01:511
      BMC_Ueberspannungszaehler_CMC04: compu-method=CM_BMC_Ueberspannungszaehler_CMC04, range phys 0..400 Unit_None, raw 0..511, implementation-data-type=uint16, invalid-value=Invalid_BMC_Ueberspannungszaehler_CMC04_XIX_BMC_HV_12_XIX_BMC_CAN01:511
      BMC_Uebertemperaturzaehler_CMC03: compu-method=CM_BMC_Uebertemperaturzaehler_CMC03, range phys 0..604800 Unit_Ohm, raw 0..65535, implementation-data-type=uint16, invalid-value=Invalid_BMC_Uebertemperaturzaehler_CMC03_XIX_BMC_HV_12_XIX_BMC_CAN01:65535
      BMC_Uebertemperaturzaehler_CMC04: compu-method=CM_BMC_Uebertemperaturzaehler_CMC04, range phys 0..604800 Unit_None, raw 0..65535, implementation-data-type=uint16, invalid-value=Invalid_BMC_Uebertemperaturzaehler_CMC04_XIX_BMC_HV_12_XIX_BMC_CAN01:65535
  application record data type SG_BMC_HV_12_adt_1: category=STRUCTURE
    7 x application record element, all with category=VALUE:
      BMC_HV_12_BZ: type=BMC_HV_12_BZ_adt_1
      BMC_HV_12_CRC: type=BMC_HV_12_CRC_adt_1
      BMC_Sperrung_Uebertemperatur: type=BMC_Sperrung_Uebertemperatur_adt_1
      BMC_Ueberspannungszaehler_CMC03: type=BMC_Ueberspannungszaehler_CMC03_adt_1
      BMC_Ueberspannungszaehler_CMC04: type=BMC_Ueberspannungszaehler_CMC04_adt_1
      BMC_Uebertemperaturzaehler_CMC03: type=BMC_Uebertemperaturzaehler_CMC03_adt_1
      BMC_Uebertemperaturzaehler_CMC04: type=BMC_Uebertemperaturzaehler_CMC04_adt_1
  7 x app type, all with category=VALUE:
    BMC_HV_12_BZ_adt_1: range phys 0..15, raw 0..15
    BMC_HV_12_CRC_adt_1: range phys 0..255, raw 0..255
    BMC_Sperrung_Uebertemperatur_adt_1: compu-method=CM_BMC_Sperrung_Uebertemperatur, range raw 0..3, invalid-value=3
    BMC_Ueberspannungszaehler_CMC03_adt_1: compu-method=CM_BMC_Ueberspannungszaehler_CMC03, range phys 0..400 Unit_None, raw 0..511, invalid-value=511
    BMC_Ueberspannungszaehler_CMC04_adt_1: compu-method=CM_BMC_Ueberspannungszaehler_CMC04, range phys 0..400 Unit_None, raw 0..511, invalid-value=511
    BMC_Uebertemperaturzaehler_CMC03_adt_1: compu-method=CM_BMC_Uebertemperaturzaehler_CMC03, range phys 0..604800 Unit_Ohm, raw 0..65535, invalid-value=65535
    BMC_Uebertemperaturzaehler_CMC04_adt_1: compu-method=CM_BMC_Uebertemperaturzaehler_CMC04, range phys 0..604800 Unit_None, raw 0..65535, invalid-value=65535
  impl type SG_BMC_HV_18: category=STRUCTURE
    8 x element, all with category=TYPE_REFERENCE:
      BMC_HV_13_BZ: range phys 0..15, raw 0..15, implementation-data-type=uint8
      BMC_HV_13_CRC: range phys 0..255, raw 0..255, implementation-data-type=uint8
      BMC_Unterspannungszaehler_CMC{01..04}: compu-method=CM_BMC_Unterspannungszaehler_CMC{01..04}, range phys 0..400 Unit_None, raw 0..511, implementation-data-type=uint16, invalid-value=Invalid_BMC_Unterspannungszaehler_CMC{01..04}_XIX_BMC_HV_13_XIX_BMC_CAN01:511
      SignalVoid_BMC_HV_13_0: range phys 0..255, raw 0..255, implementation-data-type=uint8
      SignalVoid_BMC_HV_13_1: range phys 0..255, raw 0..255, implementation-data-type=uint8
  application record data type SG_BMC_HV_13_adt_1: category=STRUCTURE
    8 x application record element, all with category=VALUE:
      BMC_HV_13_BZ: type=BMC_HV_13_BZ_adt_1
      BMC_HV_13_CRC: type=BMC_HV_13_CRC_adt_1
      BMC_Unterspannungszaehler_CMC{01..04}: type=BMC_Unterspannungszaehler_CMC{01..04}_adt_1
      SignalVoid_BMC_HV_13_0: type=SignalVoid_BMC_HV_13_0_adt_1
      SignalVoid_BMC_HV_13_1: type=SignalVoid_BMC_HV_13_1_adt_1
  8 x app type, all with category=VALUE:
    BMC_HV_13_BZ_adt_1: range phys 0..15, raw 0..15
    BMC_HV_13_CRC_adt_1: range phys 0..255, raw 0..255
    BMC_Unterspannungszaehler_CMC{01..04}_adt_1: compu-method=CM_BMC_Unterspannungszaehler_CMC{01..04}, range phys 0..400 Unit_None, raw 0..511, invalid-value=511
    SignalVoid_BMC_HV_13_0_adt_1: range phys 0..255, raw 0..255
    SignalVoid_BMC_HV_13_1_adt_1: range phys 0..255, raw 0..255
  6 x impl type, all with category=TYPE_REFERENCE:
    Vishnu_Test_100Bytes_PDU_NewSignal1_37542d23452fe910: range raw 0..1048575, implementation-data-type=uint32
    Vishnu_Test_100Bytes_PDU_NewSignal2_302017e93d94206c: range raw 0..1048575, implementation-data-type=uint32
    Vishnu_Test_100Bytes_PDU_NewSignal3_ebd34b418955d5b1: range raw 0..1048575, implementation-data-type=uint32
    Vishnu_Test_100Bytes_PDU_NewSignal4_21c239f862026de9: range raw 0..1048575, implementation-data-type=uint32
    Vishnu_Test_100Bytes_PDU_NewSignal5_2a9e79b5a4a81ebd: range raw 0..1048575, implementation-data-type=uint32
    DTC_Test_PDU_Set_Signal_e68158b3301efab7: range raw 0..255, implementation-data-type=uint8
package /DataTypes/BaseTypes
  7 x base type, all with category=FIXED_LENGTH:
    LdCom_UINT8_N: base-type-size=8, base-type-encoding=NONE
    UdpNm_UINT8_N: base-type-size=8, base-type-encoding=NONE, byte-order=opaque
    uint32_1: base-type-size=32, base-type-encoding=NONE
    uint8_6_iso_8859_1: base-type-size=48, base-type-encoding=ISO-8859-1
    uint8_6_iso_8859_1_1: base-type-size=48, base-type-encoding=ISO-8859-1
    uint8_8_iso_8859_1: base-type-size=64, base-type-encoding=ISO-8859-1
    uint8_8_iso_8859_1_1: base-type-size=64, base-type-encoding=ISO-8859-1
package /DataTypes/CompuMethods
  compu method CM_sig_VitaReq_Ctrl: 0..4294967295=RANGE
  compu method CM_sig_VitaReq_Data: 0..4294967295=RANGE
  compu method CM_sig_VitaResp_Ctrl: 0..4294967295=RANGE
  compu method CM_sig_VitaResp_Data: 0..4294967295=RANGE
  compu method CM_sig_com_data1_CAN1: 0..18446744073709551615=RANGE
  compu method CM_sig_com_data1_CAN2: 0..18446744073709551615=RANGE
  compu method CM_sig_com_data2_CAN1: 0..18446744073709551615=RANGE
  compu method CM_sig_com_data2_CAN2: 0..18446744073709551615=RANGE
  compu method CM_sig_nm_MyECU_CAN1_UserData: 0..281474976710655=RANGE
  compu method CM_sig_nm_MyECU_CAN2_UserData: 0..281474976710655=RANGE
package /DataTypes/ApplicationDataTypes
  4 x app type, all with category=VALUE:
    float32_ADT_Basics
    float32_ADT_Triangle
    float32_DT
    int32_DT
  application record data type REC_Basics_1_0_Echo: category=STRUCTURE
    application record element value: category=VALUE, type=float32_ADT_Basics
  application record data type REC_Maths_1_0_Triangle: category=STRUCTURE
    application record element sample: category=VALUE, type=float32_ADT_Triangle
  16 x app type:
    AdminDataTextType: category=STRING
    Boolean: category=BOOLEAN
    Boolean_1: category=BOOLEAN
    SOMEIP_ID: category=VALUE
    SOMEIP_ServiceID: category=VALUE
    String: category=STRING
    String_1: category=STRING, sw-text-props={array-size-semantics=FIXED-SIZE, sw-max-text-size=0, sw-fill-character=0}
    boolean_ADT_BatteryWarning: category=VALUE
    boolean_ADT_Turnindication: category=VALUE
    boolean_DT: category=VALUE
    int16_DT: category=VALUE
    int8_DT: category=VALUE
    uint16_ADT_Frequency: category=VALUE
    uint16_DT: category=VALUE
    uint8_ADT_Volume: category=VALUE
    uint8_DT: category=VALUE
  4 x application record data type, all with category=STRUCTURE:
    REC_BatteryWarning
      application record element status: type=boolean_ADT_BatteryWarning
    REC_TurnIndicationSig
      application record element status: type=boolean_ADT_Turnindication
    REC_Volume_1_0_CurrentFrequency
      application record element frequency: type=uint16_ADT_Frequency
    REC_Volume_1_0_CurrentVolume
      application record element vol: type=uint8_ADT_Volume
package /DataTypes/ImplementationDataTypes
  6 x impl type, all with category=STRUCTURE:
    REC_Basics_1_0_Echo
      element float32_Basics: category=VALUE, base-type=BaseTypes/float32
    REC_Maths_1_0_Triangle
      element float32_Triangle: category=VALUE, base-type=BaseTypes/float32
    REC_BatteryWarning
      element boolean_BatteryWarning: category=VALUE, base-type=BaseTypes/boolean, compu {0=FALSE, 1=TRUE}
    REC_TurnIndicationSig
      element boolean_Turnindication: category=VALUE, base-type=BaseTypes/boolean, compu {0=Blinker_OFF, 1=Blinker_ON}
    REC_Volume_1_0_CurrentFrequency
      element uint16_Frequency: category=VALUE, base-type=BaseTypes/uint16
    REC_Volume_1_0_CurrentVolume
      element uint8_Volume: category=VALUE, base-type=BaseTypes/uint8
package /DataTypes/DataConstrs
  range BMC_Sperrung_Ueberspannung_1: phys 0..400, raw 0..511
  range BMC_Ueberspannungszaehler_CMC01_1: phys 0..400
  range BMC_Ueberspannungszaehler_CMC02_1: phys 0..400, raw 0..511
  range BMC_Uebertemperaturzaehler_CMC01_1: phys 0..400, raw 0..511
  range BMC_Uebertemperaturzaehler_CMC02_1: phys 0..400, raw 0..511
  range BMC_Sperrung_Ueberspannung_2: phys 0..400, raw 0..511
  range BMC_Ueberspannungszaehler_CMC01_2: phys 0..400, raw 0..511
  range BMC_Ueberspannungszaehler_CMC02_2: phys 0..400, raw 0..511
  range BMC_Uebertemperaturzaehler_CMC01_2: phys 0..400, raw 0..511
  range BMC_Uebertemperaturzaehler_CMC02_2: phys 0..400, raw 0..511
package /DataTypeMappingSets
  data type mapping set Data_Type_Mappings
    data-type-maps:
      application-data-type=REC_Basics_1_0_Echo, implementation-data-type=REC_Basics_1_0_Echo
      application-data-type=REC_Maths_1_0_Triangle, implementation-data-type=REC_Maths_1_0_Triangle
      application-data-type=float32_DT, implementation-data-type=ImplementationDataTypes/float32
      application-data-type=int32_DT, implementation-data-type=ImplementationDataTypes/sint32
      application-data-type=boolean_DT, implementation-data-type=ImplementationDataTypes/boolean
      application-data-type=int16_DT, implementation-data-type=ImplementationDataTypes/sint16
      application-data-type=int8_DT, implementation-data-type=ImplementationDataTypes/sint8
      application-data-type=uint16_DT, implementation-data-type=ImplementationDataTypes/uint16
      application-data-type=uint8_DT, implementation-data-type=ImplementationDataTypes/uint8
package /Unit
  28 x unit:
    Unit_Unit_Amper: display-name=Unit_Amper, factor-si-to-unit=1, physical-dimension=PD_siAmpere
    Unit_Unit_AmperHour: display-name=Unit_AmperHour, factor-si-to-unit=0.000277778, physical-dimension=PD_siAmpereSecond
    Unit_Unit_AmperSecon: display-name=Unit_AmperSecon, factor-si-to-unit=1, physical-dimension=PD_siAmpereSecond
    Unit_Unit_Day: display-name=Unit_Day, factor-si-to-unit=1.157E-05, physical-dimension=PD_siSecond
    Unit_Unit_DegreCelsi: display-name=Unit_DegreCelsi, factor-si-to-unit=1, offset-si-to-unit=-273.2, physical-dimension=PD_siKelvin
    Unit_Unit_Hertz: display-name=Unit_Hertz, factor-si-to-unit=1, physical-dimension=PD_siPerSecond
    Unit_Unit_Hours: display-name=Unit_Hours, factor-si-to-unit=0.0002778, physical-dimension=PD_siSecond
    Unit_Unit_KiloMeter: display-name=Unit_KiloMeter, factor-si-to-unit=0.001, physical-dimension=PD_siMeter
    Unit_Unit_KiloMeterPerHour: display-name=Unit_KiloMeterPerHour, factor-si-to-unit=3.6, physical-dimension=PD_siMeterPerSecond
    Unit_Unit_KiloPascal: display-name=Unit_KiloPascal, factor-si-to-unit=0.001, physical-dimension=PD_siPascal
    Unit_Unit_KiloWatt: display-name=Unit_KiloWatt, factor-si-to-unit=0.001, physical-dimension=PD_siWatt
    Unit_Unit_KiloWattHour: display-name=Unit_KiloWattHour, factor-si-to-unit=2.7777778E-07, physical-dimension=PD_siWattSecond
    Unit_Unit_LiterPerMinut: display-name=Unit_LiterPerMinut, factor-si-to-unit=60000, physical-dimension=PD_siCubicMeterPerSecond
    Unit_Unit_MeterPerSecon: display-name=Unit_MeterPerSecon, factor-si-to-unit=1, physical-dimension=PD_siMeterPerSecond
    Unit_Unit_MilliVolt: display-name=Unit_MilliVolt, factor-si-to-unit=1000, physical-dimension=PD_siVolt
    Unit_Unit_Minut: display-name=Unit_Minut, factor-si-to-unit=60, physical-dimension=PD_siSecond
    Unit_Unit_MinutInver: display-name=Unit_MinutInver, factor-si-to-unit=60, physical-dimension=PD_siPerSecond
    Unit_Unit_Month: display-name=Unit_Month, factor-si-to-unit=3.805E-07, physical-dimension=PD_siSecond
    Unit_Unit_NewtoMeter: display-name=Unit_NewtoMeter, factor-si-to-unit=1, physical-dimension=PD_siNewtonMeter
    Unit_Unit_None: display-name=Unit_None, factor-si-to-unit=1, physical-dimension=PD_siNone
    Unit_Unit_Ohm: display-name=Unit_Ohm, factor-si-to-unit=1, physical-dimension=PD_siOhm
    Unit_Unit_PerCent: display-name=Unit_PerCent, factor-si-to-unit=1, physical-dimension=PD_siNone
    Unit_Unit_Secon: display-name=Unit_Secon, factor-si-to-unit=1, physical-dimension=PD_siSecond
    Unit_Unit_Volt: display-name=Unit_Volt, factor-si-to-unit=1, physical-dimension=PD_siVolt
    Unit_Unit_Watt: display-name=Unit_Watt, factor-si-to-unit=1, physical-dimension=PD_siWatt
    Unit_Unit_WattHour: display-name=Unit_WattHour, factor-si-to-unit=0.00027778, physical-dimension=PD_siWattSecond
    Unit_Unit_WattSecond: display-name=Unit_WattSecond, factor-si-to-unit=1, physical-dimension=PD_siWattSecond
    Unit_Unit_Year: display-name=Unit_Year, factor-si-to-unit=3.16887646E-08, physical-dimension=PD_siSecond
