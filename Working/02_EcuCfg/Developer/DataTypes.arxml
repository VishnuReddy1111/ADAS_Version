[part 3 of 5: package /Semantics]
AUTOSAR XML (schema 00048)
package /Semantics  (continued)
  compu method CM_HVEM_AIAD_Leistungsvorgabe: phys=raw*50 for raw 0..509, 510=Cx1fe_Init (CM_HVEM_AIAD_Leistungsvorgabe_Cx1fe_Init), 511=Cx1ff_Fehler (CM_HVEM_AIAD_Leistungsvorgabe_Cx1ff_Fehler); unit Unit_Watt
  compu method CM_BMC_Pack_SN_15: 255=Cxff_Init (CM_BMC_Pack_SN_15_Cxff_Init)
  compu method CM_BMC_CMC_Temperatur_048: phys=raw*0.5-40 for raw 0..252, 253=Cxfd_nicht_vorhanden (CM_BMC_CMC_Temperatur_048_Cxfd_nicht_vorhanden), 254=Cxfe_Init (CM_BMC_CMC_Temperatur_048_Cxfe_Init), 255=Cxff_Fehler (CM_BMC_CMC_Temperatur_048_Cxff_Fehler); unit Unit_DegreCelsi
  compu method CM_DC_Fehler_intern: 0=Cx0_kein_Fehler (CM_DC_Fehler_intern_Cx0_kein_Fehler), 1=Cx1_interner_Fehler_erkannt (CM_DC_Fehler_intern_Cx1_interner_Fehler_erkannt)
  compu method CM_BMC_CMC_Zellspannung_080: phys=raw+1000 for raw 0..4091, 4092=Cxffc_kleiner_1V (CM_BMC_CMC_Zellspannung_080_Cxffc_kleiner_1V), 4093=Cxffd_nicht_vorhanden (CM_BMC_CMC_Zellspannung_080_Cxffd_nicht_vorhanden), 4094=Cxffe_Init (CM_BMC_CMC_Zellspannung_080_Cxffe_Init), 4095=Cxfff_Fehler (CM_BMC_CMC_Zellspannung_080_Cxfff_Fehler); unit Unit_MilliVolt
  compu method CM_BMC_CMC_Temperatur_009: phys=raw*0.5-40 for raw 0..252, 253=Cxfd_nicht_vorhanden (CM_BMC_CMC_Temperatur_009_Cxfd_nicht_vorhanden), 254=Cxfe_Init (CM_BMC_CMC_Temperatur_009_Cxfe_Init), 255=Cxff_Fehler (CM_BMC_CMC_Temperatur_009_Cxff_Fehler); unit Unit_DegreCelsi
  compu method CM_BMC_CMC_Zellspannung_146: phys=raw+1000 for raw 0..4091, 4092=Cxffc_kleiner_1V (CM_BMC_CMC_Zellspannung_146_Cxffc_kleiner_1V), 4093=Cxffd_nicht_vorhanden (CM_BMC_CMC_Zellspannung_146_Cxffd_nicht_vorhanden), 4094=Cxffe_Init (CM_BMC_CMC_Zellspannung_146_Cxffe_Init), 4095=Cxfff_Fehler (CM_BMC_CMC_Zellspannung_146_Cxfff_Fehler); unit Unit_MilliVolt
  compu method CM_BMC_CMC_Zellspannung_037: phys=raw+1000 for raw 0..4091, 4092=Cxffc_kleiner_1V (CM_BMC_CMC_Zellspannung_037_Cxffc_kleiner_1V), 4093=Cxffd_nicht_vorhanden (CM_BMC_CMC_Zellspannung_037_Cxffd_nicht_vorhanden), 4094=Cxffe_Init (CM_BMC_CMC_Zellspannung_037_Cxffe_Init), 4095=Cxfff_Fehler (CM_BMC_CMC_Zellspannung_037_Cxfff_Fehler); unit Unit_MilliVolt
  compu method CM_BMC_Pack_SN_16: 255=Cxff_Init (CM_BMC_Pack_SN_16_Cxff_Init)
  compu method CM_BMC_CMC_Temperatur_049: phys=raw*0.5-40 for raw 0..252, 253=Cxfd_nicht_vorhanden (CM_BMC_CMC_Temperatur_049_Cxfd_nicht_vorhanden), 254=Cxfe_Init (CM_BMC_CMC_Temperatur_049_Cxfe_Init), 255=Cxff_Fehler (CM_BMC_CMC_Temperatur_049_Cxff_Fehler); unit Unit_DegreCelsi
  compu method CM_DC_IstLeistung_HV: phys=raw*10-4000 for raw 0..1021, 1022=Cx3fe_Init (CM_DC_IstLeistung_HV_Cx3fe_Init), 1023=Cx3ff_Fehler (CM_DC_IstLeistung_HV_Cx3ff_Fehler); unit Unit_Watt
  compu method CM_BMC_CMC_Zellspannung_081: phys=raw+1000 for raw 0..4091, 4092=Cxffc_kleiner_1V (CM_BMC_CMC_Zellspannung_081_Cxffc_kleiner_1V), 4093=Cxffd_nicht_vorhanden (CM_BMC_CMC_Zellspannung_081_Cxffd_nicht_vorhanden), 4094=Cxffe_Init (CM_BMC_CMC_Zellspannung_081_Cxffe_Init), 4095=Cxfff_Fehler (CM_BMC_CMC_Zellspannung_081_Cxfff_Fehler); unit Unit_MilliVolt
  compu method CM_BMC_CMC_Temperatur_010: phys=raw*0.5-40 for raw 0..252, 253=Cxfd_nicht_vorhanden (CM_BMC_CMC_Temperatur_010_Cxfd_nicht_vorhanden), 254=Cxfe_Init (CM_BMC_CMC_Temperatur_010_Cxfe_Init), 255=Cxff_Fehler (CM_BMC_CMC_Temperatur_010_Cxff_Fehler); unit Unit_DegreCelsi
  compu method CM_DCDC_NV_Komponentenfehler_47: 0=Cx0_TstNotComplThisOpCycle_Init (CM_DCDC_NV_Komponentenfehler_47_Cx0_TstNotComplThisOpCycle_Init), 1=Cx1_TstComplThisOpCycle_Pass (CM_DCDC_NV_Komponentenfehler_47_Cx1_TstComplThisOpCycle_Pass), 2=Cx2_TstCmplThisCycle_Pass_TimeElapse (CM_DCDC_NV_Komponentenfehler_47_Cx2_TstCmplThisCycle_Pass_TimeElapse), 3=Cx3_TstComplThisOpCycle_FAIL (CM_DCDC_NV_Komponentenfehler_47_Cx3_TstComplThisOpCycle_FAIL)
  compu method CM_BMC_CMC_Zellspannung_147: phys=raw+1000 for raw 0..4091, 4092=Cxffc_kleiner_1V (CM_BMC_CMC_Zellspannung_147_Cxffc_kleiner_1V), 4093=Cxffd_nicht_vorhanden (CM_BMC_CMC_Zellspannung_147_Cxffd_nicht_vorhanden), 4094=Cxffe_Init (CM_BMC_CMC_Zellspannung_147_Cxffe_Init), 4095=Cxfff_Fehler (CM_BMC_CMC_Zellspannung_147_Cxfff_Fehler); unit Unit_MilliVolt
  compu method CM_HVEM_AIAD_RekuVerbot: 0=Cx0_kein_Verbot (CM_HVEM_AIAD_RekuVerbot_Cx0_kein_Verbot), 1=Cx1_Reku_Verbot (CM_HVEM_AIAD_RekuVerbot_Cx1_Reku_Verbot), 2=Cx2_reserviert (CM_HVEM_AIAD_RekuVerbot_Cx2_reserviert), 3=Cx3_reserviert (CM_HVEM_AIAD_RekuVerbot_Cx3_reserviert)
  compu method CM_BMC_CMC_Temperatur_011: phys=raw*0.5-40 for raw 0..252, 253=Cxfd_nicht_vorhanden (CM_BMC_CMC_Temperatur_011_Cxfd_nicht_vorhanden), 254=Cxfe_Init (CM_BMC_CMC_Temperatur_011_Cxfe_Init), 255=Cxff_Fehler (CM_BMC_CMC_Temperatur_011_Cxff_Fehler); unit Unit_DegreCelsi
  compu method CM_BMC_Pack_SN_17: 255=Cxff_Init (CM_BMC_Pack_SN_17_Cxff_Init)
  compu method CM_DC_IstModus_02: 0=Cx0_Standby (CM_DC_IstModus_02_Cx0_Standby), 1=Cx1_HV_On_Vorladen (CM_DC_IstModus_02_Cx1_HV_On_Vorladen), 2=Cx2_Tiefsetzen (CM_DC_IstModus_02_Cx2_Tiefsetzen), 3=Cx3_Hochsetzen (CM_DC_IstModus_02_Cx3_Hochsetzen), 4=Cx4_Pruefimpuls_12V (CM_DC_IstModus_02_Cx4_Pruefimpuls_12V), 5=Cx5_Fehler (CM_DC_IstModus_02_Cx5_Fehler), 7=Cx7_Initialisierung (CM_DC_IstModus_02_Cx7_Initialisierung)
  compu method CM_BMC_CMC_Zellspannung_038: phys=raw+1000 for raw 0..4091, 4092=Cxffc_kleiner_1V (CM_BMC_CMC_Zellspannung_038_Cxffc_kleiner_1V), 4093=Cxffd_nicht_vorhanden (CM_BMC_CMC_Zellspannung_038_Cxffd_nicht_vorhanden), 4094=Cxffe_Init (CM_BMC_CMC_Zellspannung_038_Cxffe_Init), 4095=Cxfff_Fehler (CM_BMC_CMC_Zellspannung_038_Cxfff_Fehler); unit Unit_MilliVolt
  compu method CM_BMC_CMC_Zellspannung_148: phys=raw+1000 for raw 0..4091, 4092=Cxffc_kleiner_1V (CM_BMC_CMC_Zellspannung_148_Cxffc_kleiner_1V), 4093=Cxffd_nicht_vorhanden (CM_BMC_CMC_Zellspannung_148_Cxffd_nicht_vorhanden), 4094=Cxffe_Init (CM_BMC_CMC_Zellspannung_148_Cxffe_Init), 4095=Cxfff_Fehler (CM_BMC_CMC_Zellspannung_148_Cxfff_Fehler); unit Unit_MilliVolt
  compu method CM_BMC_CMC_Temperatur_050: phys=raw*0.5-40 for raw 0..252, 253=Cxfd_nicht_vorhanden (CM_BMC_CMC_Temperatur_050_Cxfd_nicht_vorhanden), 254=Cxfe_Init (CM_BMC_CMC_Temperatur_050_Cxfe_Init), 255=Cxff_Fehler (CM_BMC_CMC_Temperatur_050_Cxff_Fehler); unit Unit_DegreCelsi
  compu method CM_BMC_CMC_Zellspannung_082: phys=raw+1000 for raw 0..4091, 4092=Cxffc_kleiner_1V (CM_BMC_CMC_Zellspannung_082_Cxffc_kleiner_1V), 4093=Cxffd_nicht_vorhanden (CM_BMC_CMC_Zellspannung_082_Cxffd_nicht_vorhanden), 4094=Cxffe_Init (CM_BMC_CMC_Zellspannung_082_Cxffe_Init), 4095=Cxfff_Fehler (CM_BMC_CMC_Zellspannung_082_Cxfff_Fehler); unit Unit_MilliVolt
  compu method CM_BMC_CMC_Temperatur_012: phys=raw*0.5-40 for raw 0..252, 253=Cxfd_nicht_vorhanden (CM_BMC_CMC_Temperatur_012_Cxfd_nicht_vorhanden), 254=Cxfe_Init (CM_BMC_CMC_Temperatur_012_Cxfe_Init), 255=Cxff_Fehler (CM_BMC_CMC_Temperatur_012_Cxff_Fehler); unit Unit_DegreCelsi
  compu method CM_DCDC_NV_Komponentenfehler_48: 0=Cx0_TstNotComplThisOpCycle_Init (CM_DCDC_NV_Komponentenfehler_48_Cx0_TstNotComplThisOpCycle_Init), 1=Cx1_TstComplThisOpCycle_Pass (CM_DCDC_NV_Komponentenfehler_48_Cx1_TstComplThisOpCycle_Pass), 2=Cx2_TstCmplThisCycle_Pass_TimeElapse (CM_DCDC_NV_Komponentenfehler_48_Cx2_TstCmplThisCycle_Pass_TimeElapse), 3=Cx3_TstComplThisOpCycle_FAIL (CM_DCDC_NV_Komponentenfehler_48_Cx3_TstComplThisOpCycle_FAIL)
  compu method CM_BMC_Pack_SN_18: 255=Cxff_Init (CM_BMC_Pack_SN_18_Cxff_Init)
  compu method CM_BMC_CMC_Zellspannung_149: phys=raw+1000 for raw 0..4091, 4092=Cxffc_kleiner_1V (CM_BMC_CMC_Zellspannung_149_Cxffc_kleiner_1V), 4093=Cxffd_nicht_vorhanden (CM_BMC_CMC_Zellspannung_149_Cxffd_nicht_vorhanden), 4094=Cxffe_Init (CM_BMC_CMC_Zellspannung_149_Cxffe_Init), 4095=Cxfff_Fehler (CM_BMC_CMC_Zellspannung_149_Cxfff_Fehler); unit Unit_MilliVolt
  compu method CM_BMC_CMC_Zellspannung_039: phys=raw+1000 for raw 0..4091, 4092=Cxffc_kleiner_1V (CM_BMC_CMC_Zellspannung_039_Cxffc_kleiner_1V), 4093=Cxffd_nicht_vorhanden (CM_BMC_CMC_Zellspannung_039_Cxffd_nicht_vorhanden), 4094=Cxffe_Init (CM_BMC_CMC_Zellspannung_039_Cxffe_Init), 4095=Cxfff_Fehler (CM_BMC_CMC_Zellspannung_039_Cxfff_Fehler); unit Unit_MilliVolt
  compu method CM_BMC_CMC_Temperatur_051: phys=raw*0.5-40 for raw 0..252, 253=Cxfd_nicht_vorhanden (CM_BMC_CMC_Temperatur_051_Cxfd_nicht_vorhanden), 254=Cxfe_Init (CM_BMC_CMC_Temperatur_051_Cxfe_Init), 255=Cxff_Fehler (CM_BMC_CMC_Temperatur_051_Cxff_Fehler); unit Unit_DegreCelsi
  compu method CM_HVEM_BMC_CHA_Wunschleistung: phys=raw*100 for raw 0..8189, 8190=Cx1ffe_Init (CM_HVEM_BMC_CHA_Wunschleistung_Cx1ffe_Init), 8191=Cx1fff_Fehler (CM_HVEM_BMC_CHA_Wunschleistung_Cx1fff_Fehler); unit Unit_Watt
  compu method CM_DC_Vorladung_Status: 0=Cx0_nicht_abgeschlossen (CM_DC_Vorladung_Status_Cx0_nicht_abgeschlossen), 1=Cx1_abgeschlossen (CM_DC_Vorladung_Status_Cx1_abgeschlossen)
  compu method CM_BMC_CMC_Zellspannung_083: phys=raw+1000 for raw 0..4091, 4092=Cxffc_kleiner_1V (CM_BMC_CMC_Zellspannung_083_Cxffc_kleiner_1V), 4093=Cxffd_nicht_vorhanden (CM_BMC_CMC_Zellspannung_083_Cxffd_nicht_vorhanden), 4094=Cxffe_Init (CM_BMC_CMC_Zellspannung_083_Cxffe_Init), 4095=Cxfff_Fehler (CM_BMC_CMC_Zellspannung_083_Cxfff_Fehler); unit Unit_MilliVolt
  compu method CM_BMC_CMC_Zellspannung_150: phys=raw+1000 for raw 0..4091, 4092=Cxffc_kleiner_1V (CM_BMC_CMC_Zellspannung_150_Cxffc_kleiner_1V), 4093=Cxffd_nicht_vorhanden (CM_BMC_CMC_Zellspannung_150_Cxffd_nicht_vorhanden), 4094=Cxffe_Init (CM_BMC_CMC_Zellspannung_150_Cxffe_Init), 4095=Cxfff_Fehler (CM_BMC_CMC_Zellspannung_150_Cxfff_Fehler); unit Unit_MilliVolt
  compu method CM_BMC_CMC_Zellspannung_03_Messzeit: phys=raw for raw 0..253, 254=Cxfe_Init (CM_BMC_CMC_Zellspannung_03_Messzeit_Cxfe_Init), 255=Cxff_Fehler (CM_BMC_CMC_Zellspannung_03_Messzeit_Cxff_Fehler); unit Unit_None
  compu method CM_HVK_EKK_Sollmodus: 0=Cx0_Keine_Freigabe (CM_HVK_EKK_Sollmodus_Cx0_Keine_Freigabe), 1=Cx1_Freigabe (CM_HVK_EKK_Sollmodus_Cx1_Freigabe), 2=Cx2_Freigabe_ausgesetzt (CM_HVK_EKK_Sollmodus_Cx2_Freigabe_ausgesetzt), 7=Cx7_Init (CM_HVK_EKK_Sollmodus_Cx7_Init)
  compu method CM_DCDC_HVK_EoHVL_Status: 0=Cx0_Init (CM_DCDC_HVK_EoHVL_Status_Cx0_Init), 1=Cx1_Uzwkr_kleiner_UEoHVL_Schwell (CM_DCDC_HVK_EoHVL_Status_Cx1_Uzwkr_kleiner_UEoHVL_Schwell), 2=Cx2_Uzwkr_groesgleich_UEoHVL_Schwell (CM_DCDC_HVK_EoHVL_Status_Cx2_Uzwkr_groesgleich_UEoHVL_Schwell), 3=Cx3_Fehler (CM_DCDC_HVK_EoHVL_Status_Cx3_Fehler)
  compu method CM_BMC_Pack_SN_19: 255=Cxff_Init (CM_BMC_Pack_SN_19_Cxff_Init)
  compu method CM_BMC_CMC_Temperatur_052: phys=raw*0.5-40 for raw 0..252, 253=Cxfd_nicht_vorhanden (CM_BMC_CMC_Temperatur_052_Cxfd_nicht_vorhanden), 254=Cxfe_Init (CM_BMC_CMC_Temperatur_052_Cxfe_Init), 255=Cxff_Fehler (CM_BMC_CMC_Temperatur_052_Cxff_Fehler); unit Unit_DegreCelsi
  compu method CM_BMC_CMC_Zellspannung_084: phys=raw+1000 for raw 0..4091, 4092=Cxffc_kleiner_1V (CM_BMC_CMC_Zellspannung_084_Cxffc_kleiner_1V), 4093=Cxffd_nicht_vorhanden (CM_BMC_CMC_Zellspannung_084_Cxffd_nicht_vorhanden), 4094=Cxffe_Init (CM_BMC_CMC_Zellspannung_084_Cxffe_Init), 4095=Cxfff_Fehler (CM_BMC_CMC_Zellspannung_084_Cxfff_Fehler); unit Unit_MilliVolt
  compu method CM_BMC_CMC_Temperatur_074: phys=raw*0.5-40 for raw 0..252, 253=Cxfd_nicht_vorhanden (CM_BMC_CMC_Temperatur_074_Cxfd_nicht_vorhanden), 254=Cxfe_Init (CM_BMC_CMC_Temperatur_074_Cxfe_Init), 255=Cxff_Fehler (CM_BMC_CMC_Temperatur_074_Cxff_Fehler); unit Unit_DegreCelsi
  compu method CM_BMC_CMC_Zellspannung_151: phys=raw+1000 for raw 0..4091, 4092=Cxffc_kleiner_1V (CM_BMC_CMC_Zellspannung_151_Cxffc_kleiner_1V), 4093=Cxffd_nicht_vorhanden (CM_BMC_CMC_Zellspannung_151_Cxffd_nicht_vorhanden), 4094=Cxffe_Init (CM_BMC_CMC_Zellspannung_151_Cxffe_Init), 4095=Cxfff_Fehler (CM_BMC_CMC_Zellspannung_151_Cxfff_Fehler); unit Unit_MilliVolt
  compu method CM_DCDC_NV_Komponentenfehler_49: 0=Cx0_TstNotComplThisOpCycle_Init (CM_DCDC_NV_Komponentenfehler_49_Cx0_TstNotComplThisOpCycle_Init), 1=Cx1_TstComplThisOpCycle_Pass (CM_DCDC_NV_Komponentenfehler_49_Cx1_TstComplThisOpCycle_Pass), 2=Cx2_TstCmplThisCycle_Pass_TimeElapse (CM_DCDC_NV_Komponentenfehler_49_Cx2_TstCmplThisCycle_Pass_TimeElapse), 3=Cx3_TstComplThisOpCycle_FAIL (CM_DCDC_NV_Komponentenfehler_49_Cx3_TstComplThisOpCycle_FAIL)
  compu method CM_HVK_ETM_Freigabe: 0=Cx0_keine_Freigabe (CM_HVK_ETM_Freigabe_Cx0_keine_Freigabe), 1=Cx1_Freigabe (CM_HVK_ETM_Freigabe_Cx1_Freigabe), 2=Cx2_Freigabe_Sonderbetrieb (CM_HVK_ETM_Freigabe_Cx2_Freigabe_Sonderbetrieb), 3=Cx3_Init (CM_HVK_ETM_Freigabe_Cx3_Init)
  compu method CM_BMC_CMC_Zellspannung_040: phys=raw+1000 for raw 0..4091, 4092=Cxffc_kleiner_1V (CM_BMC_CMC_Zellspannung_040_Cxffc_kleiner_1V), 4093=Cxffd_nicht_vorhanden (CM_BMC_CMC_Zellspannung_040_Cxffd_nicht_vorhanden), 4094=Cxffe_Init (CM_BMC_CMC_Zellspannung_040_Cxffe_Init), 4095=Cxfff_Fehler (CM_BMC_CMC_Zellspannung_040_Cxfff_Fehler); unit Unit_MilliVolt
  compu method CM_BMC_CMC_Zellspannung_085: phys=raw+1000 for raw 0..4091, 4092=Cxffc_kleiner_1V (CM_BMC_CMC_Zellspannung_085_Cxffc_kleiner_1V), 4093=Cxffd_nicht_vorhanden (CM_BMC_CMC_Zellspannung_085_Cxffd_nicht_vorhanden), 4094=Cxffe_Init (CM_BMC_CMC_Zellspannung_085_Cxffe_Init), 4095=Cxfff_Fehler (CM_BMC_CMC_Zellspannung_085_Cxfff_Fehler); unit Unit_MilliVolt
  compu method CM_HVEM_BMC_CHA_Wunschleistung_02: phys=raw*100 for raw 0..32500, 32766=Cx7ffe_Init (CM_HVEM_BMC_CHA_Wunschleistung_02_Cx7ffe_Init), 32767=Cx7fff_Fehler (CM_HVEM_BMC_CHA_Wunschleistung_02_Cx7fff_Fehler); unit Unit_Watt
  compu method CM_BMC_CMC_Zellspannung_152: phys=raw+1000 for raw 0..4091, 4092=Cxffc_kleiner_1V (CM_BMC_CMC_Zellspannung_152_Cxffc_kleiner_1V), 4093=Cxffd_nicht_vorhanden (CM_BMC_CMC_Zellspannung_152_Cxffd_nicht_vorhanden), 4094=Cxffe_Init (CM_BMC_CMC_Zellspannung_152_Cxffe_Init), 4095=Cxfff_Fehler (CM_BMC_CMC_Zellspannung_152_Cxfff_Fehler); unit Unit_MilliVolt
  compu method CM_DCDC_HVK_Fehler_AE: 0=Cx0_kein_Fehler_AE (CM_DCDC_HVK_Fehler_AE_Cx0_kein_Fehler_AE), 1=Cx1_Fehler_AE (CM_DCDC_HVK_Fehler_AE_Cx1_Fehler_AE), 3=Cx3_Init (CM_DCDC_HVK_Fehler_AE_Cx3_Init)
  compu method CM_BMC_CMC_Temperatur_053: phys=raw*0.5-40 for raw 0..252, 253=Cxfd_nicht_vorhanden (CM_BMC_CMC_Temperatur_053_Cxfd_nicht_vorhanden), 254=Cxfe_Init (CM_BMC_CMC_Temperatur_053_Cxfe_Init), 255=Cxff_Fehler (CM_BMC_CMC_Temperatur_053_Cxff_Fehler); unit Unit_DegreCelsi
  compu method CM_BMC_Pack_SN_20: 255=Cxff_Init (CM_BMC_Pack_SN_20_Cxff_Init)
  compu method CM_HVK_Gesamtst_Spgfreiheit: 0=Cx0_Funktion_Init_ohne_Funktion (CM_HVK_Gesamtst_Spgfreiheit_Cx0_Funktion_Init_ohne_Funktion) (Funktion_Init__ohne_Funktion), 1=Cx1_HV_System_spannungsfrei (CM_HVK_Gesamtst_Spgfreiheit_Cx1_HV_System_spannungsfrei), 2=Cx2_HV_System_nicht_spannungsfrei (CM_HVK_Gesamtst_Spgfreiheit_Cx2_HV_System_nicht_spannungsfrei), 3=Cx3_Fehler (CM_HVK_Gesamtst_Spgfreiheit_Cx3_Fehler)
  compu method CM_BMC_CMC_Zellspannung_153: phys=raw+1000 for raw 0..4091, 4092=Cxffc_kleiner_1V (CM_BMC_CMC_Zellspannung_153_Cxffc_kleiner_1V), 4093=Cxffd_nicht_vorhanden (CM_BMC_CMC_Zellspannung_153_Cxffd_nicht_vorhanden), 4094=Cxffe_Init (CM_BMC_CMC_Zellspannung_153_Cxffe_Init), 4095=Cxfff_Fehler (CM_BMC_CMC_Zellspannung_153_Cxfff_Fehler); unit Unit_MilliVolt
  compu method CM_BMC_CMC_Zellspannung_041: phys=raw+1000 for raw 0..4091, 4092=Cxffc_kleiner_1V (CM_BMC_CMC_Zellspannung_041_Cxffc_kleiner_1V), 4093=Cxffd_nicht_vorhanden (CM_BMC_CMC_Zellspannung_041_Cxffd_nicht_vorhanden), 4094=Cxffe_Init (CM_BMC_CMC_Zellspannung_041_Cxffe_Init), 4095=Cxfff_Fehler (CM_BMC_CMC_Zellspannung_041_Cxfff_Fehler); unit Unit_MilliVolt
  compu method CM_BMC_CMC_Zellspannung_086: phys=raw+1000 for raw 0..4091, 4092=Cxffc_kleiner_1V (CM_BMC_CMC_Zellspannung_086_Cxffc_kleiner_1V), 4093=Cxffd_nicht_vorhanden (CM_BMC_CMC_Zellspannung_086_Cxffd_nicht_vorhanden), 4094=Cxffe_Init (CM_BMC_CMC_Zellspannung_086_Cxffe_Init), 4095=Cxfff_Fehler (CM_BMC_CMC_Zellspannung_086_Cxfff_Fehler); unit Unit_MilliVolt
  compu method CM_DCDC_HVK_Fehler_SD: 0=Cx0_SD_gesteckt (CM_DCDC_HVK_Fehler_SD_Cx0_SD_gesteckt) (SD gesteckt), 1=Cx1_SD_gezogen (CM_DCDC_HVK_Fehler_SD_Cx1_SD_gezogen) (SD gezogen), 2=Cx2_Fehler (CM_DCDC_HVK_Fehler_SD_Cx2_Fehler), 3=Cx3_Init (CM_DCDC_HVK_Fehler_SD_Cx3_Init)
  compu method CM_BMC_CMC_Temperatur_054: phys=raw*0.5-40 for raw 0..252, 253=Cxfd_nicht_vorhanden (CM_BMC_CMC_Temperatur_054_Cxfd_nicht_vorhanden), 254=Cxfe_Init (CM_BMC_CMC_Temperatur_054_Cxfe_Init), 255=Cxff_Fehler (CM_BMC_CMC_Temperatur_054_Cxff_Fehler); unit Unit_DegreCelsi
  compu method CM_BMC_Pack_SN_21: 255=Cxff_Init (CM_BMC_Pack_SN_21_Cxff_Init)
  compu method CM_DCDC_NV_Komponentenfehler_50: 0=Cx0_TstNotComplThisOpCycle_Init (CM_DCDC_NV_Komponentenfehler_50_Cx0_TstNotComplThisOpCycle_Init), 1=Cx1_TstComplThisOpCycle_Pass (CM_DCDC_NV_Komponentenfehler_50_Cx1_TstComplThisOpCycle_Pass), 2=Cx2_TstCmplThisCycle_Pass_TimeElapse (CM_DCDC_NV_Komponentenfehler_50_Cx2_TstCmplThisCycle_Pass_TimeElapse), 3=Cx3_TstComplThisOpCycle_FAIL (CM_DCDC_NV_Komponentenfehler_50_Cx3_TstComplThisOpCycle_FAIL)
  compu method CM_BMC_CMC_Zellspannung_154: phys=raw+1000 for raw 0..4091, 4092=Cxffc_kleiner_1V (CM_BMC_CMC_Zellspannung_154_Cxffc_kleiner_1V), 4093=Cxffd_nicht_vorhanden (CM_BMC_CMC_Zellspannung_154_Cxffd_nicht_vorhanden), 4094=Cxffe_Init (CM_BMC_CMC_Zellspannung_154_Cxffe_Init), 4095=Cxfff_Fehler (CM_BMC_CMC_Zellspannung_154_Cxfff_Fehler); unit Unit_MilliVolt
  compu method CM_HVK_HV_Netz_Warnungen: 0=Cx0_Keine_Warnung (CM_HVK_HV_Netz_Warnungen_Cx0_Keine_Warnung), 1=Cx1_Warntext_HV_Netz_Anf (CM_HVK_HV_Netz_Warnungen_Cx1_Warntext_HV_Netz_Anf), 2=Cx2_Fehlertext_HV_Netz_Anf (CM_HVK_HV_Netz_Warnungen_Cx2_Fehlertext_HV_Netz_Anf), 3=Cx3_Warnung_Kein_Wiederstart_moeglich (CM_HVK_HV_Netz_Warnungen_Cx3_Warnung_Kein_Wiederstart_moeglich)
  compu method CM_HVEM_ETM_Max_Entladeleistung: phys=raw*100 for raw 0..8189, 8190=Cx1ffe_Init (CM_HVEM_ETM_Max_Entladeleistung_Cx1ffe_Init), 8191=Cx1fff_Fehler (CM_HVEM_ETM_Max_Entladeleistung_Cx1fff_Fehler); unit Unit_Watt
  compu method CM_DCDC_NV_CALID_Index_01: phys=raw for raw 0..255
  compu method CM_BMC_CMC_Zellspannung_042: phys=raw+1000 for raw 0..4091, 4092=Cxffc_kleiner_1V (CM_BMC_CMC_Zellspannung_042_Cxffc_kleiner_1V), 4093=Cxffd_nicht_vorhanden (CM_BMC_CMC_Zellspannung_042_Cxffd_nicht_vorhanden), 4094=Cxffe_Init (CM_BMC_CMC_Zellspannung_042_Cxffe_Init), 4095=Cxfff_Fehler (CM_BMC_CMC_Zellspannung_042_Cxfff_Fehler); unit Unit_MilliVolt
  compu method CM_BMC_CMC_Zellspannung_087: phys=raw+1000 for raw 0..4091, 4092=Cxffc_kleiner_1V (CM_BMC_CMC_Zellspannung_087_Cxffc_kleiner_1V), 4093=Cxffd_nicht_vorhanden (CM_BMC_CMC_Zellspannung_087_Cxffd_nicht_vorhanden), 4094=Cxffe_Init (CM_BMC_CMC_Zellspannung_087_Cxffe_Init), 4095=Cxfff_Fehler (CM_BMC_CMC_Zellspannung_087_Cxfff_Fehler); unit Unit_MilliVolt
  compu method CM_BMC_Pack_SN_22: 255=Cxff_Init (CM_BMC_Pack_SN_22_Cxff_Init)
  compu method CM_HVK_HV_Netz_Zustand: 0=Cx0_Aus (CM_HVK_HV_Netz_Zustand_Cx0_Aus), 1=Cx1_Aktivierung (CM_HVK_HV_Netz_Zustand_Cx1_Aktivierung), 2=Cx2_Diagnose (CM_HVK_HV_Netz_Zustand_Cx2_Diagnose), 3=Cx3_Aktiv (CM_HVK_HV_Netz_Zustand_Cx3_Aktiv), 4=Cx4_Fahrbetrieb (CM_HVK_HV_Netz_Zustand_Cx4_Fahrbetrieb), 5=Cx5_AC_Ladebetrieb (CM_HVK_HV_Netz_Zustand_Cx5_AC_Ladebetrieb), 6=Cx6_DC_Ladebetrieb (CM_HVK_HV_Netz_Zustand_Cx6_DC_Ladebetrieb), 7=Cx7_Aktiv_ohne_HVSpeicher (CM_HVK_HV_Netz_Zustand_Cx7_Aktiv_ohne_HVSpeicher), 11=Cxb_Aus_Fehlerfall (CM_HVK_HV_Netz_Zustand_Cxb_Aus_Fehlerfall), 12=Cxc_lastfreie_Abschaltung (CM_HVK_HV_Netz_Zustand_Cxc_lastfreie_Abschaltung), 13=Cxd_Notabschaltung (CM_HVK_HV_Netz_Zustand_Cxd_Notabschaltung), 14=Cxe_Entladung (CM_HVK_HV_Netz_Zustand_Cxe_Entladung), 15=Cxf_Init (CM_HVK_HV_Netz_Zustand_Cxf_Init)
  compu method CM_BMC_CMC_Temperatur_055: phys=raw*0.5-40 for raw 0..252, 253=Cxfd_nicht_vorhanden (CM_BMC_CMC_Temperatur_055_Cxfd_nicht_vorhanden), 254=Cxfe_Init (CM_BMC_CMC_Temperatur_055_Cxfe_Init), 255=Cxff_Fehler (CM_BMC_CMC_Temperatur_055_Cxff_Fehler); unit Unit_DegreCelsi
  compu method CM_BMC_CMC_Zellspannung_155: phys=raw+1000 for raw 0..4091, 4092=Cxffc_kleiner_1V (CM_BMC_CMC_Zellspannung_155_Cxffc_kleiner_1V), 4093=Cxffd_nicht_vorhanden (CM_BMC_CMC_Zellspannung_155_Cxffd_nicht_vorhanden), 4094=Cxffe_Init (CM_BMC_CMC_Zellspannung_155_Cxffe_Init), 4095=Cxfff_Fehler (CM_BMC_CMC_Zellspannung_155_Cxfff_Fehler); unit Unit_MilliVolt
  compu method CM_BMC_CMC_Temperatur_075: phys=raw*0.5-40 for raw 0..252, 253=Cxfd_nicht_vorhanden (CM_BMC_CMC_Temperatur_075_Cxfd_nicht_vorhanden), 254=Cxfe_Init (CM_BMC_CMC_Temperatur_075_Cxfe_Init), 255=Cxff_Fehler (CM_BMC_CMC_Temperatur_075_Cxff_Fehler); unit Unit_DegreCelsi
  compu method CM_BMC_CMC_Zellspannung_043: phys=raw+1000 for raw 0..4091, 4092=Cxffc_kleiner_1V (CM_BMC_CMC_Zellspannung_043_Cxffc_kleiner_1V), 4093=Cxffd_nicht_vorhanden (CM_BMC_CMC_Zellspannung_043_Cxffd_nicht_vorhanden), 4094=Cxffe_Init (CM_BMC_CMC_Zellspannung_043_Cxffe_Init), 4095=Cxfff_Fehler (CM_BMC_CMC_Zellspannung_043_Cxfff_Fehler); unit Unit_MilliVolt
  compu method CM_DCDC_NV_Komponentenfehler_51: 0=Cx0_TstNotComplThisOpCycle_Init (CM_DCDC_NV_Komponentenfehler_51_Cx0_TstNotComplThisOpCycle_Init), 1=Cx1_TstComplThisOpCycle_Pass (CM_DCDC_NV_Komponentenfehler_51_Cx1_TstComplThisOpCycle_Pass), 2=Cx2_TstCmplThisCycle_Pass_TimeElapse (CM_DCDC_NV_Komponentenfehler_51_Cx2_TstCmplThisCycle_Pass_TimeElapse), 3=Cx3_TstComplThisOpCycle_FAIL (CM_DCDC_NV_Komponentenfehler_51_Cx3_TstComplThisOpCycle_FAIL)
  compu method CM_HVK_HVHL_Sollmodus: 0=Cx0_Keine_Freigabe (CM_HVK_HVHL_Sollmodus_Cx0_Keine_Freigabe), 1=Cx1_Freigabe (CM_HVK_HVHL_Sollmodus_Cx1_Freigabe), 2=Cx2_Freigabe_ausgesetzt (CM_HVK_HVHL_Sollmodus_Cx2_Freigabe_ausgesetzt), 3=Cx3_Init (CM_HVK_HVHL_Sollmodus_Cx3_Init)
  compu method CM_BMC_Pack_SN_23: 255=Cxff_Init (CM_BMC_Pack_SN_23_Cxff_Init)
  compu method CM_BMC_CMC_Zellspannung_088: phys=raw+1000 for raw 0..4091, 4092=Cxffc_kleiner_1V (CM_BMC_CMC_Zellspannung_088_Cxffc_kleiner_1V), 4093=Cxffd_nicht_vorhanden (CM_BMC_CMC_Zellspannung_088_Cxffd_nicht_vorhanden), 4094=Cxffe_Init (CM_BMC_CMC_Zellspannung_088_Cxffe_Init), 4095=Cxfff_Fehler (CM_BMC_CMC_Zellspannung_088_Cxfff_Fehler); unit Unit_MilliVolt
  compu method CM_DCDC_NV_CALID_Index_02: phys=raw for raw 0..255
  compu method CM_BMC_CMC_Zellspannung_156: phys=raw+1000 for raw 0..4091, 4092=Cxffc_kleiner_1V (CM_BMC_CMC_Zellspannung_156_Cxffc_kleiner_1V), 4093=Cxffd_nicht_vorhanden (CM_BMC_CMC_Zellspannung_156_Cxffd_nicht_vorhanden), 4094=Cxffe_Init (CM_BMC_CMC_Zellspannung_156_Cxffe_Init), 4095=Cxfff_Fehler (CM_BMC_CMC_Zellspannung_156_Cxfff_Fehler); unit Unit_MilliVolt
  compu method CM_HVEM_ETM_Max_Entladeleistung_02: phys=raw*100 for raw 0..32500, 32766=Cx7ffe_Init (CM_HVEM_ETM_Max_Entladeleistung_02_Cx7ffe_Init), 32767=Cx7fff_Fehler (CM_HVEM_ETM_Max_Entladeleistung_02_Cx7fff_Fehler); unit Unit_Watt
  compu method CM_BMC_CMC_Temperatur_056: phys=raw*0.5-40 for raw 0..252, 253=Cxfd_nicht_vorhanden (CM_BMC_CMC_Temperatur_056_Cxfd_nicht_vorhanden), 254=Cxfe_Init (CM_BMC_CMC_Temperatur_056_Cxfe_Init), 255=Cxff_Fehler (CM_BMC_CMC_Temperatur_056_Cxff_Fehler); unit Unit_DegreCelsi
  compu method CM_HVK_HVHW_Sollmodus: 0=Cx0_Keine_Freigabe (CM_HVK_HVHW_Sollmodus_Cx0_Keine_Freigabe), 1=Cx1_Freigabe (CM_HVK_HVHW_Sollmodus_Cx1_Freigabe), 2=Cx2_Freigabe_ausgesetzt (CM_HVK_HVHW_Sollmodus_Cx2_Freigabe_ausgesetzt), 3=Cx3_Init (CM_HVK_HVHW_Sollmodus_Cx3_Init)
  compu method CM_BMC_CMC_Zellspannung_044: phys=raw+1000 for raw 0..4091, 4092=Cxffc_kleiner_1V (CM_BMC_CMC_Zellspannung_044_Cxffc_kleiner_1V), 4093=Cxffd_nicht_vorhanden (CM_BMC_CMC_Zellspannung_044_Cxffd_nicht_vorhanden), 4094=Cxffe_Init (CM_BMC_CMC_Zellspannung_044_Cxffe_Init), 4095=Cxfff_Fehler (CM_BMC_CMC_Zellspannung_044_Cxfff_Fehler); unit Unit_MilliVolt
  compu method CM_BMC_CMC_Zellspannung_157: phys=raw+1000 for raw 0..4091, 4092=Cxffc_kleiner_1V (CM_BMC_CMC_Zellspannung_157_Cxffc_kleiner_1V), 4093=Cxffd_nicht_vorhanden (CM_BMC_CMC_Zellspannung_157_Cxffd_nicht_vorhanden), 4094=Cxffe_Init (CM_BMC_CMC_Zellspannung_157_Cxffe_Init), 4095=Cxfff_Fehler (CM_BMC_CMC_Zellspannung_157_Cxfff_Fehler); unit Unit_MilliVolt
  compu method CM_BMC_CMC_Zellspannung_089: phys=raw+1000 for raw 0..4091, 4092=Cxffc_kleiner_1V (CM_BMC_CMC_Zellspannung_089_Cxffc_kleiner_1V), 4093=Cxffd_nicht_vorhanden (CM_BMC_CMC_Zellspannung_089_Cxffd_nicht_vorhanden), 4094=Cxffe_Init (CM_BMC_CMC_Zellspannung_089_Cxffe_Init), 4095=Cxfff_Fehler (CM_BMC_CMC_Zellspannung_089_Cxfff_Fehler); unit Unit_MilliVolt
  compu method CM_DCDC_NV_CALID_Index_03: phys=raw for raw 0..255
  compu method CM_BMC_Pack_SN_24: 255=Cxff_Init (CM_BMC_Pack_SN_24_Cxff_Init)
  compu method CM_BMC_CMC_Temperatur_057: phys=raw*0.5-40 for raw 0..252, 253=Cxfd_nicht_vorhanden (CM_BMC_CMC_Temperatur_057_Cxfd_nicht_vorhanden), 254=Cxfe_Init (CM_BMC_CMC_Temperatur_057_Cxfe_Init), 255=Cxff_Fehler (CM_BMC_CMC_Temperatur_057_Cxff_Fehler); unit Unit_DegreCelsi
  compu method CM_DCDC_NV_Komponentenfehler_52: 0=Cx0_TstNotComplThisOpCycle_Init (CM_DCDC_NV_Komponentenfehler_52_Cx0_TstNotComplThisOpCycle_Init), 1=Cx1_TstComplThisOpCycle_Pass (CM_DCDC_NV_Komponentenfehler_52_Cx1_TstComplThisOpCycle_Pass), 2=Cx2_TstCmplThisCycle_Pass_TimeElapse (CM_DCDC_NV_Komponentenfehler_52_Cx2_TstCmplThisCycle_Pass_TimeElapse), 3=Cx3_TstComplThisOpCycle_FAIL (CM_DCDC_NV_Komponentenfehler_52_Cx3_TstComplThisOpCycle_FAIL)
  compu method CM_HVK_HVLM_Sollmodus: 0=Cx0_keine_Freigabe (CM_HVK_HVLM_Sollmodus_Cx0_keine_Freigabe), 1=Cx1_Freigabe_Lademanager (CM_HVK_HVLM_Sollmodus_Cx1_Freigabe_Lademanager), 2=Cx2_Vorladung_AC_Pfad (CM_HVK_HVLM_Sollmodus_Cx2_Vorladung_AC_Pfad), 7=Cx7_Init (CM_HVK_HVLM_Sollmodus_Cx7_Init)
  compu method CM_BMC_CMC_Zellspannung_158: phys=raw+1000 for raw 0..4091, 4092=Cxffc_kleiner_1V (CM_BMC_CMC_Zellspannung_158_Cxffc_kleiner_1V), 4093=Cxffd_nicht_vorhanden (CM_BMC_CMC_Zellspannung_158_Cxffd_nicht_vorhanden), 4094=Cxffe_Init (CM_BMC_CMC_Zellspannung_158_Cxffe_Init), 4095=Cxfff_Fehler (CM_BMC_CMC_Zellspannung_158_Cxfff_Fehler); unit Unit_MilliVolt
  compu method CM_BMC_CMC_Temperatur_076: phys=raw*0.5-40 for raw 0..252, 253=Cxfd_nicht_vorhanden (CM_BMC_CMC_Temperatur_076_Cxfd_nicht_vorhanden), 254=Cxfe_Init (CM_BMC_CMC_Temperatur_076_Cxfe_Init), 255=Cxff_Fehler (CM_BMC_CMC_Temperatur_076_Cxff_Fehler); unit Unit_DegreCelsi
  compu method CM_BMC_CMC_Zellspannung_045: phys=raw+1000 for raw 0..4091, 4092=Cxffc_kleiner_1V (CM_BMC_CMC_Zellspannung_045_Cxffc_kleiner_1V), 4093=Cxffd_nicht_vorhanden (CM_BMC_CMC_Zellspannung_045_Cxffd_nicht_vorhanden), 4094=Cxffe_Init (CM_BMC_CMC_Zellspannung_045_Cxffe_Init), 4095=Cxfff_Fehler (CM_BMC_CMC_Zellspannung_045_Cxfff_Fehler); unit Unit_MilliVolt
  compu method CM_BMC_CMC_Zellspannung_090: phys=raw+1000 for raw 0..4091, 4092=Cxffc_kleiner_1V (CM_BMC_CMC_Zellspannung_090_Cxffc_kleiner_1V), 4093=Cxffd_nicht_vorhanden (CM_BMC_CMC_Zellspannung_090_Cxffd_nicht_vorhanden), 4094=Cxffe_Init (CM_BMC_CMC_Zellspannung_090_Cxffe_Init), 4095=Cxfff_Fehler (CM_BMC_CMC_Zellspannung_090_Cxfff_Fehler); unit Unit_MilliVolt
  compu method CM_HVEM_ETM_Max_Ladeleistung: phys=raw*100 for raw 0..8189, 8190=Cx1ffe_Init (CM_HVEM_ETM_Max_Ladeleistung_Cx1ffe_Init), 8191=Cx1fff_Fehler (CM_HVEM_ETM_Max_Ladeleistung_Cx1fff_Fehler); unit Unit_Watt
  compu method CM_DCDC_NV_CALID_Index_04: phys=raw for raw 0..255
  compu method CM_BMC_Pack_SN_25: 255=Cxff_Init (CM_BMC_Pack_SN_25_Cxff_Init)
  compu method CM_BMC_CMC_Zellspannung_159: phys=raw+1000 for raw 0..4091, 4092=Cxffc_kleiner_1V (CM_BMC_CMC_Zellspannung_159_Cxffc_kleiner_1V), 4093=Cxffd_nicht_vorhanden (CM_BMC_CMC_Zellspannung_159_Cxffd_nicht_vorhanden), 4094=Cxffe_Init (CM_BMC_CMC_Zellspannung_159_Cxffe_Init), 4095=Cxfff_Fehler (CM_BMC_CMC_Zellspannung_159_Cxfff_Fehler); unit Unit_MilliVolt
  compu method CM_HVK_Iso_Messung_Start: 0=Cx0_keine_Messung (CM_HVK_Iso_Messung_Start_Cx0_keine_Messung), 1=Cx1_Messung_HV_Netz_1 (CM_HVK_Iso_Messung_Start_Cx1_Messung_HV_Netz_1), 2=Cx2_Messung_HV_Netz_2 (CM_HVK_Iso_Messung_Start_Cx2_Messung_HV_Netz_2), 4=Cx4_deaktiviert (CM_HVK_Iso_Messung_Start_Cx4_deaktiviert)
  compu method CM_BMC_CMC_Temperatur_058: phys=raw*0.5-40 for raw 0..252, 253=Cxfd_nicht_vorhanden (CM_BMC_CMC_Temperatur_058_Cxfd_nicht_vorhanden), 254=Cxfe_Init (CM_BMC_CMC_Temperatur_058_Cxfe_Init), 255=Cxff_Fehler (CM_BMC_CMC_Temperatur_058_Cxff_Fehler); unit Unit_DegreCelsi
  compu method CM_BMC_CMC_Zellspannung_046: phys=raw+1000 for raw 0..4091, 4092=Cxffc_kleiner_1V (CM_BMC_CMC_Zellspannung_046_Cxffc_kleiner_1V), 4093=Cxffd_nicht_vorhanden (CM_BMC_CMC_Zellspannung_046_Cxffd_nicht_vorhanden), 4094=Cxffe_Init (CM_BMC_CMC_Zellspannung_046_Cxffe_Init), 4095=Cxfff_Fehler (CM_BMC_CMC_Zellspannung_046_Cxfff_Fehler); unit Unit_MilliVolt
  compu method CM_BMC_CMC_Zellspannung_091: phys=raw+1000 for raw 0..4091, 4092=Cxffc_kleiner_1V (CM_BMC_CMC_Zellspannung_091_Cxffc_kleiner_1V), 4093=Cxffd_nicht_vorhanden (CM_BMC_CMC_Zellspannung_091_Cxffd_nicht_vorhanden), 4094=Cxffe_Init (CM_BMC_CMC_Zellspannung_091_Cxffe_Init), 4095=Cxfff_Fehler (CM_BMC_CMC_Zellspannung_091_Cxfff_Fehler); unit Unit_MilliVolt
  compu method CM_HVK_Istmodus_Anf: 0=Cx0_nicht_angefordert (CM_HVK_Istmodus_Anf_Cx0_nicht_angefordert), 1=Cx1_angefordert (CM_HVK_Istmodus_Anf_Cx1_angefordert)
  compu method CM_DCDC_NV_Komponentenfehler_53: 0=Cx0_TstNotComplThisOpCycle_Init (CM_DCDC_NV_Komponentenfehler_53_Cx0_TstNotComplThisOpCycle_Init), 1=Cx1_TstComplThisOpCycle_Pass (CM_DCDC_NV_Komponentenfehler_53_Cx1_TstComplThisOpCycle_Pass), 2=Cx2_TstCmplThisCycle_Pass_TimeElapse (CM_DCDC_NV_Komponentenfehler_53_Cx2_TstCmplThisCycle_Pass_TimeElapse), 3=Cx3_TstComplThisOpCycle_FAIL (CM_DCDC_NV_Komponentenfehler_53_Cx3_TstComplThisOpCycle_FAIL)
  compu method CM_DCDC_NV_CALID_Index_05: phys=raw for raw 0..255
  compu method CM_BMC_Pack_SN_26: 255=Cxff_Init (CM_BMC_Pack_SN_26_Cxff_Init)
  compu method CM_BMC_CMC_Zellspannung_160: phys=raw+1000 for raw 0..4091, 4092=Cxffc_kleiner_1V (CM_BMC_CMC_Zellspannung_160_Cxffc_kleiner_1V), 4093=Cxffd_nicht_vorhanden (CM_BMC_CMC_Zellspannung_160_Cxffd_nicht_vorhanden), 4094=Cxffe_Init (CM_BMC_CMC_Zellspannung_160_Cxffe_Init), 4095=Cxfff_Fehler (CM_BMC_CMC_Zellspannung_160_Cxfff_Fehler); unit Unit_MilliVolt
  compu method CM_BMC_CMC_Temperatur_077: phys=raw*0.5-40 for raw 0..252, 253=Cxfd_nicht_vorhanden (CM_BMC_CMC_Temperatur_077_Cxfd_nicht_vorhanden), 254=Cxfe_Init (CM_BMC_CMC_Temperatur_077_Cxfe_Init), 255=Cxff_Fehler (CM_BMC_CMC_Temperatur_077_Cxff_Fehler); unit Unit_DegreCelsi
  compu method CM_BMC_CMC_Temperatur_059: phys=raw*0.5-40 for raw 0..252, 253=Cxfd_nicht_vorhanden (CM_BMC_CMC_Temperatur_059_Cxfd_nicht_vorhanden), 254=Cxfe_Init (CM_BMC_CMC_Temperatur_059_Cxfe_Init), 255=Cxff_Fehler (CM_BMC_CMC_Temperatur_059_Cxff_Fehler); unit Unit_DegreCelsi
  compu method CM_AB_Abschaltanf_SIH_BF: 0=Cx0_Normalbetrieb (CM_AB_Abschaltanf_SIH_BF_Cx0_Normalbetrieb), 1=Cx1_Abschaltung_angefordert (CM_AB_Abschaltanf_SIH_BF_Cx1_Abschaltung_angefordert)
  compu method CM_HVEM_ETM_Max_Ladeleistung_02: phys=raw*100 for raw 0..32500, 32766=Cx7ffe_Init (CM_HVEM_ETM_Max_Ladeleistung_02_Cx7ffe_Init), 32767=Cx7fff_Fehler (CM_HVEM_ETM_Max_Ladeleistung_02_Cx7fff_Fehler); unit Unit_Watt
  compu method CM_HVK_Vorladung_aktiv: 0=Cx0_Vorladung_nicht_aktiv (CM_HVK_Vorladung_aktiv_Cx0_Vorladung_nicht_aktiv), 1=Cx1_Vorladung_aktiv (CM_HVK_Vorladung_aktiv_Cx1_Vorladung_aktiv)
  compu method CM_BMC_CMC_Zellspannung_161: phys=raw+1000 for raw 0..4091, 4092=Cxffc_kleiner_1V (CM_BMC_CMC_Zellspannung_161_Cxffc_kleiner_1V), 4093=Cxffd_nicht_vorhanden (CM_BMC_CMC_Zellspannung_161_Cxffd_nicht_vorhanden), 4094=Cxffe_Init (CM_BMC_CMC_Zellspannung_161_Cxffe_Init), 4095=Cxfff_Fehler (CM_BMC_CMC_Zellspannung_161_Cxfff_Fehler); unit Unit_MilliVolt
  compu method CM_BMC_CMC_Zellspannung_047: phys=raw+1000 for raw 0..4091, 4092=Cxffc_kleiner_1V (CM_BMC_CMC_Zellspannung_047_Cxffc_kleiner_1V), 4093=Cxffd_nicht_vorhanden (CM_BMC_CMC_Zellspannung_047_Cxffd_nicht_vorhanden), 4094=Cxffe_Init (CM_BMC_CMC_Zellspannung_047_Cxffe_Init), 4095=Cxfff_Fehler (CM_BMC_CMC_Zellspannung_047_Cxfff_Fehler); unit Unit_MilliVolt
  compu method CM_BMC_PCM_VTD_Freeze_Req: 0=Cx0_NoResetResponse (CM_BMC_PCM_VTD_Freeze_Req_Cx0_NoResetResponse), 1=Cx1_ResetResponse (CM_BMC_PCM_VTD_Freeze_Req_Cx1_ResetResponse), 2=Cx2_Init (CM_BMC_PCM_VTD_Freeze_Req_Cx2_Init), 3=Cx3_Fehler (CM_BMC_PCM_VTD_Freeze_Req_Cx3_Fehler)
  compu method CM_DCDC_NV_CALID_Index_06: phys=raw for raw 0..255
  compu method CM_BMC_CMC_Zellspannung_092: phys=raw+1000 for raw 0..4091, 4092=Cxffc_kleiner_1V (CM_BMC_CMC_Zellspannung_092_Cxffc_kleiner_1V), 4093=Cxffd_nicht_vorhanden (CM_BMC_CMC_Zellspannung_092_Cxffd_nicht_vorhanden), 4094=Cxffe_Init (CM_BMC_CMC_Zellspannung_092_Cxffe_Init), 4095=Cxfff_Fehler (CM_BMC_CMC_Zellspannung_092_Cxfff_Fehler); unit Unit_MilliVolt
  compu method CM_HVLE_AnzahlVerwendeterPhasen: 0=Cx0_eine_phase_verwendet (CM_HVLE_AnzahlVerwendeterPhasen_Cx0_eine_phase_verwendet), 1=Cx1_zwei_phasen_verwendet (CM_HVLE_AnzahlVerwendeterPhasen_Cx1_zwei_phasen_verwendet), 2=Cx2_drei_phasen_verwendet (CM_HVLE_AnzahlVerwendeterPhasen_Cx2_drei_phasen_verwendet), 3=Cx3_Fehler (CM_HVLE_AnzahlVerwendeterPhasen_Cx3_Fehler)
  compu method CM_BMC_CMC_Zellspannung_162: phys=raw+1000 for raw 0..4091, 4092=Cxffc_kleiner_1V (CM_BMC_CMC_Zellspannung_162_Cxffc_kleiner_1V), 4093=Cxffd_nicht_vorhanden (CM_BMC_CMC_Zellspannung_162_Cxffd_nicht_vorhanden), 4094=Cxffe_Init (CM_BMC_CMC_Zellspannung_162_Cxffe_Init), 4095=Cxfff_Fehler (CM_BMC_CMC_Zellspannung_162_Cxfff_Fehler); unit Unit_MilliVolt
  compu method CM_BMC_CMC_Temperatur_060: phys=raw*0.5-40 for raw 0..252, 253=Cxfd_nicht_vorhanden (CM_BMC_CMC_Temperatur_060_Cxfd_nicht_vorhanden), 254=Cxfe_Init (CM_BMC_CMC_Temperatur_060_Cxfe_Init), 255=Cxff_Fehler (CM_BMC_CMC_Temperatur_060_Cxff_Fehler); unit Unit_DegreCelsi
  compu method CM_BMC_CMC_Zellspannung_048: phys=raw+1000 for raw 0..4091, 4092=Cxffc_kleiner_1V (CM_BMC_CMC_Zellspannung_048_Cxffc_kleiner_1V), 4093=Cxffd_nicht_vorhanden (CM_BMC_CMC_Zellspannung_048_Cxffd_nicht_vorhanden), 4094=Cxffe_Init (CM_BMC_CMC_Zellspannung_048_Cxffe_Init), 4095=Cxfff_Fehler (CM_BMC_CMC_Zellspannung_048_Cxfff_Fehler); unit Unit_MilliVolt
  compu method CM_BMC_PCM_VTD_LifeTimeReset_Req: 0=Cx0_NoResetResponse (CM_BMC_PCM_VTD_LifeTimeReset_Req_Cx0_NoResetResponse), 1=Cx1_ResetResponse (CM_BMC_PCM_VTD_LifeTimeReset_Req_Cx1_ResetResponse), 2=Cx2_Init (CM_BMC_PCM_VTD_LifeTimeReset_Req_Cx2_Init), 3=Cx3_Fehler (CM_BMC_PCM_VTD_LifeTimeReset_Req_Cx3_Fehler)
  compu method CM_BMC_CMC_Zellspannung_093: phys=raw+1000 for raw 0..4091, 4092=Cxffc_kleiner_1V (CM_BMC_CMC_Zellspannung_093_Cxffc_kleiner_1V), 4093=Cxffd_nicht_vorhanden (CM_BMC_CMC_Zellspannung_093_Cxffd_nicht_vorhanden), 4094=Cxffe_Init (CM_BMC_CMC_Zellspannung_093_Cxffe_Init), 4095=Cxfff_Fehler (CM_BMC_CMC_Zellspannung_093_Cxfff_Fehler); unit Unit_MilliVolt
  compu method CM_DCDC_NV_CALID_Index_07: phys=raw for raw 0..255
  compu method CM_BMC_CMC_Zellspannung_163: phys=raw+1000 for raw 0..4091, 4092=Cxffc_kleiner_1V (CM_BMC_CMC_Zellspannung_163_Cxffc_kleiner_1V), 4093=Cxffd_nicht_vorhanden (CM_BMC_CMC_Zellspannung_163_Cxffd_nicht_vorhanden), 4094=Cxffe_Init (CM_BMC_CMC_Zellspannung_163_Cxffe_Init), 4095=Cxfff_Fehler (CM_BMC_CMC_Zellspannung_163_Cxfff_Fehler); unit Unit_MilliVolt
  compu method CM_DCDC_NV_Komponentenfehler_54: 0=Cx0_TstNotComplThisOpCycle_Init (CM_DCDC_NV_Komponentenfehler_54_Cx0_TstNotComplThisOpCycle_Init), 1=Cx1_TstComplThisOpCycle_Pass (CM_DCDC_NV_Komponentenfehler_54_Cx1_TstComplThisOpCycle_Pass), 2=Cx2_TstCmplThisCycle_Pass_TimeElapse (CM_DCDC_NV_Komponentenfehler_54_Cx2_TstCmplThisCycle_Pass_TimeElapse), 3=Cx3_TstComplThisOpCycle_FAIL (CM_DCDC_NV_Komponentenfehler_54_Cx3_TstComplThisOpCycle_FAIL)
  compu method CM_BMC_CMC_Temperatur_061: phys=raw*0.5-40 for raw 0..252, 253=Cxfd_nicht_vorhanden (CM_BMC_CMC_Temperatur_061_Cxfd_nicht_vorhanden), 254=Cxfe_Init (CM_BMC_CMC_Temperatur_061_Cxfe_Init), 255=Cxff_Fehler (CM_BMC_CMC_Temperatur_061_Cxff_Fehler); unit Unit_DegreCelsi
  compu method CM_HVEM_ETM_Max_Leistung_Verteiler: phys=raw*50 for raw 0..1021, 1022=Cx3fe_Init (CM_HVEM_ETM_Max_Leistung_Verteiler_Cx3fe_Init), 1023=Cx3ff_Fehler (CM_HVEM_ETM_Max_Leistung_Verteiler_Cx3ff_Fehler); unit Unit_Watt
  compu method CM_HVLE_AsymmetrischLadenMoeglich: 0=Cx0_moeglich (CM_HVLE_AsymmetrischLadenMoeglich_Cx0_moeglich), 1=Cx1_nicht_moeglich (CM_HVLE_AsymmetrischLadenMoeglich_Cx1_nicht_moeglich)
  compu method CM_BMC_CMC_Temperatur_078: phys=raw*0.5-40 for raw 0..252, 253=Cxfd_nicht_vorhanden (CM_BMC_CMC_Temperatur_078_Cxfd_nicht_vorhanden), 254=Cxfe_Init (CM_BMC_CMC_Temperatur_078_Cxfe_Init), 255=Cxff_Fehler (CM_BMC_CMC_Temperatur_078_Cxff_Fehler); unit Unit_DegreCelsi
  compu method CM_BMC_CMC_Zellspannung_049: phys=raw+1000 for raw 0..4091, 4092=Cxffc_kleiner_1V (CM_BMC_CMC_Zellspannung_049_Cxffc_kleiner_1V), 4093=Cxffd_nicht_vorhanden (CM_BMC_CMC_Zellspannung_049_Cxffd_nicht_vorhanden), 4094=Cxffe_Init (CM_BMC_CMC_Zellspannung_049_Cxffe_Init), 4095=Cxfff_Fehler (CM_BMC_CMC_Zellspannung_049_Cxfff_Fehler); unit Unit_MilliVolt
  compu method CM_BMC_CMC_Zellspannung_164: phys=raw+1000 for raw 0..4091, 4092=Cxffc_kleiner_1V (CM_BMC_CMC_Zellspannung_164_Cxffc_kleiner_1V), 4093=Cxffd_nicht_vorhanden (CM_BMC_CMC_Zellspannung_164_Cxffd_nicht_vorhanden), 4094=Cxffe_Init (CM_BMC_CMC_Zellspannung_164_Cxffe_Init), 4095=Cxfff_Fehler (CM_BMC_CMC_Zellspannung_164_Cxfff_Fehler); unit Unit_MilliVolt
  compu method CM_BMC_CMC_Zellspannung_094: phys=raw+1000 for raw 0..4091, 4092=Cxffc_kleiner_1V (CM_BMC_CMC_Zellspannung_094_Cxffc_kleiner_1V), 4093=Cxffd_nicht_vorhanden (CM_BMC_CMC_Zellspannung_094_Cxffd_nicht_vorhanden), 4094=Cxffe_Init (CM_BMC_CMC_Zellspannung_094_Cxffe_Init), 4095=Cxfff_Fehler (CM_BMC_CMC_Zellspannung_094_Cxfff_Fehler); unit Unit_MilliVolt
  compu method CM_DCDC_NV_CALID_Index_08: phys=raw for raw 0..255
  compu method CM_BMC_PCM_VTD_LifeTimeReset_Resp: 0=Cx0_NoResetResponse (CM_BMC_PCM_VTD_LifeTimeReset_Resp_Cx0_NoResetResponse), 1=Cx1_ResetResponse (CM_BMC_PCM_VTD_LifeTimeReset_Resp_Cx1_ResetResponse), 2=Cx2_Init (CM_BMC_PCM_VTD_LifeTimeReset_Resp_Cx2_Init), 3=Cx3_Fehler (CM_BMC_PCM_VTD_LifeTimeReset_Resp_Cx3_Fehler)
  compu method CM_HVLE_Derating_Temperatur: 0=Cx0_kein_Derating_aktiv (CM_HVLE_Derating_Temperatur_Cx0_kein_Derating_aktiv), 1=Cx1_Derating_aktiv (CM_HVLE_Derating_Temperatur_Cx1_Derating_aktiv)
  compu method CM_BMC_CMC_Temperatur_062: phys=raw*0.5-40 for raw 0..252, 253=Cxfd_nicht_vorhanden (CM_BMC_CMC_Temperatur_062_Cxfd_nicht_vorhanden), 254=Cxfe_Init (CM_BMC_CMC_Temperatur_062_Cxfe_Init), 255=Cxff_Fehler (CM_BMC_CMC_Temperatur_062_Cxff_Fehler); unit Unit_DegreCelsi
  compu method CM_AB_Anzeige_Fussg: 0=Cx0_keine_FSG_Aktion_ausgeloest (CM_AB_Anzeige_Fussg_Cx0_keine_FSG_Aktion_ausgeloest), 1=Cx1_Motorhaube_offen (CM_AB_Anzeige_Fussg_Cx1_Motorhaube_offen), 2=Cx2_Systemfehler (CM_AB_Anzeige_Fussg_Cx2_Systemfehler)
  compu method CM_BMC_CMC_Zellspannung_04_Messzeit: phys=raw for raw 0..253, 254=Cxfe_Init (CM_BMC_CMC_Zellspannung_04_Messzeit_Cxfe_Init), 255=Cxff_Fehler (CM_BMC_CMC_Zellspannung_04_Messzeit_Cxff_Fehler); unit Unit_None
  compu method CM_BMC_CMC_Zellspannung_165: phys=raw+1000 for raw 0..4091, 4092=Cxffc_kleiner_1V (CM_BMC_CMC_Zellspannung_165_Cxffc_kleiner_1V), 4093=Cxffd_nicht_vorhanden (CM_BMC_CMC_Zellspannung_165_Cxffd_nicht_vorhanden), 4094=Cxffe_Init (CM_BMC_CMC_Zellspannung_165_Cxffe_Init), 4095=Cxfff_Fehler (CM_BMC_CMC_Zellspannung_165_Cxfff_Fehler); unit Unit_MilliVolt
  compu method CM_BMC_CMC_Zellspannung_095: phys=raw+1000 for raw 0..4091, 4092=Cxffc_kleiner_1V (CM_BMC_CMC_Zellspannung_095_Cxffc_kleiner_1V), 4093=Cxffd_nicht_vorhanden (CM_BMC_CMC_Zellspannung_095_Cxffd_nicht_vorhanden), 4094=Cxffe_Init (CM_BMC_CMC_Zellspannung_095_Cxffe_Init), 4095=Cxfff_Fehler (CM_BMC_CMC_Zellspannung_095_Cxfff_Fehler); unit Unit_MilliVolt
  compu method CM_HVLE_Energiemenge_Laden: phys=raw*40 for raw 0..16370; unit Unit_WattHour
  compu method CM_DCDC_NV_Komponentenfehler_55: 0=Cx0_TstNotComplThisOpCycle_Init (CM_DCDC_NV_Komponentenfehler_55_Cx0_TstNotComplThisOpCycle_Init), 1=Cx1_TstComplThisOpCycle_Pass (CM_DCDC_NV_Komponentenfehler_55_Cx1_TstComplThisOpCycle_Pass), 2=Cx2_TstCmplThisCycle_Pass_TimeElapse (CM_DCDC_NV_Komponentenfehler_55_Cx2_TstCmplThisCycle_Pass_TimeElapse), 3=Cx3_TstComplThisOpCycle_FAIL (CM_DCDC_NV_Komponentenfehler_55_Cx3_TstComplThisOpCycle_FAIL)
  compu method CM_DCDC_NV_CALID_Index_09: phys=raw for raw 0..255
  compu method CM_HVEM_IstLeistung_HVVerbraucher: phys=raw*50-102300 for raw 0..4093, 4094=Cxffe_Init (CM_HVEM_IstLeistung_HVVerbraucher_Cxffe_Init), 4095=Cxfff_Fehler (CM_HVEM_IstLeistung_HVVerbraucher_Cxfff_Fehler); unit Unit_Watt
  compu method CM_BMC_PCM_VTD_RecentReset_Req: 0=Cx0_NoResetResponse (CM_BMC_PCM_VTD_RecentReset_Req_Cx0_NoResetResponse), 1=Cx1_ResetResponse (CM_BMC_PCM_VTD_RecentReset_Req_Cx1_ResetResponse), 2=Cx2_Init (CM_BMC_PCM_VTD_RecentReset_Req_Cx2_Init), 3=Cx3_Fehler (CM_BMC_PCM_VTD_RecentReset_Req_Cx3_Fehler)
  compu method CM_BMC_CMC_Temperatur_079: phys=raw*0.5-40 for raw 0..252, 253=Cxfd_nicht_vorhanden (CM_BMC_CMC_Temperatur_079_Cxfd_nicht_vorhanden), 254=Cxfe_Init (CM_BMC_CMC_Temperatur_079_Cxfe_Init), 255=Cxff_Fehler (CM_BMC_CMC_Temperatur_079_Cxff_Fehler); unit Unit_DegreCelsi
  compu method CM_BMC_CMC_Temperatur_063: phys=raw*0.5-40 for raw 0..252, 253=Cxfd_nicht_vorhanden (CM_BMC_CMC_Temperatur_063_Cxfd_nicht_vorhanden), 254=Cxfe_Init (CM_BMC_CMC_Temperatur_063_Cxfe_Init), 255=Cxff_Fehler (CM_BMC_CMC_Temperatur_063_Cxff_Fehler); unit Unit_DegreCelsi
  compu method CM_BMC_CMC_Zellspannung_166: phys=raw+1000 for raw 0..4091, 4092=Cxffc_kleiner_1V (CM_BMC_CMC_Zellspannung_166_Cxffc_kleiner_1V), 4093=Cxffd_nicht_vorhanden (CM_BMC_CMC_Zellspannung_166_Cxffd_nicht_vorhanden), 4094=Cxffe_Init (CM_BMC_CMC_Zellspannung_166_Cxffe_Init), 4095=Cxfff_Fehler (CM_BMC_CMC_Zellspannung_166_Cxfff_Fehler); unit Unit_MilliVolt
  compu method CM_HVLE_I_istAC_Netz_L1: phys=raw*0.1 for raw 0..508, 509=Cx1fd_nicht_vorhanden (CM_HVLE_I_istAC_Netz_L1_Cx1fd_nicht_vorhanden), 510=Cx1fe_Init (CM_HVLE_I_istAC_Netz_L1_Cx1fe_Init), 511=Cx1ff_Fehler (CM_HVLE_I_istAC_Netz_L1_Cx1ff_Fehler); unit Unit_Amper
  compu method CM_BMC_CMC_Zellspannung_050: phys=raw+1000 for raw 0..4091, 4092=Cxffc_kleiner_1V (CM_BMC_CMC_Zellspannung_050_Cxffc_kleiner_1V), 4093=Cxffd_nicht_vorhanden (CM_BMC_CMC_Zellspannung_050_Cxffd_nicht_vorhanden), 4094=Cxffe_Init (CM_BMC_CMC_Zellspannung_050_Cxffe_Init), 4095=Cxfff_Fehler (CM_BMC_CMC_Zellspannung_050_Cxfff_Fehler); unit Unit_MilliVolt
  compu method CM_BMC_CMC_Zellspannung_096: phys=raw+1000 for raw 0..4091, 4092=Cxffc_kleiner_1V (CM_BMC_CMC_Zellspannung_096_Cxffc_kleiner_1V), 4093=Cxffd_nicht_vorhanden (CM_BMC_CMC_Zellspannung_096_Cxffd_nicht_vorhanden), 4094=Cxffe_Init (CM_BMC_CMC_Zellspannung_096_Cxffe_Init), 4095=Cxfff_Fehler (CM_BMC_CMC_Zellspannung_096_Cxfff_Fehler); unit Unit_MilliVolt
  compu method CM_DCDC_NV_CALID_Index_10: phys=raw for raw 0..255
  compu method CM_BMC_CMC_Zellspannung_167: phys=raw+1000 for raw 0..4091, 4092=Cxffc_kleiner_1V (CM_BMC_CMC_Zellspannung_167_Cxffc_kleiner_1V), 4093=Cxffd_nicht_vorhanden (CM_BMC_CMC_Zellspannung_167_Cxffd_nicht_vorhanden), 4094=Cxffe_Init (CM_BMC_CMC_Zellspannung_167_Cxffe_Init), 4095=Cxfff_Fehler (CM_BMC_CMC_Zellspannung_167_Cxfff_Fehler); unit Unit_MilliVolt
  compu method CM_BMC_PerfInd_Entladen: phys=raw*0.2 for raw 0..1021, 1022=Cx3fe_Init (CM_BMC_PerfInd_Entladen_Cx3fe_Init), 1023=Cx3ff_Fehler (CM_BMC_PerfInd_Entladen_Cx3ff_Fehler); unit Unit_PerCent
  compu method CM_HVLE_I_istAC_Netz_L2: phys=raw*0.1 for raw 0..508, 509=Cx1fd_nicht_vorhanden (CM_HVLE_I_istAC_Netz_L2_Cx1fd_nicht_vorhanden), 510=Cx1fe_Init (CM_HVLE_I_istAC_Netz_L2_Cx1fe_Init), 511=Cx1ff_Fehler (CM_HVLE_I_istAC_Netz_L2_Cx1ff_Fehler); unit Unit_Amper
  compu method CM_BMC_CMC_Temperatur_064: phys=raw*0.5-40 for raw 0..252, 253=Cxfd_nicht_vorhanden (CM_BMC_CMC_Temperatur_064_Cxfd_nicht_vorhanden), 254=Cxfe_Init (CM_BMC_CMC_Temperatur_064_Cxfe_Init), 255=Cxff_Fehler (CM_BMC_CMC_Temperatur_064_Cxff_Fehler); unit Unit_DegreCelsi
  compu method CM_DCDC_NV_Komponentenfehler_56: 0=Cx0_TstNotComplThisOpCycle_Init (CM_DCDC_NV_Komponentenfehler_56_Cx0_TstNotComplThisOpCycle_Init), 1=Cx1_TstComplThisOpCycle_Pass (CM_DCDC_NV_Komponentenfehler_56_Cx1_TstComplThisOpCycle_Pass), 2=Cx2_TstCmplThisCycle_Pass_TimeElapse (CM_DCDC_NV_Komponentenfehler_56_Cx2_TstCmplThisCycle_Pass_TimeElapse), 3=Cx3_TstComplThisOpCycle_FAIL (CM_DCDC_NV_Komponentenfehler_56_Cx3_TstComplThisOpCycle_FAIL)
  compu method CM_AB_Belegung_VB: 0=Cx0_nicht_verfuegbar (CM_AB_Belegung_VB_Cx0_nicht_verfuegbar), 1=Cx1_Fehler (CM_AB_Belegung_VB_Cx1_Fehler), 2=Cx2_nicht_belegt (CM_AB_Belegung_VB_Cx2_nicht_belegt), 3=Cx3_belegt (CM_AB_Belegung_VB_Cx3_belegt)
  compu method CM_HVEM_IstStrom_HVVerbraucher: phys=raw*0.1-204.7 for raw 0..4093, 4094=Cxffe_Init (CM_HVEM_IstStrom_HVVerbraucher_Cxffe_Init), 4095=Cxfff_Fehler (CM_HVEM_IstStrom_HVVerbraucher_Cxfff_Fehler); unit Unit_Amper
  compu method CM_BMC_CMC_Zellspannung_168: phys=raw+1000 for raw 0..4091, 4092=Cxffc_kleiner_1V (CM_BMC_CMC_Zellspannung_168_Cxffc_kleiner_1V), 4093=Cxffd_nicht_vorhanden (CM_BMC_CMC_Zellspannung_168_Cxffd_nicht_vorhanden), 4094=Cxffe_Init (CM_BMC_CMC_Zellspannung_168_Cxffe_Init), 4095=Cxfff_Fehler (CM_BMC_CMC_Zellspannung_168_Cxfff_Fehler); unit Unit_MilliVolt
  compu method CM_BMC_CMC_Zellspannung_051: phys=raw+1000 for raw 0..4091, 4092=Cxffc_kleiner_1V (CM_BMC_CMC_Zellspannung_051_Cxffc_kleiner_1V), 4093=Cxffd_nicht_vorhanden (CM_BMC_CMC_Zellspannung_051_Cxffd_nicht_vorhanden), 4094=Cxffe_Init (CM_BMC_CMC_Zellspannung_051_Cxffe_Init), 4095=Cxfff_Fehler (CM_BMC_CMC_Zellspannung_051_Cxfff_Fehler); unit Unit_MilliVolt
  compu method CM_BMC_CMC_Temperatur_080: phys=raw*0.5-40 for raw 0..252, 253=Cxfd_nicht_vorhanden (CM_BMC_CMC_Temperatur_080_Cxfd_nicht_vorhanden), 254=Cxfe_Init (CM_BMC_CMC_Temperatur_080_Cxfe_Init), 255=Cxff_Fehler (CM_BMC_CMC_Temperatur_080_Cxff_Fehler); unit Unit_DegreCelsi
  compu method CM_DCDC_NV_CALID_Index_11: phys=raw for raw 0..255
  compu method CM_BMC_PerfInd_Laden: phys=raw*0.2 for raw 0..1021, 1022=Cx3fe_Init (CM_BMC_PerfInd_Laden_Cx3fe_Init), 1023=Cx3ff_Fehler (CM_BMC_PerfInd_Laden_Cx3ff_Fehler); unit Unit_PerCent
  compu method CM_HVLE_I_istAC_Netz_L3: phys=raw*0.1 for raw 0..508, 509=Cx1fd_nicht_vorhanden (CM_HVLE_I_istAC_Netz_L3_Cx1fd_nicht_vorhanden), 510=Cx1fe_Init (CM_HVLE_I_istAC_Netz_L3_Cx1fe_Init), 511=Cx1ff_Fehler (CM_HVLE_I_istAC_Netz_L3_Cx1ff_Fehler); unit Unit_Amper
  compu method CM_BMC_CMC_Zellspannung_097: phys=raw+1000 for raw 0..4091, 4092=Cxffc_kleiner_1V (CM_BMC_CMC_Zellspannung_097_Cxffc_kleiner_1V), 4093=Cxffd_nicht_vorhanden (CM_BMC_CMC_Zellspannung_097_Cxffd_nicht_vorhanden), 4094=Cxffe_Init (CM_BMC_CMC_Zellspannung_097_Cxffe_Init), 4095=Cxfff_Fehler (CM_BMC_CMC_Zellspannung_097_Cxfff_Fehler); unit Unit_MilliVolt
  compu method CM_BMC_CMC_Zellspannung_169: phys=raw+1000 for raw 0..4091, 4092=Cxffc_kleiner_1V (CM_BMC_CMC_Zellspannung_169_Cxffc_kleiner_1V), 4093=Cxffd_nicht_vorhanden (CM_BMC_CMC_Zellspannung_169_Cxffd_nicht_vorhanden), 4094=Cxffe_Init (CM_BMC_CMC_Zellspannung_169_Cxffe_Init), 4095=Cxfff_Fehler (CM_BMC_CMC_Zellspannung_169_Cxfff_Fehler); unit Unit_MilliVolt
  compu method CM_BMC_CMC_Temperatur_065: phys=raw*0.5-40 for raw 0..252, 253=Cxfd_nicht_vorhanden (CM_BMC_CMC_Temperatur_065_Cxfd_nicht_vorhanden), 254=Cxfe_Init (CM_BMC_CMC_Temperatur_065_Cxfe_Init), 255=Cxff_Fehler (CM_BMC_CMC_Temperatur_065_Cxff_Fehler); unit Unit_DegreCelsi
  compu method CM_BMC_CMC_Zellspannung_052: phys=raw+1000 for raw 0..4091, 4092=Cxffc_kleiner_1V (CM_BMC_CMC_Zellspannung_052_Cxffc_kleiner_1V), 4093=Cxffd_nicht_vorhanden (CM_BMC_CMC_Zellspannung_052_Cxffd_nicht_vorhanden), 4094=Cxffe_Init (CM_BMC_CMC_Zellspannung_052_Cxffe_Init), 4095=Cxfff_Fehler (CM_BMC_CMC_Zellspannung_052_Cxfff_Fehler); unit Unit_MilliVolt
  compu method CM_DCDC_NV_CALID_Index_12: phys=raw for raw 0..255
  compu method CM_BMC_PredLeistung_StuetzungNV: phys=raw*200 for raw 0..4092, 4093=Cxffd_keine_Berechnung (CM_BMC_PredLeistung_StuetzungNV_Cxffd_keine_Berechnung) (keine Berechnung), 4094=Cxffe_Init (CM_BMC_PredLeistung_StuetzungNV_Cxffe_Init), 4095=Cxfff_Fehler (CM_BMC_PredLeistung_StuetzungNV_Cxfff_Fehler); unit Unit_Watt
  compu method CM_HVLE_Ist_Wirkungsgrad: phys=raw for raw 0..100, 126=Cx7e_Init (CM_HVLE_Ist_Wirkungsgrad_Cx7e_Init), 127=Cx7f_Fehler (CM_HVLE_Ist_Wirkungsgrad_Cx7f_Fehler); unit Unit_PerCent
  compu method CM_DCDC_NV_Komponentenfehler_57: 0=Cx0_TstNotComplThisOpCycle_Init (CM_DCDC_NV_Komponentenfehler_57_Cx0_TstNotComplThisOpCycle_Init), 1=Cx1_TstComplThisOpCycle_Pass (CM_DCDC_NV_Komponentenfehler_57_Cx1_TstComplThisOpCycle_Pass), 2=Cx2_TstCmplThisCycle_Pass_TimeElapse (CM_DCDC_NV_Komponentenfehler_57_Cx2_TstCmplThisCycle_Pass_TimeElapse), 3=Cx3_TstComplThisOpCycle_FAIL (CM_DCDC_NV_Komponentenfehler_57_Cx3_TstComplThisOpCycle_FAIL)
  compu method CM_HVEM_Leistungsvorhalt_Entladen: phys=raw*50-51100 for raw 0..2045, 2046=Cx7fe_Init (CM_HVEM_Leistungsvorhalt_Entladen_Cx7fe_Init), 2047=Cx7ff_Fehler (CM_HVEM_Leistungsvorhalt_Entladen_Cx7ff_Fehler); unit Unit_Watt
  compu method CM_BMC_CMC_Zellspannung_098: phys=raw+1000 for raw 0..4091, 4092=Cxffc_kleiner_1V (CM_BMC_CMC_Zellspannung_098_Cxffc_kleiner_1V), 4093=Cxffd_nicht_vorhanden (CM_BMC_CMC_Zellspannung_098_Cxffd_nicht_vorhanden), 4094=Cxffe_Init (CM_BMC_CMC_Zellspannung_098_Cxffe_Init), 4095=Cxfff_Fehler (CM_BMC_CMC_Zellspannung_098_Cxfff_Fehler); unit Unit_MilliVolt
  compu method CM_BMC_CMC_Temperatur_066: phys=raw*0.5-40 for raw 0..252, 253=Cxfd_nicht_vorhanden (CM_BMC_CMC_Temperatur_066_Cxfd_nicht_vorhanden), 254=Cxfe_Init (CM_BMC_CMC_Temperatur_066_Cxfe_Init), 255=Cxff_Fehler (CM_BMC_CMC_Temperatur_066_Cxff_Fehler); unit Unit_DegreCelsi
  compu method CM_BMC_CMC_Zellspannung_170: phys=raw+1000 for raw 0..4091, 4092=Cxffc_kleiner_1V (CM_BMC_CMC_Zellspannung_170_Cxffc_kleiner_1V), 4093=Cxffd_nicht_vorhanden (CM_BMC_CMC_Zellspannung_170_Cxffd_nicht_vorhanden), 4094=Cxffe_Init (CM_BMC_CMC_Zellspannung_170_Cxffe_Init), 4095=Cxfff_Fehler (CM_BMC_CMC_Zellspannung_170_Cxfff_Fehler); unit Unit_MilliVolt
  compu method CM_AB_Belegung_VF: 0=Cx0_nicht_verfuegbar (CM_AB_Belegung_VF_Cx0_nicht_verfuegbar), 1=Cx1_Fehler (CM_AB_Belegung_VF_Cx1_Fehler), 2=Cx2_nicht_belegt (CM_AB_Belegung_VF_Cx2_nicht_belegt), 3=Cx3_belegt (CM_AB_Belegung_VF_Cx3_belegt)
  compu method CM_BMC_CMC_Temperatur_081: phys=raw*0.5-40 for raw 0..252, 253=Cxfd_nicht_vorhanden (CM_BMC_CMC_Temperatur_081_Cxfd_nicht_vorhanden), 254=Cxfe_Init (CM_BMC_CMC_Temperatur_081_Cxfe_Init), 255=Cxff_Fehler (CM_BMC_CMC_Temperatur_081_Cxff_Fehler); unit Unit_DegreCelsi
  compu method CM_BMC_CMC_Zellspannung_053: phys=raw+1000 for raw 0..4091, 4092=Cxffc_kleiner_1V (CM_BMC_CMC_Zellspannung_053_Cxffc_kleiner_1V), 4093=Cxffd_nicht_vorhanden (CM_BMC_CMC_Zellspannung_053_Cxffd_nicht_vorhanden), 4094=Cxffe_Init (CM_BMC_CMC_Zellspannung_053_Cxffe_Init), 4095=Cxfff_Fehler (CM_BMC_CMC_Zellspannung_053_Cxfff_Fehler); unit Unit_MilliVolt
  compu method CM_HVLE_IstSpannung_HV: phys=raw for raw 0..1021, 1022=Cx3fe_Init (CM_HVLE_IstSpannung_HV_Cx3fe_Init), 1023=Cx3ff_Fehler (CM_HVLE_IstSpannung_HV_Cx3ff_Fehler); unit Unit_Volt
  compu method CM_DCDC_NV_CALID_Index_13: phys=raw for raw 0..255
  compu method CM_BMC_CMC_Zellspannung_171: phys=raw+1000 for raw 0..4091, 4092=Cxffc_kleiner_1V (CM_BMC_CMC_Zellspannung_171_Cxffc_kleiner_1V), 4093=Cxffd_nicht_vorhanden (CM_BMC_CMC_Zellspannung_171_Cxffd_nicht_vorhanden), 4094=Cxffe_Init (CM_BMC_CMC_Zellspannung_171_Cxffe_Init), 4095=Cxfff_Fehler (CM_BMC_CMC_Zellspannung_171_Cxfff_Fehler); unit Unit_MilliVolt
  compu method CM_BMC_Range_Indikator: phys=raw*0.05 for raw 0..2000, 2042=Cx7fa_Funktion_nicht_umgesetzt (CM_BMC_Range_Indikator_Cx7fa_Funktion_nicht_umgesetzt), 2043=Cx7fb_kleiner_0 (CM_BMC_Range_Indikator_Cx7fb_kleiner_0), 2044=Cx7fc_groesser_100 (CM_BMC_Range_Indikator_Cx7fc_groesser_100), 2045=Cx7fd_nicht_angelernt (CM_BMC_Range_Indikator_Cx7fd_nicht_angelernt), 2046=Cx7fe_Init (CM_BMC_Range_Indikator_Cx7fe_Init), 2047=Cx7ff_Fehler (CM_BMC_Range_Indikator_Cx7ff_Fehler); unit Unit_PerCent
  compu method CM_BMC_CMC_Zellspannung_099: phys=raw+1000 for raw 0..4091, 4092=Cxffc_kleiner_1V (CM_BMC_CMC_Zellspannung_099_Cxffc_kleiner_1V), 4093=Cxffd_nicht_vorhanden (CM_BMC_CMC_Zellspannung_099_Cxffd_nicht_vorhanden), 4094=Cxffe_Init (CM_BMC_CMC_Zellspannung_099_Cxffe_Init), 4095=Cxfff_Fehler (CM_BMC_CMC_Zellspannung_099_Cxfff_Fehler); unit Unit_MilliVolt
  compu method CM_BMC_CMC_Temperatur_067: phys=raw*0.5-40 for raw 0..252, 253=Cxfd_nicht_vorhanden (CM_BMC_CMC_Temperatur_067_Cxfd_nicht_vorhanden), 254=Cxfe_Init (CM_BMC_CMC_Temperatur_067_Cxfe_Init), 255=Cxff_Fehler (CM_BMC_CMC_Temperatur_067_Cxff_Fehler); unit Unit_DegreCelsi
  compu method CM_HVLE_Netzfrequenz_EVU: phys=raw*0.1+40 for raw 0..400, 509=Cx1fd_kein_Frequenz_erkannt (CM_HVLE_Netzfrequenz_EVU_Cx1fd_kein_Frequenz_erkannt), 510=Cx1fe_Init (CM_HVLE_Netzfrequenz_EVU_Cx1fe_Init), 511=Cx1ff_Fehler (CM_HVLE_Netzfrequenz_EVU_Cx1ff_Fehler); unit Unit_Hertz
  compu method CM_DCDC_NV_Komponentenfehler_58: 0=Cx0_TstNotComplThisOpCycle_Init (CM_DCDC_NV_Komponentenfehler_58_Cx0_TstNotComplThisOpCycle_Init), 1=Cx1_TstComplThisOpCycle_Pass (CM_DCDC_NV_Komponentenfehler_58_Cx1_TstComplThisOpCycle_Pass), 2=Cx2_TstCmplThisCycle_Pass_TimeElapse (CM_DCDC_NV_Komponentenfehler_58_Cx2_TstCmplThisCycle_Pass_TimeElapse), 3=Cx3_TstComplThisOpCycle_FAIL (CM_DCDC_NV_Komponentenfehler_58_Cx3_TstComplThisOpCycle_FAIL)
  compu method CM_BMC_CMC_Zellspannung_172: phys=raw+1000 for raw 0..4091, 4092=Cxffc_kleiner_1V (CM_BMC_CMC_Zellspannung_172_Cxffc_kleiner_1V), 4093=Cxffd_nicht_vorhanden (CM_BMC_CMC_Zellspannung_172_Cxffd_nicht_vorhanden), 4094=Cxffe_Init (CM_BMC_CMC_Zellspannung_172_Cxffe_Init), 4095=Cxfff_Fehler (CM_BMC_CMC_Zellspannung_172_Cxfff_Fehler); unit Unit_MilliVolt
  compu method CM_BMC_CMC_Zellspannung_054: phys=raw+1000 for raw 0..4091, 4092=Cxffc_kleiner_1V (CM_BMC_CMC_Zellspannung_054_Cxffc_kleiner_1V), 4093=Cxffd_nicht_vorhanden (CM_BMC_CMC_Zellspannung_054_Cxffd_nicht_vorhanden), 4094=Cxffe_Init (CM_BMC_CMC_Zellspannung_054_Cxffe_Init), 4095=Cxfff_Fehler (CM_BMC_CMC_Zellspannung_054_Cxfff_Fehler); unit Unit_MilliVolt
  compu method CM_DCDC_NV_CALID_Index_14: phys=raw for raw 0..255
  compu method CM_HVEM_Leistungsvorhalt_Laden: phys=raw*50-51100 for raw 0..2045, 2046=Cx7fe_Init (CM_HVEM_Leistungsvorhalt_Laden_Cx7fe_Init), 2047=Cx7ff_Fehler (CM_HVEM_Leistungsvorhalt_Laden_Cx7ff_Fehler); unit Unit_Watt
  compu method CM_AB_Belegung_VF_ext: 0=Cx0_nicht_verbaut (CM_AB_Belegung_VF_ext_Cx0_nicht_verbaut), 1=Cx1_reserviert (CM_AB_Belegung_VF_ext_Cx1_reserviert), 2=Cx2_nicht_belegt (CM_AB_Belegung_VF_ext_Cx2_nicht_belegt), 3=Cx3_belegt (CM_AB_Belegung_VF_ext_Cx3_belegt), 4=Cx4_dauerhaft_nicht_belegt (CM_AB_Belegung_VF_ext_Cx4_dauerhaft_nicht_belegt), 5=Cx5_dauerhaft_belegt (CM_AB_Belegung_VF_ext_Cx5_dauerhaft_belegt), 6=Cx6_Init (CM_AB_Belegung_VF_ext_Cx6_Init), 7=Cx7_Fehler (CM_AB_Belegung_VF_ext_Cx7_Fehler)
  compu method CM_HVLE_Netzmodus: 0=Cx0_Init (CM_HVLE_Netzmodus_Cx0_Init), 1=Cx1_no_grid (CM_HVLE_Netzmodus_Cx1_no_grid), 2=Cx2_one_phase_L1 (CM_HVLE_Netzmodus_Cx2_one_phase_L1), 3=Cx3_one_phase_not_L1 (CM_HVLE_Netzmodus_Cx3_one_phase_not_L1), 4=Cx4_two_phase (CM_HVLE_Netzmodus_Cx4_two_phase), 5=Cx5_three_phase (CM_HVLE_Netzmodus_Cx5_three_phase), 6=Cx6_delta_grid (CM_HVLE_Netzmodus_Cx6_delta_grid), 7=Cx7_parallel_phases (CM_HVLE_Netzmodus_Cx7_parallel_phases), 15=Cxf_Fehler (CM_HVLE_Netzmodus_Cxf_Fehler)
  compu method CM_BMC_CMC_Temperatur_082: phys=raw*0.5-40 for raw 0..252, 253=Cxfd_nicht_vorhanden (CM_BMC_CMC_Temperatur_082_Cxfd_nicht_vorhanden), 254=Cxfe_Init (CM_BMC_CMC_Temperatur_082_Cxfe_Init), 255=Cxff_Fehler (CM_BMC_CMC_Temperatur_082_Cxff_Fehler); unit Unit_DegreCelsi
  compu method CM_BMC_CMC_Zellspannung_100: phys=raw+1000 for raw 0..4091, 4092=Cxffc_kleiner_1V (CM_BMC_CMC_Zellspannung_100_Cxffc_kleiner_1V), 4093=Cxffd_nicht_vorhanden (CM_BMC_CMC_Zellspannung_100_Cxffd_nicht_vorhanden), 4094=Cxffe_Init (CM_BMC_CMC_Zellspannung_100_Cxffe_Init), 4095=Cxfff_Fehler (CM_BMC_CMC_Zellspannung_100_Cxfff_Fehler); unit Unit_MilliVolt
  compu method CM_BMC_Rekuperation: phys=raw*10 for raw 0..65535; unit Unit_WattSecond
  compu method CM_BMC_CMC_Temperatur_068: phys=raw*0.5-40 for raw 0..252, 253=Cxfd_nicht_vorhanden (CM_BMC_CMC_Temperatur_068_Cxfd_nicht_vorhanden), 254=Cxfe_Init (CM_BMC_CMC_Temperatur_068_Cxfe_Init), 255=Cxff_Fehler (CM_BMC_CMC_Temperatur_068_Cxff_Fehler); unit Unit_DegreCelsi
  compu method CM_BMC_CMC_Zellspannung_173: phys=raw+1000 for raw 0..4091, 4092=Cxffc_kleiner_1V (CM_BMC_CMC_Zellspannung_173_Cxffc_kleiner_1V), 4093=Cxffd_nicht_vorhanden (CM_BMC_CMC_Zellspannung_173_Cxffd_nicht_vorhanden), 4094=Cxffe_Init (CM_BMC_CMC_Zellspannung_173_Cxffe_Init), 4095=Cxfff_Fehler (CM_BMC_CMC_Zellspannung_173_Cxfff_Fehler); unit Unit_MilliVolt
  compu method CM_BMC_CMC_Zellspannung_055: phys=raw+1000 for raw 0..4091, 4092=Cxffc_kleiner_1V (CM_BMC_CMC_Zellspannung_055_Cxffc_kleiner_1V), 4093=Cxffd_nicht_vorhanden (CM_BMC_CMC_Zellspannung_055_Cxffd_nicht_vorhanden), 4094=Cxffe_Init (CM_BMC_CMC_Zellspannung_055_Cxffe_Init), 4095=Cxfff_Fehler (CM_BMC_CMC_Zellspannung_055_Cxfff_Fehler); unit Unit_MilliVolt
  compu method CM_DCDC_NV_CALID_Index_15: phys=raw for raw 0..255
  compu method CM_BMC_CMC_Zellspannung_174: phys=raw+1000 for raw 0..4091, 4092=Cxffc_kleiner_1V (CM_BMC_CMC_Zellspannung_174_Cxffc_kleiner_1V), 4093=Cxffd_nicht_vorhanden (CM_BMC_CMC_Zellspannung_174_Cxffd_nicht_vorhanden), 4094=Cxffe_Init (CM_BMC_CMC_Zellspannung_174_Cxffe_Init), 4095=Cxfff_Fehler (CM_BMC_CMC_Zellspannung_174_Cxfff_Fehler); unit Unit_MilliVolt
  compu method CM_HVLE_OBG_AC_maxSpannung: phys=raw for raw 0..1000, 1022=Cx3fe_Init (CM_HVLE_OBG_AC_maxSpannung_Cx3fe_Init), 1023=Cx3ff_Fehler (CM_HVLE_OBG_AC_maxSpannung_Cx3ff_Fehler); unit Unit_Volt
  compu method CM_BMC_CMC_Zellspannung_101: phys=raw+1000 for raw 0..4091, 4092=Cxffc_kleiner_1V (CM_BMC_CMC_Zellspannung_101_Cxffc_kleiner_1V), 4093=Cxffd_nicht_vorhanden (CM_BMC_CMC_Zellspannung_101_Cxffd_nicht_vorhanden), 4094=Cxffe_Init (CM_BMC_CMC_Zellspannung_101_Cxffe_Init), 4095=Cxfff_Fehler (CM_BMC_CMC_Zellspannung_101_Cxfff_Fehler); unit Unit_MilliVolt
  compu method CM_BMC_CMC_Temperatur_069: phys=raw*0.5-40 for raw 0..252, 253=Cxfd_nicht_vorhanden (CM_BMC_CMC_Temperatur_069_Cxfd_nicht_vorhanden), 254=Cxfe_Init (CM_BMC_CMC_Temperatur_069_Cxfe_Init), 255=Cxff_Fehler (CM_BMC_CMC_Temperatur_069_Cxff_Fehler); unit Unit_DegreCelsi
  compu method CM_BMC_Rekuperation_Ueberlauf: 0=Cx0_kein_Ueberlauf (CM_BMC_Rekuperation_Ueberlauf_Cx0_kein_Ueberlauf), 1=Cx1_Ueberlauf (CM_BMC_Rekuperation_Ueberlauf_Cx1_Ueberlauf)
  compu method CM_DCDC_NV_Komponentenfehler_59: 0=Cx0_TstNotComplThisOpCycle_Init (CM_DCDC_NV_Komponentenfehler_59_Cx0_TstNotComplThisOpCycle_Init), 1=Cx1_TstComplThisOpCycle_Pass (CM_DCDC_NV_Komponentenfehler_59_Cx1_TstComplThisOpCycle_Pass), 2=Cx2_TstCmplThisCycle_Pass_TimeElapse (CM_DCDC_NV_Komponentenfehler_59_Cx2_TstCmplThisCycle_Pass_TimeElapse), 3=Cx3_TstComplThisOpCycle_FAIL (CM_DCDC_NV_Komponentenfehler_59_Cx3_TstComplThisOpCycle_FAIL)
  compu method CM_AB_Belegung_VF_ext_aktiv: 0=Cx0_inaktiv (CM_AB_Belegung_VF_ext_aktiv_Cx0_inaktiv), 1=Cx1_aktiv (CM_AB_Belegung_VF_ext_aktiv_Cx1_aktiv)
  compu method CM_HVLE_OBG_AC_maxStrom: phys=raw*0.1 for raw 0..1000, 1022=Cx3fe_Init (CM_HVLE_OBG_AC_maxStrom_Cx3fe_Init), 1023=Cx3ff_Fehler (CM_HVLE_OBG_AC_maxStrom_Cx3ff_Fehler); unit Unit_Amper
  compu method CM_HVEM_MMTR_State: 0=Cx0_Nicht_verfuegbar (CM_HVEM_MMTR_State_Cx0_Nicht_verfuegbar), 1=Cx1_Inaktiv (CM_HVEM_MMTR_State_Cx1_Inaktiv), 2=Cx2_Aktiv_Vorkonditionierung (CM_HVEM_MMTR_State_Cx2_Aktiv_Vorkonditionierung), 3=Cx3_Abgeschlossen_Vorkonditionierung (CM_HVEM_MMTR_State_Cx3_Abgeschlossen_Vorkonditionierung), 4=Cx4_Aktiv_TrackSession (CM_HVEM_MMTR_State_Cx4_Aktiv_TrackSession), 5=Cx5_Aktiv_Endurance (CM_HVEM_MMTR_State_Cx5_Aktiv_Endurance), 6=Cx6_Aktiv_HotLap (CM_HVEM_MMTR_State_Cx6_Aktiv_HotLap), 7=Cx7_Beendet_TrackSession (CM_HVEM_MMTR_State_Cx7_Beendet_TrackSession), 14=Cxe_Init (CM_HVEM_MMTR_State_Cxe_Init), 15=Cxf_Fehler (CM_HVEM_MMTR_State_Cxf_Fehler)
  compu method CM_BMC_CMC_Zellspannung_056: phys=raw+1000 for raw 0..4091, 4092=Cxffc_kleiner_1V (CM_BMC_CMC_Zellspannung_056_Cxffc_kleiner_1V), 4093=Cxffd_nicht_vorhanden (CM_BMC_CMC_Zellspannung_056_Cxffd_nicht_vorhanden), 4094=Cxffe_Init (CM_BMC_CMC_Zellspannung_056_Cxffe_Init), 4095=Cxfff_Fehler (CM_BMC_CMC_Zellspannung_056_Cxfff_Fehler); unit Unit_MilliVolt
  compu method CM_DCDC_NV_CALID_Index_16: phys=raw for raw 0..255
  compu method CM_BMC_CMC_Zellspannung_175: phys=raw+1000 for raw 0..4091, 4092=Cxffc_kleiner_1V (CM_BMC_CMC_Zellspannung_175_Cxffc_kleiner_1V), 4093=Cxffd_nicht_vorhanden (CM_BMC_CMC_Zellspannung_175_Cxffd_nicht_vorhanden), 4094=Cxffe_Init (CM_BMC_CMC_Zellspannung_175_Cxffe_Init), 4095=Cxfff_Fehler (CM_BMC_CMC_Zellspannung_175_Cxfff_Fehler); unit Unit_MilliVolt
  compu method CM_BMC_RtmWarnBattUnautorisiert: 0=Cx0_kein_Fehler (CM_BMC_RtmWarnBattUnautorisiert_Cx0_kein_Fehler), 1=Cx1_Fehler_Stufe_1 (CM_BMC_RtmWarnBattUnautorisiert_Cx1_Fehler_Stufe_1), 2=Cx2_Fehler_Stufe_2 (CM_BMC_RtmWarnBattUnautorisiert_Cx2_Fehler_Stufe_2), 3=Cx3_Fehler_Stufe_3 (CM_BMC_RtmWarnBattUnautorisiert_Cx3_Fehler_Stufe_3), 4=Cx4_reserviert (CM_BMC_RtmWarnBattUnautorisiert_Cx4_reserviert), 5=Cx5_reserviert (CM_BMC_RtmWarnBattUnautorisiert_Cx5_reserviert), 6=Cx6_reserviert (CM_BMC_RtmWarnBattUnautorisiert_Cx6_reserviert), 7=Cx7_reserviert (CM_BMC_RtmWarnBattUnautorisiert_Cx7_reserviert)
  compu method CM_BMC_CMC_Temperatur_083: phys=raw*0.5-40 for raw 0..252, 253=Cxfd_nicht_vorhanden (CM_BMC_CMC_Temperatur_083_Cxfd_nicht_vorhanden), 254=Cxfe_Init (CM_BMC_CMC_Temperatur_083_Cxfe_Init), 255=Cxff_Fehler (CM_BMC_CMC_Temperatur_083_Cxff_Fehler); unit Unit_DegreCelsi
  compu method CM_BMC_CMC_Zellspannung_102: phys=raw+1000 for raw 0..4091, 4092=Cxffc_kleiner_1V (CM_BMC_CMC_Zellspannung_102_Cxffc_kleiner_1V), 4093=Cxffd_nicht_vorhanden (CM_BMC_CMC_Zellspannung_102_Cxffd_nicht_vorhanden), 4094=Cxffe_Init (CM_BMC_CMC_Zellspannung_102_Cxffe_Init), 4095=Cxfff_Fehler (CM_BMC_CMC_Zellspannung_102_Cxfff_Fehler); unit Unit_MilliVolt
  compu method CM_HVLE_OBG_ACDC_IstLeistung: phys=raw*25 for raw 0..1800, 2046=Cx7fe_Init (CM_HVLE_OBG_ACDC_IstLeistung_Cx7fe_Init), 2047=Cx7ff_Fehler (CM_HVLE_OBG_ACDC_IstLeistung_Cx7ff_Fehler); unit Unit_Watt
  compu method CM_BMC_CMC_Temperatur_070: phys=raw*0.5-40 for raw 0..252, 253=Cxfd_nicht_vorhanden (CM_BMC_CMC_Temperatur_070_Cxfd_nicht_vorhanden), 254=Cxfe_Init (CM_BMC_CMC_Temperatur_070_Cxfe_Init), 255=Cxff_Fehler (CM_BMC_CMC_Temperatur_070_Cxff_Fehler); unit Unit_DegreCelsi
  compu method CM_BMC_CMC_Zellspannung_176: phys=raw+1000 for raw 0..4091, 4092=Cxffc_kleiner_1V (CM_BMC_CMC_Zellspannung_176_Cxffc_kleiner_1V), 4093=Cxffd_nicht_vorhanden (CM_BMC_CMC_Zellspannung_176_Cxffd_nicht_vorhanden), 4094=Cxffe_Init (CM_BMC_CMC_Zellspannung_176_Cxffe_Init), 4095=Cxfff_Fehler (CM_BMC_CMC_Zellspannung_176_Cxfff_Fehler); unit Unit_MilliVolt
  compu method CM_BMC_CMC_Zellspannung_057: phys=raw+1000 for raw 0..4091, 4092=Cxffc_kleiner_1V (CM_BMC_CMC_Zellspannung_057_Cxffc_kleiner_1V), 4093=Cxffd_nicht_vorhanden (CM_BMC_CMC_Zellspannung_057_Cxffd_nicht_vorhanden), 4094=Cxffe_Init (CM_BMC_CMC_Zellspannung_057_Cxffe_Init), 4095=Cxfff_Fehler (CM_BMC_CMC_Zellspannung_057_Cxfff_Fehler); unit Unit_MilliVolt
  compu method CM_BMC_CMC_Zellspannung_103: phys=raw+1000 for raw 0..4091, 4092=Cxffc_kleiner_1V (CM_BMC_CMC_Zellspannung_103_Cxffc_kleiner_1V), 4093=Cxffd_nicht_vorhanden (CM_BMC_CMC_Zellspannung_103_Cxffd_nicht_vorhanden), 4094=Cxffe_Init (CM_BMC_CMC_Zellspannung_103_Cxffe_Init), 4095=Cxfff_Fehler (CM_BMC_CMC_Zellspannung_103_Cxfff_Fehler); unit Unit_MilliVolt
  compu method CM_DCDC_NV_CVN_Byte_1: phys=raw for raw 0..255
  compu method CM_BMC_RtmWarnPackKommunikation: 0=Cx0_kein_Fehler (CM_BMC_RtmWarnPackKommunikation_Cx0_kein_Fehler), 1=Cx1_Fehler_Stufe_1 (CM_BMC_RtmWarnPackKommunikation_Cx1_Fehler_Stufe_1), 2=Cx2_Fehler_Stufe_2 (CM_BMC_RtmWarnPackKommunikation_Cx2_Fehler_Stufe_2), 3=Cx3_Fehler_Stufe_3 (CM_BMC_RtmWarnPackKommunikation_Cx3_Fehler_Stufe_3), 4=Cx4_reserviert (CM_BMC_RtmWarnPackKommunikation_Cx4_reserviert), 5=Cx5_reserviert (CM_BMC_RtmWarnPackKommunikation_Cx5_reserviert), 6=Cx6_reserviert (CM_BMC_RtmWarnPackKommunikation_Cx6_reserviert), 7=Cx7_reserviert (CM_BMC_RtmWarnPackKommunikation_Cx7_reserviert)
  compu method CM_HVLE_OBG_ACDC_MaxLeistung: phys=raw*25 for raw 0..1800, 2046=Cx7fe_Init (CM_HVLE_OBG_ACDC_MaxLeistung_Cx7fe_Init), 2047=Cx7ff_Fehler (CM_HVLE_OBG_ACDC_MaxLeistung_Cx7ff_Fehler); unit Unit_Watt
  compu method CM_AB_Crash_Int: 0=Cx0_kein_Crash (CM_AB_Crash_Int_Cx0_kein_Crash), 1=Cx1_Crash_Intensitaet_1 (CM_AB_Crash_Int_Cx1_Crash_Intensitaet_1), 2=Cx2_Crash_Intensitaet_2_nur_Stellgliedtest_MLB_B8 (CM_AB_Crash_Int_Cx2_Crash_Intensitaet_2_nur_Stellgliedtest_MLB_B8) (Crash_Intensitaet_2_(nur_Stellgliedtest_MLB_B8)), 3=Cx3_Crash_Intensitaet_2_nur_D4_C7_Colorado_NF_PAG_Crash_im_MLB_B8 (CM_AB_Crash_Int_Cx3_Crash_Intensitaet_2_nur_D4_C7_Colorado_NF_PAG_Crash_im_MLB_B8) (Crash_Intensitaet_2_(nur_D4_C7_Colorado_NF_PAG__Crash_im_MLB_B8)), 4=Cx4_Crash_Intensitaet_3_alt_VW_AUDI_Stellgliedtest_MLB_B8 (CM_AB_Crash_Int_Cx4_Crash_Intensitaet_3_alt_VW_AUDI_Stellgliedtest_MLB_B8) (Crash_Intensitaet_3_(alt_VW/AUDI__Stellgliedtest_MLB_B8)), 5=Cx5_Crash_Intensitaet_3_alt_PAG (CM_AB_Crash_Int_Cx5_Crash_Intensitaet_3_alt_PAG) (Crash_Intensitaet_3_(alt_PAG)), 7=Cx7_Crash_Intensitaet_3 (CM_AB_Crash_Int_Cx7_Crash_Intensitaet_3)
  compu method CM_DCDC_NV_Komponentenfehler_60: 0=Cx0_TstNotComplThisOpCycle_Init (CM_DCDC_NV_Komponentenfehler_60_Cx0_TstNotComplThisOpCycle_Init), 1=Cx1_TstComplThisOpCycle_Pass (CM_DCDC_NV_Komponentenfehler_60_Cx1_TstComplThisOpCycle_Pass), 2=Cx2_TstCmplThisCycle_Pass_TimeElapse (CM_DCDC_NV_Komponentenfehler_60_Cx2_TstCmplThisCycle_Pass_TimeElapse), 3=Cx3_TstComplThisOpCycle_FAIL (CM_DCDC_NV_Komponentenfehler_60_Cx3_TstComplThisOpCycle_FAIL)
  compu method CM_HVEM_Nachlad_Status: 0=Cx0_nicht_moeglich_Fehler (CM_HVEM_Nachlad_Status_Cx0_nicht_moeglich_Fehler) (nicht_moeglich__Fehler), 1=Cx1_moeglich_begonnen (CM_HVEM_Nachlad_Status_Cx1_moeglich_begonnen) (moeglich__begonnen), 2=Cx2_Beendet (CM_HVEM_Nachlad_Status_Cx2_Beendet), 3=Cx3_Init (CM_HVEM_Nachlad_Status_Cx3_Init)
  compu method CM_BMC_CMC_Temperatur_071: phys=raw*0.5-40 for raw 0..252, 253=Cxfd_nicht_vorhanden (CM_BMC_CMC_Temperatur_071_Cxfd_nicht_vorhanden), 254=Cxfe_Init (CM_BMC_CMC_Temperatur_071_Cxfe_Init), 255=Cxff_Fehler (CM_BMC_CMC_Temperatur_071_Cxff_Fehler); unit Unit_DegreCelsi
  compu method CM_BMC_CMC_Zellspannung_177: phys=raw+1000 for raw 0..4091, 4092=Cxffc_kleiner_1V (CM_BMC_CMC_Zellspannung_177_Cxffc_kleiner_1V), 4093=Cxffd_nicht_vorhanden (CM_BMC_CMC_Zellspannung_177_Cxffd_nicht_vorhanden), 4094=Cxffe_Init (CM_BMC_CMC_Zellspannung_177_Cxffe_Init), 4095=Cxfff_Fehler (CM_BMC_CMC_Zellspannung_177_Cxfff_Fehler); unit Unit_MilliVolt
  compu method CM_BMC_CMC_Temperatur_084: phys=raw*0.5-40 for raw 0..252, 253=Cxfd_nicht_vorhanden (CM_BMC_CMC_Temperatur_084_Cxfd_nicht_vorhanden), 254=Cxfe_Init (CM_BMC_CMC_Temperatur_084_Cxfe_Init), 255=Cxff_Fehler (CM_BMC_CMC_Temperatur_084_Cxff_Fehler); unit Unit_DegreCelsi
  compu method CM_BMC_CMC_Zellspannung_104: phys=raw+1000 for raw 0..4091, 4092=Cxffc_kleiner_1V (CM_BMC_CMC_Zellspannung_104_Cxffc_kleiner_1V), 4093=Cxffd_nicht_vorhanden (CM_BMC_CMC_Zellspannung_104_Cxffd_nicht_vorhanden), 4094=Cxffe_Init (CM_BMC_CMC_Zellspannung_104_Cxffe_Init), 4095=Cxfff_Fehler (CM_BMC_CMC_Zellspannung_104_Cxfff_Fehler); unit Unit_MilliVolt
  compu method CM_HVLE_OBG_DC_IstStrom: phys=raw*0.1 for raw 0..2045, 2046=Cx7fe_Init (CM_HVLE_OBG_DC_IstStrom_Cx7fe_Init), 2047=Cx7ff_Fehler (CM_HVLE_OBG_DC_IstStrom_Cx7ff_Fehler); unit Unit_Amper
  compu method CM_BMC_CMC_Zellspannung_058: phys=raw+1000 for raw 0..4091, 4092=Cxffc_kleiner_1V (CM_BMC_CMC_Zellspannung_058_Cxffc_kleiner_1V), 4093=Cxffd_nicht_vorhanden (CM_BMC_CMC_Zellspannung_058_Cxffd_nicht_vorhanden), 4094=Cxffe_Init (CM_BMC_CMC_Zellspannung_058_Cxffe_Init), 4095=Cxfff_Fehler (CM_BMC_CMC_Zellspannung_058_Cxfff_Fehler); unit Unit_MilliVolt
  compu method CM_DCDC_NV_CVN_Byte_2: phys=raw for raw 0..255
  compu method CM_DCDC_NV_Komponentenfehler_61: 0=Cx0_TstNotComplThisOpCycle_Init (CM_DCDC_NV_Komponentenfehler_61_Cx0_TstNotComplThisOpCycle_Init), 1=Cx1_TstComplThisOpCycle_Pass (CM_DCDC_NV_Komponentenfehler_61_Cx1_TstComplThisOpCycle_Pass), 2=Cx2_TstCmplThisCycle_Pass_TimeElapse (CM_DCDC_NV_Komponentenfehler_61_Cx2_TstCmplThisCycle_Pass_TimeElapse), 3=Cx3_TstComplThisOpCycle_FAIL (CM_DCDC_NV_Komponentenfehler_61_Cx3_TstComplThisOpCycle_FAIL)
  compu method CM_BMC_Dauer_Ladeleistung_02: phys=raw*200 for raw 0..16250, 16382=Cx3ffe_Init (CM_BMC_Dauer_Ladeleistung_02_Cx3ffe_Init), 16383=Cx3fff_Fehler (CM_BMC_Dauer_Ladeleistung_02_Cx3fff_Fehler); unit Unit_Watt
  compu method CM_BMC_CMC_Zellspannung_178: phys=raw+1000 for raw 0..4091, 4092=Cxffc_kleiner_1V (CM_BMC_CMC_Zellspannung_178_Cxffc_kleiner_1V), 4093=Cxffd_nicht_vorhanden (CM_BMC_CMC_Zellspannung_178_Cxffd_nicht_vorhanden), 4094=Cxffe_Init (CM_BMC_CMC_Zellspannung_178_Cxffe_Init), 4095=Cxfff_Fehler (CM_BMC_CMC_Zellspannung_178_Cxfff_Fehler); unit Unit_MilliVolt
  compu method CM_HVEM_Nachladen_Anf: 0=Cx0_keine_Anforderung (CM_HVEM_Nachladen_Anf_Cx0_keine_Anforderung), 1=Cx1_Nachladen_angefordert (CM_HVEM_Nachladen_Anf_Cx1_Nachladen_angefordert)
  compu method CM_BMC_CMC_Temperatur_072: phys=raw*0.5-40 for raw 0..252, 253=Cxfd_nicht_vorhanden (CM_BMC_CMC_Temperatur_072_Cxfd_nicht_vorhanden), 254=Cxfe_Init (CM_BMC_CMC_Temperatur_072_Cxfe_Init), 255=Cxff_Fehler (CM_BMC_CMC_Temperatur_072_Cxff_Fehler); unit Unit_DegreCelsi
  compu method CM_BMC_RtmWarnPackUeberladen: 0=Cx0_kein_Fehler (CM_BMC_RtmWarnPackUeberladen_Cx0_kein_Fehler), 1=Cx1_Fehler_Stufe_1 (CM_BMC_RtmWarnPackUeberladen_Cx1_Fehler_Stufe_1), 2=Cx2_Fehler_Stufe_2 (CM_BMC_RtmWarnPackUeberladen_Cx2_Fehler_Stufe_2), 3=Cx3_Fehler_Stufe_3 (CM_BMC_RtmWarnPackUeberladen_Cx3_Fehler_Stufe_3), 4=Cx4_reserviert (CM_BMC_RtmWarnPackUeberladen_Cx4_reserviert), 5=Cx5_reserviert (CM_BMC_RtmWarnPackUeberladen_Cx5_reserviert), 6=Cx6_reserviert (CM_BMC_RtmWarnPackUeberladen_Cx6_reserviert), 7=Cx7_reserviert (CM_BMC_RtmWarnPackUeberladen_Cx7_reserviert)
  compu method CM_BMC_CMC_Temperatur_085: phys=raw*0.5-40 for raw 0..252, 253=Cxfd_nicht_vorhanden (CM_BMC_CMC_Temperatur_085_Cxfd_nicht_vorhanden), 254=Cxfe_Init (CM_BMC_CMC_Temperatur_085_Cxfe_Init), 255=Cxff_Fehler (CM_BMC_CMC_Temperatur_085_Cxff_Fehler); unit Unit_DegreCelsi
  compu method CM_BMC_CMC_Zellspannung_179: phys=raw+1000 for raw 0..4091, 4092=Cxffc_kleiner_1V (CM_BMC_CMC_Zellspannung_179_Cxffc_kleiner_1V), 4093=Cxffd_nicht_vorhanden (CM_BMC_CMC_Zellspannung_179_Cxffd_nicht_vorhanden), 4094=Cxffe_Init (CM_BMC_CMC_Zellspannung_179_Cxffe_Init), 4095=Cxfff_Fehler (CM_BMC_CMC_Zellspannung_179_Cxfff_Fehler); unit Unit_MilliVolt
  compu method CM_HVLE_OBG_DC_MaxStrom: phys=raw*0.1 for raw 0..2045, 2046=Cx7fe_Init (CM_HVLE_OBG_DC_MaxStrom_Cx7fe_Init), 2047=Cx7ff_Fehler (CM_HVLE_OBG_DC_MaxStrom_Cx7ff_Fehler); unit Unit_Amper
  compu method CM_DCDC_NV_CVN_Byte_3: phys=raw for raw 0..255
  compu method CM_BMC_CMC_Zellspannung_105: phys=raw+1000 for raw 0..4091, 4092=Cxffc_kleiner_1V (CM_BMC_CMC_Zellspannung_105_Cxffc_kleiner_1V), 4093=Cxffd_nicht_vorhanden (CM_BMC_CMC_Zellspannung_105_Cxffd_nicht_vorhanden), 4094=Cxffe_Init (CM_BMC_CMC_Zellspannung_105_Cxffe_Init), 4095=Cxfff_Fehler (CM_BMC_CMC_Zellspannung_105_Cxfff_Fehler); unit Unit_MilliVolt
  compu method CM_BMC_CMC_Zellspannung_059: phys=raw+1000 for raw 0..4091, 4092=Cxffc_kleiner_1V (CM_BMC_CMC_Zellspannung_059_Cxffc_kleiner_1V), 4093=Cxffd_nicht_vorhanden (CM_BMC_CMC_Zellspannung_059_Cxffd_nicht_vorhanden), 4094=Cxffe_Init (CM_BMC_CMC_Zellspannung_059_Cxffe_Init), 4095=Cxfff_Fehler (CM_BMC_CMC_Zellspannung_059_Cxfff_Fehler); unit Unit_MilliVolt
  compu method CM_DCDC_NV_Komponentenfehler_62: 0=Cx0_TstNotComplThisOpCycle_Init (CM_DCDC_NV_Komponentenfehler_62_Cx0_TstNotComplThisOpCycle_Init), 1=Cx1_TstComplThisOpCycle_Pass (CM_DCDC_NV_Komponentenfehler_62_Cx1_TstComplThisOpCycle_Pass), 2=Cx2_TstCmplThisCycle_Pass_TimeElapse (CM_DCDC_NV_Komponentenfehler_62_Cx2_TstCmplThisCycle_Pass_TimeElapse), 3=Cx3_TstComplThisOpCycle_FAIL (CM_DCDC_NV_Komponentenfehler_62_Cx3_TstComplThisOpCycle_FAIL)
  compu method CM_BMC_CMC_Temperatur_073: phys=raw*0.5-40 for raw 0..252, 253=Cxfd_nicht_vorhanden (CM_BMC_CMC_Temperatur_073_Cxfd_nicht_vorhanden), 254=Cxfe_Init (CM_BMC_CMC_Temperatur_073_Cxfe_Init), 255=Cxff_Fehler (CM_BMC_CMC_Temperatur_073_Cxff_Fehler); unit Unit_DegreCelsi
  compu method CM_HVEM_StCpbDrv: 0=Cx0_Init (CM_HVEM_StCpbDrv_Cx0_Init), 1=Cx1_erweiterte_Performance_verfuegbar (CM_HVEM_StCpbDrv_Cx1_erweiterte_Performance_verfuegbar) (erweiterte_Performance_verfügbar), 2=Cx2_normale_Performance_verfuegbar (CM_HVEM_StCpbDrv_Cx2_normale_Performance_verfuegbar) (normale_Performance_verfügbar), 3=Cx3_geringfuegige_Leistungseinschraenkung (CM_HVEM_StCpbDrv_Cx3_geringfuegige_Leistungseinschraenkung) (geringfügige_Leistungseinschränkung), 4=Cx4_Warnung_erhebliche_Leistungseinschraenkung (CM_HVEM_StCpbDrv_Cx4_Warnung_erhebliche_Leistungseinschraenkung) (Warnung_erhebliche_Leistungseinschränkung), 5=Cx5_Fehler_schwerwiegende_Leistungseinschraenkung (CM_HVEM_StCpbDrv_Cx5_Fehler_schwerwiegende_Leistungseinschraenkung) (Fehler_schwerwiegende_Leistungseinschränkung)
  compu method CM_BMC_RtmWarnSocHoch: 0=Cx0_kein_Fehler (CM_BMC_RtmWarnSocHoch_Cx0_kein_Fehler), 1=Cx1_Fehler_Stufe_1 (CM_BMC_RtmWarnSocHoch_Cx1_Fehler_Stufe_1), 2=Cx2_Fehler_Stufe_2 (CM_BMC_RtmWarnSocHoch_Cx2_Fehler_Stufe_2), 3=Cx3_Fehler_Stufe_3 (CM_BMC_RtmWarnSocHoch_Cx3_Fehler_Stufe_3), 4=Cx4_reserviert (CM_BMC_RtmWarnSocHoch_Cx4_reserviert), 5=Cx5_reserviert (CM_BMC_RtmWarnSocHoch_Cx5_reserviert), 6=Cx6_reserviert (CM_BMC_RtmWarnSocHoch_Cx6_reserviert), 7=Cx7_reserviert (CM_BMC_RtmWarnSocHoch_Cx7_reserviert)
  compu method CM_HVLE_OBG_Fehlerstatus: 0=Cx0_kein_Fehler_aktiv (CM_HVLE_OBG_Fehlerstatus_Cx0_kein_Fehler_aktiv), 1=Cx1_Fehler_aktiv_Laden_beendet (CM_HVLE_OBG_Fehlerstatus_Cx1_Fehler_aktiv_Laden_beendet)
  compu method CM_BMC_CMC_Zellspannung_180: phys=raw+1000 for raw 0..4091, 4092=Cxffc_kleiner_1V (CM_BMC_CMC_Zellspannung_180_Cxffc_kleiner_1V), 4093=Cxffd_nicht_vorhanden (CM_BMC_CMC_Zellspannung_180_Cxffd_nicht_vorhanden), 4094=Cxffe_Init (CM_BMC_CMC_Zellspannung_180_Cxffe_Init), 4095=Cxfff_Fehler (CM_BMC_CMC_Zellspannung_180_Cxfff_Fehler); unit Unit_MilliVolt
  compu method CM_AB_DeltaV_X_eCall: 0=Cx0_Init_no_DeltaV_X_detected (CM_AB_DeltaV_X_eCall_Cx0_Init_no_DeltaV_X_detected) (Init/no_DeltaV_X_detected), 1=Cx1_DeltaV_X_less_than_neg126km_h (CM_AB_DeltaV_X_eCall_Cx1_DeltaV_X_less_than_neg126km_h) (DeltaV_X_less_than_neg126km/h), phys=raw-128 for raw 2..254, 255=Cxff_DeltaV_X_larger_than_pos126km_h (CM_AB_DeltaV_X_eCall_Cxff_DeltaV_X_larger_than_pos126km_h) (DeltaV_X_larger_than_pos126km/h); unit Unit_KiloMeterPerHour
  compu method CM_BMC_CMC_Temperatur_086: phys=raw*0.5-40 for raw 0..252, 253=Cxfd_nicht_vorhanden (CM_BMC_CMC_Temperatur_086_Cxfd_nicht_vorhanden), 254=Cxfe_Init (CM_BMC_CMC_Temperatur_086_Cxfe_Init), 255=Cxff_Fehler (CM_BMC_CMC_Temperatur_086_Cxff_Fehler); unit Unit_DegreCelsi
  compu method CM_BMC_CMC_Zellspannung_106: phys=raw+1000 for raw 0..4091, 4092=Cxffc_kleiner_1V (CM_BMC_CMC_Zellspannung_106_Cxffc_kleiner_1V), 4093=Cxffd_nicht_vorhanden (CM_BMC_CMC_Zellspannung_106_Cxffd_nicht_vorhanden), 4094=Cxffe_Init (CM_BMC_CMC_Zellspannung_106_Cxffe_Init), 4095=Cxfff_Fehler (CM_BMC_CMC_Zellspannung_106_Cxfff_Fehler); unit Unit_MilliVolt
  compu method CM_HVLE_OBG_Fehlerstrom: 0=Cx0_Kein_Fehlerstrom (CM_HVLE_OBG_Fehlerstrom_Cx0_Kein_Fehlerstrom), 1=Cx1_Fehlerstrom (CM_HVLE_OBG_Fehlerstrom_Cx1_Fehlerstrom)
  compu method CM_BMC_CMC_Zellspannung_181: phys=raw+1000 for raw 0..4091, 4092=Cxffc_kleiner_1V (CM_BMC_CMC_Zellspannung_181_Cxffc_kleiner_1V), 4093=Cxffd_nicht_vorhanden (CM_BMC_CMC_Zellspannung_181_Cxffd_nicht_vorhanden), 4094=Cxffe_Init (CM_BMC_CMC_Zellspannung_181_Cxffe_Init), 4095=Cxfff_Fehler (CM_BMC_CMC_Zellspannung_181_Cxfff_Fehler); unit Unit_MilliVolt
  compu method CM_DCDC_NV_CVN_Byte_4: phys=raw for raw 0..255
  compu method CM_BMC_CMC_Zellspannung_05_Messzeit: phys=raw for raw 0..253, 254=Cxfe_Init (CM_BMC_CMC_Zellspannung_05_Messzeit_Cxfe_Init), 255=Cxff_Fehler (CM_BMC_CMC_Zellspannung_05_Messzeit_Cxff_Fehler); unit Unit_None
  compu method CM_BMC_RtmWarnSocNiedrig: 0=Cx0_kein_Fehler (CM_BMC_RtmWarnSocNiedrig_Cx0_kein_Fehler), 1=Cx1_Fehler_Stufe_1 (CM_BMC_RtmWarnSocNiedrig_Cx1_Fehler_Stufe_1), 2=Cx2_Fehler_Stufe_2 (CM_BMC_RtmWarnSocNiedrig_Cx2_Fehler_Stufe_2), 3=Cx3_Fehler_Stufe_3 (CM_BMC_RtmWarnSocNiedrig_Cx3_Fehler_Stufe_3), 4=Cx4_reserviert (CM_BMC_RtmWarnSocNiedrig_Cx4_reserviert), 5=Cx5_reserviert (CM_BMC_RtmWarnSocNiedrig_Cx5_reserviert), 6=Cx6_reserviert (CM_BMC_RtmWarnSocNiedrig_Cx6_reserviert), 7=Cx7_reserviert (CM_BMC_RtmWarnSocNiedrig_Cx7_reserviert)
  compu method CM_HVLE_OBG_IstModus: 0=Cx0_Standby (CM_HVLE_OBG_IstModus_Cx0_Standby), 1=Cx1_Netzladung_aktiv (CM_HVLE_OBG_IstModus_Cx1_Netzladung_aktiv), 2=Cx2_Rueckspeisung_aktiv (CM_HVLE_OBG_IstModus_Cx2_Rueckspeisung_aktiv), 3=Cx3_Vorladen_aktiv (CM_HVLE_OBG_IstModus_Cx3_Vorladen_aktiv), 4=Cx4_Vorladespannung_erreicht_und_halten (CM_HVLE_OBG_IstModus_Cx4_Vorladespannung_erreicht_und_halten), 5=Cx5_reserve (CM_HVLE_OBG_IstModus_Cx5_reserve), 6=Cx6_Init (CM_HVLE_OBG_IstModus_Cx6_Init), 7=Cx7_Fehler (CM_HVLE_OBG_IstModus_Cx7_Fehler)
  compu method CM_DCDC_NV_Komponentenfehler_63: 0=Cx0_TstNotComplThisOpCycle_Init (CM_DCDC_NV_Komponentenfehler_63_Cx0_TstNotComplThisOpCycle_Init), 1=Cx1_TstComplThisOpCycle_Pass (CM_DCDC_NV_Komponentenfehler_63_Cx1_TstComplThisOpCycle_Pass), 2=Cx2_TstCmplThisCycle_Pass_TimeElapse (CM_DCDC_NV_Komponentenfehler_63_Cx2_TstCmplThisCycle_Pass_TimeElapse), 3=Cx3_TstComplThisOpCycle_FAIL (CM_DCDC_NV_Komponentenfehler_63_Cx3_TstComplThisOpCycle_FAIL)
  compu method CM_BMC_CMC_Zellspannung_182: phys=raw+1000 for raw 0..4091, 4092=Cxffc_kleiner_1V (CM_BMC_CMC_Zellspannung_182_Cxffc_kleiner_1V), 4093=Cxffd_nicht_vorhanden (CM_BMC_CMC_Zellspannung_182_Cxffd_nicht_vorhanden), 4094=Cxffe_Init (CM_BMC_CMC_Zellspannung_182_Cxffe_Init), 4095=Cxfff_Fehler (CM_BMC_CMC_Zellspannung_182_Cxfff_Fehler); unit Unit_MilliVolt
  compu method CM_HVEM_StCpbElAcy: 0=Cx0_InitWert_keine_Abschaltung_moeglich (CM_HVEM_StCpbElAcy_Cx0_InitWert_keine_Abschaltung_moeglich) (InitWert_keine_Abschaltung_möglich), 1=Cx1_Abschaltung_moeglich (CM_HVEM_StCpbElAcy_Cx1_Abschaltung_moeglich) (Abschaltung_möglich)
  compu method CM_HVLM_Intensitaet_Lk3: phys=raw for raw 0..100, 126=Cx7e_Init (CM_HVLM_Intensitaet_Lk3_Cx7e_Init), 127=Cx7f_Fehler (CM_HVLM_Intensitaet_Lk3_Cx7f_Fehler); unit Unit_PerCent
  compu method CM_BMC_CMC_Zellspannung_107: phys=raw+1000 for raw 0..4091, 4092=Cxffc_kleiner_1V (CM_BMC_CMC_Zellspannung_107_Cxffc_kleiner_1V), 4093=Cxffd_nicht_vorhanden (CM_BMC_CMC_Zellspannung_107_Cxffd_nicht_vorhanden), 4094=Cxffe_Init (CM_BMC_CMC_Zellspannung_107_Cxffe_Init), 4095=Cxfff_Fehler (CM_BMC_CMC_Zellspannung_107_Cxfff_Fehler); unit Unit_MilliVolt
  compu method CM_AB_DeltaV_Y_eCall: 0=Cx0_Init_no_DeltaV_Y_detected (CM_AB_DeltaV_Y_eCall_Cx0_Init_no_DeltaV_Y_detected) (Init/no_DeltaV_Y_detected), 1=Cx1_DeltaV_Y_less_than_neg126km_h (CM_AB_DeltaV_Y_eCall_Cx1_DeltaV_Y_less_than_neg126km_h) (DeltaV_Y_less_than_neg126km/h), phys=raw-128 for raw 2..254, 255=Cxff_DeltaV_Y_larger_than_pos126km_h (CM_AB_DeltaV_Y_eCall_Cxff_DeltaV_Y_larger_than_pos126km_h) (DeltaV_Y_larger_than_pos126km/h); unit Unit_KiloMeterPerHour
  compu method CM_BMC_RtmWarnSocSprung: 0=Cx0_kein_Fehler (CM_BMC_RtmWarnSocSprung_Cx0_kein_Fehler), 1=Cx1_Fehler_Stufe_1 (CM_BMC_RtmWarnSocSprung_Cx1_Fehler_Stufe_1), 2=Cx2_Fehler_Stufe_2 (CM_BMC_RtmWarnSocSprung_Cx2_Fehler_Stufe_2), 3=Cx3_Fehler_Stufe_3 (CM_BMC_RtmWarnSocSprung_Cx3_Fehler_Stufe_3), 4=Cx4_reserviert (CM_BMC_RtmWarnSocSprung_Cx4_reserviert), 5=Cx5_reserviert (CM_BMC_RtmWarnSocSprung_Cx5_reserviert), 6=Cx6_reserviert (CM_BMC_RtmWarnSocSprung_Cx6_reserviert), 7=Cx7_reserviert (CM_BMC_RtmWarnSocSprung_Cx7_reserviert)
  compu method CM_BMC_CMC_Zellspannung_183: phys=raw+1000 for raw 0..4091, 4092=Cxffc_kleiner_1V (CM_BMC_CMC_Zellspannung_183_Cxffc_kleiner_1V), 4093=Cxffd_nicht_vorhanden (CM_BMC_CMC_Zellspannung_183_Cxffd_nicht_vorhanden), 4094=Cxffe_Init (CM_BMC_CMC_Zellspannung_183_Cxffe_Init), 4095=Cxfff_Fehler (CM_BMC_CMC_Zellspannung_183_Cxfff_Fehler); unit Unit_MilliVolt
  compu method CM_BMC_DC_Laden: 0=Cx0_Init (CM_BMC_DC_Laden_Cx0_Init), 1=Cx1_nicht_vorhanden (CM_BMC_DC_Laden_Cx1_nicht_vorhanden), 2=Cx2_vorhanden (CM_BMC_DC_Laden_Cx2_vorhanden), 3=Cx3_Fehler (CM_BMC_DC_Laden_Cx3_Fehler)
  compu method CM_BMC_CMC_Temperatur_087: phys=raw*0.5-40 for raw 0..252, 253=Cxfd_nicht_vorhanden (CM_BMC_CMC_Temperatur_087_Cxfd_nicht_vorhanden), 254=Cxfe_Init (CM_BMC_CMC_Temperatur_087_Cxfe_Init), 255=Cxff_Fehler (CM_BMC_CMC_Temperatur_087_Cxff_Fehler); unit Unit_DegreCelsi
  compu method CM_HVLE_OBG_Typ_verbaut: 0=Cx0_IPB_galvanisch_nichtGetrennt (CM_HVLE_OBG_Typ_verbaut_Cx0_IPB_galvanisch_nichtGetrennt), 1=Cx1_SAC (CM_HVLE_OBG_Typ_verbaut_Cx1_SAC), 2=Cx2_OCC (CM_HVLE_OBG_Typ_verbaut_Cx2_OCC), 3=Cx3_IPB_galvanisch_getrennt (CM_HVLE_OBG_Typ_verbaut_Cx3_IPB_galvanisch_getrennt), 4=Cx4_SAC_galvanisch_getrennt (CM_HVLE_OBG_Typ_verbaut_Cx4_SAC_galvanisch_getrennt), 5=Cx5_Reserve (CM_HVLE_OBG_Typ_verbaut_Cx5_Reserve), 6=Cx6_Reserve (CM_HVLE_OBG_Typ_verbaut_Cx6_Reserve), 7=Cx7_Init (CM_HVLE_OBG_Typ_verbaut_Cx7_Init)
  compu method CM_DCDC_NV_CVN_VLD: 0=Cx0_Ungueltig (CM_DCDC_NV_CVN_VLD_Cx0_Ungueltig), 1=Cx1_Gueltig (CM_DCDC_NV_CVN_VLD_Cx1_Gueltig)
  compu method CM_BMC_CMC_Zellspannung_060: phys=raw+1000 for raw 0..4091, 4092=Cxffc_kleiner_1V (CM_BMC_CMC_Zellspannung_060_Cxffc_kleiner_1V), 4093=Cxffd_nicht_vorhanden (CM_BMC_CMC_Zellspannung_060_Cxffd_nicht_vorhanden), 4094=Cxffe_Init (CM_BMC_CMC_Zellspannung_060_Cxffe_Init), 4095=Cxfff_Fehler (CM_BMC_CMC_Zellspannung_060_Cxfff_Fehler); unit Unit_MilliVolt
  compu method CM_BMC_CMC_Zellspannung_184: phys=raw+1000 for raw 0..4091, 4092=Cxffc_kleiner_1V (CM_BMC_CMC_Zellspannung_184_Cxffc_kleiner_1V), 4093=Cxffd_nicht_vorhanden (CM_BMC_CMC_Zellspannung_184_Cxffd_nicht_vorhanden), 4094=Cxffe_Init (CM_BMC_CMC_Zellspannung_184_Cxffe_Init), 4095=Cxfff_Fehler (CM_BMC_CMC_Zellspannung_184_Cxfff_Fehler); unit Unit_MilliVolt
  compu method CM_BMC_CMC_Zellspannung_108: phys=raw+1000 for raw 0..4091, 4092=Cxffc_kleiner_1V (CM_BMC_CMC_Zellspannung_108_Cxffc_kleiner_1V), 4093=Cxffd_nicht_vorhanden (CM_BMC_CMC_Zellspannung_108_Cxffd_nicht_vorhanden), 4094=Cxffe_Init (CM_BMC_CMC_Zellspannung_108_Cxffe_Init), 4095=Cxfff_Fehler (CM_BMC_CMC_Zellspannung_108_Cxfff_Fehler); unit Unit_MilliVolt
  compu method CM_BMC_RtmWarnTZelleDiff: 0=Cx0_kein_Fehler (CM_BMC_RtmWarnTZelleDiff_Cx0_kein_Fehler), 1=Cx1_Fehler_Stufe_1 (CM_BMC_RtmWarnTZelleDiff_Cx1_Fehler_Stufe_1), 2=Cx2_Fehler_Stufe_2 (CM_BMC_RtmWarnTZelleDiff_Cx2_Fehler_Stufe_2), 3=Cx3_Fehler_Stufe_3 (CM_BMC_RtmWarnTZelleDiff_Cx3_Fehler_Stufe_3), 4=Cx4_reserviert (CM_BMC_RtmWarnTZelleDiff_Cx4_reserviert), 5=Cx5_reserviert (CM_BMC_RtmWarnTZelleDiff_Cx5_reserviert), 6=Cx6_reserviert (CM_BMC_RtmWarnTZelleDiff_Cx6_reserviert), 7=Cx7_reserviert (CM_BMC_RtmWarnTZelleDiff_Cx7_reserviert)
  compu method CM_HVLE_OBG_Warnzustand: 0=Cx0_keine_Warnung_aktiv (CM_HVLE_OBG_Warnzustand_Cx0_keine_Warnung_aktiv), 1=Cx1_Leistungsbegrenzung_maxDCAusgangsstrom (CM_HVLE_OBG_Warnzustand_Cx1_Leistungsbegrenzung_maxDCAusgangsstrom), 2=Cx2_Leistungsbegrenzung_maxDCAusgangsspannung (CM_HVLE_OBG_Warnzustand_Cx2_Leistungsbegrenzung_maxDCAusgangsspannung), 3=Cx3_Leistungsbegrenzung_Spanungsnetz (CM_HVLE_OBG_Warnzustand_Cx3_Leistungsbegrenzung_Spanungsnetz), 4=Cx4_Ueberspannung (CM_HVLE_OBG_Warnzustand_Cx4_Ueberspannung), 5=Cx5_minStromLimit (CM_HVLE_OBG_Warnzustand_Cx5_minStromLimit), 6=Cx6_Ueberstrom_aktuell (CM_HVLE_OBG_Warnzustand_Cx6_Ueberstrom_aktuell), 7=Cx7_Ueberstrom_Ladegeraet (CM_HVLE_OBG_Warnzustand_Cx7_Ueberstrom_Ladegeraet), 8=Cx8_Netzausfall (CM_HVLE_OBG_Warnzustand_Cx8_Netzausfall), 9=Cx9_Komponentenschutz_aktiv (CM_HVLE_OBG_Warnzustand_Cx9_Komponentenschutz_aktiv)
  compu method CM_DCDC_NV_Komponentenfehler_01: 0=Cx0_TstNotComplThisOpCycle_Init (CM_DCDC_NV_Komponentenfehler_01_Cx0_TstNotComplThisOpCycle_Init), 1=Cx1_TstComplThisOpCycle_Pass (CM_DCDC_NV_Komponentenfehler_01_Cx1_TstComplThisOpCycle_Pass), 2=Cx2_TstCmplThisCycle_Pass_TimeElapse (CM_DCDC_NV_Komponentenfehler_01_Cx2_TstCmplThisCycle_Pass_TimeElapse), 3=Cx3_TstComplThisOpCycle_FAIL (CM_DCDC_NV_Komponentenfehler_01_Cx3_TstComplThisOpCycle_FAIL)
  compu method CM_BMC_CMC_Zellspannung_061: phys=raw+1000 for raw 0..4091, 4092=Cxffc_kleiner_1V (CM_BMC_CMC_Zellspannung_061_Cxffc_kleiner_1V), 4093=Cxffd_nicht_vorhanden (CM_BMC_CMC_Zellspannung_061_Cxffd_nicht_vorhanden), 4094=Cxffe_Init (CM_BMC_CMC_Zellspannung_061_Cxffe_Init), 4095=Cxfff_Fehler (CM_BMC_CMC_Zellspannung_061_Cxfff_Fehler); unit Unit_MilliVolt
  compu method CM_HVLM_LadedosenSuchlicht: 0=Cx0_Suchlicht_aus (CM_HVLM_LadedosenSuchlicht_Cx0_Suchlicht_aus), 1=Cx1_Suchlicht_an (CM_HVLM_LadedosenSuchlicht_Cx1_Suchlicht_an), 2=Cx2_Stecker_erkannt (CM_HVLM_LadedosenSuchlicht_Cx2_Stecker_erkannt)
  compu method CM_HVEM_STK_Leistung_verfuegbar: phys=raw*50 for raw 0..253, 254=Cxfe_Init (CM_HVEM_STK_Leistung_verfuegbar_Cxfe_Init), 255=Cxff_Fehler (CM_HVEM_STK_Leistung_verfuegbar_Cxff_Fehler); unit Unit_Watt
  compu method CM_AB_EDR_Trigger: 0=Cx0_No_Event (CM_AB_EDR_Trigger_Cx0_No_Event), 1=Cx1_Start_Event (CM_AB_EDR_Trigger_Cx1_Start_Event), 2=Cx2_NonDeployment_Event (CM_AB_EDR_Trigger_Cx2_NonDeployment_Event), 3=Cx3_Deployment_Event (CM_AB_EDR_Trigger_Cx3_Deployment_Event)
  compu method CM_BMC_CMC_Zellspannung_185: phys=raw+1000 for raw 0..4091, 4092=Cxffc_kleiner_1V (CM_BMC_CMC_Zellspannung_185_Cxffc_kleiner_1V), 4093=Cxffd_nicht_vorhanden (CM_BMC_CMC_Zellspannung_185_Cxffd_nicht_vorhanden), 4094=Cxffe_Init (CM_BMC_CMC_Zellspannung_185_Cxffe_Init), 4095=Cxfff_Fehler (CM_BMC_CMC_Zellspannung_185_Cxfff_Fehler); unit Unit_MilliVolt
  compu method CM_BMC_CMC_Zellspannung_109: phys=raw+1000 for raw 0..4091, 4092=Cxffc_kleiner_1V (CM_BMC_CMC_Zellspannung_109_Cxffc_kleiner_1V), 4093=Cxffd_nicht_vorhanden (CM_BMC_CMC_Zellspannung_109_Cxffd_nicht_vorhanden), 4094=Cxffe_Init (CM_BMC_CMC_Zellspannung_109_Cxffe_Init), 4095=Cxfff_Fehler (CM_BMC_CMC_Zellspannung_109_Cxfff_Fehler); unit Unit_MilliVolt
  compu method CM_DCDC_NV_Komponentenfehler_64: 0=Cx0_TstNotComplThisOpCycle_Init (CM_DCDC_NV_Komponentenfehler_64_Cx0_TstNotComplThisOpCycle_Init), 1=Cx1_TstComplThisOpCycle_Pass (CM_DCDC_NV_Komponentenfehler_64_Cx1_TstComplThisOpCycle_Pass), 2=Cx2_TstCmplThisCycle_Pass_TimeElapse (CM_DCDC_NV_Komponentenfehler_64_Cx2_TstCmplThisCycle_Pass_TimeElapse), 3=Cx3_TstComplThisOpCycle_FAIL (CM_DCDC_NV_Komponentenfehler_64_Cx3_TstComplThisOpCycle_FAIL)
  compu method CM_BMC_Dev_Freigabe: 0=Cx0_keine_Freigabe (CM_BMC_Dev_Freigabe_Cx0_keine_Freigabe), 1=Cx1_Freigabe (CM_BMC_Dev_Freigabe_Cx1_Freigabe)
  compu method CM_BMC_RtmWarnTZelleMax: 0=Cx0_kein_Fehler (CM_BMC_RtmWarnTZelleMax_Cx0_kein_Fehler), 1=Cx1_Fehler_Stufe_1 (CM_BMC_RtmWarnTZelleMax_Cx1_Fehler_Stufe_1), 2=Cx2_Fehler_Stufe_2 (CM_BMC_RtmWarnTZelleMax_Cx2_Fehler_Stufe_2), 3=Cx3_Fehler_Stufe_3 (CM_BMC_RtmWarnTZelleMax_Cx3_Fehler_Stufe_3), 4=Cx4_reserviert (CM_BMC_RtmWarnTZelleMax_Cx4_reserviert), 5=Cx5_reserviert (CM_BMC_RtmWarnTZelleMax_Cx5_reserviert), 6=Cx6_reserviert (CM_BMC_RtmWarnTZelleMax_Cx6_reserviert), 7=Cx7_reserviert (CM_BMC_RtmWarnTZelleMax_Cx7_reserviert)
  compu method CM_HVLE_PE_Monitor: 0=Cx0_keine_PE_Messung_aktiv (CM_HVLE_PE_Monitor_Cx0_keine_PE_Messung_aktiv), 1=Cx1_PE_erkannt (CM_HVLE_PE_Monitor_Cx1_PE_erkannt), 2=Cx2_IT_Netz_erkannt (CM_HVLE_PE_Monitor_Cx2_IT_Netz_erkannt) (IT-Netz_erkannt), 3=Cx3_PE_nicht_erkannt (CM_HVLE_PE_Monitor_Cx3_PE_nicht_erkannt), 7=Cx7_Fehler (CM_HVLE_PE_Monitor_Cx7_Fehler)
  compu method CM_BMC_CMC_Temperatur_088: phys=raw*0.5-40 for raw 0..252, 253=Cxfd_nicht_vorhanden (CM_BMC_CMC_Temperatur_088_Cxfd_nicht_vorhanden), 254=Cxfe_Init (CM_BMC_CMC_Temperatur_088_Cxfe_Init), 255=Cxff_Fehler (CM_BMC_CMC_Temperatur_088_Cxff_Fehler); unit Unit_DegreCelsi
  compu method CM_HVLM_Ladeklappe_VerEntriegeAnf_1: 0=Cx0_Init (CM_HVLM_Ladeklappe_VerEntriegeAnf_1_Cx0_Init), 1=Cx1_Ladeklappe_verriegeln (CM_HVLM_Ladeklappe_VerEntriegeAnf_1_Cx1_Ladeklappe_verriegeln), 2=Cx2_Ladeklappe_entriegeln (CM_HVLM_Ladeklappe_VerEntriegeAnf_1_Cx2_Ladeklappe_entriegeln), 3=Cx3_keine_Anforderung (CM_HVLM_Ladeklappe_VerEntriegeAnf_1_Cx3_keine_Anforderung)
  compu method CM_BMC_CMC_Zellspannung_186: phys=raw+1000 for raw 0..4091, 4092=Cxffc_kleiner_1V (CM_BMC_CMC_Zellspannung_186_Cxffc_kleiner_1V), 4093=Cxffd_nicht_vorhanden (CM_BMC_CMC_Zellspannung_186_Cxffd_nicht_vorhanden), 4094=Cxffe_Init (CM_BMC_CMC_Zellspannung_186_Cxffe_Init), 4095=Cxfff_Fehler (CM_BMC_CMC_Zellspannung_186_Cxfff_Fehler); unit Unit_MilliVolt
  compu method CM_DCDC_NV_Komponentenfehler_02: 0=Cx0_TstNotComplThisOpCycle_Init (CM_DCDC_NV_Komponentenfehler_02_Cx0_TstNotComplThisOpCycle_Init), 1=Cx1_TstComplThisOpCycle_Pass (CM_DCDC_NV_Komponentenfehler_02_Cx1_TstComplThisOpCycle_Pass), 2=Cx2_TstCmplThisCycle_Pass_TimeElapse (CM_DCDC_NV_Komponentenfehler_02_Cx2_TstCmplThisCycle_Pass_TimeElapse), 3=Cx3_TstComplThisOpCycle_FAIL (CM_DCDC_NV_Komponentenfehler_02_Cx3_TstComplThisOpCycle_FAIL)
  compu method CM_BMC_CMC_Zellspannung_062: phys=raw+1000 for raw 0..4091, 4092=Cxffc_kleiner_1V (CM_BMC_CMC_Zellspannung_062_Cxffc_kleiner_1V), 4093=Cxffd_nicht_vorhanden (CM_BMC_CMC_Zellspannung_062_Cxffd_nicht_vorhanden), 4094=Cxffe_Init (CM_BMC_CMC_Zellspannung_062_Cxffe_Init), 4095=Cxfff_Fehler (CM_BMC_CMC_Zellspannung_062_Cxfff_Fehler); unit Unit_MilliVolt
  compu method CM_BMC_CMC_Zellspannung_110: phys=raw+1000 for raw 0..4091, 4092=Cxffc_kleiner_1V (CM_BMC_CMC_Zellspannung_110_Cxffc_kleiner_1V), 4093=Cxffd_nicht_vorhanden (CM_BMC_CMC_Zellspannung_110_Cxffd_nicht_vorhanden), 4094=Cxffe_Init (CM_BMC_CMC_Zellspannung_110_Cxffe_Init), 4095=Cxfff_Fehler (CM_BMC_CMC_Zellspannung_110_Cxfff_Fehler); unit Unit_MilliVolt
  compu method CM_HVLE_U_istAC_Netz_L1: phys=raw for raw 0..508, 509=Cx1fd_nicht_vorhanden (CM_HVLE_U_istAC_Netz_L1_Cx1fd_nicht_vorhanden), 510=Cx1fe_Init (CM_HVLE_U_istAC_Netz_L1_Cx1fe_Init), 511=Cx1ff_Fehler (CM_HVLE_U_istAC_Netz_L1_Cx1ff_Fehler); unit Unit_Volt
  compu method CM_BMC_RtmWarnTZelleMin: 0=Cx0_kein_Fehler (CM_BMC_RtmWarnTZelleMin_Cx0_kein_Fehler), 1=Cx1_Fehler_Stufe_1 (CM_BMC_RtmWarnTZelleMin_Cx1_Fehler_Stufe_1), 2=Cx2_Fehler_Stufe_2 (CM_BMC_RtmWarnTZelleMin_Cx2_Fehler_Stufe_2), 3=Cx3_Fehler_Stufe_3 (CM_BMC_RtmWarnTZelleMin_Cx3_Fehler_Stufe_3), 4=Cx4_reserviert (CM_BMC_RtmWarnTZelleMin_Cx4_reserviert), 5=Cx5_reserviert (CM_BMC_RtmWarnTZelleMin_Cx5_reserviert), 6=Cx6_reserviert (CM_BMC_RtmWarnTZelleMin_Cx6_reserviert), 7=Cx7_reserviert (CM_BMC_RtmWarnTZelleMin_Cx7_reserviert)
  compu method CM_BMC_CMC_Zellspannung_187: phys=raw+1000 for raw 0..4091, 4092=Cxffc_kleiner_1V (CM_BMC_CMC_Zellspannung_187_Cxffc_kleiner_1V), 4093=Cxffd_nicht_vorhanden (CM_BMC_CMC_Zellspannung_187_Cxffd_nicht_vorhanden), 4094=Cxffe_Init (CM_BMC_CMC_Zellspannung_187_Cxffe_Init), 4095=Cxfff_Fehler (CM_BMC_CMC_Zellspannung_187_Cxfff_Fehler); unit Unit_MilliVolt
  compu method CM_AB_Erh_Auf_VB: 0=Cx0_keine_Anzeige (CM_AB_Erh_Auf_VB_Cx0_keine_Anzeige), 1=Cx1_Beifahrerairbag_deaktiviert (CM_AB_Erh_Auf_VB_Cx1_Beifahrerairbag_deaktiviert), 2=Cx2_Beifahrerairbag_aktiviert (CM_AB_Erh_Auf_VB_Cx2_Beifahrerairbag_aktiviert), 3=Cx3_nicht_definiert (CM_AB_Erh_Auf_VB_Cx3_nicht_definiert)
  compu method CM_HVEM_StLimElAcy: 0=Cx0_InitWert_nicht_aktiv (CM_HVEM_StLimElAcy_Cx0_InitWert_nicht_aktiv), 1=Cx1_aktiv (CM_HVEM_StLimElAcy_Cx1_aktiv)
  compu method CM_HVLM_Ladeklappe_VerEntriegeAnf_2: 0=Cx0_Init (CM_HVLM_Ladeklappe_VerEntriegeAnf_2_Cx0_Init), 1=Cx1_Ladeklappe_verriegeln (CM_HVLM_Ladeklappe_VerEntriegeAnf_2_Cx1_Ladeklappe_verriegeln), 2=Cx2_Ladeklappe_entriegeln (CM_HVLM_Ladeklappe_VerEntriegeAnf_2_Cx2_Ladeklappe_entriegeln), 3=Cx3_keine_Anforderung (CM_HVLM_Ladeklappe_VerEntriegeAnf_2_Cx3_keine_Anforderung)
  compu method CM_DCDC_NV_Komponentenfehler_65: 0=Cx0_TstNotComplThisOpCycle_Init (CM_DCDC_NV_Komponentenfehler_65_Cx0_TstNotComplThisOpCycle_Init), 1=Cx1_TstComplThisOpCycle_Pass (CM_DCDC_NV_Komponentenfehler_65_Cx1_TstComplThisOpCycle_Pass), 2=Cx2_TstCmplThisCycle_Pass_TimeElapse (CM_DCDC_NV_Komponentenfehler_65_Cx2_TstCmplThisCycle_Pass_TimeElapse), 3=Cx3_TstComplThisOpCycle_FAIL (CM_DCDC_NV_Komponentenfehler_65_Cx3_TstComplThisOpCycle_FAIL)
  compu method CM_BMC_CMC_Zellspannung_063: phys=raw+1000 for raw 0..4091, 4092=Cxffc_kleiner_1V (CM_BMC_CMC_Zellspannung_063_Cxffc_kleiner_1V), 4093=Cxffd_nicht_vorhanden (CM_BMC_CMC_Zellspannung_063_Cxffd_nicht_vorhanden), 4094=Cxffe_Init (CM_BMC_CMC_Zellspannung_063_Cxffe_Init), 4095=Cxfff_Fehler (CM_BMC_CMC_Zellspannung_063_Cxfff_Fehler); unit Unit_MilliVolt
  compu method CM_DCDC_NV_Komponentenfehler_03: 0=Cx0_TstNotComplThisOpCycle_Init (CM_DCDC_NV_Komponentenfehler_03_Cx0_TstNotComplThisOpCycle_Init), 1=Cx1_TstComplThisOpCycle_Pass (CM_DCDC_NV_Komponentenfehler_03_Cx1_TstComplThisOpCycle_Pass), 2=Cx2_TstCmplThisCycle_Pass_TimeElapse (CM_DCDC_NV_Komponentenfehler_03_Cx2_TstCmplThisCycle_Pass_TimeElapse), 3=Cx3_TstComplThisOpCycle_FAIL (CM_DCDC_NV_Komponentenfehler_03_Cx3_TstComplThisOpCycle_FAIL)
  compu method CM_BMC_CMC_Zellspannung_111: phys=raw+1000 for raw 0..4091, 4092=Cxffc_kleiner_1V (CM_BMC_CMC_Zellspannung_111_Cxffc_kleiner_1V), 4093=Cxffd_nicht_vorhanden (CM_BMC_CMC_Zellspannung_111_Cxffd_nicht_vorhanden), 4094=Cxffe_Init (CM_BMC_CMC_Zellspannung_111_Cxffe_Init), 4095=Cxfff_Fehler (CM_BMC_CMC_Zellspannung_111_Cxfff_Fehler); unit Unit_MilliVolt
  compu method CM_BMC_Energie_Entladen: phys=raw*0.01 for raw 0..65533, 65534=Cxfffe_Init (CM_BMC_Energie_Entladen_Cxfffe_Init), 65535=Cxffff_Fehler (CM_BMC_Energie_Entladen_Cxffff_Fehler); unit Unit_KiloWattHour
  compu method CM_HVLE_U_istAC_Netz_L2: phys=raw for raw 0..508, 509=Cx1fd_nicht_vorhanden (CM_HVLE_U_istAC_Netz_L2_Cx1fd_nicht_vorhanden), 510=Cx1fe_Init (CM_HVLE_U_istAC_Netz_L2_Cx1fe_Init), 511=Cx1ff_Fehler (CM_HVLE_U_istAC_Netz_L2_Cx1ff_Fehler); unit Unit_Volt
  compu method CM_BMC_ThermAuslastung: phys=raw for raw 0..100, 101=Cx65_Notfallkuehlung (CM_BMC_ThermAuslastung_Cx65_Notfallkuehlung), 126=Cx7e_Init (CM_BMC_ThermAuslastung_Cx7e_Init), 127=Cx7f_Fehler (CM_BMC_ThermAuslastung_Cx7f_Fehler); unit Unit_PerCent
  compu method CM_BMC_CMC_Zellspannung_188: phys=raw+1000 for raw 0..4091, 4092=Cxffc_kleiner_1V (CM_BMC_CMC_Zellspannung_188_Cxffc_kleiner_1V), 4093=Cxffd_nicht_vorhanden (CM_BMC_CMC_Zellspannung_188_Cxffd_nicht_vorhanden), 4094=Cxffe_Init (CM_BMC_CMC_Zellspannung_188_Cxffe_Init), 4095=Cxfff_Fehler (CM_BMC_CMC_Zellspannung_188_Cxfff_Fehler); unit Unit_MilliVolt
  compu method CM_BMC_CMC_Temperatur_089: phys=raw*0.5-40 for raw 0..252, 253=Cxfd_nicht_vorhanden (CM_BMC_CMC_Temperatur_089_Cxfd_nicht_vorhanden), 254=Cxfe_Init (CM_BMC_CMC_Temperatur_089_Cxfe_Init), 255=Cxff_Fehler (CM_BMC_CMC_Temperatur_089_Cxff_Fehler); unit Unit_DegreCelsi
  compu method CM_BMC_RtmWarnUeberstrom: 0=Cx0_kein_Fehler (CM_BMC_RtmWarnUeberstrom_Cx0_kein_Fehler), 1=Cx1_Fehler_Stufe_1 (CM_BMC_RtmWarnUeberstrom_Cx1_Fehler_Stufe_1), 2=Cx2_Fehler_Stufe_2 (CM_BMC_RtmWarnUeberstrom_Cx2_Fehler_Stufe_2), 3=Cx3_Fehler_Stufe_3 (CM_BMC_RtmWarnUeberstrom_Cx3_Fehler_Stufe_3), 4=Cx4_reserviert (CM_BMC_RtmWarnUeberstrom_Cx4_reserviert), 5=Cx5_reserviert (CM_BMC_RtmWarnUeberstrom_Cx5_reserviert), 6=Cx6_reserviert (CM_BMC_RtmWarnUeberstrom_Cx6_reserviert), 7=Cx7_reserviert (CM_BMC_RtmWarnUeberstrom_Cx7_reserviert)
  compu method CM_HVLM_Ladeklappe_VerEntriegeAnf_3: 0=Cx0_Init (CM_HVLM_Ladeklappe_VerEntriegeAnf_3_Cx0_Init), 1=Cx1_Ladeklappe_verriegeln (CM_HVLM_Ladeklappe_VerEntriegeAnf_3_Cx1_Ladeklappe_verriegeln), 2=Cx2_Ladeklappe_entriegeln (CM_HVLM_Ladeklappe_VerEntriegeAnf_3_Cx2_Ladeklappe_entriegeln), 3=Cx3_keine_Anforderung (CM_HVLM_Ladeklappe_VerEntriegeAnf_3_Cx3_keine_Anforderung)
  compu method CM_BMC_CMC_Zellspannung_189: phys=raw+1000 for raw 0..4091, 4092=Cxffc_kleiner_1V (CM_BMC_CMC_Zellspannung_189_Cxffc_kleiner_1V), 4093=Cxffd_nicht_vorhanden (CM_BMC_CMC_Zellspannung_189_Cxffd_nicht_vorhanden), 4094=Cxffe_Init (CM_BMC_CMC_Zellspannung_189_Cxffe_Init), 4095=Cxfff_Fehler (CM_BMC_CMC_Zellspannung_189_Cxfff_Fehler); unit Unit_MilliVolt
  compu method CM_HVLE_U_istAC_Netz_L3: phys=raw for raw 0..508, 509=Cx1fd_nicht_vorhanden (CM_HVLE_U_istAC_Netz_L3_Cx1fd_nicht_vorhanden), 510=Cx1fe_Init (CM_HVLE_U_istAC_Netz_L3_Cx1fe_Init), 511=Cx1ff_Fehler (CM_HVLE_U_istAC_Netz_L3_Cx1ff_Fehler); unit Unit_Volt
  compu method CM_BMC_CMC_Zellspannung_064: phys=raw+1000 for raw 0..4091, 4092=Cxffc_kleiner_1V (CM_BMC_CMC_Zellspannung_064_Cxffc_kleiner_1V), 4093=Cxffd_nicht_vorhanden (CM_BMC_CMC_Zellspannung_064_Cxffd_nicht_vorhanden), 4094=Cxffe_Init (CM_BMC_CMC_Zellspannung_064_Cxffe_Init), 4095=Cxfff_Fehler (CM_BMC_CMC_Zellspannung_064_Cxfff_Fehler); unit Unit_MilliVolt
  compu method CM_DCDC_NV_Komponentenfehler_04: 0=Cx0_TstNotComplThisOpCycle_Init (CM_DCDC_NV_Komponentenfehler_04_Cx0_TstNotComplThisOpCycle_Init), 1=Cx1_TstComplThisOpCycle_Pass (CM_DCDC_NV_Komponentenfehler_04_Cx1_TstComplThisOpCycle_Pass), 2=Cx2_TstCmplThisCycle_Pass_TimeElapse (CM_DCDC_NV_Komponentenfehler_04_Cx2_TstCmplThisCycle_Pass_TimeElapse), 3=Cx3_TstComplThisOpCycle_FAIL (CM_DCDC_NV_Komponentenfehler_04_Cx3_TstComplThisOpCycle_FAIL)
  compu method CM_BMC_CMC_Zellspannung_112: phys=raw+1000 for raw 0..4091, 4092=Cxffc_kleiner_1V (CM_BMC_CMC_Zellspannung_112_Cxffc_kleiner_1V), 4093=Cxffd_nicht_vorhanden (CM_BMC_CMC_Zellspannung_112_Cxffd_nicht_vorhanden), 4094=Cxffe_Init (CM_BMC_CMC_Zellspannung_112_Cxffe_Init), 4095=Cxfff_Fehler (CM_BMC_CMC_Zellspannung_112_Cxfff_Fehler); unit Unit_MilliVolt
  compu method CM_BMC_RtmWarnUPackMax: 0=Cx0_kein_Fehler (CM_BMC_RtmWarnUPackMax_Cx0_kein_Fehler), 1=Cx1_Fehler_Stufe_1 (CM_BMC_RtmWarnUPackMax_Cx1_Fehler_Stufe_1), 2=Cx2_Fehler_Stufe_2 (CM_BMC_RtmWarnUPackMax_Cx2_Fehler_Stufe_2), 3=Cx3_Fehler_Stufe_3 (CM_BMC_RtmWarnUPackMax_Cx3_Fehler_Stufe_3), 4=Cx4_reserviert (CM_BMC_RtmWarnUPackMax_Cx4_reserviert), 5=Cx5_reserviert (CM_BMC_RtmWarnUPackMax_Cx5_reserviert), 6=Cx6_reserviert (CM_BMC_RtmWarnUPackMax_Cx6_reserviert), 7=Cx7_reserviert (CM_BMC_RtmWarnUPackMax_Cx7_reserviert)
  compu method CM_HVEM_SystemMinLeistungsgrenze: phys=raw*1000 for raw 0..125, 126=Cx7e_Init (CM_HVEM_SystemMinLeistungsgrenze_Cx7e_Init), 127=Cx7f_Fehler (CM_HVEM_SystemMinLeistungsgrenze_Cx7f_Fehler); unit Unit_Watt
  compu method CM_DCDC_NV_Komponentenfehler_66: 0=Cx0_TstNotComplThisOpCycle_Init (CM_DCDC_NV_Komponentenfehler_66_Cx0_TstNotComplThisOpCycle_Init), 1=Cx1_TstComplThisOpCycle_Pass (CM_DCDC_NV_Komponentenfehler_66_Cx1_TstComplThisOpCycle_Pass), 2=Cx2_TstCmplThisCycle_Pass_TimeElapse (CM_DCDC_NV_Komponentenfehler_66_Cx2_TstCmplThisCycle_Pass_TimeElapse), 3=Cx3_TstComplThisOpCycle_FAIL (CM_DCDC_NV_Komponentenfehler_66_Cx3_TstComplThisOpCycle_FAIL)
  compu method CM_AB_Front_Crash: 0=Cx0_kein_Front_Crash (CM_AB_Front_Crash_Cx0_kein_Front_Crash), 1=Cx1_Front_Crash (CM_AB_Front_Crash_Cx1_Front_Crash)
  compu method CM_BMC_CMC_Zellspannung_190: phys=raw+1000 for raw 0..4091, 4092=Cxffc_kleiner_1V (CM_BMC_CMC_Zellspannung_190_Cxffc_kleiner_1V), 4093=Cxffd_nicht_vorhanden (CM_BMC_CMC_Zellspannung_190_Cxffd_nicht_vorhanden), 4094=Cxffe_Init (CM_BMC_CMC_Zellspannung_190_Cxffe_Init), 4095=Cxfff_Fehler (CM_BMC_CMC_Zellspannung_190_Cxfff_Fehler); unit Unit_MilliVolt
  compu method CM_BMC_Energie_Laden: phys=raw*0.01 for raw 0..65533, 65534=Cxfffe_Init (CM_BMC_Energie_Laden_Cxfffe_Init), 65535=Cxffff_Fehler (CM_BMC_Energie_Laden_Cxffff_Fehler); unit Unit_KiloWattHour
  compu method CM_BMC_CMC_Temperatur_090: phys=raw*0.5-40 for raw 0..252, 253=Cxfd_nicht_vorhanden (CM_BMC_CMC_Temperatur_090_Cxfd_nicht_vorhanden), 254=Cxfe_Init (CM_BMC_CMC_Temperatur_090_Cxfe_Init), 255=Cxff_Fehler (CM_BMC_CMC_Temperatur_090_Cxff_Fehler); unit Unit_DegreCelsi
  compu method CM_HVLM_13_BZ: phys=raw for raw 0..15
  compu method CM_HVLM_Laden_ISO_Messung_Anf: 0=Cx0_Anforderung (CM_HVLM_Laden_ISO_Messung_Anf_Cx0_Anforderung), 1=Cx1_keine_Anforderung (CM_HVLM_Laden_ISO_Messung_Anf_Cx1_keine_Anforderung)
  compu method CM_BMC_CMC_Zellspannung_065: phys=raw+1000 for raw 0..4091, 4092=Cxffc_kleiner_1V (CM_BMC_CMC_Zellspannung_065_Cxffc_kleiner_1V), 4093=Cxffd_nicht_vorhanden (CM_BMC_CMC_Zellspannung_065_Cxffd_nicht_vorhanden), 4094=Cxffe_Init (CM_BMC_CMC_Zellspannung_065_Cxffe_Init), 4095=Cxfff_Fehler (CM_BMC_CMC_Zellspannung_065_Cxfff_Fehler); unit Unit_MilliVolt
  compu method CM_BMC_CMC_Zellspannung_113: phys=raw+1000 for raw 0..4091, 4092=Cxffc_kleiner_1V (CM_BMC_CMC_Zellspannung_113_Cxffc_kleiner_1V), 4093=Cxffd_nicht_vorhanden (CM_BMC_CMC_Zellspannung_113_Cxffd_nicht_vorhanden), 4094=Cxffe_Init (CM_BMC_CMC_Zellspannung_113_Cxffe_Init), 4095=Cxfff_Fehler (CM_BMC_CMC_Zellspannung_113_Cxfff_Fehler); unit Unit_MilliVolt
  compu method CM_DCDC_NV_Komponentenfehler_05: 0=Cx0_TstNotComplThisOpCycle_Init (CM_DCDC_NV_Komponentenfehler_05_Cx0_TstNotComplThisOpCycle_Init), 1=Cx1_TstComplThisOpCycle_Pass (CM_DCDC_NV_Komponentenfehler_05_Cx1_TstComplThisOpCycle_Pass), 2=Cx2_TstCmplThisCycle_Pass_TimeElapse (CM_DCDC_NV_Komponentenfehler_05_Cx2_TstCmplThisCycle_Pass_TimeElapse), 3=Cx3_TstComplThisOpCycle_FAIL (CM_DCDC_NV_Komponentenfehler_05_Cx3_TstComplThisOpCycle_FAIL)
  compu method CM_BMC_RtmWarnUPackMin: 0=Cx0_kein_Fehler (CM_BMC_RtmWarnUPackMin_Cx0_kein_Fehler), 1=Cx1_Fehler_Stufe_1 (CM_BMC_RtmWarnUPackMin_Cx1_Fehler_Stufe_1), 2=Cx2_Fehler_Stufe_2 (CM_BMC_RtmWarnUPackMin_Cx2_Fehler_Stufe_2), 3=Cx3_Fehler_Stufe_3 (CM_BMC_RtmWarnUPackMin_Cx3_Fehler_Stufe_3), 4=Cx4_reserviert (CM_BMC_RtmWarnUPackMin_Cx4_reserviert), 5=Cx5_reserviert (CM_BMC_RtmWarnUPackMin_Cx5_reserviert), 6=Cx6_reserviert (CM_BMC_RtmWarnUPackMin_Cx6_reserviert), 7=Cx7_reserviert (CM_BMC_RtmWarnUPackMin_Cx7_reserviert)
  compu method CM_BMC_CMC_Zellspannung_191: phys=raw+1000 for raw 0..4091, 4092=Cxffc_kleiner_1V (CM_BMC_CMC_Zellspannung_191_Cxffc_kleiner_1V), 4093=Cxffd_nicht_vorhanden (CM_BMC_CMC_Zellspannung_191_Cxffd_nicht_vorhanden), 4094=Cxffe_Init (CM_BMC_CMC_Zellspannung_191_Cxffe_Init), 4095=Cxfff_Fehler (CM_BMC_CMC_Zellspannung_191_Cxfff_Fehler); unit Unit_MilliVolt
  compu method CM_HVLM_13_CRC: phys=raw for raw 0..255
  compu method CM_HVLM_Ladenaktiv_Standzyklus: 0=Cx0_inaktiv (CM_HVLM_Ladenaktiv_Standzyklus_Cx0_inaktiv), 1=Cx1_aktiv (CM_HVLM_Ladenaktiv_Standzyklus_Cx1_aktiv)
  compu method CM_BMC_CMC_Zellspannung_192: phys=raw+1000 for raw 0..4091, 4092=Cxffc_kleiner_1V (CM_BMC_CMC_Zellspannung_192_Cxffc_kleiner_1V), 4093=Cxffd_nicht_vorhanden (CM_BMC_CMC_Zellspannung_192_Cxffd_nicht_vorhanden), 4094=Cxffe_Init (CM_BMC_CMC_Zellspannung_192_Cxffe_Init), 4095=Cxfff_Fehler (CM_BMC_CMC_Zellspannung_192_Cxfff_Fehler); unit Unit_MilliVolt
  compu method CM_BMC_CMC_Zellspannung_066: phys=raw+1000 for raw 0..4091, 4092=Cxffc_kleiner_1V (CM_BMC_CMC_Zellspannung_066_Cxffc_kleiner_1V), 4093=Cxffd_nicht_vorhanden (CM_BMC_CMC_Zellspannung_066_Cxffd_nicht_vorhanden), 4094=Cxffe_Init (CM_BMC_CMC_Zellspannung_066_Cxffe_Init), 4095=Cxfff_Fehler (CM_BMC_CMC_Zellspannung_066_Cxfff_Fehler); unit Unit_MilliVolt
  compu method CM_BMC_CMC_Zellspannung_114: phys=raw+1000 for raw 0..4091, 4092=Cxffc_kleiner_1V (CM_BMC_CMC_Zellspannung_114_Cxffc_kleiner_1V), 4093=Cxffd_nicht_vorhanden (CM_BMC_CMC_Zellspannung_114_Cxffd_nicht_vorhanden), 4094=Cxffe_Init (CM_BMC_CMC_Zellspannung_114_Cxffe_Init), 4095=Cxfff_Fehler (CM_BMC_CMC_Zellspannung_114_Cxfff_Fehler); unit Unit_MilliVolt
  compu method CM_DCDC_NV_Komponentenfehler_67: 0=Cx0_TstNotComplThisOpCycle_Init (CM_DCDC_NV_Komponentenfehler_67_Cx0_TstNotComplThisOpCycle_Init), 1=Cx1_TstComplThisOpCycle_Pass (CM_DCDC_NV_Komponentenfehler_67_Cx1_TstComplThisOpCycle_Pass), 2=Cx2_TstCmplThisCycle_Pass_TimeElapse (CM_DCDC_NV_Komponentenfehler_67_Cx2_TstCmplThisCycle_Pass_TimeElapse), 3=Cx3_TstComplThisOpCycle_FAIL (CM_DCDC_NV_Komponentenfehler_67_Cx3_TstComplThisOpCycle_FAIL)
  compu method CM_HVEM_TME_Energie_Vorgabe: phys=raw*10 for raw 0..2045, 2046=Cx7fe_Init (CM_HVEM_TME_Energie_Vorgabe_Cx7fe_Init), 2047=Cx7ff_Fehler (CM_HVEM_TME_Energie_Vorgabe_Cx7ff_Fehler); unit Unit_WattHour
  compu method CM_DCDC_NV_Komponentenfehler_06: 0=Cx0_TstNotComplThisOpCycle_Init (CM_DCDC_NV_Komponentenfehler_06_Cx0_TstNotComplThisOpCycle_Init), 1=Cx1_TstComplThisOpCycle_Pass (CM_DCDC_NV_Komponentenfehler_06_Cx1_TstComplThisOpCycle_Pass), 2=Cx2_TstCmplThisCycle_Pass_TimeElapse (CM_DCDC_NV_Komponentenfehler_06_Cx2_TstCmplThisCycle_Pass_TimeElapse), 3=Cx3_TstComplThisOpCycle_FAIL (CM_DCDC_NV_Komponentenfehler_06_Cx3_TstComplThisOpCycle_FAIL)
  compu method CM_BMC_RtmWarnUZelleMax: 0=Cx0_kein_Fehler (CM_BMC_RtmWarnUZelleMax_Cx0_kein_Fehler), 1=Cx1_Fehler_Stufe_1 (CM_BMC_RtmWarnUZelleMax_Cx1_Fehler_Stufe_1), 2=Cx2_Fehler_Stufe_2 (CM_BMC_RtmWarnUZelleMax_Cx2_Fehler_Stufe_2), 3=Cx3_Fehler_Stufe_3 (CM_BMC_RtmWarnUZelleMax_Cx3_Fehler_Stufe_3), 4=Cx4_reserviert (CM_BMC_RtmWarnUZelleMax_Cx4_reserviert), 5=Cx5_reserviert (CM_BMC_RtmWarnUZelleMax_Cx5_reserviert), 6=Cx6_reserviert (CM_BMC_RtmWarnUZelleMax_Cx6_reserviert), 7=Cx7_reserviert (CM_BMC_RtmWarnUZelleMax_Cx7_reserviert)
  compu method CM_AB_Gurtschloss_BF: 0=Cx0_nicht_verbaut (CM_AB_Gurtschloss_BF_Cx0_nicht_verbaut), 1=Cx1_nicht_verfuegbar_Fehler_oder_Init (CM_AB_Gurtschloss_BF_Cx1_nicht_verfuegbar_Fehler_oder_Init) (nicht_verfügbar (Fehler oder Init)), 2=Cx2_nicht_gesteckt (CM_AB_Gurtschloss_BF_Cx2_nicht_gesteckt), 3=Cx3_gesteckt (CM_AB_Gurtschloss_BF_Cx3_gesteckt)
  compu method CM_HVLM_14_BZ: phys=raw for raw 0..15
  compu method CM_BMC_CMC_Temperatur_091: phys=raw*0.5-40 for raw 0..252, 253=Cxfd_nicht_vorhanden (CM_BMC_CMC_Temperatur_091_Cxfd_nicht_vorhanden), 254=Cxfe_Init (CM_BMC_CMC_Temperatur_091_Cxfe_Init), 255=Cxff_Fehler (CM_BMC_CMC_Temperatur_091_Cxff_Fehler); unit Unit_DegreCelsi
  compu method CM_BMC_Energie_Sockel_SoC: phys=raw*0.1 for raw 0..1000, 1001=Cx3e9_reserviert (CM_BMC_Energie_Sockel_SoC_Cx3e9_reserviert), 1002=Cx3ea_reserviert (CM_BMC_Energie_Sockel_SoC_Cx3ea_reserviert), 1003=Cx3eb_reserviert (CM_BMC_Energie_Sockel_SoC_Cx3eb_reserviert), 1004=Cx3ec_reserviert (CM_BMC_Energie_Sockel_SoC_Cx3ec_reserviert), 1005=Cx3ed_reserviert (CM_BMC_Energie_Sockel_SoC_Cx3ed_reserviert), 1006=Cx3ee_reserviert (CM_BMC_Energie_Sockel_SoC_Cx3ee_reserviert), 1007=Cx3ef_reserviert (CM_BMC_Energie_Sockel_SoC_Cx3ef_reserviert), 1008=Cx3f0_reserviert (CM_BMC_Energie_Sockel_SoC_Cx3f0_reserviert), 1009=Cx3f1_reserviert (CM_BMC_Energie_Sockel_SoC_Cx3f1_reserviert), 1010=Cx3f2_reserviert (CM_BMC_Energie_Sockel_SoC_Cx3f2_reserviert), 1011=Cx3f3_reserviert (CM_BMC_Energie_Sockel_SoC_Cx3f3_reserviert), 1012=Cx3f4_reserviert (CM_BMC_Energie_Sockel_SoC_Cx3f4_reserviert), 1013=Cx3f5_reserviert (CM_BMC_Energie_Sockel_SoC_Cx3f5_reserviert), 1014=Cx3f6_reserviert (CM_BMC_Energie_Sockel_SoC_Cx3f6_reserviert), 1015=Cx3f7_reserviert (CM_BMC_Energie_Sockel_SoC_Cx3f7_reserviert), 1016=Cx3f8_reserviert (CM_BMC_Energie_Sockel_SoC_Cx3f8_reserviert), 1017=Cx3f9_reserviert (CM_BMC_Energie_Sockel_SoC_Cx3f9_reserviert), 1018=Cx3fa_reserviert (CM_BMC_Energie_Sockel_SoC_Cx3fa_reserviert), 1019=Cx3fb_reserviert (CM_BMC_Energie_Sockel_SoC_Cx3fb_reserviert), 1020=Cx3fc_reserviert (CM_BMC_Energie_Sockel_SoC_Cx3fc_reserviert), 1021=Cx3fd_reserviert (CM_BMC_Energie_Sockel_SoC_Cx3fd_reserviert), 1022=Cx3fe_Init (CM_BMC_Energie_Sockel_SoC_Cx3fe_Init), 1023=Cx3ff_Fehler (CM_BMC_Energie_Sockel_SoC_Cx3ff_Fehler); unit Unit_PerCent
  compu method CM_BMC_Datenuebernahme_Anf: 0=Cx0_Daten_nicht_uebernehmen (CM_BMC_Datenuebernahme_Anf_Cx0_Daten_nicht_uebernehmen), 1=Cx1_Daten_uebernehmen (CM_BMC_Datenuebernahme_Anf_Cx1_Daten_uebernehmen)
  compu method CM_BMC_ThermSpreizung: phys=raw*10 for raw 0..10, 14=Cxe_Init (CM_BMC_ThermSpreizung_Cxe_Init), 15=Cxf_Fehler (CM_BMC_ThermSpreizung_Cxf_Fehler); unit Unit_PerCent
  compu method CM_HVLM_Ladeniveau_Anf: 0=Cx0_Keine_Ladeniveau_Anf (CM_HVLM_Ladeniveau_Anf_Cx0_Keine_Ladeniveau_Anf), 1=Cx1_Bevorsteh_Ladevorgang_erkannt (CM_HVLM_Ladeniveau_Anf_Cx1_Bevorsteh_Ladevorgang_erkannt), 2=Cx2_Ladeposition_wird_angefahren (CM_HVLM_Ladeniveau_Anf_Cx2_Ladeposition_wird_angefahren), 3=Cx3_Ladeposition_erreicht (CM_HVLM_Ladeniveau_Anf_Cx3_Ladeposition_erreicht), 4=Cx4_Ladevorgang_aktiv (CM_HVLM_Ladeniveau_Anf_Cx4_Ladevorgang_aktiv), 5=Cx5_Ladevorgang_abgeschlossen (CM_HVLM_Ladeniveau_Anf_Cx5_Ladevorgang_abgeschlossen), 6=Cx6_Init (CM_HVLM_Ladeniveau_Anf_Cx6_Init), 7=Cx7_Fehler (CM_HVLM_Ladeniveau_Anf_Cx7_Fehler)
  compu method CM_BMC_CMC_Zellspannung_115: phys=raw+1000 for raw 0..4091, 4092=Cxffc_kleiner_1V (CM_BMC_CMC_Zellspannung_115_Cxffc_kleiner_1V), 4093=Cxffd_nicht_vorhanden (CM_BMC_CMC_Zellspannung_115_Cxffd_nicht_vorhanden), 4094=Cxffe_Init (CM_BMC_CMC_Zellspannung_115_Cxffe_Init), 4095=Cxfff_Fehler (CM_BMC_CMC_Zellspannung_115_Cxfff_Fehler); unit Unit_MilliVolt
  compu method CM_BMC_CMC_Zellspannung_067: phys=raw+1000 for raw 0..4091, 4092=Cxffc_kleiner_1V (CM_BMC_CMC_Zellspannung_067_Cxffc_kleiner_1V), 4093=Cxffd_nicht_vorhanden (CM_BMC_CMC_Zellspannung_067_Cxffd_nicht_vorhanden), 4094=Cxffe_Init (CM_BMC_CMC_Zellspannung_067_Cxffe_Init), 4095=Cxfff_Fehler (CM_BMC_CMC_Zellspannung_067_Cxfff_Fehler); unit Unit_MilliVolt
  compu method CM_DCDC_NV_Komponentenfehler_07: 0=Cx0_TstNotComplThisOpCycle_Init (CM_DCDC_NV_Komponentenfehler_07_Cx0_TstNotComplThisOpCycle_Init), 1=Cx1_TstComplThisOpCycle_Pass (CM_DCDC_NV_Komponentenfehler_07_Cx1_TstComplThisOpCycle_Pass), 2=Cx2_TstCmplThisCycle_Pass_TimeElapse (CM_DCDC_NV_Komponentenfehler_07_Cx2_TstCmplThisCycle_Pass_TimeElapse), 3=Cx3_TstComplThisOpCycle_FAIL (CM_DCDC_NV_Komponentenfehler_07_Cx3_TstComplThisOpCycle_FAIL)
  compu method CM_BMC_RtmWarnUZelleMin: 0=Cx0_kein_Fehler (CM_BMC_RtmWarnUZelleMin_Cx0_kein_Fehler), 1=Cx1_Fehler_Stufe_1 (CM_BMC_RtmWarnUZelleMin_Cx1_Fehler_Stufe_1), 2=Cx2_Fehler_Stufe_2 (CM_BMC_RtmWarnUZelleMin_Cx2_Fehler_Stufe_2), 3=Cx3_Fehler_Stufe_3 (CM_BMC_RtmWarnUZelleMin_Cx3_Fehler_Stufe_3), 4=Cx4_reserviert (CM_BMC_RtmWarnUZelleMin_Cx4_reserviert), 5=Cx5_reserviert (CM_BMC_RtmWarnUZelleMin_Cx5_reserviert), 6=Cx6_reserviert (CM_BMC_RtmWarnUZelleMin_Cx6_reserviert), 7=Cx7_reserviert (CM_BMC_RtmWarnUZelleMin_Cx7_reserviert)
  compu method CM_HVLM_14_CRC: phys=raw for raw 0..255
  compu method CM_BMC_Dauer_Entladeleistung: phys=raw*200 for raw 0..4093, 4094=Cxffe_Init (CM_BMC_Dauer_Entladeleistung_Cxffe_Init), 4095=Cxfff_Fehler (CM_BMC_Dauer_Entladeleistung_Cxfff_Fehler); unit Unit_Watt
  compu method CM_DCDC_NV_Komponentenfehler_68: 0=Cx0_TstNotComplThisOpCycle_Init (CM_DCDC_NV_Komponentenfehler_68_Cx0_TstNotComplThisOpCycle_Init), 1=Cx1_TstComplThisOpCycle_Pass (CM_DCDC_NV_Komponentenfehler_68_Cx1_TstComplThisOpCycle_Pass), 2=Cx2_TstCmplThisCycle_Pass_TimeElapse (CM_DCDC_NV_Komponentenfehler_68_Cx2_TstCmplThisCycle_Pass_TimeElapse), 3=Cx3_TstComplThisOpCycle_FAIL (CM_DCDC_NV_Komponentenfehler_68_Cx3_TstComplThisOpCycle_FAIL)
  compu method CM_BMC_CMC_Zellspannung_116: phys=raw+1000 for raw 0..4091, 4092=Cxffc_kleiner_1V (CM_BMC_CMC_Zellspannung_116_Cxffc_kleiner_1V), 4093=Cxffd_nicht_vorhanden (CM_BMC_CMC_Zellspannung_116_Cxffd_nicht_vorhanden), 4094=Cxffe_Init (CM_BMC_CMC_Zellspannung_116_Cxffe_Init), 4095=Cxfff_Fehler (CM_BMC_CMC_Zellspannung_116_Cxfff_Fehler); unit Unit_MilliVolt
  compu method CM_HVLM_Ladeszenario: 0=Cx0_Aus (CM_HVLM_Ladeszenario_Cx0_Aus), 1=Cx1_Timerladen_abgeschlossen (CM_HVLM_Ladeszenario_Cx1_Timerladen_abgeschlossen), 2=Cx2_Sofortladen_abgeschlossen (CM_HVLM_Ladeszenario_Cx2_Sofortladen_abgeschlossen), 3=Cx3_Optimiertes_Laden_abgeschlossen (CM_HVLM_Ladeszenario_Cx3_Optimiertes_Laden_abgeschlossen), 4=Cx4_Timerladen_aktiv (CM_HVLM_Ladeszenario_Cx4_Timerladen_aktiv), 5=Cx5_Sofortladen_aktiv (CM_HVLM_Ladeszenario_Cx5_Sofortladen_aktiv), 6=Cx6_Optimiertes_Laden_aktiv (CM_HVLM_Ladeszenario_Cx6_Optimiertes_Laden_aktiv), 7=Cx7_Timerladen_warten (CM_HVLM_Ladeszenario_Cx7_Timerladen_warten), 8=Cx8_Optimiertes_Laden_warten (CM_HVLM_Ladeszenario_Cx8_Optimiertes_Laden_warten), 9=Cx9_Keine_Netzspannung (CM_HVLM_Ladeszenario_Cx9_Keine_Netzspannung), 10=Cxa_Fehler_Verriegelung (CM_HVLM_Ladeszenario_Cxa_Fehler_Verriegelung), 11=Cxb_Fehler_Ladesytem (CM_HVLM_Ladeszenario_Cxb_Fehler_Ladesytem), 12=Cxc_Init_Ladekommunikation (CM_HVLM_Ladeszenario_Cxc_Init_Ladekommunikation), 15=Cxf_Notladen (CM_HVLM_Ladeszenario_Cxf_Notladen), 16=Cx10_Ladeunterbrechung_Kunde (CM_HVLM_Ladeszenario_Cx10_Ladeunterbrechung_Kunde), 17=Cx11_Stecker_abziehbar (CM_HVLM_Ladeszenario_Cx11_Stecker_abziehbar), 18=Cx12_Kompatibilitaets_Umschaltung_aktiv (CM_HVLM_Ladeszenario_Cx12_Kompatibilitaets_Umschaltung_aktiv), 30=Cx1e_Init (CM_HVLM_Ladeszenario_Cx1e_Init), 31=Cx1f_Fehler (CM_HVLM_Ladeszenario_Cx1f_Fehler)
  compu method CM_HVEM_TME_Leistung_Vorgabe: phys=raw*50 for raw 0..1021, 1022=Cx3fe_Init (CM_HVEM_TME_Leistung_Vorgabe_Cx3fe_Init), 1023=Cx3ff_Fehler (CM_HVEM_TME_Leistung_Vorgabe_Cx3ff_Fehler); unit Unit_Watt
  compu method CM_HVLM_Aktive_Ladeart: 0=Cx0_Kein_Laden_aktiv (CM_HVLM_Aktive_Ladeart_Cx0_Kein_Laden_aktiv), 1=Cx1_AC_Laden_aktiv (CM_HVLM_Aktive_Ladeart_Cx1_AC_Laden_aktiv), 2=Cx2_DC_Laden_aktiv (CM_HVLM_Aktive_Ladeart_Cx2_DC_Laden_aktiv), 3=Cx3_AWC (CM_HVLM_Aktive_Ladeart_Cx3_AWC), 4=Cx4_Reserve (CM_HVLM_Aktive_Ladeart_Cx4_Reserve), 5=Cx5_Reserve (CM_HVLM_Aktive_Ladeart_Cx5_Reserve), 6=Cx6_Reserve (CM_HVLM_Aktive_Ladeart_Cx6_Reserve), 7=Cx7_Fehler (CM_HVLM_Aktive_Ladeart_Cx7_Fehler)
  compu method CM_AB_Gurtschloss_FA: 0=Cx0_nicht_verbaut (CM_AB_Gurtschloss_FA_Cx0_nicht_verbaut), 1=Cx1_nicht_verfuegbar_Fehler_oder_Init (CM_AB_Gurtschloss_FA_Cx1_nicht_verfuegbar_Fehler_oder_Init) (nicht_verfügbar (Fehler oder Init)), 2=Cx2_nicht_gesteckt (CM_AB_Gurtschloss_FA_Cx2_nicht_gesteckt), 3=Cx3_gesteckt (CM_AB_Gurtschloss_FA_Cx3_gesteckt)
  compu method CM_BMC_CMC_Zellspannung_068: phys=raw+1000 for raw 0..4091, 4092=Cxffc_kleiner_1V (CM_BMC_CMC_Zellspannung_068_Cxffc_kleiner_1V), 4093=Cxffd_nicht_vorhanden (CM_BMC_CMC_Zellspannung_068_Cxffd_nicht_vorhanden), 4094=Cxffe_Init (CM_BMC_CMC_Zellspannung_068_Cxffe_Init), 4095=Cxfff_Fehler (CM_BMC_CMC_Zellspannung_068_Cxfff_Fehler); unit Unit_MilliVolt
  compu method CM_BMC_RtmWarnZelleZustand: 0=Cx0_kein_Fehler (CM_BMC_RtmWarnZelleZustand_Cx0_kein_Fehler), 1=Cx1_Fehler_Stufe_1 (CM_BMC_RtmWarnZelleZustand_Cx1_Fehler_Stufe_1), 2=Cx2_Fehler_Stufe_2 (CM_BMC_RtmWarnZelleZustand_Cx2_Fehler_Stufe_2), 3=Cx3_Fehler_Stufe_3 (CM_BMC_RtmWarnZelleZustand_Cx3_Fehler_Stufe_3), 4=Cx4_reserviert (CM_BMC_RtmWarnZelleZustand_Cx4_reserviert), 5=Cx5_reserviert (CM_BMC_RtmWarnZelleZustand_Cx5_reserviert), 6=Cx6_reserviert (CM_BMC_RtmWarnZelleZustand_Cx6_reserviert), 7=Cx7_reserviert (CM_BMC_RtmWarnZelleZustand_Cx7_reserviert)
  compu method CM_DCDC_NV_Komponentenfehler_08: 0=Cx0_TstNotComplThisOpCycle_Init (CM_DCDC_NV_Komponentenfehler_08_Cx0_TstNotComplThisOpCycle_Init), 1=Cx1_TstComplThisOpCycle_Pass (CM_DCDC_NV_Komponentenfehler_08_Cx1_TstComplThisOpCycle_Pass), 2=Cx2_TstCmplThisCycle_Pass_TimeElapse (CM_DCDC_NV_Komponentenfehler_08_Cx2_TstCmplThisCycle_Pass_TimeElapse), 3=Cx3_TstComplThisOpCycle_FAIL (CM_DCDC_NV_Komponentenfehler_08_Cx3_TstComplThisOpCycle_FAIL)
  compu method CM_BMC_CMC_Temperatur_092: phys=raw*0.5-40 for raw 0..252, 253=Cxfd_nicht_vorhanden (CM_BMC_CMC_Temperatur_092_Cxfd_nicht_vorhanden), 254=Cxfe_Init (CM_BMC_CMC_Temperatur_092_Cxfe_Init), 255=Cxff_Fehler (CM_BMC_CMC_Temperatur_092_Cxff_Fehler); unit Unit_DegreCelsi
  compu method CM_BMC_Dauer_Entladeleistung_02: phys=raw*200 for raw 0..16250, 16382=Cx3ffe_Init (CM_BMC_Dauer_Entladeleistung_02_Cx3ffe_Init), 16383=Cx3fff_Fehler (CM_BMC_Dauer_Entladeleistung_02_Cx3fff_Fehler); unit Unit_Watt
  compu method CM_BMC_Energieinhalt: phys=raw*4 for raw 0..65533, 65534=Cxfffe_Init (CM_BMC_Energieinhalt_Cxfffe_Init), 65535=Cxffff_Fehler (CM_BMC_Energieinhalt_Cxffff_Fehler); unit Unit_WattHour
  compu method CM_BMC_UBE_Indik_last_update_km: phys=raw for raw 0..1048573, 1048574=Cxffffe_Init (CM_BMC_UBE_Indik_last_update_km_Cxffffe_Init), 1048575=Cxfffff_Fehler (CM_BMC_UBE_Indik_last_update_km_Cxfffff_Fehler); unit Unit_KiloMeter
  compu method CM_HVLM_Ladevorgang_Anf: 0=Cx0_Laden_nicht_angefordert (CM_HVLM_Ladevorgang_Anf_Cx0_Laden_nicht_angefordert), 1=Cx1_AC_Laden_Angefordert (CM_HVLM_Ladevorgang_Anf_Cx1_AC_Laden_Angefordert), 2=Cx2_DC_Laden_Angefordert (CM_HVLM_Ladevorgang_Anf_Cx2_DC_Laden_Angefordert), 3=Cx3_AC_und_DC_Angefordert (CM_HVLM_Ladevorgang_Anf_Cx3_AC_und_DC_Angefordert), 4=Cx4_Induktiv_Laden_Angef (CM_HVLM_Ladevorgang_Anf_Cx4_Induktiv_Laden_Angef), 5=Cx5_AC_und_Induktiv_Angef (CM_HVLM_Ladevorgang_Anf_Cx5_AC_und_Induktiv_Angef), 6=Cx6_DC_und_Induktiv_Angef (CM_HVLM_Ladevorgang_Anf_Cx6_DC_und_Induktiv_Angef), 7=Cx7_AC_DC_und_Induktiv_Angef (CM_HVLM_Ladevorgang_Anf_Cx7_AC_DC_und_Induktiv_Angef)
  compu method CM_BMC_Dauer_Ladeleistung: phys=raw*200 for raw 0..4093, 4094=Cxffe_Init (CM_BMC_Dauer_Ladeleistung_Cxffe_Init), 4095=Cxfff_Fehler (CM_BMC_Dauer_Ladeleistung_Cxfff_Fehler); unit Unit_Watt
  compu method CM_BMC_RuecklaufTemperatur: phys=raw*0.125-40 for raw 0..1020, 1021=Cx3fd_Nicht_verbaut (CM_BMC_RuecklaufTemperatur_Cx3fd_Nicht_verbaut), 1022=Cx3fe_Init (CM_BMC_RuecklaufTemperatur_Cx3fe_Init), 1023=Cx3ff_Fehler (CM_BMC_RuecklaufTemperatur_Cx3ff_Fehler); unit Unit_DegreCelsi
  compu method CM_DCDC_NV_Komponentenfehler_09: 0=Cx0_TstNotComplThisOpCycle_Init (CM_DCDC_NV_Komponentenfehler_09_Cx0_TstNotComplThisOpCycle_Init), 1=Cx1_TstComplThisOpCycle_Pass (CM_DCDC_NV_Komponentenfehler_09_Cx1_TstComplThisOpCycle_Pass), 2=Cx2_TstCmplThisCycle_Pass_TimeElapse (CM_DCDC_NV_Komponentenfehler_09_Cx2_TstCmplThisCycle_Pass_TimeElapse), 3=Cx3_TstComplThisOpCycle_FAIL (CM_DCDC_NV_Komponentenfehler_09_Cx3_TstComplThisOpCycle_FAIL)
  compu method CM_HVLM_ALF_AktiverLadeniveauwunsch: 0=Cx0_Keine_Kundenanforderung (CM_HVLM_ALF_AktiverLadeniveauwunsch_Cx0_Keine_Kundenanforderung), 1=Cx1_Aktive_Kundenanforderung (CM_HVLM_ALF_AktiverLadeniveauwunsch_Cx1_Aktive_Kundenanforderung)
  compu method CM_BMC_CMC_Zellspannung_117: phys=raw+1000 for raw 0..4091, 4092=Cxffc_kleiner_1V (CM_BMC_CMC_Zellspannung_117_Cxffc_kleiner_1V), 4093=Cxffd_nicht_vorhanden (CM_BMC_CMC_Zellspannung_117_Cxffd_nicht_vorhanden), 4094=Cxffe_Init (CM_BMC_CMC_Zellspannung_117_Cxffe_Init), 4095=Cxfff_Fehler (CM_BMC_CMC_Zellspannung_117_Cxfff_Fehler); unit Unit_MilliVolt
  compu method CM_AB_Gurtschloss_FA_ext: 0=Cx0_nicht_verbaut (CM_AB_Gurtschloss_FA_ext_Cx0_nicht_verbaut), 1=Cx1_reserviert (CM_AB_Gurtschloss_FA_ext_Cx1_reserviert), 2=Cx2_nicht_gesteckt (CM_AB_Gurtschloss_FA_ext_Cx2_nicht_gesteckt), 3=Cx3_gesteckt (CM_AB_Gurtschloss_FA_ext_Cx3_gesteckt), 4=Cx4_dauerhaft_nicht_gesteckt (CM_AB_Gurtschloss_FA_ext_Cx4_dauerhaft_nicht_gesteckt), 5=Cx5_dauerhaft_gesteckt (CM_AB_Gurtschloss_FA_ext_Cx5_dauerhaft_gesteckt), 6=Cx6_Init (CM_AB_Gurtschloss_FA_ext_Cx6_Init), 7=Cx7_Fehler (CM_AB_Gurtschloss_FA_ext_Cx7_Fehler)
  compu method CM_DCDC_NV_Komponentenfehler_69: 0=Cx0_TstNotComplThisOpCycle_Init (CM_DCDC_NV_Komponentenfehler_69_Cx0_TstNotComplThisOpCycle_Init), 1=Cx1_TstComplThisOpCycle_Pass (CM_DCDC_NV_Komponentenfehler_69_Cx1_TstComplThisOpCycle_Pass), 2=Cx2_TstCmplThisCycle_Pass_TimeElapse (CM_DCDC_NV_Komponentenfehler_69_Cx2_TstCmplThisCycle_Pass_TimeElapse), 3=Cx3_TstComplThisOpCycle_FAIL (CM_DCDC_NV_Komponentenfehler_69_Cx3_TstComplThisOpCycle_FAIL)
  compu method CM_HVLM_ALF_Ladestatus_Niveau: 0=Cx0_Kein_Laden_aktiv (CM_HVLM_ALF_Ladestatus_Niveau_Cx0_Kein_Laden_aktiv), 1=Cx1_Ladestrom_aktiv (CM_HVLM_ALF_Ladestatus_Niveau_Cx1_Ladestrom_aktiv), 2=Cx2_Laden_pausiert (CM_HVLM_ALF_Ladestatus_Niveau_Cx2_Laden_pausiert), 3=Cx3_Objekterkennung_aktiv (CM_HVLM_ALF_Ladestatus_Niveau_Cx3_Objekterkennung_aktiv), 4=Cx4_Ladeniveau_herstellen (CM_HVLM_ALF_Ladestatus_Niveau_Cx4_Ladeniveau_herstellen), 6=Cx6_Init (CM_HVLM_ALF_Ladestatus_Niveau_Cx6_Init), 7=Cx7_Fehler (CM_HVLM_ALF_Ladestatus_Niveau_Cx7_Fehler)
  compu method CM_HVEM_TME_MSF_aktiv: 0=Cx0_InitWert_MSF_nicht_aktiv (CM_HVEM_TME_MSF_aktiv_Cx0_InitWert_MSF_nicht_aktiv), 1=Cx1_MSF_aktiv (CM_HVEM_TME_MSF_aktiv_Cx1_MSF_aktiv)
  compu method CM_HVLM_Max_Strom_Netz_L1: phys=raw*0.1 for raw 0..630, 1022=Cx3fe_Init (CM_HVLM_Max_Strom_Netz_L1_Cx3fe_Init), 1023=Cx3ff_Fehler (CM_HVLM_Max_Strom_Netz_L1_Cx3ff_Fehler); unit Unit_Amper
  compu method CM_BMC_CMC_Zellspannung_118: phys=raw+1000 for raw 0..4091, 4092=Cxffc_kleiner_1V (CM_BMC_CMC_Zellspannung_118_Cxffc_kleiner_1V), 4093=Cxffd_nicht_vorhanden (CM_BMC_CMC_Zellspannung_118_Cxffd_nicht_vorhanden), 4094=Cxffe_Init (CM_BMC_CMC_Zellspannung_118_Cxffe_Init), 4095=Cxfff_Fehler (CM_BMC_CMC_Zellspannung_118_Cxfff_Fehler); unit Unit_MilliVolt
  compu method CM_BMC_Spannung: phys=raw*0.0625 for raw 0..16380, 16381=Cx3ffd_Null_Bank (CM_BMC_Spannung_Cx3ffd_Null_Bank), 16382=Cx3ffe_Init (CM_BMC_Spannung_Cx3ffe_Init), 16383=Cx3fff_Fehler (CM_BMC_Spannung_Cx3fff_Fehler); unit Unit_Volt
  compu method CM_NM_aktiv_ConnectVerbund_UseCase5: 0=Cx0_Inaktiv (CM_NM_aktiv_ConnectVerbund_UseCase5_Cx0_Inaktiv), 1=Cx1_Aktiv (CM_NM_aktiv_ConnectVerbund_UseCase5_Cx1_Aktiv)
  compu method CM_BMC_EnergieVorhalt: phys=raw*0.1 for raw 0..65532, 65533=Cxfffd_Funktion_nicht_umgesetzt (CM_BMC_EnergieVorhalt_Cxfffd_Funktion_nicht_umgesetzt), 65534=Cxfffe_Init (CM_BMC_EnergieVorhalt_Cxfffe_Init), 65535=Cxffff_Fehler (CM_BMC_EnergieVorhalt_Cxffff_Fehler); unit Unit_KiloWattHour
  compu method CM_BMC_CMC_Temperatur_093: phys=raw*0.5-40 for raw 0..252, 253=Cxfd_nicht_vorhanden (CM_BMC_CMC_Temperatur_093_Cxfd_nicht_vorhanden), 254=Cxfe_Init (CM_BMC_CMC_Temperatur_093_Cxfe_Init), 255=Cxff_Fehler (CM_BMC_CMC_Temperatur_093_Cxff_Fehler); unit Unit_DegreCelsi
  compu method CM_BMC_UBE_Indikator: phys=raw*0.1 for raw 0..1000, 2043=Cx7fb_kleiner_0 (CM_BMC_UBE_Indikator_Cx7fb_kleiner_0), 2044=Cx7fc_groesser_100 (CM_BMC_UBE_Indikator_Cx7fc_groesser_100), 2045=Cx7fd_nicht_angelernt (CM_BMC_UBE_Indikator_Cx7fd_nicht_angelernt), 2046=Cx7fe_Init (CM_BMC_UBE_Indikator_Cx7fe_Init), 2047=Cx7ff_Fehler (CM_BMC_UBE_Indikator_Cx7ff_Fehler); unit Unit_PerCent
  compu method CM_DCDC_NV_Komponentenfehler_10: 0=Cx0_TstNotComplThisOpCycle_Init (CM_DCDC_NV_Komponentenfehler_10_Cx0_TstNotComplThisOpCycle_Init), 1=Cx1_TstComplThisOpCycle_Pass (CM_DCDC_NV_Komponentenfehler_10_Cx1_TstComplThisOpCycle_Pass), 2=Cx2_TstCmplThisCycle_Pass_TimeElapse (CM_DCDC_NV_Komponentenfehler_10_Cx2_TstCmplThisCycle_Pass_TimeElapse), 3=Cx3_TstComplThisOpCycle_FAIL (CM_DCDC_NV_Komponentenfehler_10_Cx3_TstComplThisOpCycle_FAIL)
  compu method CM_HVLM_ALF_PosAnforderung: 0=Cx0_inaktiv (CM_HVLM_ALF_PosAnforderung_Cx0_inaktiv), 1=Cx1_Aktivierungsanforderung_ManuellesParken (CM_HVLM_ALF_PosAnforderung_Cx1_Aktivierungsanforderung_ManuellesParken), 2=Cx2_Aktivierungsanforderung_AssistiertesParken (CM_HVLM_ALF_PosAnforderung_Cx2_Aktivierungsanforderung_AssistiertesParken), 3=Cx3_Umschaltung_Nahbereich_ManuellesParken (CM_HVLM_ALF_PosAnforderung_Cx3_Umschaltung_Nahbereich_ManuellesParken), 7=Cx7_Fehler (CM_HVLM_ALF_PosAnforderung_Cx7_Fehler)
  compu method CM_NM_aktiv_ConnectVerbund_UseCase6: 0=Cx0_Inaktiv (CM_NM_aktiv_ConnectVerbund_UseCase6_Cx0_Inaktiv), 1=Cx1_Aktiv (CM_NM_aktiv_ConnectVerbund_UseCase6_Cx1_Aktiv)
  compu method CM_BMC_CMC_Zellspannung_119: phys=raw+1000 for raw 0..4091, 4092=Cxffc_kleiner_1V (CM_BMC_CMC_Zellspannung_119_Cxffc_kleiner_1V), 4093=Cxffd_nicht_vorhanden (CM_BMC_CMC_Zellspannung_119_Cxffd_nicht_vorhanden), 4094=Cxffe_Init (CM_BMC_CMC_Zellspannung_119_Cxffe_Init), 4095=Cxfff_Fehler (CM_BMC_CMC_Zellspannung_119_Cxfff_Fehler); unit Unit_MilliVolt
  compu method CM_HVLM_Max_Strom_Netz_L2: phys=raw*0.1 for raw 0..630, 1022=Cx3fe_Init (CM_HVLM_Max_Strom_Netz_L2_Cx3fe_Init), 1023=Cx3ff_Fehler (CM_HVLM_Max_Strom_Netz_L2_Cx3ff_Fehler); unit Unit_Amper
  compu method CM_BMC_Spannung_DC_Ladesaeule: phys=raw*0.0625-1023 for raw 0..32764, 32765=Cx7ffd_nicht_messbar (CM_BMC_Spannung_DC_Ladesaeule_Cx7ffd_nicht_messbar), 32766=Cx7ffe_Init (CM_BMC_Spannung_DC_Ladesaeule_Cx7ffe_Init), 32767=Cx7fff_Fehler (CM_BMC_Spannung_DC_Ladesaeule_Cx7fff_Fehler); unit Unit_Volt
  compu method CM_DCDC_NV_Komponentenfehler_11: 0=Cx0_TstNotComplThisOpCycle_Init (CM_DCDC_NV_Komponentenfehler_11_Cx0_TstNotComplThisOpCycle_Init), 1=Cx1_TstComplThisOpCycle_Pass (CM_DCDC_NV_Komponentenfehler_11_Cx1_TstComplThisOpCycle_Pass), 2=Cx2_TstCmplThisCycle_Pass_TimeElapse (CM_DCDC_NV_Komponentenfehler_11_Cx2_TstCmplThisCycle_Pass_TimeElapse), 3=Cx3_TstComplThisOpCycle_FAIL (CM_DCDC_NV_Komponentenfehler_11_Cx3_TstComplThisOpCycle_FAIL)
  compu method CM_AB_Gurtschloss_FA_ext_aktiv: 0=Cx0_inaktiv (CM_AB_Gurtschloss_FA_ext_aktiv_Cx0_inaktiv), 1=Cx1_aktiv (CM_AB_Gurtschloss_FA_ext_aktiv_Cx1_aktiv)
  compu method CM_HVLM_ALF_PosLadeart: 0=Cx0_keine_ALF (CM_HVLM_ALF_PosLadeart_Cx0_keine_ALF), 1=Cx1_AWC (CM_HVLM_ALF_PosLadeart_Cx1_AWC), 2=Cx2_ACD_U (CM_HVLM_ALF_PosLadeart_Cx2_ACD_U) (ACD-U), 3=Cx3_ACD_S (CM_HVLM_ALF_PosLadeart_Cx3_ACD_S) (ACD-S), 7=Cx7_Fehler (CM_HVLM_ALF_PosLadeart_Cx7_Fehler)
  compu method CM_DCDC_NV_Komponentenfehler_70: 0=Cx0_TstNotComplThisOpCycle_Init (CM_DCDC_NV_Komponentenfehler_70_Cx0_TstNotComplThisOpCycle_Init), 1=Cx1_TstComplThisOpCycle_Pass (CM_DCDC_NV_Komponentenfehler_70_Cx1_TstComplThisOpCycle_Pass), 2=Cx2_TstCmplThisCycle_Pass_TimeElapse (CM_DCDC_NV_Komponentenfehler_70_Cx2_TstCmplThisCycle_Pass_TimeElapse), 3=Cx3_TstComplThisOpCycle_FAIL (CM_DCDC_NV_Komponentenfehler_70_Cx3_TstComplThisOpCycle_FAIL)
  compu method CM_NM_aktiv_E3_SW_Plattform_1: 0=Cx0_Inaktiv (CM_NM_aktiv_E3_SW_Plattform_1_Cx0_Inaktiv), 1=Cx1_Aktiv (CM_NM_aktiv_E3_SW_Plattform_1_Cx1_Aktiv)
  compu method CM_HVEM_TME_Sollstatus: 0=Cx0_Regelbetrieb (CM_HVEM_TME_Sollstatus_Cx0_Regelbetrieb), 1=Cx1_Leistung_reduzieren (CM_HVEM_TME_Sollstatus_Cx1_Leistung_reduzieren), 2=Cx2_Verzoegerung_Lastabwurf (CM_HVEM_TME_Sollstatus_Cx2_Verzoegerung_Lastabwurf), 3=Cx3_Leistung_erhoehen (CM_HVEM_TME_Sollstatus_Cx3_Leistung_erhoehen)
  compu method CM_BMC_ExtLadeleistung: phys=raw*0.05 for raw 0..65533, 65534=Cxfffe_Init (CM_BMC_ExtLadeleistung_Cxfffe_Init), 65535=Cxffff_Fehler (CM_BMC_ExtLadeleistung_Cxffff_Fehler); unit Unit_KiloWatt
  compu method CM_BMC_CMC_Temperatur_094: phys=raw*0.5-40 for raw 0..252, 253=Cxfd_nicht_vorhanden (CM_BMC_CMC_Temperatur_094_Cxfd_nicht_vorhanden), 254=Cxfe_Init (CM_BMC_CMC_Temperatur_094_Cxfe_Init), 255=Cxff_Fehler (CM_BMC_CMC_Temperatur_094_Cxff_Fehler); unit Unit_DegreCelsi
  compu method CM_BMC_Ueberspannungszaehler_CMC01: phys=raw for raw 0..400, 510=Cx1fe_InitWert (CM_BMC_Ueberspannungszaehler_CMC01_Cx1fe_InitWert), 511=Cx1ff_Fehler (CM_BMC_Ueberspannungszaehler_CMC01_Cx1ff_Fehler); unit Unit_None
  compu method CM_BMC_CMC_Zellspannung_120: phys=raw+1000 for raw 0..4091, 4092=Cxffc_kleiner_1V (CM_BMC_CMC_Zellspannung_120_Cxffc_kleiner_1V), 4093=Cxffd_nicht_vorhanden (CM_BMC_CMC_Zellspannung_120_Cxffd_nicht_vorhanden), 4094=Cxffe_Init (CM_BMC_CMC_Zellspannung_120_Cxffe_Init), 4095=Cxfff_Fehler (CM_BMC_CMC_Zellspannung_120_Cxfff_Fehler); unit Unit_MilliVolt
  compu method CM_BMC_Spannung_Messzeit: phys=raw for raw 0..253, 254=Cxfe_Init (CM_BMC_Spannung_Messzeit_Cxfe_Init), 255=Cxff_Fehler (CM_BMC_Spannung_Messzeit_Cxff_Fehler); unit Unit_None
  compu method CM_HVLM_Max_Strom_Netz_L3: phys=raw*0.1 for raw 0..630, 1022=Cx3fe_Init (CM_HVLM_Max_Strom_Netz_L3_Cx3fe_Init), 1023=Cx3ff_Fehler (CM_HVLM_Max_Strom_Netz_L3_Cx3ff_Fehler); unit Unit_Amper
  compu method CM_DCDC_NV_Komponentenfehler_12: 0=Cx0_TstNotComplThisOpCycle_Init (CM_DCDC_NV_Komponentenfehler_12_Cx0_TstNotComplThisOpCycle_Init), 1=Cx1_TstComplThisOpCycle_Pass (CM_DCDC_NV_Komponentenfehler_12_Cx1_TstComplThisOpCycle_Pass), 2=Cx2_TstCmplThisCycle_Pass_TimeElapse (CM_DCDC_NV_Komponentenfehler_12_Cx2_TstCmplThisCycle_Pass_TimeElapse), 3=Cx3_TstComplThisOpCycle_FAIL (CM_DCDC_NV_Komponentenfehler_12_Cx3_TstComplThisOpCycle_FAIL)
  compu method CM_HVLM_ALF_PosStatus: 0=Cx0_Inaktiv (CM_HVLM_ALF_PosStatus_Cx0_Inaktiv), 1=Cx1_Ladebereich_nicht_erreicht (CM_HVLM_ALF_PosStatus_Cx1_Ladebereich_nicht_erreicht), 2=Cx2_Ladebereich_erreicht (CM_HVLM_ALF_PosStatus_Cx2_Ladebereich_erreicht), 7=Cx7_Fehler (CM_HVLM_ALF_PosStatus_Cx7_Fehler)
  compu method CM_NM_aktiv_E3_SW_Plattform_2: 0=Cx0_Inaktiv (CM_NM_aktiv_E3_SW_Plattform_2_Cx0_Inaktiv), 1=Cx1_Aktiv (CM_NM_aktiv_E3_SW_Plattform_2_Cx1_Aktiv)
  compu method CM_KS_Hybrid_01_ReM: phys=raw for raw 0..18446744073709551615; unit Unit_None
  compu method CM_BMC_CMC_Zellspannung_121: phys=raw+1000 for raw 0..4091, 4092=Cxffc_kleiner_1V (CM_BMC_CMC_Zellspannung_121_Cxffc_kleiner_1V), 4093=Cxffd_nicht_vorhanden (CM_BMC_CMC_Zellspannung_121_Cxffd_nicht_vorhanden), 4094=Cxffe_Init (CM_BMC_CMC_Zellspannung_121_Cxffe_Init), 4095=Cxfff_Fehler (CM_BMC_CMC_Zellspannung_121_Cxfff_Fehler); unit Unit_MilliVolt
  compu method CM_HVLM_MaxSpannung_OBG_HV: phys=raw for raw 0..1021, 1022=Cx3fe_Init (CM_HVLM_MaxSpannung_OBG_HV_Cx3fe_Init), 1023=Cx3ff_Fehler (CM_HVLM_MaxSpannung_OBG_HV_Cx3ff_Fehler); unit Unit_Volt
  compu method CM_DCDC_NV_Komponentenfehler_13: 0=Cx0_TstNotComplThisOpCycle_Init (CM_DCDC_NV_Komponentenfehler_13_Cx0_TstNotComplThisOpCycle_Init), 1=Cx1_TstComplThisOpCycle_Pass (CM_DCDC_NV_Komponentenfehler_13_Cx1_TstComplThisOpCycle_Pass), 2=Cx2_TstCmplThisCycle_Pass_TimeElapse (CM_DCDC_NV_Komponentenfehler_13_Cx2_TstCmplThisCycle_Pass_TimeElapse), 3=Cx3_TstComplThisOpCycle_FAIL (CM_DCDC_NV_Komponentenfehler_13_Cx3_TstComplThisOpCycle_FAIL)
  compu method CM_BMC_Spannung_ZwischenKreis: phys=raw*0.0625 for raw 0..16380, 16381=Cx3ffd_nicht_messbar (CM_BMC_Spannung_ZwischenKreis_Cx3ffd_nicht_messbar), 16382=Cx3ffe_Init (CM_BMC_Spannung_ZwischenKreis_Cx3ffe_Init), 16383=Cx3fff_Fehler (CM_BMC_Spannung_ZwischenKreis_Cx3fff_Fehler); unit Unit_Volt
  compu method CM_HVLM_BCAM_Aktiv: 0=Cx0_inaktiv (CM_HVLM_BCAM_Aktiv_Cx0_inaktiv), 1=Cx1_aktiv (CM_HVLM_BCAM_Aktiv_Cx1_aktiv)
  compu method CM_NM_aktiv_E3_SW_Plattform_3: 0=Cx0_Inaktiv (CM_NM_aktiv_E3_SW_Plattform_3_Cx0_Inaktiv), 1=Cx1_Aktiv (CM_NM_aktiv_E3_SW_Plattform_3_Cx1_Aktiv)
  compu method CM_AB_Gurtschloss_Reihe2_BF: 0=Cx0_nicht_verbaut (CM_AB_Gurtschloss_Reihe2_BF_Cx0_nicht_verbaut), 1=Cx1_nicht_verfuegbar_Fehler_oder_Init (CM_AB_Gurtschloss_Reihe2_BF_Cx1_nicht_verfuegbar_Fehler_oder_Init) (nicht_verfügbar (Fehler oder Init)), 2=Cx2_nicht_gesteckt (CM_AB_Gurtschloss_Reihe2_BF_Cx2_nicht_gesteckt), 3=Cx3_gesteckt (CM_AB_Gurtschloss_Reihe2_BF_Cx3_gesteckt)
  compu method CM_DCDC_NV_Komponentenfehler_71: 0=Cx0_TstNotComplThisOpCycle_Init (CM_DCDC_NV_Komponentenfehler_71_Cx0_TstNotComplThisOpCycle_Init), 1=Cx1_TstComplThisOpCycle_Pass (CM_DCDC_NV_Komponentenfehler_71_Cx1_TstComplThisOpCycle_Pass), 2=Cx2_TstCmplThisCycle_Pass_TimeElapse (CM_DCDC_NV_Komponentenfehler_71_Cx2_TstCmplThisCycle_Pass_TimeElapse), 3=Cx3_TstComplThisOpCycle_FAIL (CM_DCDC_NV_Komponentenfehler_71_Cx3_TstComplThisOpCycle_FAIL)
  compu method CM_HVHL_HVK_EoHVL_Status: 0=Cx0_Init (CM_HVHL_HVK_EoHVL_Status_Cx0_Init), 1=Cx1_Uzwkr_kleiner_UEoHVL_Schwell (CM_HVHL_HVK_EoHVL_Status_Cx1_Uzwkr_kleiner_UEoHVL_Schwell), 2=Cx2_Uzwkr_groesgleich_UEoHVL_Schwell (CM_HVHL_HVK_EoHVL_Status_Cx2_Uzwkr_groesgleich_UEoHVL_Schwell), 3=Cx3_Fehler (CM_HVHL_HVK_EoHVL_Status_Cx3_Fehler)
  compu method CM_BMC_Fehler_Leistungsred: 0=Cx0_kein_Fehler (CM_BMC_Fehler_Leistungsred_Cx0_kein_Fehler), 1=Cx1_Fehler_Leistungsred (CM_BMC_Fehler_Leistungsred_Cx1_Fehler_Leistungsred)
  compu method CM_BMC_CMC_Temperatur_095: phys=raw*0.5-40 for raw 0..252, 253=Cxfd_nicht_vorhanden (CM_BMC_CMC_Temperatur_095_Cxfd_nicht_vorhanden), 254=Cxfe_Init (CM_BMC_CMC_Temperatur_095_Cxfe_Init), 255=Cxff_Fehler (CM_BMC_CMC_Temperatur_095_Cxff_Fehler); unit Unit_DegreCelsi
  compu method CM_KS_Hybrid_01_ReM_IKACtr: phys=raw for raw 0..255; unit Unit_None
  compu method CM_NM_aktiv_E3_SW_Plattform_4: 0=Cx0_Inaktiv (CM_NM_aktiv_E3_SW_Plattform_4_Cx0_Inaktiv), 1=Cx1_Aktiv (CM_NM_aktiv_E3_SW_Plattform_4_Cx1_Aktiv)
  compu method CM_HVLM_BidiLadeModus: 0=Cx0_InitWert_kein_bidi_Laden (CM_HVLM_BidiLadeModus_Cx0_InitWert_kein_bidi_Laden), 1=Cx1_bidi_Laden_kleine_Leistung (CM_HVLM_BidiLadeModus_Cx1_bidi_Laden_kleine_Leistung), 2=Cx2_bidi_Laden_mittlere_Leistung (CM_HVLM_BidiLadeModus_Cx2_bidi_Laden_mittlere_Leistung)
  compu method CM_HVLM_OBG_SollModus: 0=Cx0_Standby (CM_HVLM_OBG_SollModus_Cx0_Standby), 1=Cx1_Netzladung_Anforderung (CM_HVLM_OBG_SollModus_Cx1_Netzladung_Anforderung), 2=Cx2_Rueckspeisung_solo (CM_HVLM_OBG_SollModus_Cx2_Rueckspeisung_solo), 3=Cx3_Rueckspeisung_grid (CM_HVLM_OBG_SollModus_Cx3_Rueckspeisung_grid), 4=Cx4_Vorladen_Anforderung (CM_HVLM_OBG_SollModus_Cx4_Vorladen_Anforderung)
  compu method CM_DCDC_NV_Komponentenfehler_14: 0=Cx0_TstNotComplThisOpCycle_Init (CM_DCDC_NV_Komponentenfehler_14_Cx0_TstNotComplThisOpCycle_Init), 1=Cx1_TstComplThisOpCycle_Pass (CM_DCDC_NV_Komponentenfehler_14_Cx1_TstComplThisOpCycle_Pass), 2=Cx2_TstCmplThisCycle_Pass_TimeElapse (CM_DCDC_NV_Komponentenfehler_14_Cx2_TstCmplThisCycle_Pass_TimeElapse), 3=Cx3_TstComplThisOpCycle_FAIL (CM_DCDC_NV_Komponentenfehler_14_Cx3_TstComplThisOpCycle_FAIL)
  compu method CM_BMC_Spannung_ZwischenKreis_2: phys=raw*0.0625 for raw 0..16380, 16381=Cx3ffd_nicht_messbar (CM_BMC_Spannung_ZwischenKreis_2_Cx3ffd_nicht_messbar), 16382=Cx3ffe_Init (CM_BMC_Spannung_ZwischenKreis_2_Cx3ffe_Init), 16383=Cx3fff_Fehler (CM_BMC_Spannung_ZwischenKreis_2_Cx3fff_Fehler); unit Unit_Volt
  compu method CM_BMC_CMC_Zellspannung_122: phys=raw+1000 for raw 0..4091, 4092=Cxffc_kleiner_1V (CM_BMC_CMC_Zellspannung_122_Cxffc_kleiner_1V), 4093=Cxffd_nicht_vorhanden (CM_BMC_CMC_Zellspannung_122_Cxffd_nicht_vorhanden), 4094=Cxffe_Init (CM_BMC_CMC_Zellspannung_122_Cxffe_Init), 4095=Cxfff_Fehler (CM_BMC_CMC_Zellspannung_122_Cxfff_Fehler); unit Unit_MilliVolt
  compu method CM_BMC_Ueberspannungszaehler_CMC02: phys=raw for raw 0..400, 510=Cx1fe_InitWert (CM_BMC_Ueberspannungszaehler_CMC02_Cx1fe_InitWert), 511=Cx1ff_Fehler (CM_BMC_Ueberspannungszaehler_CMC02_Cx1ff_Fehler); unit Unit_None
  compu method CM_NM_aktiv_E3_SW_Plattform_5: 0=Cx0_Inaktiv (CM_NM_aktiv_E3_SW_Plattform_5_Cx0_Inaktiv), 1=Cx1_Aktiv (CM_NM_aktiv_E3_SW_Plattform_5_Cx1_Aktiv)
  compu method CM_HVLM_CP_Fehlerzustand_A: 0=Cx0_Init (CM_HVLM_CP_Fehlerzustand_A_Cx0_Init), 1=Cx1_kein_Fehler (CM_HVLM_CP_Fehlerzustand_A_Cx1_kein_Fehler), 2=Cx2_Spannung_niO (CM_HVLM_CP_Fehlerzustand_A_Cx2_Spannung_niO), 3=Cx3_Frequenz_niO (CM_HVLM_CP_Fehlerzustand_A_Cx3_Frequenz_niO), 4=Cx4_Tastgrad_niO (CM_HVLM_CP_Fehlerzustand_A_Cx4_Tastgrad_niO), 5=Cx5_State_niO (CM_HVLM_CP_Fehlerzustand_A_Cx5_State_niO)
  compu method CM_KS_Hybrid_01_ReM_SID: phys=raw for raw 0..65535; unit Unit_None
  compu method CM_AB_Gurtschloss_Reihe2_FA: 0=Cx0_nicht_verbaut (CM_AB_Gurtschloss_Reihe2_FA_Cx0_nicht_verbaut), 1=Cx1_nicht_verfuegbar_Fehler_oder_Init (CM_AB_Gurtschloss_Reihe2_FA_Cx1_nicht_verfuegbar_Fehler_oder_Init) (nicht_verfügbar (Fehler oder Init)), 2=Cx2_nicht_gesteckt (CM_AB_Gurtschloss_Reihe2_FA_Cx2_nicht_gesteckt), 3=Cx3_gesteckt (CM_AB_Gurtschloss_Reihe2_FA_Cx3_gesteckt)
  compu method CM_BMC_CMC_Zellspannung_123: phys=raw+1000 for raw 0..4091, 4092=Cxffc_kleiner_1V (CM_BMC_CMC_Zellspannung_123_Cxffc_kleiner_1V), 4093=Cxffd_nicht_vorhanden (CM_BMC_CMC_Zellspannung_123_Cxffd_nicht_vorhanden), 4094=Cxffe_Init (CM_BMC_CMC_Zellspannung_123_Cxffe_Init), 4095=Cxfff_Fehler (CM_BMC_CMC_Zellspannung_123_Cxfff_Fehler); unit Unit_MilliVolt
  compu method CM_HVHL_HVK_Fehler_intern: 0=Cx0_kein_Fehler (CM_HVHL_HVK_Fehler_intern_Cx0_kein_Fehler) (kein Fehler), 1=Cx1_Fehler_aktiv (CM_HVHL_HVK_Fehler_intern_Cx1_Fehler_aktiv)
  compu method CM_DCDC_NV_Komponentenfehler_72: 0=Cx0_TstNotComplThisOpCycle_Init (CM_DCDC_NV_Komponentenfehler_72_Cx0_TstNotComplThisOpCycle_Init), 1=Cx1_TstComplThisOpCycle_Pass (CM_DCDC_NV_Komponentenfehler_72_Cx1_TstComplThisOpCycle_Pass), 2=Cx2_TstCmplThisCycle_Pass_TimeElapse (CM_DCDC_NV_Komponentenfehler_72_Cx2_TstCmplThisCycle_Pass_TimeElapse), 3=Cx3_TstComplThisOpCycle_FAIL (CM_DCDC_NV_Komponentenfehler_72_Cx3_TstComplThisOpCycle_FAIL)
  compu method CM_NM_aktiv_Erw_HV_Ladefunktion: 0=Cx0_Inaktiv (CM_NM_aktiv_Erw_HV_Ladefunktion_Cx0_Inaktiv), 1=Cx1_Aktiv (CM_NM_aktiv_Erw_HV_Ladefunktion_Cx1_Aktiv)
  compu method CM_HVLM_PrkCtl_StAlyReq: 0=Cx0_NoReq (CM_HVLM_PrkCtl_StAlyReq_Cx0_NoReq), 1=Cx1_Park (CM_HVLM_PrkCtl_StAlyReq_Cx1_Park), 2=Cx2_ParkWithPPosn (CM_HVLM_PrkCtl_StAlyReq_Cx2_ParkWithPPosn), 3=Cx3_State3 (CM_HVLM_PrkCtl_StAlyReq_Cx3_State3), 4=Cx4_State4 (CM_HVLM_PrkCtl_StAlyReq_Cx4_State4), 5=Cx5_State5 (CM_HVLM_PrkCtl_StAlyReq_Cx5_State5), 6=Cx6_Init (CM_HVLM_PrkCtl_StAlyReq_Cx6_Init), 7=Cx7_Fehler (CM_HVLM_PrkCtl_StAlyReq_Cx7_Fehler)
  compu method CM_BMC_Fehler_Warnung: 0=Cx0_Keine_Warnung (CM_BMC_Fehler_Warnung_Cx0_Keine_Warnung), 1=Cx1_Warnung_ohne_Leistungseinschraenkung (CM_BMC_Fehler_Warnung_Cx1_Warnung_ohne_Leistungseinschraenkung) (Warnung_ohne_Leistungseinschränkung), 2=Cx2_Warnung_mit_Leistungseinschraenkung (CM_BMC_Fehler_Warnung_Cx2_Warnung_mit_Leistungseinschraenkung) (Warnung_mit_Leistungseinschränkung)
  compu method CM_BMC_CMC_Temperatur_096: phys=raw*0.5-40 for raw 0..252, 253=Cxfd_nicht_vorhanden (CM_BMC_CMC_Temperatur_096_Cxfd_nicht_vorhanden), 254=Cxfe_Init (CM_BMC_CMC_Temperatur_096_Cxfe_Init), 255=Cxff_Fehler (CM_BMC_CMC_Temperatur_096_Cxff_Fehler); unit Unit_DegreCelsi
  compu method CM_DCDC_NV_Komponentenfehler_15: 0=Cx0_TstNotComplThisOpCycle_Init (CM_DCDC_NV_Komponentenfehler_15_Cx0_TstNotComplThisOpCycle_Init), 1=Cx1_TstComplThisOpCycle_Pass (CM_DCDC_NV_Komponentenfehler_15_Cx1_TstComplThisOpCycle_Pass), 2=Cx2_TstCmplThisCycle_Pass_TimeElapse (CM_DCDC_NV_Komponentenfehler_15_Cx2_TstCmplThisCycle_Pass_TimeElapse), 3=Cx3_TstComplThisOpCycle_FAIL (CM_DCDC_NV_Komponentenfehler_15_Cx3_TstComplThisOpCycle_FAIL)
  compu method CM_HVLM_CP_Fehlerzustand_B: 0=Cx0_Init (CM_HVLM_CP_Fehlerzustand_B_Cx0_Init), 1=Cx1_kein_Fehler (CM_HVLM_CP_Fehlerzustand_B_Cx1_kein_Fehler), 2=Cx2_Spannung_niO (CM_HVLM_CP_Fehlerzustand_B_Cx2_Spannung_niO), 3=Cx3_Frequenz_niO (CM_HVLM_CP_Fehlerzustand_B_Cx3_Frequenz_niO), 4=Cx4_Tastgrad_niO (CM_HVLM_CP_Fehlerzustand_B_Cx4_Tastgrad_niO), 5=Cx5_State_niO (CM_HVLM_CP_Fehlerzustand_B_Cx5_State_niO)
  compu method CM_BMC_Ueberspannungszaehler_CMC03: phys=raw for raw 0..400, 510=Cx1fe_InitWert (CM_BMC_Ueberspannungszaehler_CMC03_Cx1fe_InitWert), 511=Cx1ff_Fehler (CM_BMC_Ueberspannungszaehler_CMC03_Cx1ff_Fehler); unit Unit_None
  compu method CM_BMC_CMC_Zellspannung_124: phys=raw+1000 for raw 0..4091, 4092=Cxffc_kleiner_1V (CM_BMC_CMC_Zellspannung_124_Cxffc_kleiner_1V), 4093=Cxffd_nicht_vorhanden (CM_BMC_CMC_Zellspannung_124_Cxffd_nicht_vorhanden), 4094=Cxffe_Init (CM_BMC_CMC_Zellspannung_124_Cxffe_Init), 4095=Cxfff_Fehler (CM_BMC_CMC_Zellspannung_124_Cxfff_Fehler); unit Unit_MilliVolt
  compu method CM_NM_aktiv_Gefahreninfo: 0=Cx0_inaktiv (CM_NM_aktiv_Gefahreninfo_Cx0_inaktiv), 1=Cx1_aktiv (CM_NM_aktiv_Gefahreninfo_Cx1_aktiv)
  compu method CM_HVLM_PrkCtl_StPrkLockReq: 0=Cx0_NoReq (CM_HVLM_PrkCtl_StPrkLockReq_Cx0_NoReq), 1=Cx1_ParkLock (CM_HVLM_PrkCtl_StPrkLockReq_Cx1_ParkLock), 2=Cx2_Init (CM_HVLM_PrkCtl_StPrkLockReq_Cx2_Init), 3=Cx3_Fehler (CM_HVLM_PrkCtl_StPrkLockReq_Cx3_Fehler)
  compu method CM_HVLM_CP_KommProtokoll_A: 0=Cx0_Init (CM_HVLM_CP_KommProtokoll_A_Cx0_Init), 1=Cx1_Basis_PWM (CM_HVLM_CP_KommProtokoll_A_Cx1_Basis_PWM), 2=Cx2_HLC_Datenkommunikation (CM_HVLM_CP_KommProtokoll_A_Cx2_HLC_Datenkommunikation), 3=Cx3_unbekannt (CM_HVLM_CP_KommProtokoll_A_Cx3_unbekannt)
  compu method CM_DCDC_NV_Komponentenfehler_16: 0=Cx0_TstNotComplThisOpCycle_Init (CM_DCDC_NV_Komponentenfehler_16_Cx0_TstNotComplThisOpCycle_Init), 1=Cx1_TstComplThisOpCycle_Pass (CM_DCDC_NV_Komponentenfehler_16_Cx1_TstComplThisOpCycle_Pass), 2=Cx2_TstCmplThisCycle_Pass_TimeElapse (CM_DCDC_NV_Komponentenfehler_16_Cx2_TstCmplThisCycle_Pass_TimeElapse), 3=Cx3_TstComplThisOpCycle_FAIL (CM_DCDC_NV_Komponentenfehler_16_Cx3_TstComplThisOpCycle_FAIL)
  compu method CM_AB_Gurtschloss_Reihe2_MI: 0=Cx0_nicht_verbaut (CM_AB_Gurtschloss_Reihe2_MI_Cx0_nicht_verbaut), 1=Cx1_nicht_verfuegbar_Fehler_oder_Init (CM_AB_Gurtschloss_Reihe2_MI_Cx1_nicht_verfuegbar_Fehler_oder_Init) (nicht_verfügbar (Fehler oder Init)), 2=Cx2_nicht_gesteckt (CM_AB_Gurtschloss_Reihe2_MI_Cx2_nicht_gesteckt), 3=Cx3_gesteckt (CM_AB_Gurtschloss_Reihe2_MI_Cx3_gesteckt)
  compu method CM_HVHL_HVK_Status_Spgfreiheit: 0=Cx0_Init (CM_HVHL_HVK_Status_Spgfreiheit_Cx0_Init), 1=Cx1_HV_Komponente_spannungsfrei (CM_HVHL_HVK_Status_Spgfreiheit_Cx1_HV_Komponente_spannungsfrei), 2=Cx2_HV_Komp_nicht_spannungsfrei (CM_HVHL_HVK_Status_Spgfreiheit_Cx2_HV_Komp_nicht_spannungsfrei), 3=Cx3_Fehler (CM_HVHL_HVK_Status_Spgfreiheit_Cx3_Fehler)
  compu method CM_NM_aktiv_HV_Laden: 0=Cx0_Inaktiv (CM_NM_aktiv_HV_Laden_Cx0_Inaktiv), 1=Cx1_Aktiv (CM_NM_aktiv_HV_Laden_Cx1_Aktiv)
  compu method CM_DCDC_NV_Komponentenfehler_73: 0=Cx0_TstNotComplThisOpCycle_Init (CM_DCDC_NV_Komponentenfehler_73_Cx0_TstNotComplThisOpCycle_Init), 1=Cx1_TstComplThisOpCycle_Pass (CM_DCDC_NV_Komponentenfehler_73_Cx1_TstComplThisOpCycle_Pass), 2=Cx2_TstCmplThisCycle_Pass_TimeElapse (CM_DCDC_NV_Komponentenfehler_73_Cx2_TstCmplThisCycle_Pass_TimeElapse), 3=Cx3_TstComplThisOpCycle_FAIL (CM_DCDC_NV_Komponentenfehler_73_Cx3_TstComplThisOpCycle_FAIL)
  compu method CM_BMC_CMC_Zellspannung_125: phys=raw+1000 for raw 0..4091, 4092=Cxffc_kleiner_1V (CM_BMC_CMC_Zellspannung_125_Cxffc_kleiner_1V), 4093=Cxffd_nicht_vorhanden (CM_BMC_CMC_Zellspannung_125_Cxffd_nicht_vorhanden), 4094=Cxffe_Init (CM_BMC_CMC_Zellspannung_125_Cxffe_Init), 4095=Cxfff_Fehler (CM_BMC_CMC_Zellspannung_125_Cxfff_Fehler); unit Unit_MilliVolt
  compu method CM_HVLM_Pulsierstufe: 0=Cx0_keine_Anforderung (CM_HVLM_Pulsierstufe_Cx0_keine_Anforderung), 1=Cx1_Stufe_0 (CM_HVLM_Pulsierstufe_Cx1_Stufe_0), 2=Cx2_Stufe_1 (CM_HVLM_Pulsierstufe_Cx2_Stufe_1), 3=Cx3_Stufe_2 (CM_HVLM_Pulsierstufe_Cx3_Stufe_2), 4=Cx4_Stufe_3 (CM_HVLM_Pulsierstufe_Cx4_Stufe_3), 5=Cx5_Stufe_4 (CM_HVLM_Pulsierstufe_Cx5_Stufe_4), 6=Cx6_Stufe_5 (CM_HVLM_Pulsierstufe_Cx6_Stufe_5), 7=Cx7_Stufe_6 (CM_HVLM_Pulsierstufe_Cx7_Stufe_6)
  compu method CM_KS_Hybrid_01_Req_IKA_Retry: 0=Cx0_Erste_IKA_Anfrage_des_KS_Slave (CM_KS_Hybrid_01_Req_IKA_Retry_Cx0_Erste_IKA_Anfrage_des_KS_Slave) (Erste IKA-Anfrage des KS-Slave), 1=Cx1_Wiederholte_IKA_Anfrage_des_KS_Slave_AuthRetryCounter_0 (CM_KS_Hybrid_01_Req_IKA_Retry_Cx1_Wiederholte_IKA_Anfrage_des_KS_Slave_AuthRetryCounter_0) (Wiederholte IKA-Anfrage des KS-Slave (AuthRetryCounter > 0))
  compu method CM_BMC_CMC_Zellspannung_001: phys=raw+1000 for raw 0..4091, 4092=Cxffc_kleiner_1V (CM_BMC_CMC_Zellspannung_001_Cxffc_kleiner_1V), 4093=Cxffd_nicht_vorhanden (CM_BMC_CMC_Zellspannung_001_Cxffd_nicht_vorhanden), 4094=Cxffe_Init (CM_BMC_CMC_Zellspannung_001_Cxffe_Init), 4095=Cxfff_Fehler (CM_BMC_CMC_Zellspannung_001_Cxfff_Fehler); unit Unit_MilliVolt
  compu method CM_HVLM_CP_KommProtokoll_B: 0=Cx0_Init (CM_HVLM_CP_KommProtokoll_B_Cx0_Init), 1=Cx1_Basis_PWM (CM_HVLM_CP_KommProtokoll_B_Cx1_Basis_PWM), 2=Cx2_HLC_Datenkommunikation (CM_HVLM_CP_KommProtokoll_B_Cx2_HLC_Datenkommunikation), 3=Cx3_unbekannt (CM_HVLM_CP_KommProtokoll_B_Cx3_unbekannt)
  compu method CM_DCDC_NV_Komponentenfehler_17: 0=Cx0_TstNotComplThisOpCycle_Init (CM_DCDC_NV_Komponentenfehler_17_Cx0_TstNotComplThisOpCycle_Init), 1=Cx1_TstComplThisOpCycle_Pass (CM_DCDC_NV_Komponentenfehler_17_Cx1_TstComplThisOpCycle_Pass), 2=Cx2_TstCmplThisCycle_Pass_TimeElapse (CM_DCDC_NV_Komponentenfehler_17_Cx2_TstCmplThisCycle_Pass_TimeElapse), 3=Cx3_TstComplThisOpCycle_FAIL (CM_DCDC_NV_Komponentenfehler_17_Cx3_TstComplThisOpCycle_FAIL)
  compu method CM_NM_aktiv_HVEM: 0=Cx0_Inaktiv (CM_NM_aktiv_HVEM_Cx0_Inaktiv), 1=Cx1_Aktiv (CM_NM_aktiv_HVEM_Cx1_Aktiv)
  compu method CM_BMC_Ueberspannungszaehler_CMC04: phys=raw for raw 0..400, 510=Cx1fe_InitWert (CM_BMC_Ueberspannungszaehler_CMC04_Cx1fe_InitWert), 511=Cx1ff_Fehler (CM_BMC_Ueberspannungszaehler_CMC04_Cx1ff_Fehler); unit Unit_None
  compu method CM_BMC_Flash_Freigabe: 0=Cx0_keine_Freigabe (CM_BMC_Flash_Freigabe_Cx0_keine_Freigabe), 1=Cx1_Freigabe (CM_BMC_Flash_Freigabe_Cx1_Freigabe)
  compu method CM_BMC_CMC_Zellspannung_126: phys=raw+1000 for raw 0..4091, 4092=Cxffc_kleiner_1V (CM_BMC_CMC_Zellspannung_126_Cxffc_kleiner_1V), 4093=Cxffd_nicht_vorhanden (CM_BMC_CMC_Zellspannung_126_Cxffd_nicht_vorhanden), 4094=Cxffe_Init (CM_BMC_CMC_Zellspannung_126_Cxffe_Init), 4095=Cxfff_Fehler (CM_BMC_CMC_Zellspannung_126_Cxfff_Fehler); unit Unit_MilliVolt
  compu method CM_HVLM_CP_MaxStrom_A: phys=raw*0.1 for raw 0..800, 1021=Cx3fd_nicht_bekannt (CM_HVLM_CP_MaxStrom_A_Cx3fd_nicht_bekannt), 1022=Cx3fe_Init (CM_HVLM_CP_MaxStrom_A_Cx3fe_Init); unit Unit_Amper
  compu method CM_KS_Hybrid_01_Req_Prio: 0=Cx0_KS_Slave_wird_normal_authentifiziert (CM_KS_Hybrid_01_Req_Prio_Cx0_KS_Slave_wird_normal_authentifiziert) (KS-Slave wird normal authentifiziert), 1=Cx1_KS_Slave_fordert_priorisierte_Authentifikation (CM_KS_Hybrid_01_Req_Prio_Cx1_KS_Slave_fordert_priorisierte_Authentifikation) (KS-Slave fordert priorisierte Authentifikation)
  compu method CM_HVLM_S2SchliessenAnf_A: 0=Cx0_oeffnen (CM_HVLM_S2SchliessenAnf_A_Cx0_oeffnen), 1=Cx1_schliessen (CM_HVLM_S2SchliessenAnf_A_Cx1_schliessen)
  compu method CM_NM_aktiv_HVK: 0=Cx0_Inaktiv (CM_NM_aktiv_HVK_Cx0_Inaktiv), 1=Cx1_Aktiv (CM_NM_aktiv_HVK_Cx1_Aktiv)
  compu method CM_DCDC_NV_Komponentenfehler_18: 0=Cx0_TstNotComplThisOpCycle_Init (CM_DCDC_NV_Komponentenfehler_18_Cx0_TstNotComplThisOpCycle_Init), 1=Cx1_TstComplThisOpCycle_Pass (CM_DCDC_NV_Komponentenfehler_18_Cx1_TstComplThisOpCycle_Pass), 2=Cx2_TstCmplThisCycle_Pass_TimeElapse (CM_DCDC_NV_Komponentenfehler_18_Cx2_TstCmplThisCycle_Pass_TimeElapse), 3=Cx3_TstComplThisOpCycle_FAIL (CM_DCDC_NV_Komponentenfehler_18_Cx3_TstComplThisOpCycle_FAIL)
  compu method CM_AB_Gurtschloss_Reihe3_BF: 0=Cx0_nicht_verbaut (CM_AB_Gurtschloss_Reihe3_BF_Cx0_nicht_verbaut), 1=Cx1_nicht_verfuegbar_Fehler_oder_Init (CM_AB_Gurtschloss_Reihe3_BF_Cx1_nicht_verfuegbar_Fehler_oder_Init) (nicht_verfügbar (Fehler oder Init)), 2=Cx2_nicht_gesteckt (CM_AB_Gurtschloss_Reihe3_BF_Cx2_nicht_gesteckt), 3=Cx3_gesteckt (CM_AB_Gurtschloss_Reihe3_BF_Cx3_gesteckt)
  compu method CM_HVLM_CP_MaxStrom_B: phys=raw*0.1 for raw 0..800, 1021=Cx3fd_nicht_bekannt (CM_HVLM_CP_MaxStrom_B_Cx3fd_nicht_bekannt), 1022=Cx3fe_Init (CM_HVLM_CP_MaxStrom_B_Cx3fe_Init); unit Unit_Amper
  compu method CM_NM_aktiv_HVLM: 0=Cx0_Inaktiv (CM_NM_aktiv_HVLM_Cx0_Inaktiv), 1=Cx1_Aktiv (CM_NM_aktiv_HVLM_Cx1_Aktiv)
  compu method CM_HVK_03_BZ: phys=raw for raw 0..15
  compu method CM_DCDC_NV_Komponentenfehler_74: 0=Cx0_TstNotComplThisOpCycle_Init (CM_DCDC_NV_Komponentenfehler_74_Cx0_TstNotComplThisOpCycle_Init), 1=Cx1_TstComplThisOpCycle_Pass (CM_DCDC_NV_Komponentenfehler_74_Cx1_TstComplThisOpCycle_Pass), 2=Cx2_TstCmplThisCycle_Pass_TimeElapse (CM_DCDC_NV_Komponentenfehler_74_Cx2_TstCmplThisCycle_Pass_TimeElapse), 3=Cx3_TstComplThisOpCycle_FAIL (CM_DCDC_NV_Komponentenfehler_74_Cx3_TstComplThisOpCycle_FAIL)
  compu method CM_BMC_CMC_Zellspannung_127: phys=raw+1000 for raw 0..4091, 4092=Cxffc_kleiner_1V (CM_BMC_CMC_Zellspannung_127_Cxffc_kleiner_1V), 4093=Cxffd_nicht_vorhanden (CM_BMC_CMC_Zellspannung_127_Cxffd_nicht_vorhanden), 4094=Cxffe_Init (CM_BMC_CMC_Zellspannung_127_Cxffe_Init), 4095=Cxfff_Fehler (CM_BMC_CMC_Zellspannung_127_Cxfff_Fehler); unit Unit_MilliVolt
  compu method CM_HVLM_S2SchliessenAnf_B: 0=Cx0_oeffnen (CM_HVLM_S2SchliessenAnf_B_Cx0_oeffnen), 1=Cx1_schliessen (CM_HVLM_S2SchliessenAnf_B_Cx1_schliessen)
  compu method CM_BMC_Uebertemperaturzaehler_CMC01: phys=raw*10 for raw 0..60480, 65534=Cxfffe_InitWert (CM_BMC_Uebertemperaturzaehler_CMC01_Cxfffe_InitWert), 65535=Cxffff_Fehler (CM_BMC_Uebertemperaturzaehler_CMC01_Cxffff_Fehler); unit Unit_None
  compu method CM_BMC_CMC_Zellspannung_002: phys=raw+1000 for raw 0..4091, 4092=Cxffc_kleiner_1V (CM_BMC_CMC_Zellspannung_002_Cxffc_kleiner_1V), 4093=Cxffd_nicht_vorhanden (CM_BMC_CMC_Zellspannung_002_Cxffd_nicht_vorhanden), 4094=Cxffe_Init (CM_BMC_CMC_Zellspannung_002_Cxffe_Init), 4095=Cxfff_Fehler (CM_BMC_CMC_Zellspannung_002_Cxfff_Fehler); unit Unit_MilliVolt
  compu method CM_NM_aktiv_Key_Authentifiz_SMS: 0=Cx0_Inaktiv (CM_NM_aktiv_Key_Authentifiz_SMS_Cx0_Inaktiv), 1=Cx1_Aktiv (CM_NM_aktiv_Key_Authentifiz_SMS_Cx1_Aktiv)
  compu method CM_AB_Gurtschloss_Reihe3_FA: 0=Cx0_nicht_verbaut (CM_AB_Gurtschloss_Reihe3_FA_Cx0_nicht_verbaut), 1=Cx1_nicht_verfuegbar_Fehler_oder_Init (CM_AB_Gurtschloss_Reihe3_FA_Cx1_nicht_verfuegbar_Fehler_oder_Init) (nicht_verfügbar (Fehler oder Init)), 2=Cx2_nicht_gesteckt (CM_AB_Gurtschloss_Reihe3_FA_Cx2_nicht_gesteckt), 3=Cx3_gesteckt (CM_AB_Gurtschloss_Reihe3_FA_Cx3_gesteckt)
  compu method CM_HVLM_CP_State_A: 0=Cx0_Init (CM_HVLM_CP_State_A_Cx0_Init), 1=Cx1_A (CM_HVLM_CP_State_A_Cx1_A), 2=Cx2_B1 (CM_HVLM_CP_State_A_Cx2_B1), 3=Cx3_B2 (CM_HVLM_CP_State_A_Cx3_B2), 4=Cx4_C1 (CM_HVLM_CP_State_A_Cx4_C1), 5=Cx5_C2 (CM_HVLM_CP_State_A_Cx5_C2), 6=Cx6_E (CM_HVLM_CP_State_A_Cx6_E), 7=Cx7_F (CM_HVLM_CP_State_A_Cx7_F), 8=Cx8_kein_Zustand_erkannt (CM_HVLM_CP_State_A_Cx8_kein_Zustand_erkannt)
  compu method CM_HVLM_Schluessel_Anfrage: 0=Cx0_Keine_Anfrage_Init (CM_HVLM_Schluessel_Anfrage_Cx0_Keine_Anfrage_Init), 1=Cx1_Suchanfrage_LKL_1_aktiv (CM_HVLM_Schluessel_Anfrage_Cx1_Suchanfrage_LKL_1_aktiv), 2=Cx2_Suchanfrage_LKL_2_aktiv (CM_HVLM_Schluessel_Anfrage_Cx2_Suchanfrage_LKL_2_aktiv), 3=Cx3_Reserve (CM_HVLM_Schluessel_Anfrage_Cx3_Reserve)
  compu method CM_BMC_CMC_Zellspannung_128: phys=raw+1000 for raw 0..4091, 4092=Cxffc_kleiner_1V (CM_BMC_CMC_Zellspannung_128_Cxffc_kleiner_1V), 4093=Cxffd_nicht_vorhanden (CM_BMC_CMC_Zellspannung_128_Cxffd_nicht_vorhanden), 4094=Cxffe_Init (CM_BMC_CMC_Zellspannung_128_Cxffe_Init), 4095=Cxfff_Fehler (CM_BMC_CMC_Zellspannung_128_Cxfff_Fehler); unit Unit_MilliVolt
  compu method CM_DCDC_NV_Komponentenfehler_19: 0=Cx0_TstNotComplThisOpCycle_Init (CM_DCDC_NV_Komponentenfehler_19_Cx0_TstNotComplThisOpCycle_Init), 1=Cx1_TstComplThisOpCycle_Pass (CM_DCDC_NV_Komponentenfehler_19_Cx1_TstComplThisOpCycle_Pass), 2=Cx2_TstCmplThisCycle_Pass_TimeElapse (CM_DCDC_NV_Komponentenfehler_19_Cx2_TstCmplThisCycle_Pass_TimeElapse), 3=Cx3_TstComplThisOpCycle_FAIL (CM_DCDC_NV_Komponentenfehler_19_Cx3_TstComplThisOpCycle_FAIL)
  compu method CM_HVK_03_CRC: phys=raw for raw 0..255
  compu method CM_DCDC_NV_Komponentenfehler_75: 0=Cx0_TstNotComplThisOpCycle_Init (CM_DCDC_NV_Komponentenfehler_75_Cx0_TstNotComplThisOpCycle_Init), 1=Cx1_TstComplThisOpCycle_Pass (CM_DCDC_NV_Komponentenfehler_75_Cx1_TstComplThisOpCycle_Pass), 2=Cx2_TstCmplThisCycle_Pass_TimeElapse (CM_DCDC_NV_Komponentenfehler_75_Cx2_TstCmplThisCycle_Pass_TimeElapse), 3=Cx3_TstComplThisOpCycle_FAIL (CM_DCDC_NV_Komponentenfehler_75_Cx3_TstComplThisOpCycle_FAIL)
  compu method CM_NM_aktiv_Konditionierung_Track: 0=Cx0_Inaktiv (CM_NM_aktiv_Konditionierung_Track_Cx0_Inaktiv), 1=Cx1_Aktiv (CM_NM_aktiv_Konditionierung_Track_Cx1_Aktiv)
  compu method CM_BMC_Uebertemperaturzaehler_CMC02: phys=raw*10 for raw 0..60480, 65534=Cxfffe_InitWert (CM_BMC_Uebertemperaturzaehler_CMC02_Cxfffe_InitWert), 65535=Cxffff_Fehler (CM_BMC_Uebertemperaturzaehler_CMC02_Cxffff_Fehler); unit Unit_None
  compu method CM_BMC_CMC_Zellspannung_003: phys=raw+1000 for raw 0..4091, 4092=Cxffc_kleiner_1V (CM_BMC_CMC_Zellspannung_003_Cxffc_kleiner_1V), 4093=Cxffd_nicht_vorhanden (CM_BMC_CMC_Zellspannung_003_Cxffd_nicht_vorhanden), 4094=Cxffe_Init (CM_BMC_CMC_Zellspannung_003_Cxffe_Init), 4095=Cxfff_Fehler (CM_BMC_CMC_Zellspannung_003_Cxfff_Fehler); unit Unit_MilliVolt
  compu method CM_HVLM_CP_State_B: 0=Cx0_Init (CM_HVLM_CP_State_B_Cx0_Init), 1=Cx1_A (CM_HVLM_CP_State_B_Cx1_A), 2=Cx2_B1 (CM_HVLM_CP_State_B_Cx2_B1), 3=Cx3_B2 (CM_HVLM_CP_State_B_Cx3_B2), 4=Cx4_C1 (CM_HVLM_CP_State_B_Cx4_C1), 5=Cx5_C2 (CM_HVLM_CP_State_B_Cx5_C2), 6=Cx6_E (CM_HVLM_CP_State_B_Cx6_E), 7=Cx7_F (CM_HVLM_CP_State_B_Cx7_F), 8=Cx8_kein_Zustand_erkannt (CM_HVLM_CP_State_B_Cx8_kein_Zustand_erkannt)
  compu method CM_BMC_CMC_Zellspannung_129: phys=raw+1000 for raw 0..4091, 4092=Cxffc_kleiner_1V (CM_BMC_CMC_Zellspannung_129_Cxffc_kleiner_1V), 4093=Cxffd_nicht_vorhanden (CM_BMC_CMC_Zellspannung_129_Cxffd_nicht_vorhanden), 4094=Cxffe_Init (CM_BMC_CMC_Zellspannung_129_Cxffe_Init), 4095=Cxfff_Fehler (CM_BMC_CMC_Zellspannung_129_Cxfff_Fehler); unit Unit_MilliVolt
  compu method CM_HVLM_SF4OeffnenAnf_A: 0=Cx0_schliessen (CM_HVLM_SF4OeffnenAnf_A_Cx0_schliessen), 1=Cx1_oeffnen (CM_HVLM_SF4OeffnenAnf_A_Cx1_oeffnen)
  compu method CM_NM_aktiv_Konditionierungsbedarf: 0=Cx0_Inaktiv (CM_NM_aktiv_Konditionierungsbedarf_Cx0_Inaktiv), 1=Cx1_Aktiv (CM_NM_aktiv_Konditionierungsbedarf_Cx1_Aktiv)
  compu method CM_DCDC_NV_Komponentenfehler_20: 0=Cx0_TstNotComplThisOpCycle_Init (CM_DCDC_NV_Komponentenfehler_20_Cx0_TstNotComplThisOpCycle_Init), 1=Cx1_TstComplThisOpCycle_Pass (CM_DCDC_NV_Komponentenfehler_20_Cx1_TstComplThisOpCycle_Pass), 2=Cx2_TstCmplThisCycle_Pass_TimeElapse (CM_DCDC_NV_Komponentenfehler_20_Cx2_TstCmplThisCycle_Pass_TimeElapse), 3=Cx3_TstComplThisOpCycle_FAIL (CM_DCDC_NV_Komponentenfehler_20_Cx3_TstComplThisOpCycle_FAIL)
  compu method CM_NM_aktiv_Ladestecker_erkannt_1: 0=Cx0_Inaktiv (CM_NM_aktiv_Ladestecker_erkannt_1_Cx0_Inaktiv), 1=Cx1_Aktiv (CM_NM_aktiv_Ladestecker_erkannt_1_Cx1_Aktiv)
  compu method CM_HVLM_DC_Aufstartmodus: 0=Cx0_keine_Anforderung (CM_HVLM_DC_Aufstartmodus_Cx0_keine_Anforderung), 1=Cx1_Angleich_Fahrzeug (CM_HVLM_DC_Aufstartmodus_Cx1_Angleich_Fahrzeug), 2=Cx2_Angleich_LS_1 (CM_HVLM_DC_Aufstartmodus_Cx2_Angleich_LS_1), 3=Cx3_Angleich_LS_2 (CM_HVLM_DC_Aufstartmodus_Cx3_Angleich_LS_2)
  compu method CM_BMC_CMC_Zellspannung_130: phys=raw+1000 for raw 0..4091, 4092=Cxffc_kleiner_1V (CM_BMC_CMC_Zellspannung_130_Cxffc_kleiner_1V), 4093=Cxffd_nicht_vorhanden (CM_BMC_CMC_Zellspannung_130_Cxffd_nicht_vorhanden), 4094=Cxffe_Init (CM_BMC_CMC_Zellspannung_130_Cxffe_Init), 4095=Cxfff_Fehler (CM_BMC_CMC_Zellspannung_130_Cxfff_Fehler); unit Unit_MilliVolt
  compu method CM_DCDC_NV_Komponentenfehler_76: 0=Cx0_TstNotComplThisOpCycle_Init (CM_DCDC_NV_Komponentenfehler_76_Cx0_TstNotComplThisOpCycle_Init), 1=Cx1_TstComplThisOpCycle_Pass (CM_DCDC_NV_Komponentenfehler_76_Cx1_TstComplThisOpCycle_Pass), 2=Cx2_TstCmplThisCycle_Pass_TimeElapse (CM_DCDC_NV_Komponentenfehler_76_Cx2_TstCmplThisCycle_Pass_TimeElapse), 3=Cx3_TstComplThisOpCycle_FAIL (CM_DCDC_NV_Komponentenfehler_76_Cx3_TstComplThisOpCycle_FAIL)
  compu method CM_HVK_AIAD_Sollmodus: 0=Cx0_Keine_Freigabe (CM_HVK_AIAD_Sollmodus_Cx0_Keine_Freigabe), 1=Cx1_Freigabe (CM_HVK_AIAD_Sollmodus_Cx1_Freigabe), 2=Cx2_Freigabe_ausgesetzt (CM_HVK_AIAD_Sollmodus_Cx2_Freigabe_ausgesetzt), 3=Cx3_Init (CM_HVK_AIAD_Sollmodus_Cx3_Init)
  compu method CM_HVLM_SF4OeffnenAnf_B: 0=Cx0_schliessen (CM_HVLM_SF4OeffnenAnf_B_Cx0_schliessen), 1=Cx1_oeffnen (CM_HVLM_SF4OeffnenAnf_B_Cx1_oeffnen)
  compu method CM_AB_Gurtschloss_Reihe3_MI: 0=Cx0_nicht_verbaut (CM_AB_Gurtschloss_Reihe3_MI_Cx0_nicht_verbaut), 1=Cx1_nicht_verfuegbar_Fehler_oder_Init (CM_AB_Gurtschloss_Reihe3_MI_Cx1_nicht_verfuegbar_Fehler_oder_Init) (nicht_verfügbar (Fehler oder Init)), 2=Cx2_nicht_gesteckt (CM_AB_Gurtschloss_Reihe3_MI_Cx2_nicht_gesteckt), 3=Cx3_gesteckt (CM_AB_Gurtschloss_Reihe3_MI_Cx3_gesteckt)
  compu method CM_BMC_CMC_Zellspannung_004: phys=raw+1000 for raw 0..4091, 4092=Cxffc_kleiner_1V (CM_BMC_CMC_Zellspannung_004_Cxffc_kleiner_1V), 4093=Cxffd_nicht_vorhanden (CM_BMC_CMC_Zellspannung_004_Cxffd_nicht_vorhanden), 4094=Cxffe_Init (CM_BMC_CMC_Zellspannung_004_Cxffe_Init), 4095=Cxfff_Fehler (CM_BMC_CMC_Zellspannung_004_Cxfff_Fehler); unit Unit_MilliVolt
  compu method CM_NM_aktiv_Ladestecker_erkannt_2: 0=Cx0_Inaktiv (CM_NM_aktiv_Ladestecker_erkannt_2_Cx0_Inaktiv), 1=Cx1_Aktiv (CM_NM_aktiv_Ladestecker_erkannt_2_Cx1_Aktiv)
  compu method CM_DCDC_NV_Komponentenfehler_21: 0=Cx0_TstNotComplThisOpCycle_Init (CM_DCDC_NV_Komponentenfehler_21_Cx0_TstNotComplThisOpCycle_Init), 1=Cx1_TstComplThisOpCycle_Pass (CM_DCDC_NV_Komponentenfehler_21_Cx1_TstComplThisOpCycle_Pass), 2=Cx2_TstCmplThisCycle_Pass_TimeElapse (CM_DCDC_NV_Komponentenfehler_21_Cx2_TstCmplThisCycle_Pass_TimeElapse), 3=Cx3_TstComplThisOpCycle_FAIL (CM_DCDC_NV_Komponentenfehler_21_Cx3_TstComplThisOpCycle_FAIL)
  compu method CM_HVLM_DC_SollStrom: phys=raw*0.1 for raw 0..1600, 2046=Cx7fe_Init (CM_HVLM_DC_SollStrom_Cx7fe_Init), 2047=Cx7ff_Fehler (CM_HVLM_DC_SollStrom_Cx7ff_Fehler); unit Unit_Amper
  compu method CM_BMC_Uebertemperaturzaehler_CMC03: phys=raw*10 for raw 0..60480, 65534=Cxfffe_InitWert (CM_BMC_Uebertemperaturzaehler_CMC03_Cxfffe_InitWert), 65535=Cxffff_Fehler (CM_BMC_Uebertemperaturzaehler_CMC03_Cxffff_Fehler); unit Unit_Ohm
  compu method CM_BMC_CMC_Zellspannung_131: phys=raw+1000 for raw 0..4091, 4092=Cxffc_kleiner_1V (CM_BMC_CMC_Zellspannung_131_Cxffc_kleiner_1V), 4093=Cxffd_nicht_vorhanden (CM_BMC_CMC_Zellspannung_131_Cxffd_nicht_vorhanden), 4094=Cxffe_Init (CM_BMC_CMC_Zellspannung_131_Cxffe_Init), 4095=Cxfff_Fehler (CM_BMC_CMC_Zellspannung_131_Cxfff_Fehler); unit Unit_MilliVolt
  compu method CM_KS_Hybrid_01_Req_VKMS_Err: 0=Cx0_Im_KS_Slave_liegt_kein_VKMS_Fehler_vor_VKMS_Type_Id_Ready_VKMS_ERR_NONE (CM_KS_Hybrid_01_Req_VKMS_Err_Cx0_Im_KS_Slave_liegt_kein_VKMS_Fehler_vor_VKMS_Type_Id_Ready_VKMS_ERR_NONE) (Im KS-Slave liegt kein VKMS Fehler vor (VKMS Type Id Ready = VKMS_ERR_NONE)), 1=Cx1_Im_KS_Slave_liegt_ein_VKMS_Fehler_vor_VKMS_Type_Id_Ready_VKMS_ERR_NONE (CM_KS_Hybrid_01_Req_VKMS_Err_Cx1_Im_KS_Slave_liegt_ein_VKMS_Fehler_vor_VKMS_Type_Id_Ready_VKMS_ERR_NONE) (Im KS-Slave liegt ein VKMS Fehler vor (VKMS Type Id Ready != VKMS_ERR_NONE))
  compu method CM_HVLM_SpannungsModusDc_Anf: 0=Cx0_Keine_Anforderung_DC_Laden_oder_Init (CM_HVLM_SpannungsModusDc_Anf_Cx0_Keine_Anforderung_DC_Laden_oder_Init) (Keine Anforderung DC-Laden oder Init), 1=Cx1_Anforderung_des_seriellen_Spannungsmodus_volle_Spannung (CM_HVLM_SpannungsModusDc_Anf_Cx1_Anforderung_des_seriellen_Spannungsmodus_volle_Spannung) (Anforderung des seriellen Spannungsmodus (volle Spannung)), 2=Cx2_Anforderung_des_parallelen_Spannungsmodus_halbe_Spannung (CM_HVLM_SpannungsModusDc_Anf_Cx2_Anforderung_des_parallelen_Spannungsmodus_halbe_Spannung) (Anforderung des parallelen Spannungsmodus (halbe Spannung))
  compu method CM_HVLM_GAFrequenz: phys=raw*10 for raw 0..16380, 16381=Cx3ffd_keine_Angabe (CM_HVLM_GAFrequenz_Cx3ffd_keine_Angabe), 16382=Cx3ffe_Init (CM_HVLM_GAFrequenz_Cx3ffe_Init), 16383=Cx3fff_Fehler (CM_HVLM_GAFrequenz_Cx3fff_Fehler); unit Unit_Hertz
  compu method CM_NM_aktiv_Ladezustand: 0=Cx0_Inaktiv (CM_NM_aktiv_Ladezustand_Cx0_Inaktiv), 1=Cx1_Aktiv (CM_NM_aktiv_Ladezustand_Cx1_Aktiv)
  compu method CM_DCDC_NV_Komponentenfehler_22: 0=Cx0_TstNotComplThisOpCycle_Init (CM_DCDC_NV_Komponentenfehler_22_Cx0_TstNotComplThisOpCycle_Init), 1=Cx1_TstComplThisOpCycle_Pass (CM_DCDC_NV_Komponentenfehler_22_Cx1_TstComplThisOpCycle_Pass), 2=Cx2_TstCmplThisCycle_Pass_TimeElapse (CM_DCDC_NV_Komponentenfehler_22_Cx2_TstCmplThisCycle_Pass_TimeElapse), 3=Cx3_TstComplThisOpCycle_FAIL (CM_DCDC_NV_Komponentenfehler_22_Cx3_TstComplThisOpCycle_FAIL)
  compu method CM_DCDC_NV_Komponentenfehler_77: 0=Cx0_TstNotComplThisOpCycle_Init (CM_DCDC_NV_Komponentenfehler_77_Cx0_TstNotComplThisOpCycle_Init), 1=Cx1_TstComplThisOpCycle_Pass (CM_DCDC_NV_Komponentenfehler_77_Cx1_TstComplThisOpCycle_Pass), 2=Cx2_TstCmplThisCycle_Pass_TimeElapse (CM_DCDC_NV_Komponentenfehler_77_Cx2_TstCmplThisCycle_Pass_TimeElapse), 3=Cx3_TstComplThisOpCycle_FAIL (CM_DCDC_NV_Komponentenfehler_77_Cx3_TstComplThisOpCycle_FAIL)
  compu method CM_HVK_AktiveEntladung_Anf: 0=Cx0_nicht_angefordert (CM_HVK_AktiveEntladung_Anf_Cx0_nicht_angefordert), 1=Cx1_angefordert (CM_HVK_AktiveEntladung_Anf_Cx1_angefordert)
  compu method CM_AB_Gurtschloss_Reihe4_BF: 0=Cx0_nicht_verbaut (CM_AB_Gurtschloss_Reihe4_BF_Cx0_nicht_verbaut), 1=Cx1_nicht_verfuegbar_Fehler_oder_Init (CM_AB_Gurtschloss_Reihe4_BF_Cx1_nicht_verfuegbar_Fehler_oder_Init) (nicht_verfügbar (Fehler oder Init)), 2=Cx2_nicht_gesteckt (CM_AB_Gurtschloss_Reihe4_BF_Cx2_nicht_gesteckt), 3=Cx3_gesteckt (CM_AB_Gurtschloss_Reihe4_BF_Cx3_gesteckt)
  compu method CM_KST_Anf_Klemmenfreigabe_ELV: 0=Cx0_nicht_angefordert (CM_KST_Anf_Klemmenfreigabe_ELV_Cx0_nicht_angefordert), 1=Cx1_angefordert (CM_KST_Anf_Klemmenfreigabe_ELV_Cx1_angefordert)
  compu method CM_HVLM_Start_Pulserkennung: 0=Cx0_keine_Anforderung (CM_HVLM_Start_Pulserkennung_Cx0_keine_Anforderung), 1=Cx1_Pulserkennung_starten (CM_HVLM_Start_Pulserkennung_Cx1_Pulserkennung_starten)
  compu method CM_BMC_CMC_Zellspannung_005: phys=raw+1000 for raw 0..4091, 4092=Cxffc_kleiner_1V (CM_BMC_CMC_Zellspannung_005_Cxffc_kleiner_1V), 4093=Cxffd_nicht_vorhanden (CM_BMC_CMC_Zellspannung_005_Cxffd_nicht_vorhanden), 4094=Cxffe_Init (CM_BMC_CMC_Zellspannung_005_Cxffe_Init), 4095=Cxfff_Fehler (CM_BMC_CMC_Zellspannung_005_Cxfff_Fehler); unit Unit_MilliVolt
  compu method CM_BMC_CMC_Zellspannung_132: phys=raw+1000 for raw 0..4091, 4092=Cxffc_kleiner_1V (CM_BMC_CMC_Zellspannung_132_Cxffc_kleiner_1V), 4093=Cxffd_nicht_vorhanden (CM_BMC_CMC_Zellspannung_132_Cxffd_nicht_vorhanden), 4094=Cxffe_Init (CM_BMC_CMC_Zellspannung_132_Cxffe_Init), 4095=Cxfff_Fehler (CM_BMC_CMC_Zellspannung_132_Cxfff_Fehler); unit Unit_MilliVolt
  compu method CM_HVLM_GASpulenstrom: phys=raw*0.1 for raw 0..1020, 1021=Cx3fd_keine_Angabe (CM_HVLM_GASpulenstrom_Cx3fd_keine_Angabe), 1022=Cx3fe_Init (CM_HVLM_GASpulenstrom_Cx3fe_Init), 1023=Cx3ff_Fehler (CM_HVLM_GASpulenstrom_Cx3ff_Fehler); unit Unit_Amper
  compu method CM_NM_aktiv_MVEM_Fremdladung: 0=Cx0_Inaktiv (CM_NM_aktiv_MVEM_Fremdladung_Cx0_Inaktiv), 1=Cx1_Aktiv (CM_NM_aktiv_MVEM_Fremdladung_Cx1_Aktiv)
  compu method CM_BMC_Uebertemperaturzaehler_CMC04: phys=raw*10 for raw 0..60480, 65534=Cxfffe_InitWert (CM_BMC_Uebertemperaturzaehler_CMC04_Cxfffe_InitWert), 65535=Cxffff_Fehler (CM_BMC_Uebertemperaturzaehler_CMC04_Cxffff_Fehler); unit Unit_None
  compu method CM_DCDC_NV_Komponentenfehler_23: 0=Cx0_TstNotComplThisOpCycle_Init (CM_DCDC_NV_Komponentenfehler_23_Cx0_TstNotComplThisOpCycle_Init), 1=Cx1_TstComplThisOpCycle_Pass (CM_DCDC_NV_Komponentenfehler_23_Cx1_TstComplThisOpCycle_Pass), 2=Cx2_TstCmplThisCycle_Pass_TimeElapse (CM_DCDC_NV_Komponentenfehler_23_Cx2_TstCmplThisCycle_Pass_TimeElapse), 3=Cx3_TstComplThisOpCycle_FAIL (CM_DCDC_NV_Komponentenfehler_23_Cx3_TstComplThisOpCycle_FAIL)
  compu method CM_KST_Ausparken_Betrieb: 0=Cx0_kein_Betrieb (CM_KST_Ausparken_Betrieb_Cx0_kein_Betrieb), 1=Cx1_Ausparkvorgang_aktiv (CM_KST_Ausparken_Betrieb_Cx1_Ausparkvorgang_aktiv)
  compu method CM_NM_aktiv_MVEM_Pos_RSG: 0=Cx0_Inaktiv (CM_NM_aktiv_MVEM_Pos_RSG_Cx0_Inaktiv), 1=Cx1_Aktiv (CM_NM_aktiv_MVEM_Pos_RSG_Cx1_Aktiv)
  compu method CM_HVLM_Grundladen_Anf: 0=Cx0_Keine_Anforderung_Sofortladen (CM_HVLM_Grundladen_Anf_Cx0_Keine_Anforderung_Sofortladen), 1=Cx1_Sofortladen_Kundenwunsch (CM_HVLM_Grundladen_Anf_Cx1_Sofortladen_Kundenwunsch)
  compu method CM_HVLM_Stecker_Notentriegeln_Anf_A: 0=Cx0_Init (CM_HVLM_Stecker_Notentriegeln_Anf_A_Cx0_Init), 1=Cx1_keine_Notentriegelung (CM_HVLM_Stecker_Notentriegeln_Anf_A_Cx1_keine_Notentriegelung), 2=Cx2_Ladestecker_notentriegeln (CM_HVLM_Stecker_Notentriegeln_Anf_A_Cx2_Ladestecker_notentriegeln)
  compu method CM_HVK_BMC_Sollmodus: 0=Cx0_HV_Off (CM_HVK_BMC_Sollmodus_Cx0_HV_Off), 1=Cx1_HV_On (CM_HVK_BMC_Sollmodus_Cx1_HV_On), 4=Cx4_AC_Laden (CM_HVK_BMC_Sollmodus_Cx4_AC_Laden), 6=Cx6_DC_Laden (CM_HVK_BMC_Sollmodus_Cx6_DC_Laden), 7=Cx7_Init (CM_HVK_BMC_Sollmodus_Cx7_Init)
  compu method CM_DCDC_NV_Komponentenfehler_78: 0=Cx0_TstNotComplThisOpCycle_Init (CM_DCDC_NV_Komponentenfehler_78_Cx0_TstNotComplThisOpCycle_Init), 1=Cx1_TstComplThisOpCycle_Pass (CM_DCDC_NV_Komponentenfehler_78_Cx1_TstComplThisOpCycle_Pass), 2=Cx2_TstCmplThisCycle_Pass_TimeElapse (CM_DCDC_NV_Komponentenfehler_78_Cx2_TstCmplThisCycle_Pass_TimeElapse), 3=Cx3_TstComplThisOpCycle_FAIL (CM_DCDC_NV_Komponentenfehler_78_Cx3_TstComplThisOpCycle_FAIL)
  compu method CM_DCDC_NV_Komponentenfehler_24: 0=Cx0_TstNotComplThisOpCycle_Init (CM_DCDC_NV_Komponentenfehler_24_Cx0_TstNotComplThisOpCycle_Init), 1=Cx1_TstComplThisOpCycle_Pass (CM_DCDC_NV_Komponentenfehler_24_Cx1_TstComplThisOpCycle_Pass), 2=Cx2_TstCmplThisCycle_Pass_TimeElapse (CM_DCDC_NV_Komponentenfehler_24_Cx2_TstCmplThisCycle_Pass_TimeElapse), 3=Cx3_TstComplThisOpCycle_FAIL (CM_DCDC_NV_Komponentenfehler_24_Cx3_TstComplThisOpCycle_FAIL)
  compu method CM_NM_aktiv_NVEM: 0=Cx0_Inaktiv (CM_NM_aktiv_NVEM_Cx0_Inaktiv), 1=Cx1_Aktiv (CM_NM_aktiv_NVEM_Cx1_Aktiv)
  compu method CM_AB_Gurtschloss_Reihe4_FA: 0=Cx0_nicht_verbaut (CM_AB_Gurtschloss_Reihe4_FA_Cx0_nicht_verbaut), 1=Cx1_nicht_verfuegbar_Fehler_oder_Init (CM_AB_Gurtschloss_Reihe4_FA_Cx1_nicht_verfuegbar_Fehler_oder_Init) (nicht_verfügbar (Fehler oder Init)), 2=Cx2_nicht_gesteckt (CM_AB_Gurtschloss_Reihe4_FA_Cx2_nicht_gesteckt), 3=Cx3_gesteckt (CM_AB_Gurtschloss_Reihe4_FA_Cx3_gesteckt)
  compu method CM_KST_Ausstiegswunsch_Status: 0=Cx0_KEIN_AUSSTIEGSWUNSCH_AKTIV_0 (CM_KST_Ausstiegswunsch_Status_Cx0_KEIN_AUSSTIEGSWUNSCH_AKTIV_0), 1=Cx1_AUSSTIEGSWUNSCH_AKTIV_1 (CM_KST_Ausstiegswunsch_Status_Cx1_AUSSTIEGSWUNSCH_AKTIV_1)
  compu method CM_HVLM_Intensitaet_Lk1: phys=raw for raw 0..100, 126=Cx7e_Init (CM_HVLM_Intensitaet_Lk1_Cx7e_Init), 127=Cx7f_Fehler (CM_HVLM_Intensitaet_Lk1_Cx7f_Fehler); unit Unit_PerCent
  compu method CM_BMC_CMC_Zellspannung_006: phys=raw+1000 for raw 0..4091, 4092=Cxffc_kleiner_1V (CM_BMC_CMC_Zellspannung_006_Cxffc_kleiner_1V), 4093=Cxffd_nicht_vorhanden (CM_BMC_CMC_Zellspannung_006_Cxffd_nicht_vorhanden), 4094=Cxffe_Init (CM_BMC_CMC_Zellspannung_006_Cxffe_Init), 4095=Cxfff_Fehler (CM_BMC_CMC_Zellspannung_006_Cxfff_Fehler); unit Unit_MilliVolt
  compu method CM_HVLM_Stecker_Notentriegeln_Anf_B: 0=Cx0_Init (CM_HVLM_Stecker_Notentriegeln_Anf_B_Cx0_Init), 1=Cx1_keine_Notentriegelung (CM_HVLM_Stecker_Notentriegeln_Anf_B_Cx1_keine_Notentriegelung), 2=Cx2_Ladestecker_notentriegeln (CM_HVLM_Stecker_Notentriegeln_Anf_B_Cx2_Ladestecker_notentriegeln)
  compu method CM_NM_HVZB_NM_aktiv_Diag: 0=Cx0_Inaktiv (CM_NM_HVZB_NM_aktiv_Diag_Cx0_Inaktiv), 1=Cx1_Diagnose_aktiv (CM_NM_HVZB_NM_aktiv_Diag_Cx1_Diagnose_aktiv)
  compu method CM_BMC_UI1_Spannung1_Schalt_Anf: 0=Cx0_aus (CM_BMC_UI1_Spannung1_Schalt_Anf_Cx0_aus), 1=Cx1_ein (CM_BMC_UI1_Spannung1_Schalt_Anf_Cx1_ein)
  compu method CM_NM_aktiv_NVEM2: 0=Cx0_Inaktiv (CM_NM_aktiv_NVEM2_Cx0_Inaktiv), 1=Cx1_Aktiv (CM_NM_aktiv_NVEM2_Cx1_Aktiv)
  compu method CM_HVLM_Intensitaet_Lk2: phys=raw for raw 0..100, 126=Cx7e_Init (CM_HVLM_Intensitaet_Lk2_Cx7e_Init), 127=Cx7f_Fehler (CM_HVLM_Intensitaet_Lk2_Cx7f_Fehler); unit Unit_PerCent
  compu method CM_DCDC_NV_Komponentenfehler_25: 0=Cx0_TstNotComplThisOpCycle_Init (CM_DCDC_NV_Komponentenfehler_25_Cx0_TstNotComplThisOpCycle_Init), 1=Cx1_TstComplThisOpCycle_Pass (CM_DCDC_NV_Komponentenfehler_25_Cx1_TstComplThisOpCycle_Pass), 2=Cx2_TstCmplThisCycle_Pass_TimeElapse (CM_DCDC_NV_Komponentenfehler_25_Cx2_TstCmplThisCycle_Pass_TimeElapse), 3=Cx3_TstComplThisOpCycle_FAIL (CM_DCDC_NV_Komponentenfehler_25_Cx3_TstComplThisOpCycle_FAIL)
  compu method CM_KST_aut_Abschaltung_Zuendung: 0=Cx0_Zuendung_wird_bei_Verl_nicht_deaktiviert (CM_KST_aut_Abschaltung_Zuendung_Cx0_Zuendung_wird_bei_Verl_nicht_deaktiviert), 1=Cx1_Zuendung_wird_bei_Verl_deaktiviert (CM_KST_aut_Abschaltung_Zuendung_Cx1_Zuendung_wird_bei_Verl_deaktiviert)
  compu method CM_NM_aktiv_OnlineRemoteUpdate: 0=Cx0_Inaktiv (CM_NM_aktiv_OnlineRemoteUpdate_Cx0_Inaktiv), 1=Cx1_Aktiv (CM_NM_aktiv_OnlineRemoteUpdate_Cx1_Aktiv)
  compu method CM_NM_HVZB_NM_aktiv_KL15: 0=Cx0_Inaktiv (CM_NM_HVZB_NM_aktiv_KL15_Cx0_Inaktiv), 1=Cx1_KL15_EIN (CM_NM_HVZB_NM_aktiv_KL15_Cx1_KL15_EIN)
  compu method CM_HVLM_Stecker_Notentriegeln_Anf_C: 0=Cx0_Init (CM_HVLM_Stecker_Notentriegeln_Anf_C_Cx0_Init), 1=Cx1_keine_Notentriegelung (CM_HVLM_Stecker_Notentriegeln_Anf_C_Cx1_keine_Notentriegelung), 2=Cx2_Ladestecker_notentriegeln (CM_HVLM_Stecker_Notentriegeln_Anf_C_Cx2_Ladestecker_notentriegeln)
  compu method CM_AB_Gurtschloss_Reihe4_MI: 0=Cx0_nicht_verbaut (CM_AB_Gurtschloss_Reihe4_MI_Cx0_nicht_verbaut), 1=Cx1_nicht_verfuegbar_Fehler_oder_Init (CM_AB_Gurtschloss_Reihe4_MI_Cx1_nicht_verfuegbar_Fehler_oder_Init) (nicht_verfügbar (Fehler oder Init)), 2=Cx2_nicht_gesteckt (CM_AB_Gurtschloss_Reihe4_MI_Cx2_nicht_gesteckt), 3=Cx3_gesteckt (CM_AB_Gurtschloss_Reihe4_MI_Cx3_gesteckt)
  compu method CM_HVK_BMC_Spannung_Anf: 0=Cx0_keine_Spg_Anforderung (CM_HVK_BMC_Spannung_Anf_Cx0_keine_Spg_Anforderung), 1=Cx1_400V_Spg_Anforderung (CM_HVK_BMC_Spannung_Anf_Cx1_400V_Spg_Anforderung), 2=Cx2_800V_Spg_Anforderung (CM_HVK_BMC_Spannung_Anf_Cx2_800V_Spg_Anforderung), 3=Cx3_Init (CM_HVK_BMC_Spannung_Anf_Cx3_Init)
  compu method CM_DCDC_NV_Komponentenfehler_79: 0=Cx0_TstNotComplThisOpCycle_Init (CM_DCDC_NV_Komponentenfehler_79_Cx0_TstNotComplThisOpCycle_Init), 1=Cx1_TstComplThisOpCycle_Pass (CM_DCDC_NV_Komponentenfehler_79_Cx1_TstComplThisOpCycle_Pass), 2=Cx2_TstCmplThisCycle_Pass_TimeElapse (CM_DCDC_NV_Komponentenfehler_79_Cx2_TstCmplThisCycle_Pass_TimeElapse), 3=Cx3_TstComplThisOpCycle_FAIL (CM_DCDC_NV_Komponentenfehler_79_Cx3_TstComplThisOpCycle_FAIL)
  compu method CM_NM_aktiv_Remote_Repair: 0=Cx0_Inaktiv (CM_NM_aktiv_Remote_Repair_Cx0_Inaktiv), 1=Cx1_Aktiv (CM_NM_aktiv_Remote_Repair_Cx1_Aktiv)
  compu method CM_BMC_CMC_Zellspannung_007: phys=raw+1000 for raw 0..4091, 4092=Cxffc_kleiner_1V (CM_BMC_CMC_Zellspannung_007_Cxffc_kleiner_1V), 4093=Cxffd_nicht_vorhanden (CM_BMC_CMC_Zellspannung_007_Cxffd_nicht_vorhanden), 4094=Cxffe_Init (CM_BMC_CMC_Zellspannung_007_Cxffe_Init), 4095=Cxfff_Fehler (CM_BMC_CMC_Zellspannung_007_Cxfff_Fehler); unit Unit_MilliVolt
  compu method CM_BMC_UI1_Spannung2_Schalt_Anf: 0=Cx0_aus (CM_BMC_UI1_Spannung2_Schalt_Anf_Cx0_aus), 1=Cx1_ein (CM_BMC_UI1_Spannung2_Schalt_Anf_Cx1_ein)
  compu method CM_DCDC_NV_Komponentenfehler_26: 0=Cx0_TstNotComplThisOpCycle_Init (CM_DCDC_NV_Komponentenfehler_26_Cx0_TstNotComplThisOpCycle_Init), 1=Cx1_TstComplThisOpCycle_Pass (CM_DCDC_NV_Komponentenfehler_26_Cx1_TstComplThisOpCycle_Pass), 2=Cx2_TstCmplThisCycle_Pass_TimeElapse (CM_DCDC_NV_Komponentenfehler_26_Cx2_TstCmplThisCycle_Pass_TimeElapse), 3=Cx3_TstComplThisOpCycle_FAIL (CM_DCDC_NV_Komponentenfehler_26_Cx3_TstComplThisOpCycle_FAIL)
  compu method CM_KST_BulbCheckReq: 0=Cx0_Keine_Anfrage (CM_KST_BulbCheckReq_Cx0_Keine_Anfrage), 1=Cx1_Anfrage (CM_KST_BulbCheckReq_Cx1_Anfrage)
  compu method CM_NM_HVZB_NM_aktiv_Tmin: 0=Cx0_Inaktiv (CM_NM_HVZB_NM_aktiv_Tmin_Cx0_Inaktiv), 1=Cx1_Mindestaktivzeit (CM_NM_HVZB_NM_aktiv_Tmin_Cx1_Mindestaktivzeit)
  compu method CM_NVEM_MV_DC_uMinLV: phys=raw*0.1+3.5 for raw 0..125, 126=Cx7e_Init (CM_NVEM_MV_DC_uMinLV_Cx7e_Init), 127=Cx7f_Fehler (CM_NVEM_MV_DC_uMinLV_Cx7f_Fehler); unit Unit_Volt
  compu method CM_HVLM_Stecker_VerEntriegelnAnf_A: 0=Cx0_keine_Anforderung (CM_HVLM_Stecker_VerEntriegelnAnf_A_Cx0_keine_Anforderung), 1=Cx1_Ladestecker_verriegeln (CM_HVLM_Stecker_VerEntriegelnAnf_A_Cx1_Ladestecker_verriegeln), 2=Cx2_Ladestecker_entriegeln (CM_HVLM_Stecker_VerEntriegelnAnf_A_Cx2_Ladestecker_entriegeln), 3=Cx3_reserve (CM_HVLM_Stecker_VerEntriegelnAnf_A_Cx3_reserve)
  compu method CM_NM_aktiv_Remote_Unlock_Lock: 0=Cx0_Inaktiv (CM_NM_aktiv_Remote_Unlock_Lock_Cx0_Inaktiv), 1=Cx1_Aktiv (CM_NM_aktiv_Remote_Unlock_Lock_Cx1_Aktiv)
  compu method CM_KST_ComfortReadyStatus: 0=Cx0_aus (CM_KST_ComfortReadyStatus_Cx0_aus), 1=Cx1_ComfortReadyStatus_ein (CM_KST_ComfortReadyStatus_Cx1_ComfortReadyStatus_ein)
  compu method CM_DCDC_NV_Komponentenfehler_27: 0=Cx0_TstNotComplThisOpCycle_Init (CM_DCDC_NV_Komponentenfehler_27_Cx0_TstNotComplThisOpCycle_Init), 1=Cx1_TstComplThisOpCycle_Pass (CM_DCDC_NV_Komponentenfehler_27_Cx1_TstComplThisOpCycle_Pass), 2=Cx2_TstCmplThisCycle_Pass_TimeElapse (CM_DCDC_NV_Komponentenfehler_27_Cx2_TstCmplThisCycle_Pass_TimeElapse), 3=Cx3_TstComplThisOpCycle_FAIL (CM_DCDC_NV_Komponentenfehler_27_Cx3_TstComplThisOpCycle_FAIL)
