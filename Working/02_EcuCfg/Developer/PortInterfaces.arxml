AUTOSAR XML (schema 00048)
package /VAG/Services/BAP
  15 x client server interface, all with is-service=true:
    BapGetState
      operation State
        arg LSGState: type=Boolean, direction=OUT, server-argument-impl-policy=USE-ARGUMENT-TYPE
    BAPGeneralInterface
      operation BAP_SendDebugInfo_Enable
        arg bEnable: type=Boolean, direction=IN, server-argument-impl-policy=USE-ARGUMENT-TYPE
    BapReqVoid
      operation BAP_ReqVoid: possible-error=[BapReqVoid/BapErr_Busy, BapReqVoid/BapErr_InvalidArg, BapReqVoid/BapErr_InvalidState]
      error BapErr_Busy: error-code=35  # Der Vorgang wurde nicht ausgefuehrt weil zuviele interne Vorgaenge anstehen. Genauere Beschreibung bei den Rueckgabewerten der einzelnen Funktionen.
      error BapErr_InvalidArg: error-code=55  # Einer der uebergebenen Parameter ist ungueltig (Null-Zeiger, ungueltige FctId oder LsgId, Requesttyp fuer diese Funktionsklasse nicht erlaubt, Datentyp der Funktion und FunktionID stimmen nicht ueberein) Kann auch passieren, wenn im Kombigeraet (ASG+FSG) versucht wird eine Funktion aufzurufen, die nicht fuer diesen Steuergeraetetyp erlaubt ist
      error BapErr_InvalidState: error-code=53  # Diese Operation ist in diesem Zustand nicht erlaubt.
    BapIndBs6
      operation BAP_IndBs
        arg aeInd: type=BapInd_et, direction=IN, server-argument-impl-policy=USE-ARGUMENT-TYPE
        arg apData: type=bs6_t, direction=IN, server-argument-impl-policy=USE-ARGUMENT-TYPE
        arg au32Length: type=UInt32, direction=IN, server-argument-impl-policy=USE-ARGUMENT-TYPE
      operation BAP_IndError
        arg aeErrorCode: type=BapError_et, direction=IN, server-argument-impl-policy=USE-ARGUMENT-TYPE  # Der Parameter ErrorCode beschreibt den Fehler, der aufgetreten ist.
      operation BAP_Ack
        arg aeAck: type=BapAck_et, direction=IN, server-argument-impl-policy=USE-ARGUMENT-TYPE
    BapIndU8
      operation BAP_IndU8
        arg aeInd: type=BapInd_et, direction=IN, server-argument-impl-policy=USE-ARGUMENT-TYPE
        arg au8Value: type=UInt8, direction=IN, server-argument-impl-policy=USE-ARGUMENT-TYPE
      operation BAP_IndError
        arg aeErrorCode: type=BapError_et, direction=IN, server-argument-impl-policy=USE-ARGUMENT-TYPE  # Der Parameter ErrorCode beschreibt den Fehler, der aufgetreten ist.
      operation BAP_Ack
        arg aeAck: type=BapAck_et, direction=IN, server-argument-impl-policy=USE-ARGUMENT-TYPE
    BapReqBs8
      operation BAP_ReqBs: possible-error=[BapReqBs8/BapErr_Busy, BapReqBs8/BapErr_InvalidArg, BapReqBs8/BapErr_InvalidState]
        arg apData: type=bs8_t, direction=IN, server-argument-impl-policy=USE-ARGUMENT-TYPE
        arg au32Length: type=UInt32, direction=IN, server-argument-impl-policy=USE-ARGUMENT-TYPE
      error BapErr_Busy: error-code=35  # Der Vorgang wurde nicht ausgefuehrt weil zuviele interne Vorgaenge anstehen. Genauere Beschreibung bei den Rueckgabewerten der einzelnen Funktionen.
      error BapErr_InvalidArg: error-code=55  # Einer der uebergebenen Parameter ist ungueltig (Null-Zeiger, ungueltige FctId oder LsgId, Requesttyp fuer diese Funktionsklasse nicht erlaubt, Datentyp der Funktion und FunktionID stimmen nicht ueberein) Kann auch passieren, wenn im Kombigeraet (ASG+FSG) versucht wird eine Funktion aufzurufen, die nicht fuer diesen Steuergeraetetyp erlaubt ist
      error BapErr_InvalidState: error-code=53  # Diese Operation ist in diesem Zustand nicht erlaubt.
    BapReqBs6
      operation BAP_ReqBs: possible-error=[BapReqBs6/BapErr_Busy, BapReqBs6/BapErr_InvalidArg, BapReqBs6/BapErr_InvalidState]
        arg apData: type=bs6_t, direction=IN, server-argument-impl-policy=USE-ARGUMENT-TYPE
        arg au32Length: type=UInt32, direction=IN, server-argument-impl-policy=USE-ARGUMENT-TYPE
      error BapErr_Busy: error-code=35  # Der Vorgang wurde nicht ausgefuehrt weil zuviele interne Vorgaenge anstehen. Genauere Beschreibung bei den Rueckgabewerten der einzelnen Funktionen.
      error BapErr_InvalidArg: error-code=55  # Einer der uebergebenen Parameter ist ungueltig (Null-Zeiger, ungueltige FctId oder LsgId, Requesttyp fuer diese Funktionsklasse nicht erlaubt, Datentyp der Funktion und FunktionID stimmen nicht ueberein) Kann auch passieren, wenn im Kombigeraet (ASG+FSG) versucht wird eine Funktion aufzurufen, die nicht fuer diesen Steuergeraetetyp erlaubt ist
      error BapErr_InvalidState: error-code=53  # Diese Operation ist in diesem Zustand nicht erlaubt.
    BapReqU8
      operation BAP_ReqU8: possible-error=[BapReqU8/BapErr_Busy, BapReqU8/BapErr_InvalidArg, BapReqU8/BapErr_InvalidState]
        arg au8Data: type=UInt8, direction=IN, server-argument-impl-policy=USE-ARGUMENT-TYPE
      error BapErr_Busy: error-code=35  # Der Vorgang wurde nicht ausgefuehrt weil zuviele interne Vorgaenge anstehen. Genauere Beschreibung bei den Rueckgabewerten der einzelnen Funktionen.
      error BapErr_InvalidArg: error-code=55  # Einer der uebergebenen Parameter ist ungueltig (Null-Zeiger, ungueltige FctId oder LsgId, Requesttyp fuer diese Funktionsklasse nicht erlaubt, Datentyp der Funktion und FunktionID stimmen nicht ueberein) Kann auch passieren, wenn im Kombigeraet (ASG+FSG) versucht wird eine Funktion aufzurufen, die nicht fuer diesen Steuergeraetetyp erlaubt ist
      error BapErr_InvalidState: error-code=53  # Diese Operation ist in diesem Zustand nicht erlaubt.
    BapIndU16
      operation BAP_IndU16
        arg aeInd: type=BapInd_et, direction=IN, server-argument-impl-policy=USE-ARGUMENT-TYPE
        arg au16Value: type=UInt16, direction=IN, server-argument-impl-policy=USE-ARGUMENT-TYPE
      operation BAP_IndError
        arg aeErrorCode: type=BapError_et, direction=IN, server-argument-impl-policy=USE-ARGUMENT-TYPE  # Der Parameter ErrorCode beschreibt den Fehler, der aufgetreten ist.
      operation BAP_Ack
        arg aeAck: type=BapAck_et, direction=IN, server-argument-impl-policy=USE-ARGUMENT-TYPE
    BapIndVoid
      operation BAP_IndVoid
        arg aeInd: type=BapInd_et, direction=IN, server-argument-impl-policy=USE-ARGUMENT-TYPE
      operation BAP_IndError
        arg aeErrorCode: type=BapError_et, direction=IN, server-argument-impl-policy=USE-ARGUMENT-TYPE  # Der Parameter ErrorCode beschreibt den Fehler, der aufgetreten ist.
      operation BAP_Ack
        arg aeAck: type=BapAck_et, direction=IN, server-argument-impl-policy=USE-ARGUMENT-TYPE
    BapIndBs8
      operation BAP_IndBs
        arg aeInd: type=BapInd_et, direction=IN, server-argument-impl-policy=USE-ARGUMENT-TYPE
        arg apData: type=bs8_t, direction=IN, server-argument-impl-policy=USE-ARGUMENT-TYPE
        arg au32Length: type=UInt32, direction=IN, server-argument-impl-policy=USE-ARGUMENT-TYPE
      operation BAP_IndError
        arg aeErrorCode: type=BapError_et, direction=IN, server-argument-impl-policy=USE-ARGUMENT-TYPE  # Der Parameter ErrorCode beschreibt den Fehler, der aufgetreten ist.
      operation BAP_Ack
        arg aeAck: type=BapAck_et, direction=IN, server-argument-impl-policy=USE-ARGUMENT-TYPE
    BapReqVoidMethodAbort
      operation BAP_ReqVoid: possible-error=[BapReqVoidMethodAbort/BapErr_Busy, BapReqVoidMethodAbort/BapErr_InvalidArg, BapReqVoidMethodAbort/BapErr_InvalidState]
      error BapErr_Busy: error-code=35  # Der Vorgang wurde nicht ausgefuehrt weil zuviele interne Vorgaenge anstehen. Genauere Beschreibung bei den Rueckgabewerten der einzelnen Funktionen.
      error BapErr_InvalidArg: error-code=55  # Einer der uebergebenen Parameter ist ungueltig (Null-Zeiger, ungueltige FctId oder LsgId, Requesttyp fuer diese Funktionsklasse nicht erlaubt, Datentyp der Funktion und FunktionID stimmen nicht ueberein) Kann auch passieren, wenn im Kombigeraet (ASG+FSG) versucht wird eine Funktion aufzurufen, die nicht fuer diesen Steuergeraetetyp erlaubt ist
      error BapErr_InvalidState: error-code=53  # Diese Operation ist in diesem Zustand nicht erlaubt.
    BapReqU16
      operation BAP_ReqU16: possible-error=[BapReqU16/BapErr_Busy, BapReqU16/BapErr_InvalidArg, BapReqU16/BapErr_InvalidState]
        arg au16Data: type=UInt16, direction=IN, server-argument-impl-policy=USE-ARGUMENT-TYPE
      error BapErr_Busy: error-code=35  # Der Vorgang wurde nicht ausgefuehrt weil zuviele interne Vorgaenge anstehen. Genauere Beschreibung bei den Rueckgabewerten der einzelnen Funktionen.
      error BapErr_InvalidArg: error-code=55  # Einer der uebergebenen Parameter ist ungueltig (Null-Zeiger, ungueltige FctId oder LsgId, Requesttyp fuer diese Funktionsklasse nicht erlaubt, Datentyp der Funktion und FunktionID stimmen nicht ueberein) Kann auch passieren, wenn im Kombigeraet (ASG+FSG) versucht wird eine Funktion aufzurufen, die nicht fuer diesen Steuergeraetetyp erlaubt ist
      error BapErr_InvalidState: error-code=53  # Diese Operation ist in diesem Zustand nicht erlaubt.
    BapReqBs1
      operation BAP_ReqBs: possible-error=[BapReqBs1/BapErr_Busy, BapReqBs1/BapErr_InvalidArg, BapReqBs1/BapErr_InvalidState]
        arg apData: type=bs1_t, direction=IN, server-argument-impl-policy=USE-ARGUMENT-TYPE
        arg au32Length: type=UInt32, direction=IN, server-argument-impl-policy=USE-ARGUMENT-TYPE
      error BapErr_Busy: error-code=35  # Der Vorgang wurde nicht ausgefuehrt weil zuviele interne Vorgaenge anstehen. Genauere Beschreibung bei den Rueckgabewerten der einzelnen Funktionen.
      error BapErr_InvalidArg: error-code=55  # Einer der uebergebenen Parameter ist ungueltig (Null-Zeiger, ungueltige FctId oder LsgId, Requesttyp fuer diese Funktionsklasse nicht erlaubt, Datentyp der Funktion und FunktionID stimmen nicht ueberein) Kann auch passieren, wenn im Kombigeraet (ASG+FSG) versucht wird eine Funktion aufzurufen, die nicht fuer diesen Steuergeraetetyp erlaubt ist
      error BapErr_InvalidState: error-code=53  # Diese Operation ist in diesem Zustand nicht erlaubt.
    BapIndBs250
      operation BAP_IndBs
        arg aeInd: type=BapInd_et, direction=IN, server-argument-impl-policy=USE-ARGUMENT-TYPE
        arg apData: type=bs250_t, direction=IN, server-argument-impl-policy=USE-ARGUMENT-TYPE
        arg au32Length: type=UInt32, direction=IN, server-argument-impl-policy=USE-ARGUMENT-TYPE
      operation BAP_IndError
        arg aeErrorCode: type=BapError_et, direction=IN, server-argument-impl-policy=USE-ARGUMENT-TYPE  # Der Parameter ErrorCode beschreibt den Fehler, der aufgetreten ist.
      operation BAP_Ack
        arg aeAck: type=BapAck_et, direction=IN, server-argument-impl-policy=USE-ARGUMENT-TYPE
  sender receiver interface Bap_TestASG: is-service=true
    data BapEnable: type=Boolean
package /SoftwareTypes/Interfaces
  client server interface SI_MathsInterface
    4 x operation:
      Add
        arg operand1: type=int32_DT, direction=IN, server-argument-impl-policy=USE-ARGUMENT-TYPE
        arg operand2: type=int32_DT, direction=IN, server-argument-impl-policy=USE-ARGUMENT-TYPE
        arg result: type=float32_DT, direction=OUT, server-argument-impl-policy=USE-ARGUMENT-TYPE
      Divide: possible-error=E_DIVISION_BY_ZERO
        arg operand1: type=int32_DT, direction=IN, server-argument-impl-policy=USE-ARGUMENT-TYPE
        arg operand2: type=int32_DT, direction=IN, server-argument-impl-policy=USE-ARGUMENT-TYPE
        arg result: type=float32_DT, direction=OUT, server-argument-impl-policy=USE-ARGUMENT-TYPE
      Multiply
        arg operand1: type=int32_DT, direction=IN, server-argument-impl-policy=USE-ARGUMENT-TYPE
        arg operand2: type=int32_DT, direction=IN, server-argument-impl-policy=USE-ARGUMENT-TYPE
        arg result: type=float32_DT, direction=OUT, server-argument-impl-policy=USE-ARGUMENT-TYPE
      Substract
        arg operand1: type=int32_DT, direction=IN, server-argument-impl-policy=USE-ARGUMENT-TYPE
        arg operand2: type=int32_DT, direction=IN, server-argument-impl-policy=USE-ARGUMENT-TYPE
        arg result: type=float32_DT, direction=OUT, server-argument-impl-policy=USE-ARGUMENT-TYPE
    error E_DIVISION_BY_ZERO: error-code=1
  sender receiver interface EchoInterface
    data Echo: type=REC_Basics_1_0_Echo
  sender receiver interface TriangleInterface
    data Triangle: type=REC_Maths_1_0_Triangle
  client server interface SI_BasicsInterface
package /Predefined_DEV/PortInterfaces
  43 x client server interface:
    NvMNotifyInitBlock: is-service=true
      operation InitBlock
    NvSWC_NvMNotifyInitBlock
      operation InitBlock
    NvMAdministration: is-service=true
      operation SetBlockProtection: possible-error=NvMAdministration/E_NOT_OK
        arg ProtectionEnabled: type=boolean, direction=IN, server-argument-impl-policy=USE-ARGUMENT-TYPE
      error E_NOT_OK: error-code=1
    NvSWC_NvMAdministration
      operation SetBlockProtection: possible-error=NvSWC_NvMAdministration/E_NOT_OK
        arg ProtectionEnabled: type=boolean, direction=IN, server-argument-impl-policy=USE-ARGUMENT-TYPE
      error E_NOT_OK: error-code=1
    NvMService: is-service=true
      operation GetErrorStatus: possible-error=NvMService/E_NOT_OK
        arg ErrorStatus: type=NvM_RequestResultType, direction=OUT, server-argument-impl-policy=USE-ARGUMENT-TYPE
      error E_NOT_OK: error-code=1
    NvMService_AC2: is-service=true
      operation GetErrorStatus: possible-error=NvMService_AC2/E_NOT_OK
        arg ErrorStatus: type=NvM_RequestResultType, direction=OUT, server-argument-impl-policy=USE-ARGUMENT-TYPE
      operation ReadBlock: possible-error=NvMService_AC2/E_NOT_OK
        arg DstPtr: type=dtRef_VOID, direction=IN, server-argument-impl-policy=USE-ARGUMENT-TYPE
      operation WriteBlock: possible-error=NvMService_AC2/E_NOT_OK
        arg SrcPtr: type=dtRef_const_VOID, direction=IN, server-argument-impl-policy=USE-ARGUMENT-TYPE
      error E_NOT_OK: error-code=1
    NvMService_AC2_Defs: is-service=true
      4 x operation, all with possible-error=NvMService_AC2_Defs/E_NOT_OK:
        GetErrorStatus
          arg ErrorStatus: type=NvM_RequestResultType, direction=OUT, server-argument-impl-policy=USE-ARGUMENT-TYPE
        ReadBlock
          arg DstPtr: type=dtRef_VOID, direction=IN, server-argument-impl-policy=USE-ARGUMENT-TYPE
        RestoreBlockDefaults
          arg DstPtr: type=dtRef_VOID, direction=IN, server-argument-impl-policy=USE-ARGUMENT-TYPE
        WriteBlock
          arg SrcPtr: type=dtRef_const_VOID, direction=IN, server-argument-impl-policy=USE-ARGUMENT-TYPE
      error E_NOT_OK: error-code=1
    NvMService_AC2_DS: is-service=true
      5 x operation, all with possible-error=NvMService_AC2_DS/E_NOT_OK:
        GetDataIndex
          arg DataIndex: type=uint8, direction=OUT, server-argument-impl-policy=USE-ARGUMENT-TYPE
        GetErrorStatus
          arg ErrorStatus: type=NvM_RequestResultType, direction=OUT, server-argument-impl-policy=USE-ARGUMENT-TYPE
        ReadBlock
          arg DstPtr: type=dtRef_VOID, direction=IN, server-argument-impl-policy=USE-ARGUMENT-TYPE
        SetDataIndex
          arg DataIndex: type=uint8, direction=IN, server-argument-impl-policy=USE-ARGUMENT-TYPE
        WriteBlock
          arg SrcPtr: type=dtRef_const_VOID, direction=IN, server-argument-impl-policy=USE-ARGUMENT-TYPE
      error E_NOT_OK: error-code=1
    NvMService_AC2_DS_Defs: is-service=true
      6 x operation, all with possible-error=NvMService_AC2_DS_Defs/E_NOT_OK:
        GetDataIndex
          arg DataIndex: type=uint8, direction=OUT, server-argument-impl-policy=USE-ARGUMENT-TYPE
        GetErrorStatus
          arg ErrorStatus: type=NvM_RequestResultType, direction=OUT, server-argument-impl-policy=USE-ARGUMENT-TYPE
        ReadBlock
          arg DstPtr: type=dtRef_VOID, direction=IN, server-argument-impl-policy=USE-ARGUMENT-TYPE
        RestoreBlockDefaults
          arg DstPtr: type=dtRef_VOID, direction=IN, server-argument-impl-policy=USE-ARGUMENT-TYPE
        SetDataIndex
          arg DataIndex: type=uint8, direction=IN, server-argument-impl-policy=USE-ARGUMENT-TYPE
        WriteBlock
          arg SrcPtr: type=dtRef_const_VOID, direction=IN, server-argument-impl-policy=USE-ARGUMENT-TYPE
      error E_NOT_OK: error-code=1
    NvMService_AC2_SRBS: is-service=true
      4 x operation, all with possible-error=NvMService_AC2_SRBS/E_NOT_OK:
        GetErrorStatus
          arg ErrorStatus: type=NvM_RequestResultType, direction=OUT, server-argument-impl-policy=USE-ARGUMENT-TYPE
        ReadBlock
          arg DstPtr: type=dtRef_VOID, direction=IN, server-argument-impl-policy=USE-ARGUMENT-TYPE
        SetRamBlockStatus
          arg RamBlockStatus: type=boolean, direction=IN, server-argument-impl-policy=USE-ARGUMENT-TYPE
        WriteBlock
          arg SrcPtr: type=dtRef_const_VOID, direction=IN, server-argument-impl-policy=USE-ARGUMENT-TYPE
      error E_NOT_OK: error-code=1
    NvMService_AC2_SRBS_Defs: is-service=true
      5 x operation, all with possible-error=NvMService_AC2_SRBS_Defs/E_NOT_OK:
        GetErrorStatus
          arg ErrorStatus: type=NvM_RequestResultType, direction=OUT, server-argument-impl-policy=USE-ARGUMENT-TYPE
        ReadBlock
          arg DstPtr: type=dtRef_VOID, direction=IN, server-argument-impl-policy=USE-ARGUMENT-TYPE
        RestoreBlockDefaults
          arg DstPtr: type=dtRef_VOID, direction=IN, server-argument-impl-policy=USE-ARGUMENT-TYPE
        SetRamBlockStatus
          arg RamBlockStatus: type=boolean, direction=IN, server-argument-impl-policy=USE-ARGUMENT-TYPE
        WriteBlock
          arg SrcPtr: type=dtRef_const_VOID, direction=IN, server-argument-impl-policy=USE-ARGUMENT-TYPE
      error E_NOT_OK: error-code=1
    NvMService_AC2_SRBS_DS: is-service=true
      6 x operation, all with possible-error=NvMService_AC2_SRBS_DS/E_NOT_OK:
        GetDataIndex
          arg DataIndex: type=uint8, direction=OUT, server-argument-impl-policy=USE-ARGUMENT-TYPE
        GetErrorStatus
          arg ErrorStatus: type=NvM_RequestResultType, direction=OUT, server-argument-impl-policy=USE-ARGUMENT-TYPE
        ReadBlock
          arg DstPtr: type=dtRef_VOID, direction=IN, server-argument-impl-policy=USE-ARGUMENT-TYPE
        SetDataIndex
          arg DataIndex: type=uint8, direction=IN, server-argument-impl-policy=USE-ARGUMENT-TYPE
        SetRamBlockStatus
          arg RamBlockStatus: type=boolean, direction=IN, server-argument-impl-policy=USE-ARGUMENT-TYPE
        WriteBlock
          arg SrcPtr: type=dtRef_const_VOID, direction=IN, server-argument-impl-policy=USE-ARGUMENT-TYPE
      error E_NOT_OK: error-code=1
    NvMService_AC2_SRBS_DS_Defs: is-service=true
      7 x operation, all with possible-error=NvMService_AC2_SRBS_DS_Defs/E_NOT_OK:
        GetDataIndex
          arg DataIndex: type=uint8, direction=OUT, server-argument-impl-policy=USE-ARGUMENT-TYPE
        GetErrorStatus
          arg ErrorStatus: type=NvM_RequestResultType, direction=OUT, server-argument-impl-policy=USE-ARGUMENT-TYPE
        ReadBlock
          arg DstPtr: type=dtRef_VOID, direction=IN, server-argument-impl-policy=USE-ARGUMENT-TYPE
        RestoreBlockDefaults
          arg DstPtr: type=dtRef_VOID, direction=IN, server-argument-impl-policy=USE-ARGUMENT-TYPE
        SetDataIndex
          arg DataIndex: type=uint8, direction=IN, server-argument-impl-policy=USE-ARGUMENT-TYPE
        SetRamBlockStatus
          arg RamBlockStatus: type=boolean, direction=IN, server-argument-impl-policy=USE-ARGUMENT-TYPE
        WriteBlock
          arg SrcPtr: type=dtRef_const_VOID, direction=IN, server-argument-impl-policy=USE-ARGUMENT-TYPE
      error E_NOT_OK: error-code=1
    NvMService_AC3: is-service=true
      5 x operation, all with possible-error=NvMService_AC3/E_NOT_OK:
        EraseBlock
        GetErrorStatus
          arg ErrorStatus: type=NvM_RequestResultType, direction=OUT, server-argument-impl-policy=USE-ARGUMENT-TYPE
        InvalidateNvBlock
        ReadBlock
          arg DstPtr: type=dtRef_VOID, direction=IN, server-argument-impl-policy=USE-ARGUMENT-TYPE
        WriteBlock
          arg SrcPtr: type=dtRef_const_VOID, direction=IN, server-argument-impl-policy=USE-ARGUMENT-TYPE
      error E_NOT_OK: error-code=1
    NvMService_AC3_Defs: is-service=true
      6 x operation, all with possible-error=NvMService_AC3_Defs/E_NOT_OK:
        EraseBlock
        GetErrorStatus
          arg ErrorStatus: type=NvM_RequestResultType, direction=OUT, server-argument-impl-policy=USE-ARGUMENT-TYPE
        InvalidateNvBlock
        ReadBlock
          arg DstPtr: type=dtRef_VOID, direction=IN, server-argument-impl-policy=USE-ARGUMENT-TYPE
        RestoreBlockDefaults
          arg DstPtr: type=dtRef_VOID, direction=IN, server-argument-impl-policy=USE-ARGUMENT-TYPE
        WriteBlock
          arg SrcPtr: type=dtRef_const_VOID, direction=IN, server-argument-impl-policy=USE-ARGUMENT-TYPE
      error E_NOT_OK: error-code=1
    NvMService_AC3_DS: is-service=true
      7 x operation, all with possible-error=NvMService_AC3_DS/E_NOT_OK:
        EraseBlock
        GetDataIndex
          arg DataIndex: type=uint8, direction=OUT, server-argument-impl-policy=USE-ARGUMENT-TYPE
        GetErrorStatus
          arg ErrorStatus: type=NvM_RequestResultType, direction=OUT, server-argument-impl-policy=USE-ARGUMENT-TYPE
        InvalidateNvBlock
        ReadBlock
          arg DstPtr: type=dtRef_VOID, direction=IN, server-argument-impl-policy=USE-ARGUMENT-TYPE
        SetDataIndex
          arg DataIndex: type=uint8, direction=IN, server-argument-impl-policy=USE-ARGUMENT-TYPE
        WriteBlock
          arg SrcPtr: type=dtRef_const_VOID, direction=IN, server-argument-impl-policy=USE-ARGUMENT-TYPE
      error E_NOT_OK: error-code=1
    NvMService_AC3_DS_Defs: is-service=true
      8 x operation, all with possible-error=NvMService_AC3_DS_Defs/E_NOT_OK:
        EraseBlock
        GetDataIndex
          arg DataIndex: type=uint8, direction=OUT, server-argument-impl-policy=USE-ARGUMENT-TYPE
        GetErrorStatus
          arg ErrorStatus: type=NvM_RequestResultType, direction=OUT, server-argument-impl-policy=USE-ARGUMENT-TYPE
        InvalidateNvBlock
        ReadBlock
          arg DstPtr: type=dtRef_VOID, direction=IN, server-argument-impl-policy=USE-ARGUMENT-TYPE
        RestoreBlockDefaults
          arg DstPtr: type=dtRef_VOID, direction=IN, server-argument-impl-policy=USE-ARGUMENT-TYPE
        SetDataIndex
          arg DataIndex: type=uint8, direction=IN, server-argument-impl-policy=USE-ARGUMENT-TYPE
        WriteBlock
          arg SrcPtr: type=dtRef_const_VOID, direction=IN, server-argument-impl-policy=USE-ARGUMENT-TYPE
      error E_NOT_OK: error-code=1
    NvMService_AC3_SRBS: is-service=true
      6 x operation, all with possible-error=NvMService_AC3_SRBS/E_NOT_OK:
        EraseBlock
        GetErrorStatus
          arg ErrorStatus: type=NvM_RequestResultType, direction=OUT, server-argument-impl-policy=USE-ARGUMENT-TYPE
        InvalidateNvBlock
        ReadBlock
          arg DstPtr: type=dtRef_VOID, direction=IN, server-argument-impl-policy=USE-ARGUMENT-TYPE
        SetRamBlockStatus
          arg RamBlockStatus: type=boolean, direction=IN, server-argument-impl-policy=USE-ARGUMENT-TYPE
        WriteBlock
          arg SrcPtr: type=dtRef_const_VOID, direction=IN, server-argument-impl-policy=USE-ARGUMENT-TYPE
      error E_NOT_OK: error-code=1
    NvMService_AC3_SRBS_Defs: is-service=true
      7 x operation, all with possible-error=NvMService_AC3_SRBS_Defs/E_NOT_OK:
        EraseBlock
        GetErrorStatus
          arg ErrorStatus: type=NvM_RequestResultType, direction=OUT, server-argument-impl-policy=USE-ARGUMENT-TYPE
        InvalidateNvBlock
        ReadBlock
          arg DstPtr: type=dtRef_VOID, direction=IN, server-argument-impl-policy=USE-ARGUMENT-TYPE
        RestoreBlockDefaults
          arg DstPtr: type=dtRef_VOID, direction=IN, server-argument-impl-policy=USE-ARGUMENT-TYPE
        SetRamBlockStatus
          arg RamBlockStatus: type=boolean, direction=IN, server-argument-impl-policy=USE-ARGUMENT-TYPE
        WriteBlock
          arg SrcPtr: type=dtRef_const_VOID, direction=IN, server-argument-impl-policy=USE-ARGUMENT-TYPE
      error E_NOT_OK: error-code=1
    NvMService_AC3_SRBS_DS: is-service=true
      8 x operation, all with possible-error=NvMService_AC3_SRBS_DS/E_NOT_OK:
        EraseBlock
        GetDataIndex
          arg DataIndex: type=uint8, direction=OUT, server-argument-impl-policy=USE-ARGUMENT-TYPE
        GetErrorStatus
          arg ErrorStatus: type=NvM_RequestResultType, direction=OUT, server-argument-impl-policy=USE-ARGUMENT-TYPE
        InvalidateNvBlock
        ReadBlock
          arg DstPtr: type=dtRef_VOID, direction=IN, server-argument-impl-policy=USE-ARGUMENT-TYPE
        SetDataIndex
          arg DataIndex: type=uint8, direction=IN, server-argument-impl-policy=USE-ARGUMENT-TYPE
        SetRamBlockStatus
          arg RamBlockStatus: type=boolean, direction=IN, server-argument-impl-policy=USE-ARGUMENT-TYPE
        WriteBlock
          arg SrcPtr: type=dtRef_const_VOID, direction=IN, server-argument-impl-policy=USE-ARGUMENT-TYPE
      error E_NOT_OK: error-code=1
    NvMService_AC3_SRBS_DS_Defs: is-service=true
      9 x operation, all with possible-error=NvMService_AC3_SRBS_DS_Defs/E_NOT_OK:
        EraseBlock
        GetDataIndex
          arg DataIndex: type=uint8, direction=OUT, server-argument-impl-policy=USE-ARGUMENT-TYPE
        GetErrorStatus
          arg ErrorStatus: type=NvM_RequestResultType, direction=OUT, server-argument-impl-policy=USE-ARGUMENT-TYPE
        InvalidateNvBlock
        ReadBlock
          arg DstPtr: type=dtRef_VOID, direction=IN, server-argument-impl-policy=USE-ARGUMENT-TYPE
        RestoreBlockDefaults
          arg DstPtr: type=dtRef_VOID, direction=IN, server-argument-impl-policy=USE-ARGUMENT-TYPE
        SetDataIndex
          arg DataIndex: type=uint8, direction=IN, server-argument-impl-policy=USE-ARGUMENT-TYPE
        SetRamBlockStatus
          arg RamBlockStatus: type=boolean, direction=IN, server-argument-impl-policy=USE-ARGUMENT-TYPE
        WriteBlock
          arg SrcPtr: type=dtRef_const_VOID, direction=IN, server-argument-impl-policy=USE-ARGUMENT-TYPE
      error E_NOT_OK: error-code=1
    NvMService_SRBS: is-service=true
      operation GetErrorStatus: possible-error=NvMService_SRBS/E_NOT_OK
        arg ErrorStatus: type=NvM_RequestResultType, direction=OUT, server-argument-impl-policy=USE-ARGUMENT-TYPE
      operation SetRamBlockStatus: possible-error=NvMService_SRBS/E_NOT_OK
        arg RamBlockStatus: type=boolean, direction=IN, server-argument-impl-policy=USE-ARGUMENT-TYPE
      error E_NOT_OK: error-code=1
    NvSWC_NvMService
      operation GetErrorStatus: possible-error=NvSWC_NvMService/E_NOT_OK
        arg ErrorStatus: type=NvM_RequestResultType, direction=OUT, server-argument-impl-policy=USE-ARGUMENT-TYPE
      error E_NOT_OK: error-code=1
    NvSWC_NvMService_AC2
      operation GetErrorStatus: possible-error=NvSWC_NvMService_AC2/E_NOT_OK
        arg ErrorStatus: type=NvM_RequestResultType, direction=OUT, server-argument-impl-policy=USE-ARGUMENT-TYPE
      operation ReadBlock: possible-error=NvSWC_NvMService_AC2/E_NOT_OK
        arg DstPtr: type=dtRef_VOID, direction=IN, server-argument-impl-policy=USE-ARGUMENT-TYPE
      operation WriteBlock: possible-error=NvSWC_NvMService_AC2/E_NOT_OK
        arg SrcPtr: type=dtRef_const_VOID, direction=IN, server-argument-impl-policy=USE-ARGUMENT-TYPE
      error E_NOT_OK: error-code=1
    NvSWC_NvMService_AC2_Defs
      4 x operation, all with possible-error=NvSWC_NvMService_AC2_Defs/E_NOT_OK:
        GetErrorStatus
          arg ErrorStatus: type=NvM_RequestResultType, direction=OUT, server-argument-impl-policy=USE-ARGUMENT-TYPE
        ReadBlock
          arg DstPtr: type=dtRef_VOID, direction=IN, server-argument-impl-policy=USE-ARGUMENT-TYPE
        RestoreBlockDefaults
          arg DstPtr: type=dtRef_VOID, direction=IN, server-argument-impl-policy=USE-ARGUMENT-TYPE
        WriteBlock
          arg SrcPtr: type=dtRef_const_VOID, direction=IN, server-argument-impl-policy=USE-ARGUMENT-TYPE
      error E_NOT_OK: error-code=1
    NvSWC_NvMService_AC2_DS
      5 x operation, all with possible-error=NvSWC_NvMService_AC2_DS/E_NOT_OK:
        GetDataIndex
          arg DataIndex: type=uint8, direction=OUT, server-argument-impl-policy=USE-ARGUMENT-TYPE
        GetErrorStatus
          arg ErrorStatus: type=NvM_RequestResultType, direction=OUT, server-argument-impl-policy=USE-ARGUMENT-TYPE
        ReadBlock
          arg DstPtr: type=dtRef_VOID, direction=IN, server-argument-impl-policy=USE-ARGUMENT-TYPE
        SetDataIndex
          arg DataIndex: type=uint8, direction=IN, server-argument-impl-policy=USE-ARGUMENT-TYPE
        WriteBlock
          arg SrcPtr: type=dtRef_const_VOID, direction=IN, server-argument-impl-policy=USE-ARGUMENT-TYPE
      error E_NOT_OK: error-code=1
    NvSWC_NvMService_AC2_DS_Defs
      6 x operation, all with possible-error=NvSWC_NvMService_AC2_DS_Defs/E_NOT_OK:
        GetDataIndex
          arg DataIndex: type=uint8, direction=OUT, server-argument-impl-policy=USE-ARGUMENT-TYPE
        GetErrorStatus
          arg ErrorStatus: type=NvM_RequestResultType, direction=OUT, server-argument-impl-policy=USE-ARGUMENT-TYPE
        ReadBlock
          arg DstPtr: type=dtRef_VOID, direction=IN, server-argument-impl-policy=USE-ARGUMENT-TYPE
        RestoreBlockDefaults
          arg DstPtr: type=dtRef_VOID, direction=IN, server-argument-impl-policy=USE-ARGUMENT-TYPE
        SetDataIndex
          arg DataIndex: type=uint8, direction=IN, server-argument-impl-policy=USE-ARGUMENT-TYPE
        WriteBlock
          arg SrcPtr: type=dtRef_const_VOID, direction=IN, server-argument-impl-policy=USE-ARGUMENT-TYPE
      error E_NOT_OK: error-code=1
    NvSWC_NvMService_AC2_SRBS
      4 x operation, all with possible-error=NvSWC_NvMService_AC2_SRBS/E_NOT_OK:
        GetErrorStatus
          arg ErrorStatus: type=NvM_RequestResultType, direction=OUT, server-argument-impl-policy=USE-ARGUMENT-TYPE
        ReadBlock
          arg DstPtr: type=dtRef_VOID, direction=IN, server-argument-impl-policy=USE-ARGUMENT-TYPE
        SetRamBlockStatus
          arg RamBlockStatus: type=boolean, direction=IN, server-argument-impl-policy=USE-ARGUMENT-TYPE
        WriteBlock
          arg SrcPtr: type=dtRef_const_VOID, direction=IN, server-argument-impl-policy=USE-ARGUMENT-TYPE
      error E_NOT_OK: error-code=1
    NvSWC_NvMService_AC2_SRBS_Defs
      5 x operation, all with possible-error=NvSWC_NvMService_AC2_SRBS_Defs/E_NOT_OK:
        GetErrorStatus
          arg ErrorStatus: type=NvM_RequestResultType, direction=OUT, server-argument-impl-policy=USE-ARGUMENT-TYPE
        ReadBlock
          arg DstPtr: type=dtRef_VOID, direction=IN, server-argument-impl-policy=USE-ARGUMENT-TYPE
        RestoreBlockDefaults
          arg DstPtr: type=dtRef_VOID, direction=IN, server-argument-impl-policy=USE-ARGUMENT-TYPE
        SetRamBlockStatus
          arg RamBlockStatus: type=boolean, direction=IN, server-argument-impl-policy=USE-ARGUMENT-TYPE
        WriteBlock
          arg SrcPtr: type=dtRef_const_VOID, direction=IN, server-argument-impl-policy=USE-ARGUMENT-TYPE
      error E_NOT_OK: error-code=1
    NvSWC_NvMService_AC2_SRBS_DS
      6 x operation, all with possible-error=NvSWC_NvMService_AC2_SRBS_DS/E_NOT_OK:
        GetDataIndex
          arg DataIndex: type=uint8, direction=OUT, server-argument-impl-policy=USE-ARGUMENT-TYPE
        GetErrorStatus
          arg ErrorStatus: type=NvM_RequestResultType, direction=OUT, server-argument-impl-policy=USE-ARGUMENT-TYPE
        ReadBlock
          arg DstPtr: type=dtRef_VOID, direction=IN, server-argument-impl-policy=USE-ARGUMENT-TYPE
        SetDataIndex
          arg DataIndex: type=uint8, direction=IN, server-argument-impl-policy=USE-ARGUMENT-TYPE
        SetRamBlockStatus
          arg RamBlockStatus: type=boolean, direction=IN, server-argument-impl-policy=USE-ARGUMENT-TYPE
        WriteBlock
          arg SrcPtr: type=dtRef_const_VOID, direction=IN, server-argument-impl-policy=USE-ARGUMENT-TYPE
      error E_NOT_OK: error-code=1
    NvSWC_NvMService_AC2_SRBS_DS_Defs
      7 x operation, all with possible-error=NvSWC_NvMService_AC2_SRBS_DS_Defs/E_NOT_OK:
        GetDataIndex
          arg DataIndex: type=uint8, direction=OUT, server-argument-impl-policy=USE-ARGUMENT-TYPE
        GetErrorStatus
          arg ErrorStatus: type=NvM_RequestResultType, direction=OUT, server-argument-impl-policy=USE-ARGUMENT-TYPE
        ReadBlock
          arg DstPtr: type=dtRef_VOID, direction=IN, server-argument-impl-policy=USE-ARGUMENT-TYPE
        RestoreBlockDefaults
          arg DstPtr: type=dtRef_VOID, direction=IN, server-argument-impl-policy=USE-ARGUMENT-TYPE
        SetDataIndex
          arg DataIndex: type=uint8, direction=IN, server-argument-impl-policy=USE-ARGUMENT-TYPE
        SetRamBlockStatus
          arg RamBlockStatus: type=boolean, direction=IN, server-argument-impl-policy=USE-ARGUMENT-TYPE
        WriteBlock
          arg SrcPtr: type=dtRef_const_VOID, direction=IN, server-argument-impl-policy=USE-ARGUMENT-TYPE
      error E_NOT_OK: error-code=1
    NvSWC_NvMService_AC3
      5 x operation, all with possible-error=NvSWC_NvMService_AC3/E_NOT_OK:
        EraseBlock
        GetErrorStatus
          arg ErrorStatus: type=NvM_RequestResultType, direction=OUT, server-argument-impl-policy=USE-ARGUMENT-TYPE
        InvalidateNvBlock
        ReadBlock
          arg DstPtr: type=dtRef_VOID, direction=IN, server-argument-impl-policy=USE-ARGUMENT-TYPE
        WriteBlock
          arg SrcPtr: type=dtRef_const_VOID, direction=IN, server-argument-impl-policy=USE-ARGUMENT-TYPE
      error E_NOT_OK: error-code=1
    NvSWC_NvMService_AC3_Defs
      6 x operation, all with possible-error=NvSWC_NvMService_AC3_Defs/E_NOT_OK:
        EraseBlock
        GetErrorStatus
          arg ErrorStatus: type=NvM_RequestResultType, direction=OUT, server-argument-impl-policy=USE-ARGUMENT-TYPE
        InvalidateNvBlock
        ReadBlock
          arg DstPtr: type=dtRef_VOID, direction=IN, server-argument-impl-policy=USE-ARGUMENT-TYPE
        RestoreBlockDefaults
          arg DstPtr: type=dtRef_VOID, direction=IN, server-argument-impl-policy=USE-ARGUMENT-TYPE
        WriteBlock
          arg SrcPtr: type=dtRef_const_VOID, direction=IN, server-argument-impl-policy=USE-ARGUMENT-TYPE
      error E_NOT_OK: error-code=1
    NvSWC_NvMService_AC3_DS
      7 x operation, all with possible-error=NvSWC_NvMService_AC3_DS/E_NOT_OK:
        EraseBlock
        GetDataIndex
          arg DataIndex: type=uint8, direction=OUT, server-argument-impl-policy=USE-ARGUMENT-TYPE
        GetErrorStatus
          arg ErrorStatus: type=NvM_RequestResultType, direction=OUT, server-argument-impl-policy=USE-ARGUMENT-TYPE
        InvalidateNvBlock
        ReadBlock
          arg DstPtr: type=dtRef_VOID, direction=IN, server-argument-impl-policy=USE-ARGUMENT-TYPE
        SetDataIndex
          arg DataIndex: type=uint8, direction=IN, server-argument-impl-policy=USE-ARGUMENT-TYPE
        WriteBlock
          arg SrcPtr: type=dtRef_const_VOID, direction=IN, server-argument-impl-policy=USE-ARGUMENT-TYPE
      error E_NOT_OK: error-code=1
    NvSWC_NvMService_AC3_DS_Defs
      8 x operation, all with possible-error=NvSWC_NvMService_AC3_DS_Defs/E_NOT_OK:
        EraseBlock
        GetDataIndex
          arg DataIndex: type=uint8, direction=OUT, server-argument-impl-policy=USE-ARGUMENT-TYPE
        GetErrorStatus
          arg ErrorStatus: type=NvM_RequestResultType, direction=OUT, server-argument-impl-policy=USE-ARGUMENT-TYPE
        InvalidateNvBlock
        ReadBlock
          arg DstPtr: type=dtRef_VOID, direction=IN, server-argument-impl-policy=USE-ARGUMENT-TYPE
        RestoreBlockDefaults
          arg DstPtr: type=dtRef_VOID, direction=IN, server-argument-impl-policy=USE-ARGUMENT-TYPE
        SetDataIndex
          arg DataIndex: type=uint8, direction=IN, server-argument-impl-policy=USE-ARGUMENT-TYPE
        WriteBlock
          arg SrcPtr: type=dtRef_const_VOID, direction=IN, server-argument-impl-policy=USE-ARGUMENT-TYPE
      error E_NOT_OK: error-code=1
    NvSWC_NvMService_AC3_SRBS
      6 x operation, all with possible-error=NvSWC_NvMService_AC3_SRBS/E_NOT_OK:
        EraseBlock
        GetErrorStatus
          arg ErrorStatus: type=NvM_RequestResultType, direction=OUT, server-argument-impl-policy=USE-ARGUMENT-TYPE
        InvalidateNvBlock
        ReadBlock
          arg DstPtr: type=dtRef_VOID, direction=IN, server-argument-impl-policy=USE-ARGUMENT-TYPE
        SetRamBlockStatus
          arg RamBlockStatus: type=boolean, direction=IN, server-argument-impl-policy=USE-ARGUMENT-TYPE
        WriteBlock
          arg SrcPtr: type=dtRef_const_VOID, direction=IN, server-argument-impl-policy=USE-ARGUMENT-TYPE
      error E_NOT_OK: error-code=1
    NvSWC_NvMService_AC3_SRBS_Defs
      7 x operation, all with possible-error=NvSWC_NvMService_AC3_SRBS_Defs/E_NOT_OK:
        EraseBlock
        GetErrorStatus
          arg ErrorStatus: type=NvM_RequestResultType, direction=OUT, server-argument-impl-policy=USE-ARGUMENT-TYPE
        InvalidateNvBlock
        ReadBlock
          arg DstPtr: type=dtRef_VOID, direction=IN, server-argument-impl-policy=USE-ARGUMENT-TYPE
        RestoreBlockDefaults
          arg DstPtr: type=dtRef_VOID, direction=IN, server-argument-impl-policy=USE-ARGUMENT-TYPE
        SetRamBlockStatus
          arg RamBlockStatus: type=boolean, direction=IN, server-argument-impl-policy=USE-ARGUMENT-TYPE
        WriteBlock
          arg SrcPtr: type=dtRef_const_VOID, direction=IN, server-argument-impl-policy=USE-ARGUMENT-TYPE
      error E_NOT_OK: error-code=1
    NvSWC_NvMService_AC3_SRBS_DS
      8 x operation, all with possible-error=NvSWC_NvMService_AC3_SRBS_DS/E_NOT_OK:
        EraseBlock
        GetDataIndex
          arg DataIndex: type=uint8, direction=OUT, server-argument-impl-policy=USE-ARGUMENT-TYPE
        GetErrorStatus
          arg ErrorStatus: type=NvM_RequestResultType, direction=OUT, server-argument-impl-policy=USE-ARGUMENT-TYPE
        InvalidateNvBlock
        ReadBlock
          arg DstPtr: type=dtRef_VOID, direction=IN, server-argument-impl-policy=USE-ARGUMENT-TYPE
        SetDataIndex
          arg DataIndex: type=uint8, direction=IN, server-argument-impl-policy=USE-ARGUMENT-TYPE
        SetRamBlockStatus
          arg RamBlockStatus: type=boolean, direction=IN, server-argument-impl-policy=USE-ARGUMENT-TYPE
        WriteBlock
          arg SrcPtr: type=dtRef_const_VOID, direction=IN, server-argument-impl-policy=USE-ARGUMENT-TYPE
      error E_NOT_OK: error-code=1
    NvSWC_NvMService_AC3_SRBS_DS_Defs
      9 x operation, all with possible-error=NvSWC_NvMService_AC3_SRBS_DS_Defs/E_NOT_OK:
        EraseBlock
        GetDataIndex
          arg DataIndex: type=uint8, direction=OUT, server-argument-impl-policy=USE-ARGUMENT-TYPE
        GetErrorStatus
          arg ErrorStatus: type=NvM_RequestResultType, direction=OUT, server-argument-impl-policy=USE-ARGUMENT-TYPE
        InvalidateNvBlock
        ReadBlock
          arg DstPtr: type=dtRef_VOID, direction=IN, server-argument-impl-policy=USE-ARGUMENT-TYPE
        RestoreBlockDefaults
          arg DstPtr: type=dtRef_VOID, direction=IN, server-argument-impl-policy=USE-ARGUMENT-TYPE
        SetDataIndex
          arg DataIndex: type=uint8, direction=IN, server-argument-impl-policy=USE-ARGUMENT-TYPE
        SetRamBlockStatus
          arg RamBlockStatus: type=boolean, direction=IN, server-argument-impl-policy=USE-ARGUMENT-TYPE
        WriteBlock
          arg SrcPtr: type=dtRef_const_VOID, direction=IN, server-argument-impl-policy=USE-ARGUMENT-TYPE
      error E_NOT_OK: error-code=1
    NvSWC_NvMService_SRBS
      operation GetErrorStatus: possible-error=NvSWC_NvMService_SRBS/E_NOT_OK
        arg ErrorStatus: type=NvM_RequestResultType, direction=OUT, server-argument-impl-policy=USE-ARGUMENT-TYPE
      operation SetRamBlockStatus: possible-error=NvSWC_NvMService_SRBS/E_NOT_OK
        arg RamBlockStatus: type=boolean, direction=IN, server-argument-impl-policy=USE-ARGUMENT-TYPE
      error E_NOT_OK: error-code=1
    NvMNotifyJobFinished: is-service=true
      operation JobFinished
        arg ServiceId: type=NvM_ServiceIdType, direction=IN, server-argument-impl-policy=USE-ARGUMENT-TYPE
        arg JobResult: type=NvM_RequestResultType, direction=IN, server-argument-impl-policy=USE-ARGUMENT-TYPE
    NvSWC_NvMNotifyJobFinished
      operation JobFinished
        arg ServiceId: type=NvM_ServiceIdType, direction=IN, server-argument-impl-policy=USE-ARGUMENT-TYPE
        arg JobResult: type=NvM_RequestResultType, direction=IN, server-argument-impl-policy=USE-ARGUMENT-TYPE
    CallbackDTCStatusChange: is-service=true, service-kind=DIAGNOSTIC-EVENT-MANAGER
      operation DTCStatusChanged: possible-error=CallbackDTCStatusChange/E_NOT_OK
        arg DTC: type=uint32, direction=IN, server-argument-impl-policy=USE-ARGUMENT-TYPE
        arg DTCStatusOld: type=Dem_UdsStatusByteType, direction=IN, server-argument-impl-policy=USE-ARGUMENT-TYPE
        arg DTCStatusNew: type=Dem_UdsStatusByteType, direction=IN, server-argument-impl-policy=USE-ARGUMENT-TYPE
      error E_NOT_OK: error-code=1
package /Interfaces
  1007 x sender receiver interface:
    IF_BJB_Uebertemperaturzaehler_CMC02
      data DE_BJB_Uebertemperaturzaehler_CMC02: type=uint16
    IF_BMC_CMC_Zellspannung_133
      data DE_BMC_CMC_Zellspannung_133: type=uint16
    IF_DCDC_NV_Komponentenfehler_04
      data DE_DCDC_NV_Komponentenfehler_04: type=uint8
    IF_BMC_Dauer_Ladeleistung_02
      data DE_BMC_Dauer_Ladeleistung_02: type=uint16
    IF_BMC_CMC_Zellspannung_134
      data DE_BMC_CMC_Zellspannung_134: type=uint16
    IF_BMC_DC_Laden
      data DE_BMC_DC_Laden: type=uint8
    IF_DCDC_NV_Komponentenfehler_05
      data DE_DCDC_NV_Komponentenfehler_05: type=uint8
    IF_BJB_Uebertemperaturzaehler_CMC03
      data DE_BJB_Uebertemperaturzaehler_CMC03: type=uint16
    IF_BMC_Dev_Freigabe
      data DE_BMC_Dev_Freigabe: type=boolean
    IF_BJB_Uebertemperaturzaehler_CMC04
      data DE_BJB_Uebertemperaturzaehler_CMC04: type=uint16
    IF_BMC_CMC_Zellspannung_135
      data DE_BMC_CMC_Zellspannung_135: type=uint16
    IF_BJB_Unterspannungszaehler_CMC01
      data DE_BJB_Unterspannungszaehler_CMC01: type=uint16
    IF_BMC_CMC_Zellspannung_136
      data DE_BMC_CMC_Zellspannung_136: type=uint16
    IF_BMC_CMC_Zellspannung_137
      data DE_BMC_CMC_Zellspannung_137: type=uint16
    IF_BJB_Unterspannungszaehler_CMC02
      data DE_BJB_Unterspannungszaehler_CMC02: type=uint16
    IF_BMC_CMC_Zellspannung_138
      data DE_BMC_CMC_Zellspannung_138: type=uint16
    IF_BJB_Unterspannungszaehler_CMC03
      data DE_BJB_Unterspannungszaehler_CMC03: type=uint16
    IF_BMC_CMC_Zellspannung_139
      data DE_BMC_CMC_Zellspannung_139: type=uint16
    IF_BMC_Energie_Entladen
      data DE_BMC_Energie_Entladen: type=uint16
    IF_BMC_Energie_Laden
      data DE_BMC_Energie_Laden: type=uint16
    IF_DCDC_NV_Komponentenfehler_06
      data DE_DCDC_NV_Komponentenfehler_06: type=uint8
    IF_BMC_Energie_Sockel_SoC
      data DE_BMC_Energie_Sockel_SoC: type=uint16
    IF_BJB_Unterspannungszaehler_CMC04
      data DE_BJB_Unterspannungszaehler_CMC04: type=uint16
    IF_BMC_Energieinhalt
      data DE_BMC_Energieinhalt: type=uint16
    IF_BMC_Abschaltankuendigung
      data DE_BMC_Abschaltankuendigung: type=uint16
    IF_BMC_CMC_Zellspannung_140
      data DE_BMC_CMC_Zellspannung_140: type=uint16
    IF_DCDC_NV_Komponentenfehler_07
      data DE_DCDC_NV_Komponentenfehler_07: type=uint8
    IF_BMC_EnergieVorhalt
      data DE_BMC_EnergieVorhalt: type=uint16
    IF_BMC_AC_Laden
      data DE_BMC_AC_Laden: type=uint8
    IF_BMC_CMC_Zellspannung_141
      data DE_BMC_CMC_Zellspannung_141: type=uint16
    IF_Hybrid_01_Indc_StChk
      data DE_Hybrid_01_Indc_StChk: type=boolean
    IF_BMC_CMC_Zellspannung_142
      data DE_BMC_CMC_Zellspannung_142: type=uint16
    IF_BMC_Bank_Notlauf_erlaubt
      data DE_BMC_Bank_Notlauf_erlaubt: type=boolean
    IF_DCDC_NV_Komponentenfehler_08
      data DE_DCDC_NV_Komponentenfehler_08: type=uint8
    IF_BMC_CMC_Zellspannung_143
      data DE_BMC_CMC_Zellspannung_143: type=uint16
    IF_BMC_Bank_parallel_erlaubt
      data DE_BMC_Bank_parallel_erlaubt: type=boolean
    IF_Hybrid_01_Indc_StFail
      data DE_Hybrid_01_Indc_StFail: type=boolean
    IF_DCDC_NV_Komponentenfehler_09
      data DE_DCDC_NV_Komponentenfehler_09: type=uint8
    IF_BMC_ExtLadeleistung
      data DE_BMC_ExtLadeleistung: type=uint16
    IF_BMC_Fehler_Leistungsred
      data DE_BMC_Fehler_Leistungsred: type=boolean
    IF_Hybrid_01_KD_Fehler
      data DE_Hybrid_01_KD_Fehler: type=boolean
    IF_DCDC_NV_Komponentenfehler_10
      data DE_DCDC_NV_Komponentenfehler_10: type=uint8
    IF_BMC_Fehler_Warnung
      data DE_BMC_Fehler_Warnung: type=uint8
    IF_BMC_Flash_Freigabe
      data DE_BMC_Flash_Freigabe: type=boolean
    IF_BMC_Bank_seriell_erlaubt
      data DE_BMC_Bank_seriell_erlaubt: type=boolean
    IF_BMC_Status_Trennelemente
      data DE_BMC_Status_Trennelemente: type=uint8
    IF_BMC_HV_01_BZ
      data DE_BMC_HV_01_BZ: type=uint8
    IF_BMC_Bankstatus
      data DE_BMC_Bankstatus: type=uint8
    IF_BMC_Bidi_Energie_Absolut
      data DE_BMC_Bidi_Energie_Absolut: type=uint16
    IF_BMC_Bidi_Freigabe
      data DE_BMC_Bidi_Freigabe: type=uint8
    IF_BMC_Bidi_GenutzteEnergie
      data DE_BMC_Bidi_GenutzteEnergie: type=uint16
    IF_BMC_Strom
      data DE_BMC_Strom: type=uint16
    IF_BMC_CMC_Zellspannung_144
      data DE_BMC_CMC_Zellspannung_144: type=uint16
    IF_BMC_Strom_02
      data DE_BMC_Strom_02: type=uint32
    IF_BMC_CMC_Zellspannung_145
      data DE_BMC_CMC_Zellspannung_145: type=uint16
    IF_BMC_Strom_Messzeit
      data DE_BMC_Strom_Messzeit: type=uint8
    IF_DCDC_NV_Komponentenfehler_11
      data DE_DCDC_NV_Komponentenfehler_11: type=uint8
    IF_BMC_HV_01_CRC
      data DE_BMC_HV_01_CRC: type=uint8
    IF_BMC_CMC_Zellspannung_146
      data DE_BMC_CMC_Zellspannung_146: type=uint16
    IF_BMC_HV_02_BZ
      data DE_BMC_HV_02_BZ: type=uint8
    IF_BMC_CMC_Zellspannung_147
      data DE_BMC_CMC_Zellspannung_147: type=uint16
    IF_Hybrid_01_KompSchutz
      data DE_Hybrid_01_KompSchutz: type=boolean
    IF_BMC_HV_02_CRC
      data DE_BMC_HV_02_CRC: type=uint8
    IF_BMC_CMC_Zellspannung_148
      data DE_BMC_CMC_Zellspannung_148: type=uint16
    IF_DCDC_NV_Komponentenfehler_12
      data DE_DCDC_NV_Komponentenfehler_12: type=uint8
    IF_BMC_HV_04_BZ
      data DE_BMC_HV_04_BZ: type=uint8
    IF_BMC_HV_04_CRC
      data DE_BMC_HV_04_CRC: type=uint8
    IF_Hybrid_01_Nachlauftyp
      data DE_Hybrid_01_Nachlauftyp: type=uint8
    IF_BMC_CMC_Zellspannung_069
      data DE_BMC_CMC_Zellspannung_069: type=uint16
    IF_DCDC_NV_Komponentenfehler_13
      data DE_DCDC_NV_Komponentenfehler_13: type=uint8
    IF_BMC_CMC_Temperatur_042
      data DE_BMC_CMC_Temperatur_042: type=uint8
    IF_BMC_Bidi_Max_SoC
      data DE_BMC_Bidi_Max_SoC: type=uint8
    IF_Hybrid_01_OBD_Lampe_Anf
      data DE_Hybrid_01_OBD_Lampe_Anf: type=boolean
    IF_BMC_NutzbarerSOC
      data DE_BMC_NutzbarerSOC: type=uint16
    IF_BMC_Bidi_Min_SoC
      data DE_BMC_Bidi_Min_SoC: type=uint8
    IF_DCDC_NV_Komponentenfehler_14
      data DE_DCDC_NV_Komponentenfehler_14: type=uint8
    IF_BMC_CMC_Zellspannung_149
      data DE_BMC_CMC_Zellspannung_149: type=uint16
    IF_Hybrid_01_SNI_10
      data DE_Hybrid_01_SNI_10: type=uint16
    IF_BMC_TechnischerSOC
      data DE_BMC_TechnischerSOC: type=uint16
    IF_BMC_HV_10_BZ
      data DE_BMC_HV_10_BZ: type=uint8
    IF_BMC_Bidi_Veto_Energie
      data DE_BMC_Bidi_Veto_Energie: type=boolean
    IF_BMC_CMC_Zellspannung_070
      data DE_BMC_CMC_Zellspannung_070: type=uint16
    IF_BMC_CMC_Zellspannung_010
      data DE_BMC_CMC_Zellspannung_010: type=uint16
    IF_BMC_CMC_Zellspannung_150
      data DE_BMC_CMC_Zellspannung_150: type=uint16
    IF_DCDC_NV_Komponentenfehler_52
      data DE_DCDC_NV_Komponentenfehler_52: type=uint8
    IF_BMC_Temperatur
      data DE_BMC_Temperatur: type=uint16
    IF_BMC_HV_10_CRC
      data DE_BMC_HV_10_CRC: type=uint8
    IF_BMC_Bidi_Veto_Temp
      data DE_BMC_Bidi_Veto_Temp: type=boolean
    IF_BMC_CMC_Zellspannung_151
      data DE_BMC_CMC_Zellspannung_151: type=uint16
    IF_ISO_ALL_01_Req_Data
      data DE_ISO_ALL_01_Req_Data: type=uint64
    IF_BMC_CMC_Temperatur_043
      data DE_BMC_CMC_Temperatur_043: type=uint8
    IF_BMC_Temperatur_hoechste
      data DE_BMC_Temperatur_hoechste: type=uint16
    IF_BMC_CMC_Zellspannung_152
      data DE_BMC_CMC_Zellspannung_152: type=uint16
    IF_BMC_CMC_Zellspannung_071
      data DE_BMC_CMC_Zellspannung_071: type=uint16
    IF_BMC_HV_11_BZ
      data DE_BMC_HV_11_BZ: type=uint8
    IF_BMC_CMC_Temperatur_001
      data DE_BMC_CMC_Temperatur_001: type=uint8
    IF_BMC_Pack_SN_01
      data DE_BMC_Pack_SN_01: type=uint8
    IF_BMC_CMC_Temperatur_044
      data DE_BMC_CMC_Temperatur_044: type=uint8
    IF_BMC_CMC_Zellspannung_153
      data DE_BMC_CMC_Zellspannung_153: type=uint16
    IF_BMC_Temperatur_niedrigste
      data DE_BMC_Temperatur_niedrigste: type=uint16
    IF_BMC_HV_11_CRC
      data DE_BMC_HV_11_CRC: type=uint8
    IF_BMC_CMC_Temperatur_045
      data DE_BMC_CMC_Temperatur_045: type=uint8
    IF_BMC_HV_12_BZ
      data DE_BMC_HV_12_BZ: type=uint8
    IF_BMC_ThermAuslastung
      data DE_BMC_ThermAuslastung: type=uint8
    IF_BMC_Pack_SN_02
      data DE_BMC_Pack_SN_02: type=uint8
    IF_BMC_CMC_Temperatur_046
      data DE_BMC_CMC_Temperatur_046: type=uint8
    IF_DCDC_NV_Komponentenfehler_15
      data DE_DCDC_NV_Komponentenfehler_15: type=uint8
    IF_BMC_CMC_Temperatur_047
      data DE_BMC_CMC_Temperatur_047: type=uint8
    IF_OBD_Driving_Cycle
      data DE_OBD_Driving_Cycle: type=boolean
    IF_BMC_CMC_Zellspannung_011
      data DE_BMC_CMC_Zellspannung_011: type=uint16
    IF_OBD_Eng_Cool_Temp
      data DE_OBD_Eng_Cool_Temp: type=uint8
    IF_UH_Tag
      data DE_UH_Tag: type=uint8
    IF_DCDC_NV_Komponentenfehler_16
      data DE_DCDC_NV_Komponentenfehler_16: type=uint8
    IF_BMC_CMC_Zellspannung_012
      data DE_BMC_CMC_Zellspannung_012: type=uint16
    IF_BMC_CMC_Zellspannung_013
      data DE_BMC_CMC_Zellspannung_013: type=uint16
    IF_KN_Hybrid_01_BusKnockOut
      data DE_KN_Hybrid_01_BusKnockOut: type=uint8
    IF_BMC_CMC_Zellspannung_014
      data DE_BMC_CMC_Zellspannung_014: type=uint16
    IF_DCDC_NV_Komponentenfehler_17
      data DE_DCDC_NV_Komponentenfehler_17: type=uint8
    IF_DCDC_NV_Komponentenfehler_53
      data DE_DCDC_NV_Komponentenfehler_53: type=uint8
    IF_BMC_CMC_Zellspannung_015
      data DE_BMC_CMC_Zellspannung_015: type=uint16
    IF_KN_Hybrid_01_BusKnockOutTimer
      data DE_KN_Hybrid_01_BusKnockOutTimer: type=uint8
    IF_DCDC_NV_Komponentenfehler_18
      data DE_DCDC_NV_Komponentenfehler_18: type=uint8
    IF_DCDC_NV_Komponentenfehler_54
      data DE_DCDC_NV_Komponentenfehler_54: type=uint8
    IF_KN_Hybrid_01_DiagPfad_V12
      data DE_KN_Hybrid_01_DiagPfad_V12: type=boolean
    IF_DCDC_NV_Komponentenfehler_19
      data DE_DCDC_NV_Komponentenfehler_19: type=uint8
    IF_BMC_CMC_Temperatur_048
      data DE_BMC_CMC_Temperatur_048: type=uint8
    IF_BMC_CMC_Temperatur_049
      data DE_BMC_CMC_Temperatur_049: type=uint8
    IF_BMC_CMC_Zellspannung_154
      data DE_BMC_CMC_Zellspannung_154: type=uint16
    IF_KN_Hybrid_01_ECUKnockOut
      data DE_KN_Hybrid_01_ECUKnockOut: type=uint8
    IF_DCDC_NV_Komponentenfehler_55
      data DE_DCDC_NV_Komponentenfehler_55: type=uint8
    IF_BMC_CMC_Temperatur_050
      data DE_BMC_CMC_Temperatur_050: type=uint8
    IF_BMC_CMC_Zellspannung_155
      data DE_BMC_CMC_Zellspannung_155: type=uint16
    IF_BMC_CMC_Temperatur_051
      data DE_BMC_CMC_Temperatur_051: type=uint8
    IF_BMC_CMC_Zellspannung_156
      data DE_BMC_CMC_Zellspannung_156: type=uint16
    IF_DCDC_NV_Komponentenfehler_56
      data DE_DCDC_NV_Komponentenfehler_56: type=uint8
    IF_BMC_ThermSpreizung
      data DE_BMC_ThermSpreizung: type=uint8
    IF_BMC_CMC_Temperatur_052
      data DE_BMC_CMC_Temperatur_052: type=uint8
    IF_BMC_CMC_Zellspannung_157
      data DE_BMC_CMC_Zellspannung_157: type=uint16
    IF_BMC_UBE_Indik_last_update_km
      data DE_BMC_UBE_Indik_last_update_km: type=uint32
    IF_BMC_CMC_Zellspannung_158
      data DE_BMC_CMC_Zellspannung_158: type=uint16
    IF_BMC_CMC_Temperatur_002
      data DE_BMC_CMC_Temperatur_002: type=uint8
    IF_BMC_HV_12_CRC
      data DE_BMC_HV_12_CRC: type=uint8
    IF_BMC_UBE_Indikator
      data DE_BMC_UBE_Indikator: type=uint16
    IF_BMC_CMC_Zellspannung_072
      data DE_BMC_CMC_Zellspannung_072: type=uint16
    IF_OBD_Engine_RPM
      data DE_OBD_Engine_RPM: type=uint16
    IF_BMC_CMC_Temperatur_003
      data DE_BMC_CMC_Temperatur_003: type=uint8
    IF_BMC_HV_13_BZ
      data DE_BMC_HV_13_BZ: type=uint8
    IF_BMC_Ueberspannungszaehler_CMC01
      data DE_BMC_Ueberspannungszaehler_CMC01: type=uint16
    IF_BMC_CMC_Temperatur_004
      data DE_BMC_CMC_Temperatur_004: type=uint8
    IF_BMC_Pack_SN_03
      data DE_BMC_Pack_SN_03: type=uint8
    IF_BMC_HV_13_CRC
      data DE_BMC_HV_13_CRC: type=uint8
    IF_BMC_Ueberspannungszaehler_CMC02
      data DE_BMC_Ueberspannungszaehler_CMC02: type=uint16
    IF_BMC_CMC_Temperatur_005
      data DE_BMC_CMC_Temperatur_005: type=uint8
    IF_BMC_HVK_EoHVL_Status
      data DE_BMC_HVK_EoHVL_Status: type=uint8
    IF_BMC_CMC_Zellspannung_073
      data DE_BMC_CMC_Zellspannung_073: type=uint16
    IF_OBD_Kaltstart_Denominator
      data DE_OBD_Kaltstart_Denominator: type=boolean
    IF_BMC_HVK_Fehler_HVIL
      data DE_BMC_HVK_Fehler_HVIL: type=uint8
    IF_BMC_Pack_SN_04
      data DE_BMC_Pack_SN_04: type=uint8
    IF_BMC_CMC_Zellspannung_016
      data DE_BMC_CMC_Zellspannung_016: type=uint16
    IF_BMC_CMC_Zellspannung_074
      data DE_BMC_CMC_Zellspannung_074: type=uint16
    IF_BMC_CMC_Zellspannung_017
      data DE_BMC_CMC_Zellspannung_017: type=uint16
    IF_DCDC_NV_Komponentenfehler_57
      data DE_DCDC_NV_Komponentenfehler_57: type=uint8
    IF_KN_Hybrid_01_ECUKnockOutTimer
      data DE_KN_Hybrid_01_ECUKnockOutTimer: type=uint8
    IF_BMC_CMC_Temperatur_053
      data DE_BMC_CMC_Temperatur_053: type=uint8
    IF_OBD_Minimum_Trip
      data DE_OBD_Minimum_Trip: type=boolean
    IF_AB_Deaktivierung_HV
      data DE_AB_Deaktivierung_HV: type=uint8
    IF_BMC_Pack_SN_05
      data DE_BMC_Pack_SN_05: type=uint8
    IF_BMC_CMC_Zellspannung_159
      data DE_BMC_CMC_Zellspannung_159: type=uint16
    IF_BMC_CMC_Zellspannung_018
      data DE_BMC_CMC_Zellspannung_018: type=uint16
    IF_BMC_CMC_Temperatur_054
      data DE_BMC_CMC_Temperatur_054: type=uint8
    IF_DCDC_NV_Komponentenfehler_20
      data DE_DCDC_NV_Komponentenfehler_20: type=uint8
    IF_BMC_CMC_Zellspannung_075
      data DE_BMC_CMC_Zellspannung_075: type=uint16
    IF_UI1_Iso_Neg
      data DE_UI1_Iso_Neg: type=uint16
    IF_BMC_CMC_Temperatur_055
      data DE_BMC_CMC_Temperatur_055: type=uint8
    IF_BMC_CMC_Zellspannung_160
      data DE_BMC_CMC_Zellspannung_160: type=uint16
    IF_OBD_Normed_Trip
      data DE_OBD_Normed_Trip: type=boolean
    IF_BMC_CMC_Zellspannung_019
      data DE_BMC_CMC_Zellspannung_019: type=uint16
    IF_BMC_CMC_Temperatur_056
      data DE_BMC_CMC_Temperatur_056: type=uint8
    IF_BMC_Pack_SN_06
      data DE_BMC_Pack_SN_06: type=uint8
    IF_BMC_CMC_Temperatur_006
      data DE_BMC_CMC_Temperatur_006: type=uint8
    IF_BMC_CMC_Zellspannung_161
      data DE_BMC_CMC_Zellspannung_161: type=uint16
    IF_Anzeige_SOC
      data DE_Anzeige_SOC: type=uint16
    IF_BMC_CMC_Zellspannung_01_Messzeit
      data DE_BMC_CMC_Zellspannung_01_Messzeit: type=uint8
    IF_BMC_CMC_Temperatur_057
      data DE_BMC_CMC_Temperatur_057: type=uint8
    IF_BMC_Ueberspannungszaehler_CMC03
      data DE_BMC_Ueberspannungszaehler_CMC03: type=uint16
    IF_BMC_HVK_Fehler_Intern
      data DE_BMC_HVK_Fehler_Intern: type=uint8
    IF_DCDC_NV_Komponentenfehler_58
      data DE_DCDC_NV_Komponentenfehler_58: type=uint8
    IF_KS_Hybrid_01_ChK
      data DE_KS_Hybrid_01_ChK: type=uint64
    IF_BMC_CMC_Zellspannung_076
      data DE_BMC_CMC_Zellspannung_076: type=uint16
    IF_BMC_CMC_Temperatur_007
      data DE_BMC_CMC_Temperatur_007: type=uint8
    IF_OBD_NumDcyMilOnReq
      data DE_OBD_NumDcyMilOnReq: type=uint8
    IF_BJB_10_BZ
      data DE_BJB_10_BZ: type=uint8
    IF_BMC_CMC_Zellspannung_162
      data DE_BMC_CMC_Zellspannung_162: type=uint16
    IF_DCDC_NV_Komponentenfehler_21
      data DE_DCDC_NV_Komponentenfehler_21: type=uint8
    IF_BMC_Ueberspannungszaehler_CMC04
      data DE_BMC_Ueberspannungszaehler_CMC04: type=uint16
    IF_BMC_HVK_Fehler_SD
      data DE_BMC_HVK_Fehler_SD: type=uint8
    IF_BJB_10_CRC
      data DE_BJB_10_CRC: type=uint8
    IF_BMC_CMC_Temperatur_008
      data DE_BMC_CMC_Temperatur_008: type=uint8
    IF_BMC_CMC_Zellspannung_163
      data DE_BMC_CMC_Zellspannung_163: type=uint16
    IF_UI1_Iso_Pos
      data DE_UI1_Iso_Pos: type=uint16
    IF_KS_Hybrid_01_ChK_IKACtr
      data DE_KS_Hybrid_01_ChK_IKACtr: type=uint8
    IF_DCDC_NV_Komponentenfehler_59
      data DE_DCDC_NV_Komponentenfehler_59: type=uint8
    IF_BMC_Uebertemperaturzaehler_CMC01
      data DE_BMC_Uebertemperaturzaehler_CMC01: type=uint16
    IF_BMC_Iso_Mode_Anf
      data DE_BMC_Iso_Mode_Anf: type=uint8
    IF_BMC_CMC_Temperatur_009
      data DE_BMC_CMC_Temperatur_009: type=uint8
    IF_BMC_CMC_Zellspannung_020
      data DE_BMC_CMC_Zellspannung_020: type=uint16
    IF_DCDC_NV_Komponentenfehler_22
      data DE_DCDC_NV_Komponentenfehler_22: type=uint8
    IF_BMC_IstTemperaturMax_Modul_ID
      data DE_BMC_IstTemperaturMax_Modul_ID: type=uint8
    IF_BMC_CMC_Temperatur_058
      data DE_BMC_CMC_Temperatur_058: type=uint8
    IF_BMC_Uebertemperaturzaehler_CMC02
      data DE_BMC_Uebertemperaturzaehler_CMC02: type=uint16
    IF_BMC_CMC_Temperatur_010
      data DE_BMC_CMC_Temperatur_010: type=uint8
    IF_UI1_Iso_Status
      data DE_UI1_Iso_Status: type=uint8
    IF_BMC_CMC_Zellspannung_021
      data DE_BMC_CMC_Zellspannung_021: type=uint16
    IF_KS_Hybrid_01_ChK_SID
      data DE_KS_Hybrid_01_ChK_SID: type=uint16
    IF_DCDC_NV_Komponentenfehler_60
      data DE_DCDC_NV_Komponentenfehler_60: type=uint8
    IF_BMC_CMC_Temperatur_059
      data DE_BMC_CMC_Temperatur_059: type=uint8
    IF_BMC_Uebertemperaturzaehler_CMC03
      data DE_BMC_Uebertemperaturzaehler_CMC03: type=uint16
    IF_BMC_IstTemperaturMax_Sensor_ID
      data DE_BMC_IstTemperaturMax_Sensor_ID: type=uint8
    IF_BMC_CMC_Zellspannung_022
      data DE_BMC_CMC_Zellspannung_022: type=uint16
    IF_DCDC_NV_Komponentenfehler_23
      data DE_DCDC_NV_Komponentenfehler_23: type=uint8
    IF_BMC_CMC_Temperatur_060
      data DE_BMC_CMC_Temperatur_060: type=uint8
    IF_BMC_CMC_Zellspannung_023
      data DE_BMC_CMC_Zellspannung_023: type=uint16
    IF_UI1_KL30_Spannung
      data DE_UI1_KL30_Spannung: type=uint8
    IF_BMC_CMC_Temperatur_061
      data DE_BMC_CMC_Temperatur_061: type=uint8
    IF_KS_Hybrid_01_ChM
      data DE_KS_Hybrid_01_ChM: type=uint64
    IF_DCDC_NV_Komponentenfehler_61
      data DE_DCDC_NV_Komponentenfehler_61: type=uint8
    IF_BMC_CMC_Temperatur_062
      data DE_BMC_CMC_Temperatur_062: type=uint8
    IF_DCDC_NV_Komponentenfehler_24
      data DE_DCDC_NV_Komponentenfehler_24: type=uint8
    IF_UI1_KompFehlerModus2_01
      data DE_UI1_KompFehlerModus2_01: type=uint8
    IF_BMC_CMC_Zellspannung_164
      data DE_BMC_CMC_Zellspannung_164: type=uint16
    IF_BMC_CMC_Zellspannung_165
      data DE_BMC_CMC_Zellspannung_165: type=uint16
    IF_BMC_Pack_SN_07
      data DE_BMC_Pack_SN_07: type=uint8
    IF_BMC_CMC_Zellspannung_166
      data DE_BMC_CMC_Zellspannung_166: type=uint16
    IF_BMC_CMC_Zellspannung_167
      data DE_BMC_CMC_Zellspannung_167: type=uint16
    IF_BMC_CMC_Zellspannung_168
      data DE_BMC_CMC_Zellspannung_168: type=uint16
    IF_BMC_CMC_Temperatur_011
      data DE_BMC_CMC_Temperatur_011: type=uint8
    IF_BMC_Uebertemperaturzaehler_CMC04
      data DE_BMC_Uebertemperaturzaehler_CMC04: type=uint16
    IF_BMC_CMC_Temperatur_012
      data DE_BMC_CMC_Temperatur_012: type=uint8
    IF_BMC_Pack_SN_08
      data DE_BMC_Pack_SN_08: type=uint8
    IF_BMC_UI1_Spannung1_Schalt_Anf
      data DE_BMC_UI1_Spannung1_Schalt_Anf: type=boolean
    IF_BMC_CMC_Temperatur_013
      data DE_BMC_CMC_Temperatur_013: type=uint8
    IF_BJB_11_BZ
      data DE_BJB_11_BZ: type=uint8
    IF_BMC_UI1_Spannung2_Schalt_Anf
      data DE_BMC_UI1_Spannung2_Schalt_Anf: type=boolean
    IF_BMC_CMC_Temperatur_014
      data DE_BMC_CMC_Temperatur_014: type=uint8
    IF_BJB_11_CRC
      data DE_BJB_11_CRC: type=uint8
    IF_BMC_Pack_SN_09
      data DE_BMC_Pack_SN_09: type=uint8
    IF_BMC_UI2_Spannung1_Schalt_Anf
      data DE_BMC_UI2_Spannung1_Schalt_Anf: type=boolean
    IF_BMC_CMC_Temperatur_015
      data DE_BMC_CMC_Temperatur_015: type=uint8
    IF_BJB_12_BZ
      data DE_BJB_12_BZ: type=uint8
    IF_BJB_12_CRC
      data DE_BJB_12_CRC: type=uint8
    IF_BMC_UI2_Spannung2_Schalt_Anf
      data DE_BMC_UI2_Spannung2_Schalt_Anf: type=boolean
    IF_BMC_Pack_SN_10
      data DE_BMC_Pack_SN_10: type=uint8
    IF_BJB_13_BZ
      data DE_BJB_13_BZ: type=uint8
    IF_BMC_CMC_Zellspannung_077
      data DE_BMC_CMC_Zellspannung_077: type=uint16
    IF_BMC_Pack_SN_11
      data DE_BMC_Pack_SN_11: type=uint8
    IF_BMC_CMC_Zellspannung_024
      data DE_BMC_CMC_Zellspannung_024: type=uint16
    IF_BMC_CMC_Temperatur_063
      data DE_BMC_CMC_Temperatur_063: type=uint8
    IF_BMC_CMC_Temperatur_064
      data DE_BMC_CMC_Temperatur_064: type=uint8
    IF_BMC_CMC_Zellspannung_025
      data DE_BMC_CMC_Zellspannung_025: type=uint16
    IF_KS_Hybrid_01_ChM_IKACtr
      data DE_KS_Hybrid_01_ChM_IKACtr: type=uint8
    IF_BMC_CMC_Zellspannung_078
      data DE_BMC_CMC_Zellspannung_078: type=uint16
    IF_BMC_CMC_Zellspannung_026
      data DE_BMC_CMC_Zellspannung_026: type=uint16
    IF_BMC_CMC_Temperatur_065
      data DE_BMC_CMC_Temperatur_065: type=uint8
    IF_DCDC_NV_Komponentenfehler_62
      data DE_DCDC_NV_Komponentenfehler_62: type=uint8
    IF_BMC_CMC_Zellspannung_027
      data DE_BMC_CMC_Zellspannung_027: type=uint16
    IF_BMC_CMC_Temperatur_066
      data DE_BMC_CMC_Temperatur_066: type=uint8
    IF_BMC_CMC_Temperatur_067
      data DE_BMC_CMC_Temperatur_067: type=uint8
    IF_BMC_CMC_Zellspannung_028
      data DE_BMC_CMC_Zellspannung_028: type=uint16
    IF_BMC_CMC_Zellspannung_079
      data DE_BMC_CMC_Zellspannung_079: type=uint16
    IF_KS_Hybrid_01_ChM_SID
      data DE_KS_Hybrid_01_ChM_SID: type=uint16
    IF_DCDC_NV_Komponentenfehler_63
      data DE_DCDC_NV_Komponentenfehler_63: type=uint8
    IF_BMC_CMC_Zellspannung_080
      data DE_BMC_CMC_Zellspannung_080: type=uint16
    IF_KS_Hybrid_01_ReK
      data DE_KS_Hybrid_01_ReK: type=uint64
    IF_BMC_CMC_Zellspannung_081
      data DE_BMC_CMC_Zellspannung_081: type=uint16
    IF_DCDC_NV_Komponentenfehler_64
      data DE_DCDC_NV_Komponentenfehler_64: type=uint8
    IF_BJB_13_CRC
      data DE_BJB_13_CRC: type=uint8
    IF_KS_Hybrid_01_ReK_IKACtr
      data DE_KS_Hybrid_01_ReK_IKACtr: type=uint8
    IF_BJB_CALID_Index_01
      data DE_BJB_CALID_Index_01: type=uint8
    IF_DCDC_NV_Komponentenfehler_65
      data DE_DCDC_NV_Komponentenfehler_65: type=uint8
    IF_BMC_Pack_SN_12
      data DE_BMC_Pack_SN_12: type=uint8
    IF_BJB_CALID_Index_02
      data DE_BJB_CALID_Index_02: type=uint8
    IF_BMC_CMC_Zellspannung_169
      data DE_BMC_CMC_Zellspannung_169: type=uint16
    IF_BJB_CALID_Index_03
      data DE_BJB_CALID_Index_03: type=uint8
    IF_KS_Hybrid_01_ReK_SID
      data DE_KS_Hybrid_01_ReK_SID: type=uint16
    IF_BMC_Unterboden_Warnung
      data DE_BMC_Unterboden_Warnung: type=uint8
    IF_BMC_CMC_Zellspannung_170
      data DE_BMC_CMC_Zellspannung_170: type=uint16
    IF_DCDC_NV_Komponentenfehler_66
      data DE_DCDC_NV_Komponentenfehler_66: type=uint8
    IF_DCDC_NV_Komponentenfehler_25
      data DE_DCDC_NV_Komponentenfehler_25: type=uint8
    IF_BJB_CALID_Index_04
      data DE_BJB_CALID_Index_04: type=uint8
    IF_BMC_Unterspannungszaehler_CMC01
      data DE_BMC_Unterspannungszaehler_CMC01: type=uint16
    IF_BMC_CMC_Temperatur_068
      data DE_BMC_CMC_Temperatur_068: type=uint8
    IF_BMC_CMC_Zellspannung_171
      data DE_BMC_CMC_Zellspannung_171: type=uint16
    IF_OBD_QBit_Aussen_Temp
      data DE_OBD_QBit_Aussen_Temp: type=boolean
    IF_BMC_CMC_Temperatur_016
      data DE_BMC_CMC_Temperatur_016: type=uint8
    IF_BMC_Pack_SN_13
      data DE_BMC_Pack_SN_13: type=uint8
    IF_BMC_CMC_Temperatur_069
      data DE_BMC_CMC_Temperatur_069: type=uint8
    IF_BMC_Unterspannungszaehler_CMC02
      data DE_BMC_Unterspannungszaehler_CMC02: type=uint16
    IF_BMC_CMC_Zellspannung_172
      data DE_BMC_CMC_Zellspannung_172: type=uint16
    IF_BMC_CMC_Temperatur_017
      data DE_BMC_CMC_Temperatur_017: type=uint8
    IF_BMC_CMC_Zellspannung_029
      data DE_BMC_CMC_Zellspannung_029: type=uint16
    IF_BMC_Unterspannungszaehler_CMC03
      data DE_BMC_Unterspannungszaehler_CMC03: type=uint16
    IF_BMC_CMC_Temperatur_070
      data DE_BMC_CMC_Temperatur_070: type=uint8
    IF_BMC_CMC_Zellspannung_173
      data DE_BMC_CMC_Zellspannung_173: type=uint16
    IF_UI1_KompFehlerModus2_02
      data DE_UI1_KompFehlerModus2_02: type=uint8
    IF_DCDC_NV_Komponentenfehler_26
      data DE_DCDC_NV_Komponentenfehler_26: type=uint8
    IF_BMC_CMC_Temperatur_071
      data DE_BMC_CMC_Temperatur_071: type=uint8
    IF_BMC_CMC_Zellspannung_02_Messzeit
      data DE_BMC_CMC_Zellspannung_02_Messzeit: type=uint8
    IF_BMC_CMC_Temperatur_018
      data DE_BMC_CMC_Temperatur_018: type=uint8
    IF_BMC_Pack_SN_14
      data DE_BMC_Pack_SN_14: type=uint8
    IF_BJB_CALID_Index_05
      data DE_BJB_CALID_Index_05: type=uint8
    IF_BMC_CMC_Temperatur_072
      data DE_BMC_CMC_Temperatur_072: type=uint8
    IF_BMC_CMC_Zellspannung_030
      data DE_BMC_CMC_Zellspannung_030: type=uint16
    IF_BMC_CMC_Temperatur_019
      data DE_BMC_CMC_Temperatur_019: type=uint8
    IF_BMC_CMC_Zellspannung_082
      data DE_BMC_CMC_Zellspannung_082: type=uint16
    IF_OBD_Sperrung_IUMPR
      data DE_OBD_Sperrung_IUMPR: type=boolean
    IF_BJB_CALID_Index_06
      data DE_BJB_CALID_Index_06: type=uint8
    IF_DCDC_NV_Komponentenfehler_27
      data DE_DCDC_NV_Komponentenfehler_27: type=uint8
    IF_BMC_CMC_Zellspannung_031
      data DE_BMC_CMC_Zellspannung_031: type=uint16
    IF_BMC_CMC_Temperatur_01_Messzeit
      data DE_BMC_CMC_Temperatur_01_Messzeit: type=uint8
    IF_BMC_Pack_SN_15
      data DE_BMC_Pack_SN_15: type=uint8
    IF_BJB_CALID_Index_07
      data DE_BJB_CALID_Index_07: type=uint8
    IF_BMC_CMC_Zellspannung_032
      data DE_BMC_CMC_Zellspannung_032: type=uint16
    IF_UI1_KompFehlerModus2_03
      data DE_UI1_KompFehlerModus2_03: type=uint8
    IF_BJB_CALID_Index_08
      data DE_BJB_CALID_Index_08: type=uint8
    IF_OBD_Sperrung_Kaltstart_Denom
      data DE_OBD_Sperrung_Kaltstart_Denom: type=boolean
    IF_DCDC_NV_Komponentenfehler_28
      data DE_DCDC_NV_Komponentenfehler_28: type=uint8
    IF_BMC_CMC_Zellspannung_083
      data DE_BMC_CMC_Zellspannung_083: type=uint16
    IF_KS_Hybrid_01_ReM
      data DE_KS_Hybrid_01_ReM: type=uint64
    IF_BMC_Pack_SN_16
      data DE_BMC_Pack_SN_16: type=uint8
    IF_UI1_KompFehlerModus2_04
      data DE_UI1_KompFehlerModus2_04: type=uint8
    IF_BMC_CMC_Zellspannung_174
      data DE_BMC_CMC_Zellspannung_174: type=uint16
    IF_DCDC_NV_Komponentenfehler_29
      data DE_DCDC_NV_Komponentenfehler_29: type=uint8
    IF_OBD_Typ
      data DE_OBD_Typ: type=boolean
    IF_BMC_CMC_Zellspannung_084
      data DE_BMC_CMC_Zellspannung_084: type=uint16
    IF_BMC_CMC_Zellspannung_175
      data DE_BMC_CMC_Zellspannung_175: type=uint16
    IF_BMC_Unterspannungszaehler_CMC04
      data DE_BMC_Unterspannungszaehler_CMC04: type=uint16
    IF_DCDC_NV_Komponentenfehler_67
      data DE_DCDC_NV_Komponentenfehler_67: type=uint8
    IF_BMC_CMC_Temperatur_073
      data DE_BMC_CMC_Temperatur_073: type=uint8
    IF_BMC_CMC_Zellspannung_176
      data DE_BMC_CMC_Zellspannung_176: type=uint16
    IF_UI1_KompFehlerModus2_05
      data DE_UI1_KompFehlerModus2_05: type=uint8
    IF_BMC_Verbauinfo_ACSchuetz
      data DE_BMC_Verbauinfo_ACSchuetz: type=uint8
    IF_OBD_Warm_Up_Cycle
      data DE_OBD_Warm_Up_Cycle: type=boolean
    IF_BMC_CMC_Temperatur_074
      data DE_BMC_CMC_Temperatur_074: type=uint8
    IF_KS_Hybrid_01_ReM_IKACtr
      data DE_KS_Hybrid_01_ReM_IKACtr: type=uint8
    IF_BMC_CMC_Zellspannung_085
      data DE_BMC_CMC_Zellspannung_085: type=uint16
    IF_BMC_CMC_Zellspannung_177
      data DE_BMC_CMC_Zellspannung_177: type=uint16
    IF_BMC_Verbauinfo_Bank
      data DE_BMC_Verbauinfo_Bank: type=uint8
    IF_BMC_CMC_Temperatur_075
      data DE_BMC_CMC_Temperatur_075: type=uint8
    IF_UI1_KompFehlerModus2_06
      data DE_UI1_KompFehlerModus2_06: type=uint8
    IF_BMC_CMC_Temperatur_076
      data DE_BMC_CMC_Temperatur_076: type=uint8
    IF_BMC_Verbrauch
      data DE_BMC_Verbrauch: type=uint16
    IF_KS_Hybrid_01_ReM_SID
      data DE_KS_Hybrid_01_ReM_SID: type=uint16
    IF_DCDC_NV_Komponentenfehler_68
      data DE_DCDC_NV_Komponentenfehler_68: type=uint8
    IF_BMC_Verbrauch_Ueberlauf
      data DE_BMC_Verbrauch_Ueberlauf: type=boolean
    IF_KS_Hybrid_01_Req_ErrCtr
      data DE_KS_Hybrid_01_Req_ErrCtr: type=uint8
    IF_DCDC_NV_Komponentenfehler_69
      data DE_DCDC_NV_Komponentenfehler_69: type=uint8
    IF_BMC_CMC_Temperatur_020
      data DE_BMC_CMC_Temperatur_020: type=uint8
    IF_KS_Hybrid_01_Req_IKA_Retry
      data DE_KS_Hybrid_01_Req_IKA_Retry: type=boolean
    IF_DCDC_NV_Komponentenfehler_70
      data DE_DCDC_NV_Komponentenfehler_70: type=uint8
    IF_BMC_CMC_Temperatur_021
      data DE_BMC_CMC_Temperatur_021: type=uint8
    IF_BMC_CMC_Temperatur_022
      data DE_BMC_CMC_Temperatur_022: type=uint8
    IF_BMC_CMC_Temperatur_023
      data DE_BMC_CMC_Temperatur_023: type=uint8
    IF_DCDC_NV_Komponentenfehler_71
      data DE_DCDC_NV_Komponentenfehler_71: type=uint8
    IF_BMC_CMC_Temperatur_024
      data DE_BMC_CMC_Temperatur_024: type=uint8
    IF_BMC_Pack_SN_17
      data DE_BMC_Pack_SN_17: type=uint8
    IF_DCDC_NV_Komponentenfehler_30
      data DE_DCDC_NV_Komponentenfehler_30: type=uint8
    IF_BMC_CMC_Zellspannung_178
      data DE_BMC_CMC_Zellspannung_178: type=uint16
    IF_BMC_Pack_SN_18
      data DE_BMC_Pack_SN_18: type=uint8
    IF_BMC_CMC_Zellspannung_179
      data DE_BMC_CMC_Zellspannung_179: type=uint16
    IF_BMC_CMC_Zellspannung_180
      data DE_BMC_CMC_Zellspannung_180: type=uint16
    IF_DCDC_NV_Komponentenfehler_31
      data DE_DCDC_NV_Komponentenfehler_31: type=uint8
    IF_BMC_CMC_Zellspannung_033
      data DE_BMC_CMC_Zellspannung_033: type=uint16
    IF_BJB_CALID_Index_09
      data DE_BJB_CALID_Index_09: type=uint8
    IF_BMC_CMC_Zellspannung_181
      data DE_BMC_CMC_Zellspannung_181: type=uint16
    IF_BMC_Pack_SN_19
      data DE_BMC_Pack_SN_19: type=uint8
    IF_BMC_CMC_Temperatur_077
      data DE_BMC_CMC_Temperatur_077: type=uint8
    IF_BMC_CMC_Temperatur_025
      data DE_BMC_CMC_Temperatur_025: type=uint8
    IF_BJB_CALID_Index_10
      data DE_BJB_CALID_Index_10: type=uint8
    IF_BMC_CMC_Zellspannung_034
      data DE_BMC_CMC_Zellspannung_034: type=uint16
    IF_BMC_CMC_Zellspannung_182
      data DE_BMC_CMC_Zellspannung_182: type=uint16
    IF_BMC_CMC_Temperatur_078
      data DE_BMC_CMC_Temperatur_078: type=uint8
    IF_DCDC_NV_Komponentenfehler_32
      data DE_DCDC_NV_Komponentenfehler_32: type=uint8
    IF_BMC_CMC_Temperatur_026
      data DE_BMC_CMC_Temperatur_026: type=uint8
    IF_BMC_Pack_SN_20
      data DE_BMC_Pack_SN_20: type=uint8
    IF_BJB_CALID_Index_11
      data DE_BJB_CALID_Index_11: type=uint8
    IF_BMC_CMC_Temperatur_079
      data DE_BMC_CMC_Temperatur_079: type=uint8
    IF_BMC_CMC_Zellspannung_035
      data DE_BMC_CMC_Zellspannung_035: type=uint16
    IF_BMC_CMC_Temperatur_027
      data DE_BMC_CMC_Temperatur_027: type=uint8
    IF_OBDProtocol_Hybrid_01
      data DE_OBDProtocol_Hybrid_01: type=uint8
    IF_BJB_CALID_Index_12
      data DE_BJB_CALID_Index_12: type=uint8
    IF_BMC_CMC_Temperatur_080
      data DE_BMC_CMC_Temperatur_080: type=uint8
    IF_DCDC_NV_Komponentenfehler_33
      data DE_DCDC_NV_Komponentenfehler_33: type=uint8
    IF_BMC_CMC_Zellspannung_036
      data DE_BMC_CMC_Zellspannung_036: type=uint16
    IF_BMC_CMC_Temperatur_028
      data DE_BMC_CMC_Temperatur_028: type=uint8
    IF_BJB_CALID_Index_13
      data DE_BJB_CALID_Index_13: type=uint8
    IF_BMC_CMC_Zellspannung_086
      data DE_BMC_CMC_Zellspannung_086: type=uint16
    IF_BMC_Pack_SN_21
      data DE_BMC_Pack_SN_21: type=uint8
    IF_BMC_CMC_Temperatur_081
      data DE_BMC_CMC_Temperatur_081: type=uint8
    IF_BMC_CMC_Temperatur_029
      data DE_BMC_CMC_Temperatur_029: type=uint8
    IF_BMC_CMC_Zellspannung_037
      data DE_BMC_CMC_Zellspannung_037: type=uint16
    IF_BMC_VerlustEnergie
      data DE_BMC_VerlustEnergie: type=uint16
    IF_UI1_KompFehlerModus2_07
      data DE_UI1_KompFehlerModus2_07: type=uint8
    IF_DCDC_NV_Komponentenfehler_34
      data DE_DCDC_NV_Komponentenfehler_34: type=uint8
    IF_BMC_Vorlade_Zielspannung
      data DE_BMC_Vorlade_Zielspannung: type=uint16
    IF_BMC_CMC_Zellspannung_183
      data DE_BMC_CMC_Zellspannung_183: type=uint16
    IF_OBDProtocol_req
      data DE_OBDProtocol_req: type=uint8
    IF_BMC_CMC_Zellspannung_184
      data DE_BMC_CMC_Zellspannung_184: type=uint16
    IF_BMC_VorlaufTemperatur
      data DE_BMC_VorlaufTemperatur: type=uint16
    IF_KS_Hybrid_01_Req_Prio
      data DE_KS_Hybrid_01_Req_Prio: type=boolean
    IF_BJB_CALID_Index_14
      data DE_BJB_CALID_Index_14: type=uint8
    IF_BMC_CMC_Zellspannung_087
      data DE_BMC_CMC_Zellspannung_087: type=uint16
    IF_BMC_CMC_Zellspannung_185
      data DE_BMC_CMC_Zellspannung_185: type=uint16
    IF_OnlineRemoteUpdateControlA
      data DE_OnlineRemoteUpdateControlA: type=uint8
    IF_BJB_CALID_Index_15
      data DE_BJB_CALID_Index_15: type=uint8
    IF_BMC_ZellTemp_virtuell_max
      data DE_BMC_ZellTemp_virtuell_max: type=uint16
    IF_UI1_KompFehlerModus2_08
      data DE_UI1_KompFehlerModus2_08: type=uint8
    IF_BMC_CMC_Zellspannung_186
      data DE_BMC_CMC_Zellspannung_186: type=uint16
    IF_BJB_CALID_Index_16
      data DE_BJB_CALID_Index_16: type=uint8
    IF_BMC_ZellTemp_virtuell_min
      data DE_BMC_ZellTemp_virtuell_min: type=uint16
    IF_BMC_CMC_Zellspannung_187
      data DE_BMC_CMC_Zellspannung_187: type=uint16
    IF_BMC_CMC_Zellspannung_088
      data DE_BMC_CMC_Zellspannung_088: type=uint16
    IF_BJB_CVN_Byte_1
      data DE_BJB_CVN_Byte_1: type=uint8
    IF_DCDC_NV_Komponentenfehler_72
      data DE_DCDC_NV_Komponentenfehler_72: type=uint8
    IF_OnlineRemoteUpdateControlD
      data DE_OnlineRemoteUpdateControlD: type=uint8
    IF_UI1_KompFehlerModus2_09
      data DE_UI1_KompFehlerModus2_09: type=uint8
    IF_KS_Hybrid_01_Req_SID
      data DE_KS_Hybrid_01_Req_SID: type=uint16
    IF_BJB_CVN_Byte_2
      data DE_BJB_CVN_Byte_2: type=uint8
    IF_BMC_CMC_Zellspannung_089
      data DE_BMC_CMC_Zellspannung_089: type=uint16
    IF_OnlineRemoteUpdateControlOldA
      data DE_OnlineRemoteUpdateControlOldA: type=uint8
    IF_UI1_KompFehlerModus2_10
      data DE_UI1_KompFehlerModus2_10: type=uint8
    IF_DCDC_NV_Komponentenfehler_73
      data DE_DCDC_NV_Komponentenfehler_73: type=uint8
    IF_KS_Hybrid_01_Req_SWMaj
      data DE_KS_Hybrid_01_Req_SWMaj: type=uint8
    IF_BMC_CMC_Zellspannung_090
      data DE_BMC_CMC_Zellspannung_090: type=uint16
    IF_UI1_KompFehlerModus2_11
      data DE_UI1_KompFehlerModus2_11: type=uint8
    IF_KS_Hybrid_01_Req_SWMin
      data DE_KS_Hybrid_01_Req_SWMin: type=uint8
    IF_DCDC_NV_Komponentenfehler_74
      data DE_DCDC_NV_Komponentenfehler_74: type=uint8
    IF_DCDC_NV_Komponentenfehler_35
      data DE_DCDC_NV_Komponentenfehler_35: type=uint8
    IF_BMC_CMC_Temperatur_02_Messzeit
      data DE_BMC_CMC_Temperatur_02_Messzeit: type=uint8
    IF_BMC_CMC_Temperatur_082
      data DE_BMC_CMC_Temperatur_082: type=uint8
    IF_KS_Hybrid_01_Req_SWPat
      data DE_KS_Hybrid_01_Req_SWPat: type=uint8
    IF_DCDC_NV_Komponentenfehler_75
      data DE_DCDC_NV_Komponentenfehler_75: type=uint8
    IF_BMC_CMC_Temperatur_030
      data DE_BMC_CMC_Temperatur_030: type=uint8
    IF_BMC_CMC_Temperatur_083
      data DE_BMC_CMC_Temperatur_083: type=uint8
    IF_BMC_CMC_Zellspannung_038
      data DE_BMC_CMC_Zellspannung_038: type=uint16
    IF_BMC_Pack_SN_22
      data DE_BMC_Pack_SN_22: type=uint8
    IF_BMC_CMC_Temperatur_031
      data DE_BMC_CMC_Temperatur_031: type=uint8
    IF_BMC_CMC_Temperatur_084
      data DE_BMC_CMC_Temperatur_084: type=uint8
    IF_BJB_CVN_Byte_3
      data DE_BJB_CVN_Byte_3: type=uint8
    IF_BMC_CMC_Zellspannung_039
      data DE_BMC_CMC_Zellspannung_039: type=uint16
    IF_DCDC_NV_Komponentenfehler_36
      data DE_DCDC_NV_Komponentenfehler_36: type=uint8
    IF_BMC_CMC_Temperatur_032
      data DE_BMC_CMC_Temperatur_032: type=uint8
    IF_BMC_CMC_Temperatur_085
      data DE_BMC_CMC_Temperatur_085: type=uint8
    IF_BJB_CVN_Byte_4
      data DE_BJB_CVN_Byte_4: type=uint8
    IF_BMC_CMC_Zellspannung_03_Messzeit
      data DE_BMC_CMC_Zellspannung_03_Messzeit: type=uint8
    IF_BMC_CMC_Temperatur_033
      data DE_BMC_CMC_Temperatur_033: type=uint8
    IF_BMC_CMC_Temperatur_086
      data DE_BMC_CMC_Temperatur_086: type=uint8
    IF_BJB_CVN_VLD
      data DE_BJB_CVN_VLD: type=boolean
    IF_BMC_CMC_Zellspannung_040
      data DE_BMC_CMC_Zellspannung_040: type=uint16
    IF_BMC_Pack_SN_23
      data DE_BMC_Pack_SN_23: type=uint8
    IF_DCDC_NV_Komponentenfehler_37
      data DE_DCDC_NV_Komponentenfehler_37: type=uint8
    IF_BJB_ErrMem_State
      data DE_BJB_ErrMem_State: type=uint8
    IF_BMC_CMC_Zellspannung_041
      data DE_BMC_CMC_Zellspannung_041: type=uint16
    IF_BJB_Lebensdauer_Trennelemente
      data DE_BJB_Lebensdauer_Trennelemente: type=uint32
    IF_BMC_CMC_Zellspannung_188
      data DE_BMC_CMC_Zellspannung_188: type=uint16
    IF_BMC_Pack_SN_24
      data DE_BMC_Pack_SN_24: type=uint8
    IF_DCDC_NV_Komponentenfehler_38
      data DE_DCDC_NV_Komponentenfehler_38: type=uint8
    IF_BMC_CMC_Zellspannung_189
      data DE_BMC_CMC_Zellspannung_189: type=uint16
    IF_BMC_CMC_Zellspannung_190
      data DE_BMC_CMC_Zellspannung_190: type=uint16
    IF_BMC_Pack_SN_25
      data DE_BMC_Pack_SN_25: type=uint8
    IF_DCDC_NV_Komponentenfehler_39
      data DE_DCDC_NV_Komponentenfehler_39: type=uint8
    IF_BMC_CMC_Zellspannung_191
      data DE_BMC_CMC_Zellspannung_191: type=uint16
    IF_BMC_CMC_Zellspannung_192
      data DE_BMC_CMC_Zellspannung_192: type=uint16
    IF_BMC_Pack_SN_26
      data DE_BMC_Pack_SN_26: type=uint8
    IF_BMC_CMC_Temperatur_087
      data DE_BMC_CMC_Temperatur_087: type=uint8
    IF_CHA_ReqPrgBms
      data DE_CHA_ReqPrgBms: type=uint8
    IF_BMC_CMC_Temperatur_088
      data DE_BMC_CMC_Temperatur_088: type=uint8
    IF_DC_IstLeistung_HV
      data DE_DC_IstLeistung_HV: type=uint16
    IF_BJB_Sperrung_Ueberspannung
      data DE_BJB_Sperrung_Ueberspannung: type=uint8
    IF_BMC_CMC_Temperatur_089
      data DE_BMC_CMC_Temperatur_089: type=uint8
    IF_BMC_CMC_Temperatur_090
      data DE_BMC_CMC_Temperatur_090: type=uint8
    IF_BJB_Sperrung_Uebertemperatur
      data DE_BJB_Sperrung_Uebertemperatur: type=uint8
    IF_DCDC_NV_CALID_Index_01
      data DE_DCDC_NV_CALID_Index_01: type=uint8
    IF_BMC_CMC_Zellspannung_042
      data DE_BMC_CMC_Zellspannung_042: type=uint16
    IF_BMC_CMC_Temperatur_034
      data DE_BMC_CMC_Temperatur_034: type=uint8
    IF_BMC_CMC_Temperatur_091
      data DE_BMC_CMC_Temperatur_091: type=uint8
    IF_BJB_Sperrung_Unterspannung
      data DE_BJB_Sperrung_Unterspannung: type=uint8
    IF_BMC_CMC_Zellspannung_043
      data DE_BMC_CMC_Zellspannung_043: type=uint16
    IF_DCDC_NV_CALID_Index_02
      data DE_DCDC_NV_CALID_Index_02: type=uint8
    IF_BMC_CMC_Temperatur_035
      data DE_BMC_CMC_Temperatur_035: type=uint8
    IF_BJB_Status_HV_Spannungssensorik
      data DE_BJB_Status_HV_Spannungssensorik: type=boolean
    IF_BMC_CMC_Zellspannung_044
      data DE_BMC_CMC_Zellspannung_044: type=uint16
    IF_BMC_CMC_Temperatur_036
      data DE_BMC_CMC_Temperatur_036: type=uint8
    IF_DCDC_NV_CALID_Index_03
      data DE_DCDC_NV_CALID_Index_03: type=uint8
    IF_BJB_Status_Trennelemente
      data DE_BJB_Status_Trennelemente: type=uint8
    IF_BMC_CMC_Zellspannung_045
      data DE_BMC_CMC_Zellspannung_045: type=uint16
    IF_BMC_CMC_Temperatur_037
      data DE_BMC_CMC_Temperatur_037: type=uint8
    IF_BMC_Datenuebernahme_Anf
      data DE_BMC_Datenuebernahme_Anf: type=boolean
    IF_BMC_CMC_Temperatur_038
      data DE_BMC_CMC_Temperatur_038: type=uint8
    IF_BMC_CMC_Zellspannung_046
      data DE_BMC_CMC_Zellspannung_046: type=uint16
    IF_DCDC_NV_Komponentenfehler_3_1
      data DE_DCDC_NV_Komponentenfehler_3_1: type=uint8
    IF_BMC_Dauer_Entladeleistung
      data DE_BMC_Dauer_Entladeleistung: type=uint16
    IF_OnlineRemoteUpdateControlOldD
      data DE_OnlineRemoteUpdateControlOldD: type=uint8
    IF_BMC_Dauer_Entladeleistung_02
      data DE_BMC_Dauer_Entladeleistung_02: type=uint16
    IF_BMC_CMC_Temperatur_092
      data DE_BMC_CMC_Temperatur_092: type=uint8
    IF_BMC_Dauer_Ladeleistung
      data DE_BMC_Dauer_Ladeleistung: type=uint16
    IF_BMC_CMC_Temperatur_093
      data DE_BMC_CMC_Temperatur_093: type=uint8
    IF_DCDC_NV_Komponentenfehler_3_10
      data DE_DCDC_NV_Komponentenfehler_3_10: type=uint8
    IF_BMC_CMC_Temperatur_094
      data DE_BMC_CMC_Temperatur_094: type=uint8
    IF_ORU_Control_A_01_BZ
      data DE_ORU_Control_A_01_BZ: type=uint8
    IF_UI2_KompFehlerModus2_02
      data DE_UI2_KompFehlerModus2_02: type=uint8
    IF_BMC_CMC_Temperatur_095
      data DE_BMC_CMC_Temperatur_095: type=uint8
    IF_DCDC_NV_Komponentenfehler_3_11
      data DE_DCDC_NV_Komponentenfehler_3_11: type=uint8
    IF_BMC_CMC_Temperatur_096
      data DE_BMC_CMC_Temperatur_096: type=uint8
    IF_BMC_CMC_Temperatur_039
      data DE_BMC_CMC_Temperatur_039: type=uint8
    IF_ORU_Control_A_01_CRC
      data DE_ORU_Control_A_01_CRC: type=uint8
    IF_BMC_CMC_Temperatur_03_Messzeit
      data DE_BMC_CMC_Temperatur_03_Messzeit: type=uint8
    IF_DCDC_NV_Komponentenfehler_3_12
      data DE_DCDC_NV_Komponentenfehler_3_12: type=uint8
    IF_BJB_Ueberspannungszaehler_CMC01
      data DE_BJB_Ueberspannungszaehler_CMC01: type=uint16
    IF_BMC_CMC_Zellspannung_091
      data DE_BMC_CMC_Zellspannung_091: type=uint16
    IF_BMC_CMC_Temperatur_040
      data DE_BMC_CMC_Temperatur_040: type=uint8
    IF_UI1_KompFehlerModus2_12
      data DE_UI1_KompFehlerModus2_12: type=uint8
    IF_ORU_Control_D_01_BZ
      data DE_ORU_Control_D_01_BZ: type=uint8
    IF_BJB_Ueberspannungszaehler_CMC02
      data DE_BJB_Ueberspannungszaehler_CMC02: type=uint16
    IF_BMC_CMC_Temperatur_041
      data DE_BMC_CMC_Temperatur_041: type=uint8
    IF_BJB_Ueberspannungszaehler_CMC03
      data DE_BJB_Ueberspannungszaehler_CMC03: type=uint16
    IF_DCDC_NV_Komponentenfehler_3_13
      data DE_DCDC_NV_Komponentenfehler_3_13: type=uint8
    IF_BJB_Ueberspannungszaehler_CMC04
      data DE_BJB_Ueberspannungszaehler_CMC04: type=uint16
    IF_ORU_Control_D_01_CRC
      data DE_ORU_Control_D_01_CRC: type=uint8
    IF_UI2Sens01_CALID_Index_09
      data DE_UI2Sens01_CALID_Index_09: type=uint8
    IF_BJB_Uebertemperaturzaehler_CMC01
      data DE_BJB_Uebertemperaturzaehler_CMC01: type=uint16
    IF_UI1_KompFehlerModus2_13
      data DE_UI1_KompFehlerModus2_13: type=uint8
    IF_BMC_CMC_Zellspannung_092
      data DE_BMC_CMC_Zellspannung_092: type=uint16
    IF_DCDC_NV_CALID_Index_04
      data DE_DCDC_NV_CALID_Index_04: type=uint8
    IF_BMC_CMC_Zellspannung_001
      data DE_BMC_CMC_Zellspannung_001: type=uint16
    IF_BMC_CMC_Zellspannung_002
      data DE_BMC_CMC_Zellspannung_002: type=uint16
    IF_DCDC_NV_CALID_Index_05
      data DE_DCDC_NV_CALID_Index_05: type=uint8
    IF_UI1_KompFehlerModus2_14
      data DE_UI1_KompFehlerModus2_14: type=uint8
    IF_BMC_CMC_Zellspannung_093
      data DE_BMC_CMC_Zellspannung_093: type=uint16
    IF_BMC_CMC_Zellspannung_047
      data DE_BMC_CMC_Zellspannung_047: type=uint16
    IF_BMC_CMC_Zellspannung_003
      data DE_BMC_CMC_Zellspannung_003: type=uint16
    IF_DCDC_NV_CALID_Index_06
      data DE_DCDC_NV_CALID_Index_06: type=uint8
    IF_UI2_KompFehlerModus2_03
      data DE_UI2_KompFehlerModus2_03: type=uint8
    IF_BMC_CMC_Zellspannung_004
      data DE_BMC_CMC_Zellspannung_004: type=uint16
    IF_BMC_CMC_Zellspannung_048
      data DE_BMC_CMC_Zellspannung_048: type=uint16
    IF_UI1_KompFehlerModus2_15
      data DE_UI1_KompFehlerModus2_15: type=uint8
    IF_DCDC_NV_CALID_Index_07
      data DE_DCDC_NV_CALID_Index_07: type=uint8
    IF_BMC_CMC_Zellspannung_005
      data DE_BMC_CMC_Zellspannung_005: type=uint16
    IF_BMC_CMC_Zellspannung_094
      data DE_BMC_CMC_Zellspannung_094: type=uint16
    IF_UI2_KompFehlerModus2_04
      data DE_UI2_KompFehlerModus2_04: type=uint8
    IF_BMC_CMC_Zellspannung_049
      data DE_BMC_CMC_Zellspannung_049: type=uint16
    IF_DCDC_NV_CALID_Index_08
      data DE_DCDC_NV_CALID_Index_08: type=uint8
    IF_UI2_KompFehlerModus2_05
      data DE_UI2_KompFehlerModus2_05: type=uint8
    IF_BMC_CMC_Zellspannung_04_Messzeit
      data DE_BMC_CMC_Zellspannung_04_Messzeit: type=uint8
    IF_BMC_PCM_VTD_Freeze_Req
      data DE_BMC_PCM_VTD_Freeze_Req: type=uint8
    IF_UI1_KompFehlerModus2_16
      data DE_UI1_KompFehlerModus2_16: type=uint8
    IF_BMC_CMC_Zellspannung_095
      data DE_BMC_CMC_Zellspannung_095: type=uint16
    IF_BMC_CMC_Zellspannung_050
      data DE_BMC_CMC_Zellspannung_050: type=uint16
    IF_UI2_KompFehlerModus2_06
      data DE_UI2_KompFehlerModus2_06: type=uint8
    IF_UI2_KompFehlerModus2_07
      data DE_UI2_KompFehlerModus2_07: type=uint8
    IF_UI2Sens01_CALID_Index_10
      data DE_UI2Sens01_CALID_Index_10: type=uint8
    IF_BMC_PCM_VTD_LifeTimeReset_Req
      data DE_BMC_PCM_VTD_LifeTimeReset_Req: type=uint8
    IF_UI2Sens01_CALID_Index_11
      data DE_UI2Sens01_CALID_Index_11: type=uint8
    IF_KS_Hybrid_01_Req_VKMS_Err
      data DE_KS_Hybrid_01_Req_VKMS_Err: type=boolean
    IF_UI2Sens01_CALID_Index_12
      data DE_UI2Sens01_CALID_Index_12: type=uint8
    IF_DCDC_NV_Komponentenfehler_76
      data DE_DCDC_NV_Komponentenfehler_76: type=uint8
    IF_BMC_PCM_VTD_LifeTimeReset_Resp
      data DE_BMC_PCM_VTD_LifeTimeReset_Resp: type=uint8
    IF_UI2Sens01_CALID_Index_13
      data DE_UI2Sens01_CALID_Index_13: type=uint8
    IF_BMC_PCM_VTD_RecentReset_Req
      data DE_BMC_PCM_VTD_RecentReset_Req: type=uint8
    IF_KST_KL_15
      data DE_KST_KL_15: type=boolean
    IF_DCDC_NV_Komponentenfehler_77
      data DE_DCDC_NV_Komponentenfehler_77: type=uint8
    IF_BMC_PerfInd_Entladen
      data DE_BMC_PerfInd_Entladen: type=uint16
    IF_MM_PropulsionSystemActive
      data DE_MM_PropulsionSystemActive: type=boolean
    IF_BMC_CMC_Zellspannung_006
      data DE_BMC_CMC_Zellspannung_006: type=uint16
    IF_BMC_CMC_Zellspannung_007
      data DE_BMC_CMC_Zellspannung_007: type=uint16
    IF_DCDC_NV_Komponentenfehler_78
      data DE_DCDC_NV_Komponentenfehler_78: type=uint8
    IF_VIN_9
      data DE_VIN_9: type=uint8
    IF_BMC_CMC_Zellspannung_008
      data DE_BMC_CMC_Zellspannung_008: type=uint16
    IF_NM_aktiv_Konditionierungsbedarf
      data DE_NM_aktiv_Konditionierungsbedarf: type=boolean
    IF_ZM_HV_Auszeit
      data DE_ZM_HV_Auszeit: type=uint16
    IF_BMC_CMC_Zellspannung_009
      data DE_BMC_CMC_Zellspannung_009: type=uint16
    IF_DCDC_NV_Komponentenfehler_79
      data DE_DCDC_NV_Komponentenfehler_79: type=uint8
    IF_ZM_HV_Auszeit_HiRes
      data DE_ZM_HV_Auszeit_HiRes: type=uint16
    IF_BMC_CMC_Zellspannung_096
      data DE_BMC_CMC_Zellspannung_096: type=uint16
    IF_NM_aktiv_SubbusSteuerung_BMC_HV
      data DE_NM_aktiv_SubbusSteuerung_BMC_HV: type=boolean
    IF_ZM_HV_Auszeit_Status
      data DE_ZM_HV_Auszeit_Status: type=uint8
    IF_DCDC_NV_Komponentenfehler_80
      data DE_DCDC_NV_Komponentenfehler_80: type=uint8
    IF_BMC_CMC_Zellspannung_097
      data DE_BMC_CMC_Zellspannung_097: type=uint16
    IF_DCDC_NV_CALID_Index_09
      data DE_DCDC_NV_CALID_Index_09: type=uint8
    IF_UI2_KompFehlerModus2_08
      data DE_UI2_KompFehlerModus2_08: type=uint8
    IF_DCDC_NV_CALID_Index_10
      data DE_DCDC_NV_CALID_Index_10: type=uint8
    IF_BMC_CMC_Zellspannung_051
      data DE_BMC_CMC_Zellspannung_051: type=uint16
    IF_UI2_KompFehlerModus2_09
      data DE_UI2_KompFehlerModus2_09: type=uint8
    IF_ORU_Status
      data DE_ORU_Status: type=uint8
    IF_BMC_CMC_Zellspannung_098
      data DE_BMC_CMC_Zellspannung_098: type=uint16
    IF_UI2Sens01_CALID_Index_14
      data DE_UI2Sens01_CALID_Index_14: type=uint8
    IF_DCDC_NV_CALID_Index_11
      data DE_DCDC_NV_CALID_Index_11: type=uint8
    IF_BMC_CMC_Zellspannung_052
      data DE_BMC_CMC_Zellspannung_052: type=uint16
    IF_DCDC_NV_Komponentenfehler_3_14
      data DE_DCDC_NV_Komponentenfehler_3_14: type=uint8
    IF_UI2_KompFehlerModus2_10
      data DE_UI2_KompFehlerModus2_10: type=uint8
    IF_UI2Sens01_CALID_Index_15
      data DE_UI2Sens01_CALID_Index_15: type=uint8
    IF_DCDC_NV_CALID_Index_12
      data DE_DCDC_NV_CALID_Index_12: type=uint8
    IF_BMC_CMC_Zellspannung_053
      data DE_BMC_CMC_Zellspannung_053: type=uint16
    IF_UI2_KompFehlerModus2_11
      data DE_UI2_KompFehlerModus2_11: type=uint8
    IF_BMC_CMC_Zellspannung_099
      data DE_BMC_CMC_Zellspannung_099: type=uint16
    IF_UI2Sens01_CALID_Index_16
      data DE_UI2Sens01_CALID_Index_16: type=uint8
    IF_OruControlReleaseA
      data DE_OruControlReleaseA: type=uint16
    IF_DCDC_NV_CALID_Index_13
      data DE_DCDC_NV_CALID_Index_13: type=uint8
    IF_UI1_KompFehlerModus2_17
      data DE_UI1_KompFehlerModus2_17: type=uint8
    IF_BMC_CMC_Zellspannung_054
      data DE_BMC_CMC_Zellspannung_054: type=uint16
    IF_UI2_KompFehlerModus2_12
      data DE_UI2_KompFehlerModus2_12: type=uint8
    IF_UI2Sens01_CVN_Byte_1
      data DE_UI2Sens01_CVN_Byte_1: type=uint8
    IF_BMC_PerfInd_Laden
      data DE_BMC_PerfInd_Laden: type=uint16
    IF_DCDC_NV_Komponentenfehler_3_15
      data DE_DCDC_NV_Komponentenfehler_3_15: type=uint8
    IF_UI2Sens01_CVN_Byte_2
      data DE_UI2Sens01_CVN_Byte_2: type=uint8
    IF_BMC_CMC_Zellspannung_100
      data DE_BMC_CMC_Zellspannung_100: type=uint16
    IF_BMC_CMC_Zellspannung_055
      data DE_BMC_CMC_Zellspannung_055: type=uint16
    IF_OruControlReleaseD
      data DE_OruControlReleaseD: type=uint16
    IF_DCDC_NV_Komponentenfehler_3_16
      data DE_DCDC_NV_Komponentenfehler_3_16: type=uint8
    IF_UI1_KompFehlerModus2_18
      data DE_UI1_KompFehlerModus2_18: type=uint8
    IF_BMC_PredLeistung_StuetzungNV
      data DE_BMC_PredLeistung_StuetzungNV: type=uint16
    IF_NM_AWC_FCAB
      data DE_NM_AWC_FCAB: type=uint64
    IF_DCDC_NV_Komponentenfehler_VLD
      data DE_DCDC_NV_Komponentenfehler_VLD: type=boolean
    IF_OTAMC_D_01_BZ
      data DE_OTAMC_D_01_BZ: type=uint8
    IF_DCDC_NV_CALID_Index_14
      data DE_DCDC_NV_CALID_Index_14: type=uint8
    IF_DCDC_NV_Komponentenfehler_3_2
      data DE_DCDC_NV_Komponentenfehler_3_2: type=uint8
    IF_UI1_KompFehlerModus2_19
      data DE_UI1_KompFehlerModus2_19: type=uint8
    IF_BMC_Range_Indikator
      data DE_BMC_Range_Indikator: type=uint16
    IF_DCDC_NV_CALID_Index_15
      data DE_DCDC_NV_CALID_Index_15: type=uint8
    IF_OTAMC_D_01_CRC
      data DE_OTAMC_D_01_CRC: type=uint8
    IF_UI2_KompFehlerModus2_13
      data DE_UI2_KompFehlerModus2_13: type=uint8
    IF_DCDC_NV_CALID_Index_16
      data DE_DCDC_NV_CALID_Index_16: type=uint8
    IF_DCDC_NV_Komponentenfehler_3_3
      data DE_DCDC_NV_Komponentenfehler_3_3: type=uint8
    IF_UI1_KompFehlerModus2_20
      data DE_UI1_KompFehlerModus2_20: type=uint8
    IF_BMC_Rekuperation
      data DE_BMC_Rekuperation: type=uint16
    IF_NM_Dummy01_NM_State
      data DE_NM_Dummy01_NM_State: type=uint8
    IF_UI2Sens01_CVN_Byte_3
      data DE_UI2Sens01_CVN_Byte_3: type=uint8
    IF_DCDC_NV_CVN_Byte_1
      data DE_DCDC_NV_CVN_Byte_1: type=uint8
    IF_DEV_Hybrid_01_Req_00_FD_Data
      data DE_DEV_Hybrid_01_Req_00_FD_Data: type=DEV_Hybrid_01_Req_00_FD_Data
    IF_UI2_KompFehlerModus2_14
      data DE_UI2_KompFehlerModus2_14: type=uint8
    IF_BMC_CMC_Zellspannung_056
      data DE_BMC_CMC_Zellspannung_056: type=uint16
    IF_UI2Sens01_CVN_Byte_4
      data DE_UI2Sens01_CVN_Byte_4: type=uint8
    IF_DCDC_NV_CVN_Byte_2
      data DE_DCDC_NV_CVN_Byte_2: type=uint8
    IF_UI2_KompFehlerModus2_15
      data DE_UI2_KompFehlerModus2_15: type=uint8
    IF_UI1_KompFehlerModus2_21
      data DE_UI1_KompFehlerModus2_21: type=uint8
    IF_NM_Gateway_FCAB
      data DE_NM_Gateway_FCAB: type=uint64
    IF_BMC_CMC_Zellspannung_057
      data DE_BMC_CMC_Zellspannung_057: type=uint16
    IF_DEV_Hybrid_01_Resp_FF_FD_Data
      data DE_DEV_Hybrid_01_Resp_FF_FD_Data: type=DEV_Hybrid_01_Resp_FF_FD_Data
    IF_UI2Sens01_CVN_VLD
      data DE_UI2Sens01_CVN_VLD: type=boolean
    IF_BMC_CMC_Zellspannung_101
      data DE_BMC_CMC_Zellspannung_101: type=uint16
    IF_UI2_KompFehlerModus2_16
      data DE_UI2_KompFehlerModus2_16: type=uint8
    IF_OTP_Aussen_Temp_OBD
      data DE_OTP_Aussen_Temp_OBD: type=boolean
    IF_UI2Sens01_ErrMem_State
      data DE_UI2Sens01_ErrMem_State: type=uint8
    IF_NM_HVZB_FCAB
      data DE_NM_HVZB_FCAB: type=uint64
    IF_BMC_CMC_Zellspannung_058
      data DE_BMC_CMC_Zellspannung_058: type=uint16
    IF_UI2Sens02_CALID_Index_01
      data DE_UI2Sens02_CALID_Index_01: type=uint8
    IF_BMC_CMC_Zellspannung_102
      data DE_BMC_CMC_Zellspannung_102: type=uint16
    IF_DS_Hybrid_01_ConfDTCChanged
      data DE_DS_Hybrid_01_ConfDTCChanged: type=boolean
    IF_UI2_KompFehlerModus2_17
      data DE_UI2_KompFehlerModus2_17: type=uint8
    IF_BMC_CMC_Zellspannung_059
      data DE_BMC_CMC_Zellspannung_059: type=uint16
    IF_OTP_Aussen_Temp_ungef
      data DE_OTP_Aussen_Temp_ungef: type=uint8
    IF_NM_Hybrid_01_CAB_V12
      data DE_NM_Hybrid_01_CAB_V12: type=uint32
    IF_DS_Hybrid_01_DiagAdr
      data DE_DS_Hybrid_01_DiagAdr: type=uint16
    IF_BMC_CMC_Zellspannung_103
      data DE_BMC_CMC_Zellspannung_103: type=uint16
    IF_PCM_BMC_VTD_Freeze_Req
      data DE_PCM_BMC_VTD_Freeze_Req: type=uint8
    IF_BMC_CMC_Zellspannung_104
      data DE_BMC_CMC_Zellspannung_104: type=uint16
    IF_PCM_BMC_VTD_LifeTimeReset_Req
      data DE_PCM_BMC_VTD_LifeTimeReset_Req: type=uint8
    IF_DCDC_NV_Komponentenfehler_3_4
      data DE_DCDC_NV_Komponentenfehler_3_4: type=uint8
    IF_BMC_CMC_Zellspannung_105
      data DE_BMC_CMC_Zellspannung_105: type=uint16
    IF_PCM_BMC_VTD_LifeTimeReset_Resp
      data DE_PCM_BMC_VTD_LifeTimeReset_Resp: type=uint8
    IF_UI2Sens02_CALID_Index_02
      data DE_UI2Sens02_CALID_Index_02: type=uint8
    IF_DCDC_NV_Komponentenfehler_3_5
      data DE_DCDC_NV_Komponentenfehler_3_5: type=uint8
    IF_UI2Sens02_CALID_Index_03
      data DE_UI2Sens02_CALID_Index_03: type=uint8
    IF_UI2Sens02_CALID_Index_04
      data DE_UI2Sens02_CALID_Index_04: type=uint8
    IF_UI2Sens02_CALID_Index_05
      data DE_UI2Sens02_CALID_Index_05: type=uint8
    IF_DCDC_NV_Komponentenfehler_3_6
      data DE_DCDC_NV_Komponentenfehler_3_6: type=uint8
    IF_UI2Sens02_CALID_Index_06
      data DE_UI2Sens02_CALID_Index_06: type=uint8
    IF_DCDC_NV_CVN_Byte_3
      data DE_DCDC_NV_CVN_Byte_3: type=uint8
    IF_BMC_Rekuperation_Ueberlauf
      data DE_BMC_Rekuperation_Ueberlauf: type=boolean
    IF_DCDC_NV_Komponentenfehler_3_7
      data DE_DCDC_NV_Komponentenfehler_3_7: type=uint8
    IF_BMC_CMC_Zellspannung_05_Messzeit
      data DE_BMC_CMC_Zellspannung_05_Messzeit: type=uint8
    IF_UI1_KompFehlerModus2_22
      data DE_UI1_KompFehlerModus2_22: type=uint8
    IF_DCDC_NV_CVN_Byte_4
      data DE_DCDC_NV_CVN_Byte_4: type=uint8
    IF_UI2_KompFehlerModus2_18
      data DE_UI2_KompFehlerModus2_18: type=uint8
    IF_BMC_CMC_Zellspannung_060
      data DE_BMC_CMC_Zellspannung_060: type=uint16
    IF_DCDC_NV_Komponentenfehler_3_8
      data DE_DCDC_NV_Komponentenfehler_3_8: type=uint8
    IF_DCDC_NV_CVN_VLD
      data DE_DCDC_NV_CVN_VLD: type=boolean
    IF_NM_Hybrid_01_CBV_AWB
      data DE_NM_Hybrid_01_CBV_AWB: type=boolean
    IF_UI2_KompFehlerModus2_19
      data DE_UI2_KompFehlerModus2_19: type=uint8
    IF_BMC_CMC_Zellspannung_061
      data DE_BMC_CMC_Zellspannung_061: type=uint16
    IF_DCDC_NV_Komponentenfehler_01
      data DE_DCDC_NV_Komponentenfehler_01: type=uint8
    IF_UI2_KompFehlerModus2_20
      data DE_UI2_KompFehlerModus2_20: type=uint8
    IF_BMC_CMC_Zellspannung_062
      data DE_BMC_CMC_Zellspannung_062: type=uint16
    IF_UI1_KompFehlerModus2_23
      data DE_UI1_KompFehlerModus2_23: type=uint8
    IF_BMC_RtmWarnBattUnautorisiert
      data DE_BMC_RtmWarnBattUnautorisiert: type=uint8
    IF_DCDC_NV_Komponentenfehler_02
      data DE_DCDC_NV_Komponentenfehler_02: type=uint8
    IF_UI2_KompFehlerModus2_21
      data DE_UI2_KompFehlerModus2_21: type=uint8
    IF_BMC_CMC_Zellspannung_063
      data DE_BMC_CMC_Zellspannung_063: type=uint16
    IF_NM_Hybrid_01_CBV_CRI
      data DE_NM_Hybrid_01_CBV_CRI: type=boolean
    IF_UI1_KompFehlerModus2_24
      data DE_UI1_KompFehlerModus2_24: type=uint8
    IF_UI2_KompFehlerModus2_22
      data DE_UI2_KompFehlerModus2_22: type=uint8
    IF_BMC_RtmWarnPackKommunikation
      data DE_BMC_RtmWarnPackKommunikation: type=uint8
    IF_NM_Hybrid_01_FCAB
      data DE_NM_Hybrid_01_FCAB: type=uint64
    IF_UI1_KompFehlerModus2_25
      data DE_UI1_KompFehlerModus2_25: type=uint8
    IF_BMC_RtmWarnPackUeberladen
      data DE_BMC_RtmWarnPackUeberladen: type=uint8
    IF_NM_Hybrid_01_FCIB
      data DE_NM_Hybrid_01_FCIB: type=uint64
    IF_UI1_KompFehlerModus2_26
      data DE_UI1_KompFehlerModus2_26: type=uint8
    IF_BMC_RtmWarnSocHoch
      data DE_BMC_RtmWarnSocHoch: type=uint8
    IF_UI2Sens02_CALID_Index_07
      data DE_UI2Sens02_CALID_Index_07: type=uint8
    IF_BMC_CMC_Zellspannung_064
      data DE_BMC_CMC_Zellspannung_064: type=uint16
    IF_NM_Hybrid_01_Lokalaktiv
      data DE_NM_Hybrid_01_Lokalaktiv: type=boolean
    IF_UI2Sens02_CALID_Index_08
      data DE_UI2Sens02_CALID_Index_08: type=uint8
    IF_DS_Hybrid_01_IdentValid
      data DE_DS_Hybrid_01_IdentValid: type=boolean
    IF_UI2Sens02_CALID_Index_09
      data DE_UI2Sens02_CALID_Index_09: type=uint8
    IF_UI2_KompFehlerModus2_23
      data DE_UI2_KompFehlerModus2_23: type=uint8
    IF_UI2Sens02_CALID_Index_10
      data DE_UI2Sens02_CALID_Index_10: type=uint8
    IF_DCDC_NV_Komponentenfehler_03
      data DE_DCDC_NV_Komponentenfehler_03: type=uint8
    IF_BMC_CMC_Zellspannung_065
      data DE_BMC_CMC_Zellspannung_065: type=uint16
    IF_DCDC_NV_Komponentenfehler_3_9
      data DE_DCDC_NV_Komponentenfehler_3_9: type=uint8
    IF_UI2Sens02_CALID_Index_11
      data DE_UI2Sens02_CALID_Index_11: type=uint8
    IF_BMC_CMC_Zellspannung_106
      data DE_BMC_CMC_Zellspannung_106: type=uint16
    IF_UI2_KompFehlerModus2_24
      data DE_UI2_KompFehlerModus2_24: type=uint8
    IF_BMC_CMC_Zellspannung_066
      data DE_BMC_CMC_Zellspannung_066: type=uint16
    IF_PCM_BMC_VTD_RecentReset_Req
      data DE_PCM_BMC_VTD_RecentReset_Req: type=uint8
    IF_UI2_KompFehlerModus2_25
      data DE_UI2_KompFehlerModus2_25: type=uint8
    IF_DS_Hybrid_01_Lokalaktiv
      data DE_DS_Hybrid_01_Lokalaktiv: type=boolean
    IF_BMC_CMC_Zellspannung_067
      data DE_BMC_CMC_Zellspannung_067: type=uint16
    IF_DCDC_NV_Komponentenfehler_40
      data DE_DCDC_NV_Komponentenfehler_40: type=uint8
    IF_BMC_CMC_Zellspannung_107
      data DE_BMC_CMC_Zellspannung_107: type=uint16
    IF_UI2_KompFehlerModus2_26
      data DE_UI2_KompFehlerModus2_26: type=uint8
    IF_SG_BJB_10
      data DE_SG_BJB_10: type=AT_SG_BJB_10
    IF_BMC_CMC_Zellspannung_068
      data DE_BMC_CMC_Zellspannung_068: type=uint16
    IF_DS_Hybrid_01_MemSel10Changed
      data DE_DS_Hybrid_01_MemSel10Changed: type=boolean
    IF_DCDC_NV_Komponentenfehler_41
      data DE_DCDC_NV_Komponentenfehler_41: type=uint8
    IF_BMC_CMC_Zellspannung_108
      data DE_BMC_CMC_Zellspannung_108: type=uint16
    IF_UI2_KompFehlerModus4_01
      data DE_UI2_KompFehlerModus4_01: type=uint8
    IF_SG_BJB_11
      data DE_SG_BJB_11: type=AT_SG_BJB_11
    IF_UI2Sens02_CALID_Index_12
      data DE_UI2Sens02_CALID_Index_12: type=uint8
    IF_DS_Hybrid_01_MemSelChanged
      data DE_DS_Hybrid_01_MemSelChanged: type=boolean
    IF_DCDC_NV_Komponentenfehler_42
      data DE_DCDC_NV_Komponentenfehler_42: type=uint8
    IF_BMC_RtmWarnSocNiedrig
      data DE_BMC_RtmWarnSocNiedrig: type=uint8
    IF_UI1_KompFehlerModus4_01
      data DE_UI1_KompFehlerModus4_01: type=uint8
    IF_BMC_CMC_Zellspannung_109
      data DE_BMC_CMC_Zellspannung_109: type=uint16
    IF_UI2Sens02_CALID_Index_13
      data DE_UI2Sens02_CALID_Index_13: type=uint8
    IF_SG_BJB_12
      data DE_SG_BJB_12: type=AT_SG_BJB_12
    IF_UI2Sens02_CALID_Index_14
      data DE_UI2Sens02_CALID_Index_14: type=uint8
    IF_DS_Hybrid_01_StMemChanged
      data DE_DS_Hybrid_01_StMemChanged: type=boolean
    IF_UI2_KompFehlerModus4_02
      data DE_UI2_KompFehlerModus4_02: type=uint8
    IF_NM_Hybrid_01_NM_aktiv_Diag
      data DE_NM_Hybrid_01_NM_aktiv_Diag: type=boolean
    IF_UI2Sens02_CALID_Index_15
      data DE_UI2Sens02_CALID_Index_15: type=uint8
    IF_UI1_KompFehlerModus4_02
      data DE_UI1_KompFehlerModus4_02: type=uint8
    IF_SG_BJB_13
      data DE_SG_BJB_13: type=AT_SG_BJB_13
    IF_UI2_KompFehlerModus4_03
      data DE_UI2_KompFehlerModus4_03: type=uint8
    IF_BMC_RtmWarnSocSprung
      data DE_BMC_RtmWarnSocSprung: type=uint8
    IF_UI2Sens02_CALID_Index_16
      data DE_UI2Sens02_CALID_Index_16: type=uint8
    IF_NM_Hybrid_01_NM_aktiv_KL15
      data DE_NM_Hybrid_01_NM_aktiv_KL15: type=boolean
    IF_DCDC_NV_Komponentenfehler_43
      data DE_DCDC_NV_Komponentenfehler_43: type=uint8
    IF_UI1_KompFehlerModus4_03
      data DE_UI1_KompFehlerModus4_03: type=uint8
    IF_UI2_KompFehlerModus4_04
      data DE_UI2_KompFehlerModus4_04: type=uint8
    IF_BMC_RtmWarnTZelleDiff
      data DE_BMC_RtmWarnTZelleDiff: type=uint8
    IF_BMC_CMC_Zellspannung_110
      data DE_BMC_CMC_Zellspannung_110: type=uint16
    IF_UI2_KompFehlerModus4_05
      data DE_UI2_KompFehlerModus4_05: type=uint8
    IF_UI1_KompFehlerModus4_04
      data DE_UI1_KompFehlerModus4_04: type=uint8
    IF_NM_Hybrid_01_NM_aktiv_Tmin
      data DE_NM_Hybrid_01_NM_aktiv_Tmin: type=boolean
    IF_UI2_KompFehlerModus4_06
      data DE_UI2_KompFehlerModus4_06: type=uint8
    IF_BMC_RtmWarnTZelleMax
      data DE_BMC_RtmWarnTZelleMax: type=uint8
    IF_DCDC_NV_Komponentenfehler_44
      data DE_DCDC_NV_Komponentenfehler_44: type=uint8
    IF_UI1_KompFehlerModus4_05
      data DE_UI1_KompFehlerModus4_05: type=uint8
    IF_NM_Hybrid_01_NM_State
      data DE_NM_Hybrid_01_NM_State: type=uint8
    IF_BMC_CMC_Zellspannung_111
      data DE_BMC_CMC_Zellspannung_111: type=uint16
    IF_BMC_RtmWarnTZelleMin
      data DE_BMC_RtmWarnTZelleMin: type=uint8
    IF_DCDC_NV_Komponentenfehler_45
      data DE_DCDC_NV_Komponentenfehler_45: type=uint8
    IF_SG_HVK_03
      data DE_SG_HVK_03: type=AT_SG_HVK_03
    IF_BMC_CMC_Zellspannung_112
      data DE_BMC_CMC_Zellspannung_112: type=uint16
    IF_NM_Hybrid_01_SNI_10
      data DE_NM_Hybrid_01_SNI_10: type=uint16
    IF_DS_Hybrid_01_Subsystemaktiv
      data DE_DS_Hybrid_01_Subsystemaktiv: type=boolean
    IF_UI2_KompFehlerModus4_07
      data DE_UI2_KompFehlerModus4_07: type=uint8
    IF_BMC_RtmWarnUeberstrom
      data DE_BMC_RtmWarnUeberstrom: type=uint8
    IF_BMC_IstTemperaturMin_Modul_ID
      data DE_BMC_IstTemperaturMin_Modul_ID: type=uint8
    IF_UI2Sens02_CVN_Byte_1
      data DE_UI2Sens02_CVN_Byte_1: type=uint8
    IF_DCDC_NV_Komponentenfehler_46
      data DE_DCDC_NV_Komponentenfehler_46: type=uint8
    IF_SG_HVLM_14
      data DE_SG_HVLM_14: type=AT_SG_HVLM_14
    IF_UI1_KompFehlerModus4_06
      data DE_UI1_KompFehlerModus4_06: type=uint8
    IF_UI2Sens02_CVN_Byte_2
      data DE_UI2Sens02_CVN_Byte_2: type=uint8
    IF_UI2_KompFehlerModus4_08
      data DE_UI2_KompFehlerModus4_08: type=uint8
    IF_DS_Hybrid_01_TestFailedChanged
      data DE_DS_Hybrid_01_TestFailedChanged: type=boolean
    IF_NM_Hybrid_01_Subsystemaktiv
      data DE_NM_Hybrid_01_Subsystemaktiv: type=boolean
    IF_BMC_CMC_Zellspannung_113
      data DE_BMC_CMC_Zellspannung_113: type=uint16
    IF_BMC_RtmWarnUPackMax
      data DE_BMC_RtmWarnUPackMax: type=uint8
    IF_BMC_IstTemperaturMin_Sensor_ID
      data DE_BMC_IstTemperaturMin_Sensor_ID: type=uint8
    IF_UI2Sens02_CVN_Byte_3
      data DE_UI2Sens02_CVN_Byte_3: type=uint8
    IF_UI2_KompFehlerModus4_09
      data DE_UI2_KompFehlerModus4_09: type=uint8
    IF_SG_KS_Hybrid_01_Challenge_M
      data DE_SG_KS_Hybrid_01_Challenge_M: type=AT_SG_KS_Hybrid_01_Challenge_M
    IF_DS_Hybrid_01_WIRChanged
      data DE_DS_Hybrid_01_WIRChanged: type=boolean
    IF_DCDC_NV_Komponentenfehler_47
      data DE_DCDC_NV_Komponentenfehler_47: type=uint8
    IF_UI1_KompFehlerModus4_07
      data DE_UI1_KompFehlerModus4_07: type=uint8
    IF_BMC_CMC_Zellspannung_114
      data DE_BMC_CMC_Zellspannung_114: type=uint16
    IF_NM_Hybrid_01_UDS_CC
      data DE_NM_Hybrid_01_UDS_CC: type=boolean
    IF_BMC_IstZellspannungMax
      data DE_BMC_IstZellspannungMax: type=uint16
    IF_BMC_RtmWarnUPackMin
      data DE_BMC_RtmWarnUPackMin: type=uint8
    IF_UI2_KompFehlerModus4_10
      data DE_UI2_KompFehlerModus4_10: type=uint8
    IF_SG_KS_Hybrid_01_Response_M
      data DE_SG_KS_Hybrid_01_Response_M: type=AT_SG_KS_Hybrid_01_Response_M
    IF_UI2Sens02_CVN_Byte_4
      data DE_UI2Sens02_CVN_Byte_4: type=uint8
    IF_DW_Kilometerstand
      data DE_DW_Kilometerstand: type=uint32
    IF_UI1_KompFehlerModus4_08
      data DE_UI1_KompFehlerModus4_08: type=uint8
    IF_NM_Hybrid_01_Wakeup_V12
      data DE_NM_Hybrid_01_Wakeup_V12: type=uint8
    IF_UI2_KompFehlerModus4_11
      data DE_UI2_KompFehlerModus4_11: type=uint8
    IF_UI2Sens02_CVN_VLD
      data DE_UI2Sens02_CVN_VLD: type=boolean
    IF_BMC_IstZellSpannungMax_Modul_ID
      data DE_BMC_IstZellSpannungMax_Modul_ID: type=uint8
    IF_EKK_HVK_EoHVL_Status
      data DE_EKK_HVK_EoHVL_Status: type=uint8
    IF_SG_ORU_Control_A_01
      data DE_SG_ORU_Control_A_01: type=AT_SG_ORU_Control_A_01
    IF_BMC_RtmWarnUZelleMax
      data DE_BMC_RtmWarnUZelleMax: type=uint8
    IF_UI1_KompFehlerModus4_09
      data DE_UI1_KompFehlerModus4_09: type=uint8
    IF_NM_Ladegeraet_FCAB
      data DE_NM_Ladegeraet_FCAB: type=uint64
    IF_BMC_IstZellSpannungMax_Zell_ID
      data DE_BMC_IstZellSpannungMax_Zell_ID: type=uint8
    IF_BMC_RtmWarnUZelleMin
      data DE_BMC_RtmWarnUZelleMin: type=uint8
    IF_UI1_KompFehlerModus4_10
      data DE_UI1_KompFehlerModus4_10: type=uint8
    IF_DCDC_NV_Komponentenfehler_48
      data DE_DCDC_NV_Komponentenfehler_48: type=uint8
    IF_HVEM_BMC_CHA_Wunschleistung
      data DE_HVEM_BMC_CHA_Wunschleistung: type=uint16
    IF_UI2Sens02_ErrMem_State
      data DE_UI2Sens02_ErrMem_State: type=uint8
    IF_UISensorIso_01_BZ
      data DE_UISensorIso_01_BZ: type=uint8
    IF_HVEM_BMC_CHA_Wunschleistung_02
      data DE_HVEM_BMC_CHA_Wunschleistung_02: type=uint16
    IF_BMC_CMC_Zellspannung_115
      data DE_BMC_CMC_Zellspannung_115: type=uint16
    IF_DCDC_NV_Komponentenfehler_49
      data DE_DCDC_NV_Komponentenfehler_49: type=uint8
    IF_UISensorIso_01_CRC
      data DE_UISensorIso_01_CRC: type=uint8
    IF_HVEM_MMTR_State
      data DE_HVEM_MMTR_State: type=uint8
    IF_SG_ORU_Control_D_01
      data DE_SG_ORU_Control_D_01: type=AT_SG_ORU_Control_D_01
    IF_UISensorIso_02_BZ
      data DE_UISensorIso_02_BZ: type=uint8
    IF_HVEM_SystemMinLeistungsgrenze
      data DE_HVEM_SystemMinLeistungsgrenze: type=uint8
    IF_DCDC_NV_Komponentenfehler_50
      data DE_DCDC_NV_Komponentenfehler_50: type=uint8
    IF_UI2_KompFehlerModus4_12
      data DE_UI2_KompFehlerModus4_12: type=uint8
    IF_UISensorIso_02_CRC
      data DE_UISensorIso_02_CRC: type=uint8
    IF_BMC_IstZellspannungMin
      data DE_BMC_IstZellspannungMin: type=uint16
    IF_HVK_03_BZ
      data DE_HVK_03_BZ: type=uint8
    IF_BMC_CMC_Zellspannung_116
      data DE_BMC_CMC_Zellspannung_116: type=uint16
    IF_UI2_KompFehlerModus4_13
      data DE_UI2_KompFehlerModus4_13: type=uint8
    IF_DCDC_NV_Komponentenfehler_51
      data DE_DCDC_NV_Komponentenfehler_51: type=uint8
    IF_SG_OTAMC_D_01
      data DE_SG_OTAMC_D_01: type=AT_SG_OTAMC_D_01
    IF_UI2_KompFehlerModus4_14
      data DE_UI2_KompFehlerModus4_14: type=uint8
    IF_BMC_CMC_Zellspannung_117
      data DE_BMC_CMC_Zellspannung_117: type=uint16
    IF_BMC_IstZellSpannungMin_Modul_ID
      data DE_BMC_IstZellSpannungMin_Modul_ID: type=uint8
    IF_UI2_KompFehlerModus4_15
      data DE_UI2_KompFehlerModus4_15: type=uint8
    IF_NM_SACID_1_FCAB
      data DE_NM_SACID_1_FCAB: type=uint64
    IF_SG_UI1_01
      data DE_SG_UI1_01: type=AT_SG_UI1_01
    IF_BMC_IstZellSpannungMin_Zell_ID
      data DE_BMC_IstZellSpannungMin_Zell_ID: type=uint8
    IF_BMC_CMC_Zellspannung_118
      data DE_BMC_CMC_Zellspannung_118: type=uint16
    IF_SG_UI1_02
      data DE_SG_UI1_02: type=AT_SG_UI1_02
    IF_BMC_RtmWarnZelleZustand
      data DE_BMC_RtmWarnZelleZustand: type=uint8
    IF_UI1_KompFehlerModus4_11
      data DE_UI1_KompFehlerModus4_11: type=uint8
    IF_BMC_CMC_Zellspannung_119
      data DE_BMC_CMC_Zellspannung_119: type=uint16
    IF_BMC_IWU_Status
      data DE_BMC_IWU_Status: type=uint8
    IF_NM_SACID_2_FCAB
      data DE_NM_SACID_2_FCAB: type=uint64
    IF_UISensorPyro_01_BZ
      data DE_UISensorPyro_01_BZ: type=uint8
    IF_UI2_KompFehlerModus4_16
      data DE_UI2_KompFehlerModus4_16: type=uint8
    IF_HVK_03_CRC
      data DE_HVK_03_CRC: type=uint8
    IF_BMC_RuecklaufTemperatur
      data DE_BMC_RuecklaufTemperatur: type=uint16
    IF_BMC_IWU_Wert_neg
      data DE_BMC_IWU_Wert_neg: type=uint16
    IF_UI1_KompFehlerModus4_12
      data DE_UI1_KompFehlerModus4_12: type=uint8
    IF_NVEM_Abschaltstufe
      data DE_NVEM_Abschaltstufe: type=uint8
    IF_UI2_Pyro_Status
      data DE_UI2_Pyro_Status: type=uint8
    IF_UISensorPyro_01_CRC
      data DE_UISensorPyro_01_CRC: type=uint8
    IF_HVK_BMC_Sollmodus
      data DE_HVK_BMC_Sollmodus: type=uint8
    IF_BMC_Spannung
      data DE_BMC_Spannung: type=uint16
    IF_UI1_KompFehlerModus4_13
      data DE_UI1_KompFehlerModus4_13: type=uint8
    IF_UI2_Spannung1
      data DE_UI2_Spannung1: type=uint16
    IF_OBD_Abs_Pedal_Pos
      data DE_OBD_Abs_Pedal_Pos: type=uint8
    IF_HVK_BMC_Spannung_Anf
      data DE_HVK_BMC_Spannung_Anf: type=uint8
    IF_UISensorPyro_02_BZ
      data DE_UISensorPyro_02_BZ: type=uint8
    IF_UI2_Spannung1_Schalt_Status
      data DE_UI2_Spannung1_Schalt_Status: type=uint8
    IF_HVK_Iso_Messung_Start
      data DE_HVK_Iso_Messung_Start: type=uint8
    IF_BMC_Spannung_DC_Ladesaeule
      data DE_BMC_Spannung_DC_Ladesaeule: type=uint16
    IF_SG_UI2_01
      data DE_SG_UI2_01: type=AT_SG_UI2_01
    IF_UISensorPyro_02_CRC
      data DE_UISensorPyro_02_CRC: type=uint8
    IF_UI1_KompFehlerModus4_14
      data DE_UI1_KompFehlerModus4_14: type=uint8
    IF_UI2_Spannung2
      data DE_UI2_Spannung2: type=uint16
    IF_OBD_Aussen_Temp_gef
      data DE_OBD_Aussen_Temp_gef: type=uint8
    IF_HVK_Istmodus_Anf
      data DE_HVK_Istmodus_Anf: type=boolean
    IF_BMC_Spannung_Messzeit
      data DE_BMC_Spannung_Messzeit: type=uint8
    IF_SG_UI2_02
      data DE_SG_UI2_02: type=AT_SG_UI2_02
    IF_SG_UI2_03
      data DE_SG_UI2_03: type=AT_SG_UI2_03
    IF_SI_NWDF
      data DE_SI_NWDF: type=boolean
    IF_BMC_CMC_Zellspannung_120
      data DE_BMC_CMC_Zellspannung_120: type=uint16
    IF_SI_NWDF_30
      data DE_SI_NWDF_30: type=boolean
    IF_BMC_CMC_Zellspannung_121
      data DE_BMC_CMC_Zellspannung_121: type=uint16
    IF_BMC_CMC_Zellspannung_122
      data DE_BMC_CMC_Zellspannung_122: type=uint16
    IF_UI1_KompFehlerModus4_15
      data DE_UI1_KompFehlerModus4_15: type=uint8
    IF_BMC_CMC_Zellspannung_123
      data DE_BMC_CMC_Zellspannung_123: type=uint16
    IF_HVLE_IstSpannung_HV
      data DE_HVLE_IstSpannung_HV: type=uint16
    IF_UISensorPyro_03_BZ
      data DE_UISensorPyro_03_BZ: type=uint8
    IF_BMC_CMC_Zellspannung_124
      data DE_BMC_CMC_Zellspannung_124: type=uint16
    IF_UI2_Spannung2_Schalt_Status
      data DE_UI2_Spannung2_Schalt_Status: type=uint8
    IF_HVLE_OBG_IstModus
      data DE_HVLE_OBG_IstModus: type=uint8
    IF_OBD_Barometric_Pressure
      data DE_OBD_Barometric_Pressure: type=uint8
    IF_UISensorPyro_03_CRC
      data DE_UISensorPyro_03_CRC: type=uint8
    IF_HVLM_14_BZ
      data DE_HVLM_14_BZ: type=uint8
    IF_UI2_Spannung3
      data DE_UI2_Spannung3: type=uint16
    IF_UI1_KompFehlerModus4_16
      data DE_UI1_KompFehlerModus4_16: type=uint8
    IF_HVLM_14_CRC
      data DE_HVLM_14_CRC: type=uint8
    IF_VDSO_Vx3d
      data DE_VDSO_Vx3d: type=uint16
    IF_UI2_Spannung4
      data DE_UI2_Spannung4: type=uint16
    IF_BMC_IWU_Wert_pos
      data DE_BMC_IWU_Wert_pos: type=uint16
    IF_UI2_Spannung5
      data DE_UI2_Spannung5: type=uint16
    IF_HVLM_BCAM_Aktiv
      data DE_HVLM_BCAM_Aktiv: type=boolean
    IF_VehicleProtectedEnvironment_D
      data DE_VehicleProtectedEnvironment_D: type=uint8
    IF_UI2_Spannung6
      data DE_UI2_Spannung6: type=uint16
    IF_UI1_Spannung1
      data DE_UI1_Spannung1: type=uint16
    IF_BMC_Spannung_ZwischenKreis
      data DE_BMC_Spannung_ZwischenKreis: type=uint16
    IF_VIN_1
      data DE_VIN_1: type=uint8
    IF_OBD_Calc_Load_Val
      data DE_OBD_Calc_Load_Val: type=uint8
    IF_BMC_Konditionierung_Anf
      data DE_BMC_Konditionierung_Anf: type=boolean
    IF_SI_P_Mode
      data DE_SI_P_Mode: type=boolean
    IF_UI1_Spannung1_Schalt_Status
      data DE_UI1_Spannung1_Schalt_Status: type=uint8
    IF_OBD_ClearMem_Inhibit
      data DE_OBD_ClearMem_Inhibit: type=boolean
    IF_BMC_Spannung_ZwischenKreis_2
      data DE_BMC_Spannung_ZwischenKreis_2: type=uint16
    IF_BMC_KundenWarnung
      data DE_BMC_KundenWarnung: type=uint8
    IF_UI1_Spannung2
      data DE_UI1_Spannung2: type=uint16
    IF_BMC_Sperrung_Ueberspannung
      data DE_BMC_Sperrung_Ueberspannung: type=uint8
    IF_BMC_Lebensdauer_Trennelemente
      data DE_BMC_Lebensdauer_Trennelemente: type=uint32
    IF_BMC_Sperrung_Uebertemperatur
      data DE_BMC_Sperrung_Uebertemperatur: type=uint8
    IF_BMC_Sperrung_Unterspannung
      data DE_BMC_Sperrung_Unterspannung: type=uint8
    IF_UI1_Spannung2_Schalt_Status
      data DE_UI1_Spannung2_Schalt_Status: type=uint8
    IF_VIN_10
      data DE_VIN_10: type=uint8
    IF_UI1_Spannung3
      data DE_UI1_Spannung3: type=uint16
    IF_VIN_11
      data DE_VIN_11: type=uint8
    IF_BMC_CMC_Zellspannung_125
      data DE_BMC_CMC_Zellspannung_125: type=uint16
    IF_HVLM_BidiLadeModus
      data DE_HVLM_BidiLadeModus: type=uint8
    IF_UI1_Spannung4
      data DE_UI1_Spannung4: type=uint16
    IF_UI1_Spannung5
      data DE_UI1_Spannung5: type=uint16
    IF_VIN_12
      data DE_VIN_12: type=uint8
    IF_BMC_CMC_Zellspannung_126
      data DE_BMC_CMC_Zellspannung_126: type=uint16
    IF_HVLM_DC_Aufstartmodus
      data DE_HVLM_DC_Aufstartmodus: type=uint8
    IF_UI1_Spannung6
      data DE_UI1_Spannung6: type=uint16
    IF_BMC_CMC_Zellspannung_127
      data DE_BMC_CMC_Zellspannung_127: type=uint16
    IF_HVLM_Start_Pulserkennung
      data DE_HVLM_Start_Pulserkennung: type=boolean
    IF_VIN_13
      data DE_VIN_13: type=uint8
    IF_HVLM_Steckerstatus
      data DE_HVLM_Steckerstatus: type=uint8
    IF_BMC_CMC_Zellspannung_128
      data DE_BMC_CMC_Zellspannung_128: type=uint16
    IF_HVLM_ZustandLadeablauf
      data DE_HVLM_ZustandLadeablauf: type=uint8
    IF_VIN_14
      data DE_VIN_14: type=uint8
    IF_UI1_Status
      data DE_UI1_Status: type=boolean
    IF_BMC_CMC_Zellspannung_129
      data DE_BMC_CMC_Zellspannung_129: type=uint16
    IF_UI1_Strom
      data DE_UI1_Strom: type=uint32
    IF_BMC_CMC_Zellspannung_130
      data DE_BMC_CMC_Zellspannung_130: type=uint16
    IF_UI1_Stromintegral_Entladen
      data DE_UI1_Stromintegral_Entladen: type=uint16
    IF_VIN_15
      data DE_VIN_15: type=uint8
    IF_BMC_CMC_Zellspannung_131
      data DE_BMC_CMC_Zellspannung_131: type=uint16
    IF_UI1_Stromintegral_Laden
      data DE_UI1_Stromintegral_Laden: type=uint16
    IF_VIN_16
      data DE_VIN_16: type=uint8
    IF_BMC_CMC_Zellspannung_132
      data DE_BMC_CMC_Zellspannung_132: type=uint16
    IF_UI1_Temperatur_1
      data DE_UI1_Temperatur_1: type=uint8
    IF_VIN_17
      data DE_VIN_17: type=uint8
    IF_VIN_2
      data DE_VIN_2: type=uint8
    IF_UI1_Temperatur_2
      data DE_UI1_Temperatur_2: type=uint8
    IF_VIN_3
      data DE_VIN_3: type=uint8
    IF_UI2_HW_Crashleitung_Status
      data DE_UI2_HW_Crashleitung_Status: type=uint8
    IF_UI2_KL30_Spannung
      data DE_UI2_KL30_Spannung: type=uint8
    IF_UI2_KompFehlerModus2_01
      data DE_UI2_KompFehlerModus2_01: type=uint8
    IF_VIN_4
      data DE_VIN_4: type=uint8
    IF_VIN_5
      data DE_VIN_5: type=uint8
    IF_VIN_6
      data DE_VIN_6: type=uint8
    IF_VIN_7
      data DE_VIN_7: type=uint8
    IF_VIN_8
      data DE_VIN_8: type=uint8
    IF_BMC_Leerlaufspannung
      data DE_BMC_Leerlaufspannung: type=uint16
    IF_BMC_Status_DCLS
      data DE_BMC_Status_DCLS: type=uint8
    IF_BMC_Max_Entladeleistung
      data DE_BMC_Max_Entladeleistung: type=uint16
    IF_BMC_Status_HV_Spannungssensorik
      data DE_BMC_Status_HV_Spannungssensorik: type=boolean
    IF_BMC_Max_Entladeleistung_02
      data DE_BMC_Max_Entladeleistung_02: type=uint16
    IF_BMC_Status_Spgfreiheit
      data DE_BMC_Status_Spgfreiheit: type=uint8
    IF_BMC_Max_Entladestrom
      data DE_BMC_Max_Entladestrom: type=uint16
    IF_BMC_Max_Entladestrom_02
      data DE_BMC_Max_Entladestrom_02: type=uint16
    IF_BMC_Max_Ladeleistung
      data DE_BMC_Max_Ladeleistung: type=uint16
    IF_BMC_Max_Ladeleistung_02
      data DE_BMC_Max_Ladeleistung_02: type=uint16
    IF_BMC_Max_Ladestrom
      data DE_BMC_Max_Ladestrom: type=uint16
    IF_BMC_Max_Ladestrom_02
      data DE_BMC_Max_Ladestrom_02: type=uint16
    IF_BMC_Max_Spannung
      data DE_BMC_Max_Spannung: type=uint16
    IF_BMC_MaxEnergieinhalt
      data DE_BMC_MaxEnergieinhalt: type=uint16
    IF_BMC_Min_Spannung
      data DE_BMC_Min_Spannung: type=uint16
    IF_BMC_MinDyn_Entladespannung
      data DE_BMC_MinDyn_Entladespannung: type=uint16
    IF_BMC_MinDyn_Ladespannung
      data DE_BMC_MinDyn_Ladespannung: type=uint16
    IF_UI2_Status
      data DE_UI2_Status: type=boolean
    IF_BMC_MMTR_Status
      data DE_BMC_MMTR_Status: type=uint8
    IF_SI_P_Mode_gueltig
      data DE_SI_P_Mode_gueltig: type=boolean
    IF_BMC_Modus
      data DE_BMC_Modus: type=uint8
    IF_SI_T_Mode
      data DE_SI_T_Mode: type=boolean
    IF_UI2_Strom
      data DE_UI2_Strom: type=uint32
    IF_SOK_ungeschuetzte_Zeit
      data DE_SOK_ungeschuetzte_Zeit: type=uint64
    IF_UI2_Stromintegral_Entladen
      data DE_UI2_Stromintegral_Entladen: type=uint16
    IF_SOK_Zeit_Hybrid_01_Challenge
      data DE_SOK_Zeit_Hybrid_01_Challenge: type=uint64
    IF_UI2_Stromintegral_Laden
      data DE_UI2_Stromintegral_Laden: type=uint16
    IF_BMC_NutzbareKapazitaet
      data DE_BMC_NutzbareKapazitaet: type=uint16
    IF_SOK_Zeit_Hybrid_01_Zeit
      data DE_SOK_Zeit_Hybrid_01_Zeit: type=uint64
    IF_UI2_Temperatur_1
      data DE_UI2_Temperatur_1: type=uint8
    IF_TME_Batt_Kond_Verf
      data DE_TME_Batt_Kond_Verf: type=uint8
    IF_UI2_Temperatur_2
      data DE_UI2_Temperatur_2: type=uint8
    IF_UI2Sens01_CALID_Index_01
      data DE_UI2Sens01_CALID_Index_01: type=uint8
    IF_TME_Therm_IstLeistung_HVBatterie
      data DE_TME_Therm_IstLeistung_HVBatterie: type=uint16
    IF_UI2Sens01_CALID_Index_02
      data DE_UI2Sens01_CALID_Index_02: type=uint8
    IF_UH_Jahr
      data DE_UH_Jahr: type=uint8
    IF_UI2Sens01_CALID_Index_03
      data DE_UI2Sens01_CALID_Index_03: type=uint8
    IF_UH_Minute
      data DE_UH_Minute: type=uint8
    IF_UI2Sens01_CALID_Index_04
      data DE_UI2Sens01_CALID_Index_04: type=uint8
    IF_UH_Monat
      data DE_UH_Monat: type=uint8
    IF_UI2Sens01_CALID_Index_05
      data DE_UI2Sens01_CALID_Index_05: type=uint8
    IF_UH_Sekunde
      data DE_UH_Sekunde: type=uint8
    IF_UI2Sens01_CALID_Index_06
      data DE_UI2Sens01_CALID_Index_06: type=uint8
    IF_UH_Stunde
      data DE_UH_Stunde: type=uint8
    IF_UI2Sens01_CALID_Index_07
      data DE_UI2Sens01_CALID_Index_07: type=uint8
    IF_UI2Sens01_CALID_Index_08
      data DE_UI2Sens01_CALID_Index_08: type=uint8
package /Ivd/Interfaces
  5 x client server interface, all with is-service=true, service-kind=DIAGNOSTIC-COMMUNICATION-MANAGER:
    DataServices_Data_0x0245_Configuration_Hash
      operation ConditionCheckRead: possible-error=[DataServices_Data_0x0245_Configuration_Hash/DCM_E_PENDING, DataServices_Data_0x0245_Configuration_Hash/E_NOT_OK]
        arg OpStatus: type=Dcm_OpStatusType, direction=IN, server-argument-impl-policy=USE-ARGUMENT-TYPE
        arg ErrorCode: type=Dcm_NegativeResponseCodeType, direction=OUT, server-argument-impl-policy=USE-ARGUMENT-TYPE
      operation ReadData: possible-error=[DataServices_Data_0x0245_Configuration_Hash/DCM_E_PENDING, DataServices_Data_0x0245_Configuration_Hash/E_NOT_OK]
        arg OpStatus: type=Dcm_OpStatusType, direction=IN, server-argument-impl-policy=USE-ARGUMENT-TYPE
        arg Data: type=Dcm_Data32ByteType, direction=OUT, server-argument-impl-policy=USE-ARRAY-BASE-TYPE
      error DCM_E_PENDING: error-code=10
      error E_NOT_OK: error-code=1
    DataServices_Data_0x0250_Integrity_validation_data_configuration_list
      4 x operation, all with possible-error=[DataServices_Data_0x0250_Integrity_validation_data_configuration_list/DCM_E_PENDING, DataServices_Data_0x0250_Integrity_validation_data_configuration_list/E_NOT_OK]:
        ConditionCheckRead
          arg OpStatus: type=Dcm_OpStatusType, direction=IN, server-argument-impl-policy=USE-ARGUMENT-TYPE
          arg ErrorCode: type=Dcm_NegativeResponseCodeType, direction=OUT, server-argument-impl-policy=USE-ARGUMENT-TYPE
        ReadData
          arg OpStatus: type=Dcm_OpStatusType, direction=IN, server-argument-impl-policy=USE-ARGUMENT-TYPE
          arg Data: type=Dcm_Data4096ByteType, direction=OUT, server-argument-impl-policy=USE-ARRAY-BASE-TYPE
        ReadDataLength
          arg OpStatus: type=Dcm_OpStatusType, direction=IN, server-argument-impl-policy=USE-ARGUMENT-TYPE
          arg DataLength: type=uint16, direction=OUT, server-argument-impl-policy=USE-ARGUMENT-TYPE
        WriteData
          4 x arg:
            Data: type=Dcm_Data4096ByteType, direction=IN, server-argument-impl-policy=USE-ARRAY-BASE-TYPE
            DataLength: type=uint16, direction=IN, server-argument-impl-policy=USE-ARGUMENT-TYPE
            OpStatus: type=Dcm_OpStatusType, direction=IN, server-argument-impl-policy=USE-ARGUMENT-TYPE
            ErrorCode: type=Dcm_NegativeResponseCodeType, direction=OUT, server-argument-impl-policy=USE-ARGUMENT-TYPE
      error DCM_E_PENDING: error-code=10
      error E_NOT_OK: error-code=1
    DataServices_Data_0x0249_Programming_Hash
      operation ConditionCheckRead: possible-error=[DataServices_Data_0x0249_Programming_Hash/DCM_E_PENDING, DataServices_Data_0x0249_Programming_Hash/E_NOT_OK]
        arg OpStatus: type=Dcm_OpStatusType, direction=IN, server-argument-impl-policy=USE-ARGUMENT-TYPE
        arg ErrorCode: type=Dcm_NegativeResponseCodeType, direction=OUT, server-argument-impl-policy=USE-ARGUMENT-TYPE
      operation ReadData: possible-error=[DataServices_Data_0x0249_Programming_Hash/DCM_E_PENDING, DataServices_Data_0x0249_Programming_Hash/E_NOT_OK]
        arg OpStatus: type=Dcm_OpStatusType, direction=IN, server-argument-impl-policy=USE-ARGUMENT-TYPE
        arg Data: type=Dcm_Data32ByteType, direction=OUT, server-argument-impl-policy=USE-ARRAY-BASE-TYPE
      error DCM_E_PENDING: error-code=10
      error E_NOT_OK: error-code=1
    RoutineServices_Routine_0x0253_Calculate_integrity_validation_data_Start
      operation Start: possible-error=[RoutineServices_Routine_0x0253_Calculate_integrity_validation_data_Start/DCM_E_FORCE_RCRRP, RoutineServices_Routine_0x0253_Calculate_integrity_validation_data_Start/DCM_E_PENDING, RoutineServices_Routine_0x0253_Calculate_integrity_validation_data_Start/E_NOT_OK]
        6 x arg:
          Type_of_calculation: type=uint8, direction=IN, server-argument-impl-policy=USE-ARGUMENT-TYPE
          Type_of_hash_value: type=uint8, direction=IN, server-argument-impl-policy=USE-ARGUMENT-TYPE
          OpStatus: type=Dcm_OpStatusType, direction=IN, server-argument-impl-policy=USE-ARGUMENT-TYPE
          ResData: type=Dcm_Data4096ByteType, direction=OUT, server-argument-impl-policy=USE-ARRAY-BASE-TYPE
          DataLength: type=uint16, direction=OUT, server-argument-impl-policy=USE-ARGUMENT-TYPE
          ErrorCode: type=Dcm_NegativeResponseCodeType, direction=OUT, server-argument-impl-policy=USE-ARGUMENT-TYPE
      error DCM_E_FORCE_RCRRP: error-code=12
      error DCM_E_PENDING: error-code=10
      error E_NOT_OK: error-code=1
    RoutineServices_Routine_0x0254_Calculate_individual_hash_value_Start
      operation Start: possible-error=[RoutineServices_Routine_0x0254_Calculate_individual_hash_value_Start/DCM_E_FORCE_RCRRP, RoutineServices_Routine_0x0254_Calculate_individual_hash_value_Start/DCM_E_PENDING, RoutineServices_Routine_0x0254_Calculate_individual_hash_value_Start/E_NOT_OK]
        7 x arg:
          Type_of_hash_value: type=uint8, direction=IN, server-argument-impl-policy=USE-ARGUMENT-TYPE
          Type_of_hash: type=uint8, direction=IN, server-argument-impl-policy=USE-ARGUMENT-TYPE
          Individual_hash_value_id: type=Dcm_Data2ByteType, direction=IN, server-argument-impl-policy=USE-ARRAY-BASE-TYPE
          OpStatus: type=Dcm_OpStatusType, direction=IN, server-argument-impl-policy=USE-ARGUMENT-TYPE
          ResData: type=Dcm_Data4096ByteType, direction=OUT, server-argument-impl-policy=USE-ARRAY-BASE-TYPE
          DataLength: type=uint16, direction=OUT, server-argument-impl-policy=USE-ARGUMENT-TYPE
          ErrorCode: type=Dcm_NegativeResponseCodeType, direction=OUT, server-argument-impl-policy=USE-ARGUMENT-TYPE
      error DCM_E_FORCE_RCRRP: error-code=12
      error DCM_E_PENDING: error-code=10
      error E_NOT_OK: error-code=1
package /ModeDclrGroups
  9 x mode declaration group:
    EcuM_Mode: category=ALPHABETIC_ORDER, initial-mode=STARTUP
      6 x mode:
        POST_RUN
        RUN
        SHUTDOWN
        SLEEP
        STARTUP
        WAKE_SLEEP
    BasicSFD: category=EXPLICIT_ORDER, initial-mode=BasicSFD/DISALLOW, on-transition-value=2
      mode ALLOW: value=1
      mode DISALLOW: value=0
    EptiSFD: category=EXPLICIT_ORDER, initial-mode=EptiSFD/DISALLOW, on-transition-value=2
      mode ALLOW: value=1
      mode DISALLOW: value=0
    E2eSFD: category=EXPLICIT_ORDER, initial-mode=E2eSFD/DISALLOW, on-transition-value=2
      mode ALLOW: value=1
      mode DISALLOW: value=0
    ExtendedSFD: category=EXPLICIT_ORDER, initial-mode=ExtendedSFD/DISALLOW, on-transition-value=2
      mode ALLOW: value=1
      mode DISALLOW: value=0
    OtaSFD: category=EXPLICIT_ORDER, initial-mode=OtaSFD/DISALLOW, on-transition-value=2
      mode ALLOW: value=1
      mode DISALLOW: value=0
    ProductionSFD: category=EXPLICIT_ORDER, initial-mode=ProductionSFD/DISALLOW, on-transition-value=2
      mode ALLOW: value=1
      mode DISALLOW: value=0
    SuperUserSFD: category=EXPLICIT_ORDER, initial-mode=SuperUserSFD/DISALLOW, on-transition-value=2
      mode ALLOW: value=1
      mode DISALLOW: value=0
    Reset: category=ALPHABETIC_ORDER, initial-mode=NoReset, on-transition-value=2
      mode NoReset: value=0
      mode PerformHard: value=1
package /PortInterfaces
  4 x sender receiver interface:
    Signal_MyECU_SecOC_Tx1
      data Signal_MyECU_SecOC_Tx1: type=Signal_MyECU_SecOC_Tx1
    Signal_MyECU_SecOC_Tx2
      data Signal_MyECU_SecOC_Tx2: type=Signal_MyECU_SecOC_Tx2
    Signal_MyECU_SecOC_Rx2
      data Signal_MyECU_SecOC_Rx2: type=Signal_MyECU_SecOC_Rx2
    Signal_MyECU_SecOC_Rx2_1
      data Signal_MyECU_SecOC_Rx2: type=Signal_MyECU_SecOC_Rx2
  mode switch interface EcuM_CurrentMode: is-service=true
    mode group currentMode: type=EcuM_Mode
  sender receiver interface RequestPOSTRUN
    data Request: type=Ivd_RequestPostRun
  6 x client server interface:
    Data_0x0250_Integrity_validation_data_configuration_list_SFD2
      4 x operation, all with possible-error=[Data_0x0250_Integrity_validation_data_configuration_list_SFD2/DCM_E_PENDING, Data_0x0250_Integrity_validation_data_configuration_list_SFD2/E_NOT_OK]:
        ConditionCheckRead
          arg OpStatus: type=Dcm_OpStatusType, direction=IN, server-argument-impl-policy=USE-ARGUMENT-TYPE
          arg ErrorCode: type=Dcm_NegativeResponseCodeType, direction=OUT, server-argument-impl-policy=USE-ARGUMENT-TYPE
        ReadData
          arg OpStatus: type=Dcm_OpStatusType, direction=IN, server-argument-impl-policy=USE-ARGUMENT-TYPE
          arg Data: type=Dcm_Data4096ByteType, direction=OUT, server-argument-impl-policy=USE-ARRAY-BASE-TYPE
        ReadDataLength
          arg OpStatus: type=Dcm_OpStatusType, direction=IN, server-argument-impl-policy=USE-ARGUMENT-TYPE
          arg DidLength: type=uint16, direction=OUT, server-argument-impl-policy=USE-ARGUMENT-TYPE
        WriteData
          4 x arg:
            Data: type=Dcm_Data4096ByteType, direction=IN, server-argument-impl-policy=USE-ARRAY-BASE-TYPE
            DataLength: type=uint16, direction=IN, server-argument-impl-policy=USE-ARGUMENT-TYPE
            OpStatus: type=Dcm_OpStatusType, direction=IN, server-argument-impl-policy=USE-ARGUMENT-TYPE
            ErrorCode: type=Dcm_NegativeResponseCodeType, direction=OUT, server-argument-impl-policy=USE-ARGUMENT-TYPE
      error DCM_E_PENDING: error-code=10
      error E_NOT_OK: error-code=1
    Data_0xF18F_Regulation_x_software_identification_numbers_SFD2
      4 x operation, all with possible-error=[Data_0xF18F_Regulation_x_software_identification_numbers_SFD2/DCM_E_PENDING, Data_0xF18F_Regulation_x_software_identification_numbers_SFD2/E_NOT_OK]:
        ConditionCheckRead
          arg OpStatus: type=Dcm_OpStatusType, direction=IN, server-argument-impl-policy=USE-ARGUMENT-TYPE
          arg ErrorCode: type=Dcm_NegativeResponseCodeType, direction=OUT, server-argument-impl-policy=USE-ARGUMENT-TYPE
        ReadData
          arg OpStatus: type=Dcm_OpStatusType, direction=IN, server-argument-impl-policy=USE-ARGUMENT-TYPE
          arg Data: type=Dcm_Data4096ByteType, direction=OUT, server-argument-impl-policy=USE-ARRAY-BASE-TYPE
        ReadDataLength
          arg OpStatus: type=Dcm_OpStatusType, direction=IN, server-argument-impl-policy=USE-ARGUMENT-TYPE
          arg DidLength: type=uint16, direction=OUT, server-argument-impl-policy=USE-ARGUMENT-TYPE
        WriteData
          4 x arg:
            Data: type=Dcm_Data4096ByteType, direction=IN, server-argument-impl-policy=USE-ARRAY-BASE-TYPE
            DataLength: type=uint16, direction=IN, server-argument-impl-policy=USE-ARGUMENT-TYPE
            OpStatus: type=Dcm_OpStatusType, direction=IN, server-argument-impl-policy=USE-ARGUMENT-TYPE
            ErrorCode: type=Dcm_NegativeResponseCodeType, direction=OUT, server-argument-impl-policy=USE-ARGUMENT-TYPE
      error DCM_E_PENDING: error-code=10
      error E_NOT_OK: error-code=1
    Ivd_SlaveListProgCfgHash
      operation Data: possible-error=[Ivd_SlaveListProgCfgHash/E_NOT_OK, Ivd_SlaveListProgCfgHash/E_PENDING, E_SMALL_BUFFER]
        arg DataBuffer: type=Ivd_Data128Byte, direction=IN, server-argument-impl-policy=USE-ARRAY-BASE-TYPE
        arg DataLength: type=uint8, direction=IN, server-argument-impl-policy=USE-ARGUMENT-TYPE
        arg Cmd: type=uint8, direction=IN, server-argument-impl-policy=USE-ARGUMENT-TYPE
      operation Hash: possible-error=[E_DATA_INVALID, Ivd_SlaveListProgCfgHash/E_NOT_OK]
        arg PtrHashValue: type=Ivd_32ByteHash, direction=OUT, server-argument-impl-policy=USE-ARRAY-BASE-TYPE
      4 x error:
        E_DATA_INVALID: error-code=2
        E_NOT_OK: error-code=1
        E_PENDING: error-code=10
        E_SMALL_BUFFER: error-code=3
    Sfd2_CalcHash
      operation CalcHash_Data: possible-error=[IVD_E_DID_INVALID, IVD_E_NOT_OK]
        arg numDIDs: type=uint16, direction=IN, server-argument-impl-policy=USE-ARGUMENT-TYPE
        arg DIDs: type=Sfd2_DidArray_Type, direction=IN, server-argument-impl-policy=USE-ARGUMENT-TYPE
      operation CalcHash_Hash: possible-error=[IVD_E_NOT_OK, IVD_E_PENDING]
        arg ptrHashValue: type=Sfd2_32ByteHash_Type, direction=OUT, server-argument-impl-policy=USE-ARGUMENT-TYPE
      operation CalcHash_Setup: possible-error=[IVD_E_NOT_OK, IVD_E_PENDING, IVD_E_SMALL_BUFFER]
        arg lengthDIDs: type=uint16, direction=IN, server-argument-impl-policy=USE-ARGUMENT-TYPE
      4 x error:
        IVD_E_DID_INVALID: error-code=3
        IVD_E_NOT_OK: error-code=1
        IVD_E_PENDING: error-code=10
        IVD_E_SMALL_BUFFER: error-code=2
    AppData_Dsdl1
      operation AdrRange: possible-error=[AppData_Dsdl1/E_NOT_OK, AppData_Dsdl1/E_WAIT_FOR_DATA]
        arg dsAdrStart: type=uint16, direction=OUT, server-argument-impl-policy=USE-ARGUMENT-TYPE
        arg dsAdrEnd: type=uint16, direction=OUT, server-argument-impl-policy=USE-ARGUMENT-TYPE
      operation Data: possible-error=[AppData_Dsdl1/E_NOT_OK, AppData_Dsdl1/E_WAIT_FOR_DATA]
        arg datasetInfoList: type=AppData_Dsdl1InfoList_Type, direction=INOUT, server-argument-impl-policy=USE-ARGUMENT-TYPE
      error E_NOT_OK: error-code=1
      error E_WAIT_FOR_DATA: error-code=2
    AppData_AdaptionCodingOrDsdl2
      operation Data: possible-error=[AppData_AdaptionCodingOrDsdl2/E_NOT_OK, AppData_AdaptionCodingOrDsdl2/E_PENDING, AppData_AdaptionCodingOrDsdl2/E_WAIT_FOR_DATA]
        4 x arg, all with server-argument-impl-policy=USE-ARGUMENT-TYPE:
          cmd: type=uint8, direction=IN
          id: type=uint16, direction=IN
          ptrResultData: type=AppData_Data128Byte, direction=OUT
          ptrResultDataLength: type=uint16, direction=OUT
      error E_NOT_OK: error-code=1
      error E_PENDING: error-code=10
      error E_WAIT_FOR_DATA: error-code=2
  7 x mode switch interface, all with is-service=true:
    BasicSFD_MPI
      mode group BasicSFDRole: type=BasicSFD
    EptiSFD_MPI
      mode group EptiSFDRole: type=EptiSFD
    E2eSFD_MPI
      mode group E2eSFDRole: type=E2eSFD
    ExtendedSFD_MPI
      mode group ExtendedSFDRole: type=ExtendedSFD
    OtaSFD_MPI
      mode group OtaSFDRole: type=OtaSFD
    ProductionSFD_MPI
      mode group ProductionSFDRole: type=ProductionSFD
    SuperUserSFD_MPI
      mode group SuperUserSFDRole: type=SuperUserSFD
  17 x sender receiver interface:
    SG_BMC_HV_13
      data SG_BMC_HV_13: type=SG_BMC_HV_13_adt
    SG_UI1_01
      data SG_UI1_01: type=SG_UI1_01_adt
    BJB_ErrMem_State
      data BJB_ErrMem_State: type=BJB_ErrMem_State
    BJB_ErrMem_State_1
      data BJB_ErrMem_State: type=BJB_ErrMem_State
    SG_BMC_HV_12
      data SG_BMC_HV_12: type=SG_BMC_HV_12_adt
    AB_Deaktivierung_HV
      data AB_Deaktivierung_HV: type=AB_Deaktivierung_HV
    SG_BMC_HV_11
      data SG_BMC_HV_11: type=SG_BMC_HV_11_adt
    SG_BMC_HV_14
      data SG_BMC_HV_11: type=SG_BMC_HV_11_adt
    SG_BMC_HV_15
      data SG_BMC_HV_11: type=SG_BMC_HV_11_adt
    SG_BMC_HV_10
      data SG_BMC_HV_10: type=SG_BMC_HV_10_adt
    SG_BMC_HV_16
      data SG_BMC_HV_11: type=SG_BMC_HV_11_adt
    SG_BMC_HV_04
      data SG_BMC_HV_04: type=SG_BMC_HV_04_adt
    SG_BMC_HV_01
      data SG_BMC_HV_01: type=SG_BMC_HV_01_adt
    SG_BMC_HV_02
      data SG_BMC_HV_02: type=SG_BMC_HV_02_adt
    SG_KS_Hybrid_01_Challenge_K
      data SG_KS_Hybrid_01_Challenge_K: type=SG_KS_Hybrid_01_Challenge_K_adt
    SG_KS_Hybrid_01_ReqFrame
      data SG_KS_Hybrid_01_ReqFrame: type=SG_KS_Hybrid_01_ReqFrame_adt
    SG_KS_Hybrid_01_Response_K
      data SG_KS_Hybrid_01_Response_K: type=SG_KS_Hybrid_01_Response_K_adt
  mode switch interface ECU_PerformReset
    mode group IF_ECU_Perform_Reset_Indication: type=Reset
  19 x sender receiver interface:
    SG_BJB_11
      data SG_BJB_11: type=SG_BJB_11_adt
    SG_BMC_HV_17
      data SG_BMC_HV_10: type=SG_BMC_HV_10_adt_1
    SG_BJB_10
      data SG_BJB_10: type=SG_BJB_10_adt
    SG_BJB_12
      data SG_BJB_11: type=SG_BJB_11_adt_1
    SG_BJB_13
      data SG_BJB_11: type=SG_BJB_11_adt_2
    SG_BJB_14
      data SG_BJB_11: type=SG_BJB_11_adt_3
    SG_BJB_15
      data SG_BJB_12: type=SG_BJB_12_adt
    SG_BJB_16
      data SG_BJB_13: type=SG_BJB_13_adt
    SG_BMC_HV_5
      data SG_BMC_HV_04: type=SG_BMC_HV_04_adt_1
    SG_BMC_HV_18
      data SG_BMC_HV_10: type=SG_BMC_HV_10_adt_2
    SG_BMC_HV_19
      data SG_BMC_HV_11: type=SG_BMC_HV_11_adt_1
    SG_BMC_HV_20
      data SG_BMC_HV_12: type=SG_BMC_HV_12_adt_1
    SG_BMC_HV_21
      data SG_BMC_HV_13: type=SG_BMC_HV_13_adt_1
    Vishnu_Test_100Bytes_PDU_NewSignal1_37542d23452fe910
      data Vishnu_Test_100Bytes_PDU_NewSignal1_37542d23452fe910: type=Vishnu_Test_100Bytes_PDU_NewSignal1_37542d23452fe910
    Vishnu_Test_100Bytes_PDU_NewSignal2_302017e93d94206c
      data Vishnu_Test_100Bytes_PDU_NewSignal2_302017e93d94206c: type=Vishnu_Test_100Bytes_PDU_NewSignal2_302017e93d94206c
    Vishnu_Test_100Bytes_PDU_NewSignal3_ebd34b418955d5b1
      data Vishnu_Test_100Bytes_PDU_NewSignal3_ebd34b418955d5b1: type=Vishnu_Test_100Bytes_PDU_NewSignal3_ebd34b418955d5b1
    Vishnu_Test_100Bytes_PDU_NewSignal4_21c239f862026de9
      data Vishnu_Test_100Bytes_PDU_NewSignal4_21c239f862026de9: type=Vishnu_Test_100Bytes_PDU_NewSignal4_21c239f862026de9
    Vishnu_Test_100Bytes_PDU_NewSignal5_2a9e79b5a4a81ebd
      data Vishnu_Test_100Bytes_PDU_NewSignal5_2a9e79b5a4a81ebd: type=Vishnu_Test_100Bytes_PDU_NewSignal5_2a9e79b5a4a81ebd
    DTC_Test_PDU_Set_Signal_e68158b3301efab7
      data DTC_Test_PDU_Set_Signal_e68158b3301efab7: type=DTC_Test_PDU_Set_Signal_e68158b3301efab7
package /ShAResourceConsumption/SwAddrMethods
  sw addr method CODE: memory-allocation-keyword-policy=ADDR-METHOD-SHORT-NAME, section-type=CODE
  sw addr method VAR_INIT: memory-allocation-keyword-policy=ADDR-METHOD-SHORT-NAME-AND-ALIGNMENT, section-initialization-policy=INIT, section-type=VAR
package /NvAResourceConsumption/SwAddrMethods
  sw addr method CONST: memory-allocation-keyword-policy=ADDR-METHOD-SHORT-NAME-AND-ALIGNMENT, section-type=CONST
  sw addr method CODE: memory-allocation-keyword-policy=ADDR-METHOD-SHORT-NAME, section-type=CODE
package /DiagAResourceConsumption/SwAddrMethods
  sw addr method CODE: memory-allocation-keyword-policy=ADDR-METHOD-SHORT-NAME, section-type=CODE
  sw addr method CONST: memory-allocation-keyword-policy=ADDR-METHOD-SHORT-NAME-AND-ALIGNMENT, section-type=CONST
package /IvdSfdAResourceConsumption/SwAddrMethods
  sw addr method CODE: memory-allocation-keyword-policy=ADDR-METHOD-SHORT-NAME, section-type=CODE
package /AppDataAResourceConsumption/SwAddrMethods
  sw addr method CODE: memory-allocation-keyword-policy=ADDR-METHOD-SHORT-NAME, section-type=CODE
