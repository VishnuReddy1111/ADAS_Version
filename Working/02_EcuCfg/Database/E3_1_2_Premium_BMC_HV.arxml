[part 2 of 12: packages /E3_1_2_Premium to /Cluster]
AUTOSAR XML (schema 4-3-0)
package /E3_1_2_Premium  (continued)
  system System: pnc-vector-length=7, pnc-vector-offset=1  (continued)
    system mapping System_Mappings  (continued)
      data-mappings:  (continued)
        sender-receiver-to-signal-mapping={communication-direction=OUT, data-element=HV_Batterie_RTM_XIX_RTM_XIX_BMC_HV.Geltungsbereich_E3_1_2_Premium.SP_IF_BMC_CMC_Zellspannung_053_XIX_HV_Batterie_RTM_XIX_RTM_XIX_BMC_HV.DE_BMC_CMC_Zellspannung_053, system-signal=BMC_CMC_Zellspannung_053}
        sender-receiver-to-signal-mapping={communication-direction=OUT, data-element=HV_Batterie_RTM_XIX_RTM_XIX_BMC_HV.Geltungsbereich_E3_1_2_Premium.SP_IF_BMC_CMC_Zellspannung_118_XIX_HV_Batterie_RTM_XIX_RTM_XIX_BMC_HV.DE_BMC_CMC_Zellspannung_118, system-signal=BMC_CMC_Zellspannung_118}
        sender-receiver-to-signal-mapping={communication-direction=OUT, data-element=HV_Batterie_RTM_XIX_RTM_XIX_BMC_HV.Geltungsbereich_E3_1_2_Premium.SP_IF_BMC_CMC_Zellspannung_034_XIX_HV_Batterie_RTM_XIX_RTM_XIX_BMC_HV.DE_BMC_CMC_Zellspannung_034, system-signal=BMC_CMC_Zellspannung_034}
        sender-receiver-to-signal-mapping={communication-direction=OUT, data-element=HV_Batterie_RTM_XIX_RTM_XIX_BMC_HV.Geltungsbereich_E3_1_2_Premium.SP_IF_BMC_CMC_Zellspannung_190_XIX_HV_Batterie_RTM_XIX_RTM_XIX_BMC_HV.DE_BMC_CMC_Zellspannung_190, system-signal=BMC_CMC_Zellspannung_190}
        sender-receiver-to-signal-mapping={communication-direction=OUT, data-element=HV_Batterie_RTM_XIX_RTM_XIX_BMC_HV.Geltungsbereich_E3_1_2_Premium.SP_IF_BMC_CMC_Zellspannung_006_XIX_HV_Batterie_RTM_XIX_RTM_XIX_BMC_HV.DE_BMC_CMC_Zellspannung_006, system-signal=BMC_CMC_Zellspannung_006}
        sender-receiver-to-signal-mapping={communication-direction=OUT, data-element=HV_Batterie_RTM_XIX_RTM_XIX_BMC_HV.Geltungsbereich_E3_1_2_Premium.SP_IF_BMC_CMC_Zellspannung_041_XIX_HV_Batterie_RTM_XIX_RTM_XIX_BMC_HV.DE_BMC_CMC_Zellspannung_041, system-signal=BMC_CMC_Zellspannung_041}
        sender-receiver-to-signal-mapping={communication-direction=OUT, data-element=HV_Batterie_RTM_XIX_RTM_XIX_BMC_HV.Geltungsbereich_E3_1_2_Premium.SP_IF_BMC_CMC_Zellspannung_014_XIX_HV_Batterie_RTM_XIX_RTM_XIX_BMC_HV.DE_BMC_CMC_Zellspannung_014, system-signal=BMC_CMC_Zellspannung_014}
        sender-receiver-to-signal-mapping={communication-direction=OUT, data-element=HV_Batterie_RTM_XIX_RTM_XIX_BMC_HV.Geltungsbereich_E3_1_2_Premium.SP_IF_BMC_CMC_Zellspannung_108_XIX_HV_Batterie_RTM_XIX_RTM_XIX_BMC_HV.DE_BMC_CMC_Zellspannung_108, system-signal=BMC_CMC_Zellspannung_108}
        sender-receiver-to-signal-mapping={communication-direction=OUT, data-element=HV_Batterie_RTM_XIX_RTM_XIX_BMC_HV.Geltungsbereich_E3_1_2_Premium.SP_IF_BMC_CMC_Zellspannung_008_XIX_HV_Batterie_RTM_XIX_RTM_XIX_BMC_HV.DE_BMC_CMC_Zellspannung_008, system-signal=BMC_CMC_Zellspannung_008}
        sender-receiver-to-signal-mapping={communication-direction=OUT, data-element=HV_Batterie_RTM_XIX_RTM_XIX_BMC_HV.Geltungsbereich_E3_1_2_Premium.SP_IF_BMC_CMC_Zellspannung_051_XIX_HV_Batterie_RTM_XIX_RTM_XIX_BMC_HV.DE_BMC_CMC_Zellspannung_051, system-signal=BMC_CMC_Zellspannung_051}
        sender-receiver-to-signal-mapping={communication-direction=OUT, data-element=HV_Batterie_RTM_XIX_RTM_XIX_BMC_HV.Geltungsbereich_E3_1_2_Premium.SP_IF_BMC_CMC_Zellspannung_177_XIX_HV_Batterie_RTM_XIX_RTM_XIX_BMC_HV.DE_BMC_CMC_Zellspannung_177, system-signal=BMC_CMC_Zellspannung_177}
        sender-receiver-to-signal-mapping={communication-direction=OUT, data-element=HV_Batterie_RTM_XIX_RTM_XIX_BMC_HV.Geltungsbereich_E3_1_2_Premium.SP_IF_BMC_CMC_Zellspannung_037_XIX_HV_Batterie_RTM_XIX_RTM_XIX_BMC_HV.DE_BMC_CMC_Zellspannung_037, system-signal=BMC_CMC_Zellspannung_037}
        sender-receiver-to-signal-mapping={communication-direction=OUT, data-element=HV_Batterie_RTM_XIX_RTM_XIX_BMC_HV.Geltungsbereich_E3_1_2_Premium.SP_IF_BMC_CMC_Zellspannung_052_XIX_HV_Batterie_RTM_XIX_RTM_XIX_BMC_HV.DE_BMC_CMC_Zellspannung_052, system-signal=BMC_CMC_Zellspannung_052}
        sender-receiver-to-signal-mapping={communication-direction=OUT, data-element=HV_Batterie_RTM_XIX_RTM_XIX_BMC_HV.Geltungsbereich_E3_1_2_Premium.SP_IF_BMC_CMC_Zellspannung_064_XIX_HV_Batterie_RTM_XIX_RTM_XIX_BMC_HV.DE_BMC_CMC_Zellspannung_064, system-signal=BMC_CMC_Zellspannung_064}
        sender-receiver-to-signal-mapping={communication-direction=OUT, data-element=HV_Batterie_RTM_XIX_RTM_XIX_BMC_HV.Geltungsbereich_E3_1_2_Premium.SP_IF_BMC_CMC_Zellspannung_105_XIX_HV_Batterie_RTM_XIX_RTM_XIX_BMC_HV.DE_BMC_CMC_Zellspannung_105, system-signal=BMC_CMC_Zellspannung_105}
        sender-receiver-to-signal-mapping={communication-direction=OUT, data-element=HV_Batterie_RTM_XIX_RTM_XIX_BMC_HV.Geltungsbereich_E3_1_2_Premium.SP_IF_BMC_CMC_Zellspannung_151_XIX_HV_Batterie_RTM_XIX_RTM_XIX_BMC_HV.DE_BMC_CMC_Zellspannung_151, system-signal=BMC_CMC_Zellspannung_151}
        sender-receiver-to-signal-mapping={communication-direction=OUT, data-element=HV_Batterie_RTM_XIX_RTM_XIX_BMC_HV.Geltungsbereich_E3_1_2_Premium.SP_IF_BMC_CMC_Zellspannung_103_XIX_HV_Batterie_RTM_XIX_RTM_XIX_BMC_HV.DE_BMC_CMC_Zellspannung_103, system-signal=BMC_CMC_Zellspannung_103}
        sender-receiver-to-signal-mapping={communication-direction=OUT, data-element=HV_Batterie_RTM_XIX_RTM_XIX_BMC_HV.Geltungsbereich_E3_1_2_Premium.SP_IF_BMC_CMC_Zellspannung_082_XIX_HV_Batterie_RTM_XIX_RTM_XIX_BMC_HV.DE_BMC_CMC_Zellspannung_082, system-signal=BMC_CMC_Zellspannung_082}
        sender-receiver-to-signal-mapping={communication-direction=OUT, data-element=HV_Batterie_RTM_XIX_RTM_XIX_BMC_HV.Geltungsbereich_E3_1_2_Premium.SP_IF_BMC_CMC_Zellspannung_063_XIX_HV_Batterie_RTM_XIX_RTM_XIX_BMC_HV.DE_BMC_CMC_Zellspannung_063, system-signal=BMC_CMC_Zellspannung_063}
        sender-receiver-to-signal-mapping={communication-direction=OUT, data-element=HV_Batterie_RTM_XIX_RTM_XIX_BMC_HV.Geltungsbereich_E3_1_2_Premium.SP_IF_BMC_CMC_Zellspannung_047_XIX_HV_Batterie_RTM_XIX_RTM_XIX_BMC_HV.DE_BMC_CMC_Zellspannung_047, system-signal=BMC_CMC_Zellspannung_047}
        sender-receiver-to-signal-mapping={communication-direction=OUT, data-element=HV_Batterie_RTM_XIX_RTM_XIX_BMC_HV.Geltungsbereich_E3_1_2_Premium.SP_IF_BMC_CMC_Zellspannung_085_XIX_HV_Batterie_RTM_XIX_RTM_XIX_BMC_HV.DE_BMC_CMC_Zellspannung_085, system-signal=BMC_CMC_Zellspannung_085}
        sender-receiver-to-signal-mapping={communication-direction=OUT, data-element=HV_Batterie_RTM_XIX_RTM_XIX_BMC_HV.Geltungsbereich_E3_1_2_Premium.SP_IF_BMC_CMC_Zellspannung_083_XIX_HV_Batterie_RTM_XIX_RTM_XIX_BMC_HV.DE_BMC_CMC_Zellspannung_083, system-signal=BMC_CMC_Zellspannung_083}
        sender-receiver-to-signal-mapping={communication-direction=OUT, data-element=HV_Batterie_RTM_XIX_RTM_XIX_BMC_HV.Geltungsbereich_E3_1_2_Premium.SP_IF_BMC_CMC_Zellspannung_130_XIX_HV_Batterie_RTM_XIX_RTM_XIX_BMC_HV.DE_BMC_CMC_Zellspannung_130, system-signal=BMC_CMC_Zellspannung_130}
        sender-receiver-to-signal-mapping={communication-direction=OUT, data-element=HV_Batterie_RTM_XIX_RTM_XIX_BMC_HV.Geltungsbereich_E3_1_2_Premium.SP_IF_BMC_CMC_Zellspannung_141_XIX_HV_Batterie_RTM_XIX_RTM_XIX_BMC_HV.DE_BMC_CMC_Zellspannung_141, system-signal=BMC_CMC_Zellspannung_141}
        sender-receiver-to-signal-mapping={communication-direction=OUT, data-element=HV_Batterie_RTM_XIX_RTM_XIX_BMC_HV.Geltungsbereich_E3_1_2_Premium.SP_IF_BMC_CMC_Zellspannung_033_XIX_HV_Batterie_RTM_XIX_RTM_XIX_BMC_HV.DE_BMC_CMC_Zellspannung_033, system-signal=BMC_CMC_Zellspannung_033}
        sender-receiver-to-signal-mapping={communication-direction=OUT, data-element=HV_Batterie_RTM_XIX_RTM_XIX_BMC_HV.Geltungsbereich_E3_1_2_Premium.SP_IF_BMC_CMC_Zellspannung_001_XIX_HV_Batterie_RTM_XIX_RTM_XIX_BMC_HV.DE_BMC_CMC_Zellspannung_001, system-signal=BMC_CMC_Zellspannung_001}
        sender-receiver-to-signal-mapping={communication-direction=OUT, data-element=HV_Batterie_RTM_XIX_RTM_XIX_BMC_HV.Geltungsbereich_E3_1_2_Premium.SP_IF_BMC_CMC_Zellspannung_170_XIX_HV_Batterie_RTM_XIX_RTM_XIX_BMC_HV.DE_BMC_CMC_Zellspannung_170, system-signal=BMC_CMC_Zellspannung_170}
        sender-receiver-to-signal-mapping={communication-direction=OUT, data-element=HV_Batterie_RTM_XIX_RTM_XIX_BMC_HV.Geltungsbereich_E3_1_2_Premium.SP_IF_BMC_CMC_Zellspannung_097_XIX_HV_Batterie_RTM_XIX_RTM_XIX_BMC_HV.DE_BMC_CMC_Zellspannung_097, system-signal=BMC_CMC_Zellspannung_097}
        sender-receiver-to-signal-mapping={communication-direction=OUT, data-element=HV_Batterie_RTM_XIX_RTM_XIX_BMC_HV.Geltungsbereich_E3_1_2_Premium.SP_IF_BMC_CMC_Zellspannung_040_XIX_HV_Batterie_RTM_XIX_RTM_XIX_BMC_HV.DE_BMC_CMC_Zellspannung_040, system-signal=BMC_CMC_Zellspannung_040}
        sender-receiver-to-signal-mapping={communication-direction=OUT, data-element=HV_Batterie_RTM_XIX_RTM_XIX_BMC_HV.Geltungsbereich_E3_1_2_Premium.SP_IF_BMC_CMC_Zellspannung_038_XIX_HV_Batterie_RTM_XIX_RTM_XIX_BMC_HV.DE_BMC_CMC_Zellspannung_038, system-signal=BMC_CMC_Zellspannung_038}
        sender-receiver-to-signal-mapping={communication-direction=OUT, data-element=HV_Batterie_RTM_XIX_RTM_XIX_BMC_HV.Geltungsbereich_E3_1_2_Premium.SP_IF_BMC_CMC_Zellspannung_095_XIX_HV_Batterie_RTM_XIX_RTM_XIX_BMC_HV.DE_BMC_CMC_Zellspannung_095, system-signal=BMC_CMC_Zellspannung_095}
        sender-receiver-to-signal-mapping={communication-direction=OUT, data-element=HV_Batterie_RTM_XIX_RTM_XIX_BMC_HV.Geltungsbereich_E3_1_2_Premium.SP_IF_BMC_CMC_Zellspannung_136_XIX_HV_Batterie_RTM_XIX_RTM_XIX_BMC_HV.DE_BMC_CMC_Zellspannung_136, system-signal=BMC_CMC_Zellspannung_136}
        sender-receiver-to-signal-mapping={communication-direction=OUT, data-element=HV_Batterie_RTM_XIX_RTM_XIX_BMC_HV.Geltungsbereich_E3_1_2_Premium.SP_IF_BMC_CMC_Zellspannung_192_XIX_HV_Batterie_RTM_XIX_RTM_XIX_BMC_HV.DE_BMC_CMC_Zellspannung_192, system-signal=BMC_CMC_Zellspannung_192}
        sender-receiver-to-signal-mapping={communication-direction=OUT, data-element=HV_Batterie_RTM_XIX_RTM_XIX_BMC_HV.Geltungsbereich_E3_1_2_Premium.SP_IF_BMC_CMC_Zellspannung_024_XIX_HV_Batterie_RTM_XIX_RTM_XIX_BMC_HV.DE_BMC_CMC_Zellspannung_024, system-signal=BMC_CMC_Zellspannung_024}
        sender-receiver-to-signal-mapping={communication-direction=OUT, data-element=HV_Batterie_RTM_XIX_RTM_XIX_BMC_HV.Geltungsbereich_E3_1_2_Premium.SP_IF_BMC_CMC_Zellspannung_046_XIX_HV_Batterie_RTM_XIX_RTM_XIX_BMC_HV.DE_BMC_CMC_Zellspannung_046, system-signal=BMC_CMC_Zellspannung_046}
        sender-receiver-to-signal-mapping={communication-direction=OUT, data-element=HV_Batterie_RTM_XIX_RTM_XIX_BMC_HV.Geltungsbereich_E3_1_2_Premium.SP_IF_BMC_CMC_Zellspannung_010_XIX_HV_Batterie_RTM_XIX_RTM_XIX_BMC_HV.DE_BMC_CMC_Zellspannung_010, system-signal=BMC_CMC_Zellspannung_010}
        sender-receiver-to-signal-mapping={communication-direction=OUT, data-element=HV_Batterie_RTM_XIX_RTM_XIX_BMC_HV.Geltungsbereich_E3_1_2_Premium.SP_IF_BMC_CMC_Zellspannung_153_XIX_HV_Batterie_RTM_XIX_RTM_XIX_BMC_HV.DE_BMC_CMC_Zellspannung_153, system-signal=BMC_CMC_Zellspannung_153}
        sender-receiver-to-signal-mapping={communication-direction=OUT, data-element=HV_Batterie_RTM_XIX_RTM_XIX_BMC_HV.Geltungsbereich_E3_1_2_Premium.SP_IF_BMC_CMC_Zellspannung_104_XIX_HV_Batterie_RTM_XIX_RTM_XIX_BMC_HV.DE_BMC_CMC_Zellspannung_104, system-signal=BMC_CMC_Zellspannung_104}
        sender-receiver-to-signal-mapping={communication-direction=OUT, data-element=HV_Batterie_RTM_XIX_RTM_XIX_BMC_HV.Geltungsbereich_E3_1_2_Premium.SP_IF_BMC_CMC_Zellspannung_086_XIX_HV_Batterie_RTM_XIX_RTM_XIX_BMC_HV.DE_BMC_CMC_Zellspannung_086, system-signal=BMC_CMC_Zellspannung_086}
        sender-receiver-to-signal-mapping={communication-direction=OUT, data-element=HV_Batterie_RTM_XIX_RTM_XIX_BMC_HV.Geltungsbereich_E3_1_2_Premium.SP_IF_BMC_CMC_Zellspannung_112_XIX_HV_Batterie_RTM_XIX_RTM_XIX_BMC_HV.DE_BMC_CMC_Zellspannung_112, system-signal=BMC_CMC_Zellspannung_112}
        sender-receiver-to-signal-mapping={communication-direction=OUT, data-element=HV_Batterie_RTM_XIX_RTM_XIX_BMC_HV.Geltungsbereich_E3_1_2_Premium.SP_IF_BMC_CMC_Zellspannung_011_XIX_HV_Batterie_RTM_XIX_RTM_XIX_BMC_HV.DE_BMC_CMC_Zellspannung_011, system-signal=BMC_CMC_Zellspannung_011}
        sender-receiver-to-signal-mapping={communication-direction=OUT, data-element=HV_Batterie_RTM_XIX_RTM_XIX_BMC_HV.Geltungsbereich_E3_1_2_Premium.SP_IF_BMC_CMC_Zellspannung_156_XIX_HV_Batterie_RTM_XIX_RTM_XIX_BMC_HV.DE_BMC_CMC_Zellspannung_156, system-signal=BMC_CMC_Zellspannung_156}
        sender-receiver-to-signal-mapping={communication-direction=OUT, data-element=HV_Batterie_RTM_XIX_RTM_XIX_BMC_HV.Geltungsbereich_E3_1_2_Premium.SP_IF_BMC_CMC_Zellspannung_188_XIX_HV_Batterie_RTM_XIX_RTM_XIX_BMC_HV.DE_BMC_CMC_Zellspannung_188, system-signal=BMC_CMC_Zellspannung_188}
        sender-receiver-to-signal-mapping={communication-direction=OUT, data-element=HV_Batterie_RTM_XIX_RTM_XIX_BMC_HV.Geltungsbereich_E3_1_2_Premium.SP_IF_BMC_CMC_Zellspannung_016_XIX_HV_Batterie_RTM_XIX_RTM_XIX_BMC_HV.DE_BMC_CMC_Zellspannung_016, system-signal=BMC_CMC_Zellspannung_016}
        sender-receiver-to-signal-mapping={communication-direction=OUT, data-element=HV_Batterie_RTM_XIX_RTM_XIX_BMC_HV.Geltungsbereich_E3_1_2_Premium.SP_IF_BMC_CMC_Zellspannung_145_XIX_HV_Batterie_RTM_XIX_RTM_XIX_BMC_HV.DE_BMC_CMC_Zellspannung_145, system-signal=BMC_CMC_Zellspannung_145}
        sender-receiver-to-signal-mapping={communication-direction=OUT, data-element=HV_Batterie_RTM_XIX_RTM_XIX_BMC_HV.Geltungsbereich_E3_1_2_Premium.SP_IF_BMC_CMC_Zellspannung_048_XIX_HV_Batterie_RTM_XIX_RTM_XIX_BMC_HV.DE_BMC_CMC_Zellspannung_048, system-signal=BMC_CMC_Zellspannung_048}
        sender-receiver-to-signal-mapping={communication-direction=OUT, data-element=HV_Batterie_RTM_XIX_RTM_XIX_BMC_HV.Geltungsbereich_E3_1_2_Premium.SP_IF_BMC_CMC_Zellspannung_068_XIX_HV_Batterie_RTM_XIX_RTM_XIX_BMC_HV.DE_BMC_CMC_Zellspannung_068, system-signal=BMC_CMC_Zellspannung_068}
        sender-receiver-to-signal-mapping={communication-direction=OUT, data-element=HV_Batterie_RTM_XIX_RTM_XIX_BMC_HV.Geltungsbereich_E3_1_2_Premium.SP_IF_BMC_CMC_Zellspannung_066_XIX_HV_Batterie_RTM_XIX_RTM_XIX_BMC_HV.DE_BMC_CMC_Zellspannung_066, system-signal=BMC_CMC_Zellspannung_066}
        sender-receiver-to-signal-mapping={communication-direction=OUT, data-element=HV_Batterie_RTM_XIX_RTM_XIX_BMC_HV.Geltungsbereich_E3_1_2_Premium.SP_IF_BMC_CMC_Zellspannung_035_XIX_HV_Batterie_RTM_XIX_RTM_XIX_BMC_HV.DE_BMC_CMC_Zellspannung_035, system-signal=BMC_CMC_Zellspannung_035}
        sender-receiver-to-signal-mapping={communication-direction=OUT, data-element=HV_Batterie_RTM_XIX_RTM_XIX_BMC_HV.Geltungsbereich_E3_1_2_Premium.SP_IF_BMC_CMC_Zellspannung_128_XIX_HV_Batterie_RTM_XIX_RTM_XIX_BMC_HV.DE_BMC_CMC_Zellspannung_128, system-signal=BMC_CMC_Zellspannung_128}
        sender-receiver-to-signal-mapping={communication-direction=OUT, data-element=HV_Batterie_RTM_XIX_RTM_XIX_BMC_HV.Geltungsbereich_E3_1_2_Premium.SP_IF_BMC_CMC_Zellspannung_081_XIX_HV_Batterie_RTM_XIX_RTM_XIX_BMC_HV.DE_BMC_CMC_Zellspannung_081, system-signal=BMC_CMC_Zellspannung_081}
        sender-receiver-to-signal-mapping={communication-direction=OUT, data-element=HV_Batterie_RTM_XIX_RTM_XIX_BMC_HV.Geltungsbereich_E3_1_2_Premium.SP_IF_BMC_CMC_Zellspannung_142_XIX_HV_Batterie_RTM_XIX_RTM_XIX_BMC_HV.DE_BMC_CMC_Zellspannung_142, system-signal=BMC_CMC_Zellspannung_142}
        sender-receiver-to-signal-mapping={communication-direction=OUT, data-element=HV_Batterie_RTM_XIX_RTM_XIX_BMC_HV.Geltungsbereich_E3_1_2_Premium.SP_IF_BMC_CMC_Zellspannung_061_XIX_HV_Batterie_RTM_XIX_RTM_XIX_BMC_HV.DE_BMC_CMC_Zellspannung_061, system-signal=BMC_CMC_Zellspannung_061}
        sender-receiver-to-signal-mapping={communication-direction=OUT, data-element=HV_Batterie_RTM_XIX_RTM_XIX_BMC_HV.Geltungsbereich_E3_1_2_Premium.SP_IF_BMC_CMC_Zellspannung_017_XIX_HV_Batterie_RTM_XIX_RTM_XIX_BMC_HV.DE_BMC_CMC_Zellspannung_017, system-signal=BMC_CMC_Zellspannung_017}
        sender-receiver-to-signal-mapping={communication-direction=OUT, data-element=HV_Batterie_RTM_XIX_RTM_XIX_BMC_HV.Geltungsbereich_E3_1_2_Premium.SP_IF_BMC_CMC_Zellspannung_079_XIX_HV_Batterie_RTM_XIX_RTM_XIX_BMC_HV.DE_BMC_CMC_Zellspannung_079, system-signal=BMC_CMC_Zellspannung_079}
        sender-receiver-to-signal-mapping={communication-direction=OUT, data-element=HV_Batterie_RTM_XIX_RTM_XIX_BMC_HV.Geltungsbereich_E3_1_2_Premium.SP_IF_BMC_CMC_Zellspannung_135_XIX_HV_Batterie_RTM_XIX_RTM_XIX_BMC_HV.DE_BMC_CMC_Zellspannung_135, system-signal=BMC_CMC_Zellspannung_135}
        sender-receiver-to-signal-mapping={communication-direction=OUT, data-element=HV_Batterie_RTM_XIX_RTM_XIX_BMC_HV.Geltungsbereich_E3_1_2_Premium.SP_IF_BMC_CMC_Zellspannung_124_XIX_HV_Batterie_RTM_XIX_RTM_XIX_BMC_HV.DE_BMC_CMC_Zellspannung_124, system-signal=BMC_CMC_Zellspannung_124}
        sender-receiver-to-signal-mapping={communication-direction=OUT, data-element=HV_Batterie_RTM_XIX_RTM_XIX_BMC_HV.Geltungsbereich_E3_1_2_Premium.SP_IF_BMC_CMC_Zellspannung_144_XIX_HV_Batterie_RTM_XIX_RTM_XIX_BMC_HV.DE_BMC_CMC_Zellspannung_144, system-signal=BMC_CMC_Zellspannung_144}
        sender-receiver-to-signal-mapping={communication-direction=OUT, data-element=HV_Batterie_RTM_XIX_RTM_XIX_BMC_HV.Geltungsbereich_E3_1_2_Premium.SP_IF_BMC_CMC_Zellspannung_029_XIX_HV_Batterie_RTM_XIX_RTM_XIX_BMC_HV.DE_BMC_CMC_Zellspannung_029, system-signal=BMC_CMC_Zellspannung_029}
        sender-receiver-to-signal-mapping={communication-direction=OUT, data-element=HV_Batterie_RTM_XIX_RTM_XIX_BMC_HV.Geltungsbereich_E3_1_2_Premium.SP_IF_BMC_CMC_Zellspannung_154_XIX_HV_Batterie_RTM_XIX_RTM_XIX_BMC_HV.DE_BMC_CMC_Zellspannung_154, system-signal=BMC_CMC_Zellspannung_154}
        sender-receiver-to-signal-mapping={communication-direction=OUT, data-element=HV_Batterie_RTM_XIX_RTM_XIX_BMC_HV.Geltungsbereich_E3_1_2_Premium.SP_IF_BMC_CMC_Zellspannung_062_XIX_HV_Batterie_RTM_XIX_RTM_XIX_BMC_HV.DE_BMC_CMC_Zellspannung_062, system-signal=BMC_CMC_Zellspannung_062}
        sender-receiver-to-signal-mapping={communication-direction=OUT, data-element=HV_Batterie_RTM_XIX_RTM_XIX_BMC_HV.Geltungsbereich_E3_1_2_Premium.SP_IF_BMC_CMC_Zellspannung_127_XIX_HV_Batterie_RTM_XIX_RTM_XIX_BMC_HV.DE_BMC_CMC_Zellspannung_127, system-signal=BMC_CMC_Zellspannung_127}
        sender-receiver-to-signal-mapping={communication-direction=OUT, data-element=HV_Batterie_RTM_XIX_RTM_XIX_BMC_HV.Geltungsbereich_E3_1_2_Premium.SP_IF_BMC_CMC_Zellspannung_009_XIX_HV_Batterie_RTM_XIX_RTM_XIX_BMC_HV.DE_BMC_CMC_Zellspannung_009, system-signal=BMC_CMC_Zellspannung_009}
        sender-receiver-to-signal-mapping={communication-direction=OUT, data-element=HV_Batterie_RTM_XIX_RTM_XIX_BMC_HV.Geltungsbereich_E3_1_2_Premium.SP_IF_BMC_CMC_Zellspannung_171_XIX_HV_Batterie_RTM_XIX_RTM_XIX_BMC_HV.DE_BMC_CMC_Zellspannung_171, system-signal=BMC_CMC_Zellspannung_171}
        sender-receiver-to-signal-mapping={communication-direction=OUT, data-element=HV_Batterie_RTM_XIX_RTM_XIX_BMC_HV.Geltungsbereich_E3_1_2_Premium.SP_IF_BMC_CMC_Zellspannung_132_XIX_HV_Batterie_RTM_XIX_RTM_XIX_BMC_HV.DE_BMC_CMC_Zellspannung_132, system-signal=BMC_CMC_Zellspannung_132}
        sender-receiver-to-signal-mapping={communication-direction=OUT, data-element=HV_Batterie_RTM_XIX_RTM_XIX_BMC_HV.Geltungsbereich_E3_1_2_Premium.SP_IF_BMC_CMC_Zellspannung_139_XIX_HV_Batterie_RTM_XIX_RTM_XIX_BMC_HV.DE_BMC_CMC_Zellspannung_139, system-signal=BMC_CMC_Zellspannung_139}
        sender-receiver-to-signal-mapping={communication-direction=OUT, data-element=HV_Batterie_RTM_XIX_RTM_XIX_BMC_HV.Geltungsbereich_E3_1_2_Premium.SP_IF_BMC_CMC_Zellspannung_028_XIX_HV_Batterie_RTM_XIX_RTM_XIX_BMC_HV.DE_BMC_CMC_Zellspannung_028, system-signal=BMC_CMC_Zellspannung_028}
        sender-receiver-to-signal-mapping={communication-direction=OUT, data-element=HV_Batterie_RTM_XIX_RTM_XIX_BMC_HV.Geltungsbereich_E3_1_2_Premium.SP_IF_BMC_CMC_Zellspannung_157_XIX_HV_Batterie_RTM_XIX_RTM_XIX_BMC_HV.DE_BMC_CMC_Zellspannung_157, system-signal=BMC_CMC_Zellspannung_157}
        sender-receiver-to-signal-mapping={communication-direction=OUT, data-element=HV_Batterie_RTM_XIX_RTM_XIX_BMC_HV.Geltungsbereich_E3_1_2_Premium.SP_IF_BMC_CMC_Zellspannung_020_XIX_HV_Batterie_RTM_XIX_RTM_XIX_BMC_HV.DE_BMC_CMC_Zellspannung_020, system-signal=BMC_CMC_Zellspannung_020}
        sender-receiver-to-signal-mapping={communication-direction=OUT, data-element=HV_Batterie_RTM_XIX_RTM_XIX_BMC_HV.Geltungsbereich_E3_1_2_Premium.SP_IF_BMC_CMC_Zellspannung_148_XIX_HV_Batterie_RTM_XIX_RTM_XIX_BMC_HV.DE_BMC_CMC_Zellspannung_148, system-signal=BMC_CMC_Zellspannung_148}
        sender-receiver-to-signal-mapping={communication-direction=OUT, data-element=HV_Batterie_RTM_XIX_RTM_XIX_BMC_HV.Geltungsbereich_E3_1_2_Premium.SP_IF_BMC_CMC_Zellspannung_027_XIX_HV_Batterie_RTM_XIX_RTM_XIX_BMC_HV.DE_BMC_CMC_Zellspannung_027, system-signal=BMC_CMC_Zellspannung_027}
        sender-receiver-to-signal-mapping={communication-direction=OUT, data-element=HV_Batterie_RTM_XIX_RTM_XIX_BMC_HV.Geltungsbereich_E3_1_2_Premium.SP_IF_BMC_CMC_Zellspannung_056_XIX_HV_Batterie_RTM_XIX_RTM_XIX_BMC_HV.DE_BMC_CMC_Zellspannung_056, system-signal=BMC_CMC_Zellspannung_056}
        sender-receiver-to-signal-mapping={communication-direction=OUT, data-element=HV_Batterie_RTM_XIX_RTM_XIX_BMC_HV.Geltungsbereich_E3_1_2_Premium.SP_IF_BMC_CMC_Zellspannung_050_XIX_HV_Batterie_RTM_XIX_RTM_XIX_BMC_HV.DE_BMC_CMC_Zellspannung_050, system-signal=BMC_CMC_Zellspannung_050}
        sender-receiver-to-signal-mapping={communication-direction=OUT, data-element=HV_Batterie_RTM_XIX_RTM_XIX_BMC_HV.Geltungsbereich_E3_1_2_Premium.SP_IF_BMC_CMC_Zellspannung_174_XIX_HV_Batterie_RTM_XIX_RTM_XIX_BMC_HV.DE_BMC_CMC_Zellspannung_174, system-signal=BMC_CMC_Zellspannung_174}
        sender-receiver-to-signal-mapping={communication-direction=OUT, data-element=HV_Batterie_RTM_XIX_RTM_XIX_BMC_HV.Geltungsbereich_E3_1_2_Premium.SP_IF_BMC_CMC_Zellspannung_138_XIX_HV_Batterie_RTM_XIX_RTM_XIX_BMC_HV.DE_BMC_CMC_Zellspannung_138, system-signal=BMC_CMC_Zellspannung_138}
        sender-receiver-to-signal-mapping={communication-direction=OUT, data-element=HV_Batterie_RTM_XIX_RTM_XIX_BMC_HV.Geltungsbereich_E3_1_2_Premium.SP_IF_BMC_CMC_Zellspannung_122_XIX_HV_Batterie_RTM_XIX_RTM_XIX_BMC_HV.DE_BMC_CMC_Zellspannung_122, system-signal=BMC_CMC_Zellspannung_122}
        sender-receiver-to-signal-mapping={communication-direction=OUT, data-element=HV_Batterie_RTM_XIX_RTM_XIX_BMC_HV.Geltungsbereich_E3_1_2_Premium.SP_IF_BMC_CMC_Zellspannung_044_XIX_HV_Batterie_RTM_XIX_RTM_XIX_BMC_HV.DE_BMC_CMC_Zellspannung_044, system-signal=BMC_CMC_Zellspannung_044}
        sender-receiver-to-signal-mapping={communication-direction=OUT, data-element=HV_Batterie_RTM_XIX_RTM_XIX_BMC_HV.Geltungsbereich_E3_1_2_Premium.SP_IF_BMC_CMC_Zellspannung_147_XIX_HV_Batterie_RTM_XIX_RTM_XIX_BMC_HV.DE_BMC_CMC_Zellspannung_147, system-signal=BMC_CMC_Zellspannung_147}
        sender-receiver-to-signal-mapping={communication-direction=OUT, data-element=HV_Batterie_RTM_XIX_RTM_XIX_BMC_HV.Geltungsbereich_E3_1_2_Premium.SP_IF_BMC_CMC_Zellspannung_179_XIX_HV_Batterie_RTM_XIX_RTM_XIX_BMC_HV.DE_BMC_CMC_Zellspannung_179, system-signal=BMC_CMC_Zellspannung_179}
        sender-receiver-to-signal-mapping={communication-direction=OUT, data-element=HV_Batterie_RTM_XIX_RTM_XIX_BMC_HV.Geltungsbereich_E3_1_2_Premium.SP_IF_BMC_CMC_Zellspannung_155_XIX_HV_Batterie_RTM_XIX_RTM_XIX_BMC_HV.DE_BMC_CMC_Zellspannung_155, system-signal=BMC_CMC_Zellspannung_155}
        sender-receiver-to-signal-mapping={communication-direction=OUT, data-element=HV_Batterie_RTM_XIX_RTM_XIX_BMC_HV.Geltungsbereich_E3_1_2_Premium.SP_IF_BMC_CMC_Zellspannung_107_XIX_HV_Batterie_RTM_XIX_RTM_XIX_BMC_HV.DE_BMC_CMC_Zellspannung_107, system-signal=BMC_CMC_Zellspannung_107}
        sender-receiver-to-signal-mapping={communication-direction=OUT, data-element=HV_Batterie_RTM_XIX_RTM_XIX_BMC_HV.Geltungsbereich_E3_1_2_Premium.SP_IF_BMC_CMC_Zellspannung_007_XIX_HV_Batterie_RTM_XIX_RTM_XIX_BMC_HV.DE_BMC_CMC_Zellspannung_007, system-signal=BMC_CMC_Zellspannung_007}
        sender-receiver-to-signal-mapping={communication-direction=OUT, data-element=HV_Batterie_RTM_XIX_RTM_XIX_BMC_HV.Geltungsbereich_E3_1_2_Premium.SP_IF_BMC_CMC_Zellspannung_109_XIX_HV_Batterie_RTM_XIX_RTM_XIX_BMC_HV.DE_BMC_CMC_Zellspannung_109, system-signal=BMC_CMC_Zellspannung_109}
        sender-receiver-to-signal-mapping={communication-direction=OUT, data-element=HV_Batterie_RTM_XIX_RTM_XIX_BMC_HV.Geltungsbereich_E3_1_2_Premium.SP_IF_BMC_CMC_Zellspannung_175_XIX_HV_Batterie_RTM_XIX_RTM_XIX_BMC_HV.DE_BMC_CMC_Zellspannung_175, system-signal=BMC_CMC_Zellspannung_175}
        sender-receiver-to-signal-mapping={communication-direction=OUT, data-element=HV_Batterie_RTM_XIX_RTM_XIX_BMC_HV.Geltungsbereich_E3_1_2_Premium.SP_IF_BMC_CMC_Zellspannung_078_XIX_HV_Batterie_RTM_XIX_RTM_XIX_BMC_HV.DE_BMC_CMC_Zellspannung_078, system-signal=BMC_CMC_Zellspannung_078}
        sender-receiver-to-signal-mapping={communication-direction=OUT, data-element=HV_Batterie_RTM_XIX_RTM_XIX_BMC_HV.Geltungsbereich_E3_1_2_Premium.SP_IF_BMC_CMC_Zellspannung_163_XIX_HV_Batterie_RTM_XIX_RTM_XIX_BMC_HV.DE_BMC_CMC_Zellspannung_163, system-signal=BMC_CMC_Zellspannung_163}
        sender-receiver-to-signal-mapping={communication-direction=OUT, data-element=HV_Batterie_RTM_XIX_RTM_XIX_BMC_HV.Geltungsbereich_E3_1_2_Premium.SP_IF_BMC_CMC_Zellspannung_060_XIX_HV_Batterie_RTM_XIX_RTM_XIX_BMC_HV.DE_BMC_CMC_Zellspannung_060, system-signal=BMC_CMC_Zellspannung_060}
        sender-receiver-to-signal-mapping={communication-direction=OUT, data-element=HV_Batterie_RTM_XIX_RTM_XIX_BMC_HV.Geltungsbereich_E3_1_2_Premium.SP_IF_BMC_CMC_Zellspannung_072_XIX_HV_Batterie_RTM_XIX_RTM_XIX_BMC_HV.DE_BMC_CMC_Zellspannung_072, system-signal=BMC_CMC_Zellspannung_072}
        sender-receiver-to-signal-mapping={communication-direction=OUT, data-element=HV_Batterie_RTM_XIX_RTM_XIX_BMC_HV.Geltungsbereich_E3_1_2_Premium.SP_IF_BMC_CMC_Zellspannung_094_XIX_HV_Batterie_RTM_XIX_RTM_XIX_BMC_HV.DE_BMC_CMC_Zellspannung_094, system-signal=BMC_CMC_Zellspannung_094}
        sender-receiver-to-signal-mapping={communication-direction=OUT, data-element=HV_Batterie_RTM_XIX_RTM_XIX_BMC_HV.Geltungsbereich_E3_1_2_Premium.SP_IF_BMC_CMC_Zellspannung_183_XIX_HV_Batterie_RTM_XIX_RTM_XIX_BMC_HV.DE_BMC_CMC_Zellspannung_183, system-signal=BMC_CMC_Zellspannung_183}
        sender-receiver-to-signal-mapping={communication-direction=OUT, data-element=HV_Batterie_RTM_XIX_RTM_XIX_BMC_HV.Geltungsbereich_E3_1_2_Premium.SP_IF_BMC_CMC_Zellspannung_036_XIX_HV_Batterie_RTM_XIX_RTM_XIX_BMC_HV.DE_BMC_CMC_Zellspannung_036, system-signal=BMC_CMC_Zellspannung_036}
        sender-receiver-to-signal-mapping={communication-direction=OUT, data-element=HV_Batterie_RTM_XIX_RTM_XIX_BMC_HV.Geltungsbereich_E3_1_2_Premium.SP_IF_BMC_CMC_Zellspannung_021_XIX_HV_Batterie_RTM_XIX_RTM_XIX_BMC_HV.DE_BMC_CMC_Zellspannung_021, system-signal=BMC_CMC_Zellspannung_021}
        sender-receiver-to-signal-mapping={communication-direction=OUT, data-element=HV_Batterie_RTM_XIX_RTM_XIX_BMC_HV.Geltungsbereich_E3_1_2_Premium.SP_IF_BMC_CMC_Zellspannung_149_XIX_HV_Batterie_RTM_XIX_RTM_XIX_BMC_HV.DE_BMC_CMC_Zellspannung_149, system-signal=BMC_CMC_Zellspannung_149}
        sender-receiver-to-signal-mapping={communication-direction=OUT, data-element=HV_Batterie_RTM_XIX_RTM_XIX_BMC_HV.Geltungsbereich_E3_1_2_Premium.SP_IF_BMC_CMC_Zellspannung_167_XIX_HV_Batterie_RTM_XIX_RTM_XIX_BMC_HV.DE_BMC_CMC_Zellspannung_167, system-signal=BMC_CMC_Zellspannung_167}
        sender-receiver-to-signal-mapping={communication-direction=OUT, data-element=HV_Batterie_RTM_XIX_RTM_XIX_BMC_HV.Geltungsbereich_E3_1_2_Premium.SP_IF_BMC_CMC_Zellspannung_012_XIX_HV_Batterie_RTM_XIX_RTM_XIX_BMC_HV.DE_BMC_CMC_Zellspannung_012, system-signal=BMC_CMC_Zellspannung_012}
        sender-receiver-to-signal-mapping={communication-direction=OUT, data-element=HV_Batterie_RTM_XIX_RTM_XIX_BMC_HV.Geltungsbereich_E3_1_2_Premium.SP_IF_BMC_CMC_Zellspannung_058_XIX_HV_Batterie_RTM_XIX_RTM_XIX_BMC_HV.DE_BMC_CMC_Zellspannung_058, system-signal=BMC_CMC_Zellspannung_058}
        sender-receiver-to-signal-mapping={communication-direction=OUT, data-element=HV_Batterie_RTM_XIX_RTM_XIX_BMC_HV.Geltungsbereich_E3_1_2_Premium.SP_IF_BMC_CMC_Zellspannung_092_XIX_HV_Batterie_RTM_XIX_RTM_XIX_BMC_HV.DE_BMC_CMC_Zellspannung_092, system-signal=BMC_CMC_Zellspannung_092}
        sender-receiver-to-signal-mapping={communication-direction=OUT, data-element=HV_Batterie_RTM_XIX_RTM_XIX_BMC_HV.Geltungsbereich_E3_1_2_Premium.SP_IF_BMC_CMC_Zellspannung_071_XIX_HV_Batterie_RTM_XIX_RTM_XIX_BMC_HV.DE_BMC_CMC_Zellspannung_071, system-signal=BMC_CMC_Zellspannung_071}
        sender-receiver-to-signal-mapping={communication-direction=OUT, data-element=HV_Batterie_RTM_XIX_RTM_XIX_BMC_HV.Geltungsbereich_E3_1_2_Premium.SP_IF_BMC_CMC_Zellspannung_168_XIX_HV_Batterie_RTM_XIX_RTM_XIX_BMC_HV.DE_BMC_CMC_Zellspannung_168, system-signal=BMC_CMC_Zellspannung_168}
        sender-receiver-to-signal-mapping={communication-direction=OUT, data-element=HV_Batterie_RTM_XIX_RTM_XIX_BMC_HV.Geltungsbereich_E3_1_2_Premium.SP_IF_BMC_CMC_Zellspannung_164_XIX_HV_Batterie_RTM_XIX_RTM_XIX_BMC_HV.DE_BMC_CMC_Zellspannung_164, system-signal=BMC_CMC_Zellspannung_164}
        sender-receiver-to-signal-mapping={communication-direction=OUT, data-element=HV_Batterie_RTM_XIX_RTM_XIX_BMC_HV.Geltungsbereich_E3_1_2_Premium.SP_IF_BMC_CMC_Zellspannung_002_XIX_HV_Batterie_RTM_XIX_RTM_XIX_BMC_HV.DE_BMC_CMC_Zellspannung_002, system-signal=BMC_CMC_Zellspannung_002}
        sender-receiver-to-signal-mapping={communication-direction=OUT, data-element=HV_Batterie_RTM_XIX_RTM_XIX_BMC_HV.Geltungsbereich_E3_1_2_Premium.SP_IF_BMC_CMC_Zellspannung_165_XIX_HV_Batterie_RTM_XIX_RTM_XIX_BMC_HV.DE_BMC_CMC_Zellspannung_165, system-signal=BMC_CMC_Zellspannung_165}
        sender-receiver-to-signal-mapping={communication-direction=OUT, data-element=HV_Batterie_RTM_XIX_RTM_XIX_BMC_HV.Geltungsbereich_E3_1_2_Premium.SP_IF_BMC_CMC_Zellspannung_049_XIX_HV_Batterie_RTM_XIX_RTM_XIX_BMC_HV.DE_BMC_CMC_Zellspannung_049, system-signal=BMC_CMC_Zellspannung_049}
        sender-receiver-to-signal-mapping={communication-direction=OUT, data-element=HV_Batterie_RTM_XIX_RTM_XIX_BMC_HV.Geltungsbereich_E3_1_2_Premium.SP_IF_BMC_CMC_Zellspannung_084_XIX_HV_Batterie_RTM_XIX_RTM_XIX_BMC_HV.DE_BMC_CMC_Zellspannung_084, system-signal=BMC_CMC_Zellspannung_084}
        sender-receiver-to-signal-mapping={communication-direction=OUT, data-element=HV_Batterie_RTM_XIX_RTM_XIX_BMC_HV.Geltungsbereich_E3_1_2_Premium.SP_IF_BMC_CMC_Zellspannung_184_XIX_HV_Batterie_RTM_XIX_RTM_XIX_BMC_HV.DE_BMC_CMC_Zellspannung_184, system-signal=BMC_CMC_Zellspannung_184}
        sender-receiver-to-signal-mapping={communication-direction=OUT, data-element=HV_Batterie_RTM_XIX_RTM_XIX_BMC_HV.Geltungsbereich_E3_1_2_Premium.SP_IF_BMC_CMC_Zellspannung_039_XIX_HV_Batterie_RTM_XIX_RTM_XIX_BMC_HV.DE_BMC_CMC_Zellspannung_039, system-signal=BMC_CMC_Zellspannung_039}
        sender-receiver-to-signal-mapping={communication-direction=OUT, data-element=HV_Batterie_RTM_XIX_RTM_XIX_BMC_HV.Geltungsbereich_E3_1_2_Premium.SP_IF_BMC_CMC_Zellspannung_022_XIX_HV_Batterie_RTM_XIX_RTM_XIX_BMC_HV.DE_BMC_CMC_Zellspannung_022, system-signal=BMC_CMC_Zellspannung_022}
        sender-receiver-to-signal-mapping={communication-direction=OUT, data-element=HV_Batterie_RTM_XIX_RTM_XIX_BMC_HV.Geltungsbereich_E3_1_2_Premium.SP_IF_BMC_CMC_Zellspannung_166_XIX_HV_Batterie_RTM_XIX_RTM_XIX_BMC_HV.DE_BMC_CMC_Zellspannung_166, system-signal=BMC_CMC_Zellspannung_166}
        sender-receiver-to-signal-mapping={communication-direction=OUT, data-element=HV_Batterie_RTM_XIX_RTM_XIX_BMC_HV.Geltungsbereich_E3_1_2_Premium.SP_IF_BMC_CMC_Zellspannung_102_XIX_HV_Batterie_RTM_XIX_RTM_XIX_BMC_HV.DE_BMC_CMC_Zellspannung_102, system-signal=BMC_CMC_Zellspannung_102}
        sender-receiver-to-signal-mapping={communication-direction=OUT, data-element=HV_Batterie_RTM_XIX_RTM_XIX_BMC_HV.Geltungsbereich_E3_1_2_Premium.SP_IF_BMC_CMC_Zellspannung_026_XIX_HV_Batterie_RTM_XIX_RTM_XIX_BMC_HV.DE_BMC_CMC_Zellspannung_026, system-signal=BMC_CMC_Zellspannung_026}
        sender-receiver-to-signal-mapping={communication-direction=OUT, data-element=HV_Batterie_RTM_XIX_RTM_XIX_BMC_HV.Geltungsbereich_E3_1_2_Premium.SP_IF_BMC_CMC_Zellspannung_125_XIX_HV_Batterie_RTM_XIX_RTM_XIX_BMC_HV.DE_BMC_CMC_Zellspannung_125, system-signal=BMC_CMC_Zellspannung_125}
        sender-receiver-to-signal-mapping={communication-direction=OUT, data-element=HV_Batterie_RTM_XIX_RTM_XIX_BMC_HV.Geltungsbereich_E3_1_2_Premium.SP_IF_BMC_CMC_Zellspannung_160_XIX_HV_Batterie_RTM_XIX_RTM_XIX_BMC_HV.DE_BMC_CMC_Zellspannung_160, system-signal=BMC_CMC_Zellspannung_160}
        sender-receiver-to-signal-mapping={communication-direction=OUT, data-element=HV_Batterie_RTM_XIX_RTM_XIX_BMC_HV.Geltungsbereich_E3_1_2_Premium.SP_IF_BMC_CMC_Zellspannung_121_XIX_HV_Batterie_RTM_XIX_RTM_XIX_BMC_HV.DE_BMC_CMC_Zellspannung_121, system-signal=BMC_CMC_Zellspannung_121}
        sender-receiver-to-signal-mapping={communication-direction=OUT, data-element=HV_Batterie_RTM_XIX_RTM_XIX_BMC_HV.Geltungsbereich_E3_1_2_Premium.SP_IF_BMC_CMC_Zellspannung_106_XIX_HV_Batterie_RTM_XIX_RTM_XIX_BMC_HV.DE_BMC_CMC_Zellspannung_106, system-signal=BMC_CMC_Zellspannung_106}
        sender-receiver-to-signal-mapping={communication-direction=OUT, data-element=HV_Batterie_RTM_XIX_RTM_XIX_BMC_HV.Geltungsbereich_E3_1_2_Premium.SP_IF_BMC_CMC_Zellspannung_116_XIX_HV_Batterie_RTM_XIX_RTM_XIX_BMC_HV.DE_BMC_CMC_Zellspannung_116, system-signal=BMC_CMC_Zellspannung_116}
        sender-receiver-to-signal-mapping={communication-direction=OUT, data-element=HV_Batterie_RTM_XIX_RTM_XIX_BMC_HV.Geltungsbereich_E3_1_2_Premium.SP_IF_BMC_CMC_Zellspannung_030_XIX_HV_Batterie_RTM_XIX_RTM_XIX_BMC_HV.DE_BMC_CMC_Zellspannung_030, system-signal=BMC_CMC_Zellspannung_030}
        sender-receiver-to-signal-mapping={communication-direction=OUT, data-element=HV_Batterie_RTM_XIX_RTM_XIX_BMC_HV.Geltungsbereich_E3_1_2_Premium.SP_IF_BMC_CMC_Zellspannung_186_XIX_HV_Batterie_RTM_XIX_RTM_XIX_BMC_HV.DE_BMC_CMC_Zellspannung_186, system-signal=BMC_CMC_Zellspannung_186}
        sender-receiver-to-signal-mapping={communication-direction=OUT, data-element=HV_Batterie_RTM_XIX_RTM_XIX_BMC_HV.Geltungsbereich_E3_1_2_Premium.SP_IF_BMC_CMC_Zellspannung_187_XIX_HV_Batterie_RTM_XIX_RTM_XIX_BMC_HV.DE_BMC_CMC_Zellspannung_187, system-signal=BMC_CMC_Zellspannung_187}
        sender-receiver-to-signal-mapping={communication-direction=OUT, data-element=HV_Batterie_RTM_XIX_RTM_XIX_BMC_HV.Geltungsbereich_E3_1_2_Premium.SP_IF_BMC_CMC_Zellspannung_126_XIX_HV_Batterie_RTM_XIX_RTM_XIX_BMC_HV.DE_BMC_CMC_Zellspannung_126, system-signal=BMC_CMC_Zellspannung_126}
        sender-receiver-to-signal-mapping={communication-direction=OUT, data-element=HV_Batterie_RTM_XIX_RTM_XIX_BMC_HV.Geltungsbereich_E3_1_2_Premium.SP_IF_BMC_CMC_Zellspannung_117_XIX_HV_Batterie_RTM_XIX_RTM_XIX_BMC_HV.DE_BMC_CMC_Zellspannung_117, system-signal=BMC_CMC_Zellspannung_117}
        sender-receiver-to-signal-mapping={communication-direction=OUT, data-element=HV_Batterie_RTM_XIX_RTM_XIX_BMC_HV.Geltungsbereich_E3_1_2_Premium.SP_IF_BMC_CMC_Zellspannung_159_XIX_HV_Batterie_RTM_XIX_RTM_XIX_BMC_HV.DE_BMC_CMC_Zellspannung_159, system-signal=BMC_CMC_Zellspannung_159}
        sender-receiver-to-signal-mapping={communication-direction=OUT, data-element=HV_Batterie_RTM_XIX_RTM_XIX_BMC_HV.Geltungsbereich_E3_1_2_Premium.SP_IF_BMC_CMC_Zellspannung_003_XIX_HV_Batterie_RTM_XIX_RTM_XIX_BMC_HV.DE_BMC_CMC_Zellspannung_003, system-signal=BMC_CMC_Zellspannung_003}
        sender-receiver-to-signal-mapping={communication-direction=OUT, data-element=HV_Batterie_RTM_XIX_RTM_XIX_BMC_HV.Geltungsbereich_E3_1_2_Premium.SP_IF_BMC_CMC_Zellspannung_099_XIX_HV_Batterie_RTM_XIX_RTM_XIX_BMC_HV.DE_BMC_CMC_Zellspannung_099, system-signal=BMC_CMC_Zellspannung_099}
        sender-receiver-to-signal-mapping={communication-direction=OUT, data-element=HV_Batterie_RTM_XIX_RTM_XIX_BMC_HV.Geltungsbereich_E3_1_2_Premium.SP_IF_BMC_CMC_Zellspannung_182_XIX_HV_Batterie_RTM_XIX_RTM_XIX_BMC_HV.DE_BMC_CMC_Zellspannung_182, system-signal=BMC_CMC_Zellspannung_182}
        sender-receiver-to-signal-mapping={communication-direction=OUT, data-element=HV_Batterie_RTM_XIX_RTM_XIX_BMC_HV.Geltungsbereich_E3_1_2_Premium.SP_IF_BMC_CMC_Zellspannung_087_XIX_HV_Batterie_RTM_XIX_RTM_XIX_BMC_HV.DE_BMC_CMC_Zellspannung_087, system-signal=BMC_CMC_Zellspannung_087}
        sender-receiver-to-signal-mapping={communication-direction=OUT, data-element=HV_Batterie_RTM_XIX_RTM_XIX_BMC_HV.Geltungsbereich_E3_1_2_Premium.SP_IF_BMC_CMC_Zellspannung_074_XIX_HV_Batterie_RTM_XIX_RTM_XIX_BMC_HV.DE_BMC_CMC_Zellspannung_074, system-signal=BMC_CMC_Zellspannung_074}
        sender-receiver-to-signal-mapping={communication-direction=OUT, data-element=HV_Batterie_RTM_XIX_RTM_XIX_BMC_HV.Geltungsbereich_E3_1_2_Premium.SP_IF_BMC_CMC_Zellspannung_096_XIX_HV_Batterie_RTM_XIX_RTM_XIX_BMC_HV.DE_BMC_CMC_Zellspannung_096, system-signal=BMC_CMC_Zellspannung_096}
        sender-receiver-to-signal-mapping={communication-direction=OUT, data-element=HV_Batterie_RTM_XIX_RTM_XIX_BMC_HV.Geltungsbereich_E3_1_2_Premium.SP_IF_BMC_CMC_Zellspannung_070_XIX_HV_Batterie_RTM_XIX_RTM_XIX_BMC_HV.DE_BMC_CMC_Zellspannung_070, system-signal=BMC_CMC_Zellspannung_070}
        sender-receiver-to-signal-mapping={communication-direction=OUT, data-element=HV_Batterie_RTM_XIX_RTM_XIX_BMC_HV.Geltungsbereich_E3_1_2_Premium.SP_IF_BMC_CMC_Zellspannung_143_XIX_HV_Batterie_RTM_XIX_RTM_XIX_BMC_HV.DE_BMC_CMC_Zellspannung_143, system-signal=BMC_CMC_Zellspannung_143}
        sender-receiver-to-signal-mapping={communication-direction=OUT, data-element=HV_Batterie_RTM_XIX_RTM_XIX_BMC_HV.Geltungsbereich_E3_1_2_Premium.SP_IF_BMC_CMC_Zellspannung_161_XIX_HV_Batterie_RTM_XIX_RTM_XIX_BMC_HV.DE_BMC_CMC_Zellspannung_161, system-signal=BMC_CMC_Zellspannung_161}
        sender-receiver-to-signal-mapping={communication-direction=OUT, data-element=HV_Batterie_RTM_XIX_RTM_XIX_BMC_HV.Geltungsbereich_E3_1_2_Premium.SP_IF_BMC_CMC_Zellspannung_134_XIX_HV_Batterie_RTM_XIX_RTM_XIX_BMC_HV.DE_BMC_CMC_Zellspannung_134, system-signal=BMC_CMC_Zellspannung_134}
        sender-receiver-to-signal-mapping={communication-direction=OUT, data-element=HV_Batterie_RTM_XIX_RTM_XIX_BMC_HV.Geltungsbereich_E3_1_2_Premium.SP_IF_BMC_CMC_Zellspannung_114_XIX_HV_Batterie_RTM_XIX_RTM_XIX_BMC_HV.DE_BMC_CMC_Zellspannung_114, system-signal=BMC_CMC_Zellspannung_114}
        sender-receiver-to-signal-mapping={communication-direction=OUT, data-element=HV_Batterie_RTM_XIX_RTM_XIX_BMC_HV.Geltungsbereich_E3_1_2_Premium.SP_IF_BMC_CMC_Zellspannung_172_XIX_HV_Batterie_RTM_XIX_RTM_XIX_BMC_HV.DE_BMC_CMC_Zellspannung_172, system-signal=BMC_CMC_Zellspannung_172}
        sender-receiver-to-signal-mapping={communication-direction=OUT, data-element=HV_Batterie_RTM_XIX_RTM_XIX_BMC_HV.Geltungsbereich_E3_1_2_Premium.SP_IF_BMC_IstTemperaturMax_Modul_ID_XIX_HV_Batterie_RTM_XIX_RTM_XIX_BMC_HV.DE_BMC_IstTemperaturMax_Modul_ID, system-signal=BMC_IstTemperaturMax_Modul_ID}
        sender-receiver-to-signal-mapping={communication-direction=OUT, data-element=HV_Batterie_RTM_XIX_RTM_XIX_BMC_HV.Geltungsbereich_E3_1_2_Premium.SP_IF_BMC_RtmWarnUeberstrom_XIX_HV_Batterie_RTM_XIX_RTM_XIX_BMC_HV.DE_BMC_RtmWarnUeberstrom, system-signal=BMC_RtmWarnUeberstrom}
        sender-receiver-to-signal-mapping={communication-direction=OUT, data-element=HV_Batterie_RTM_XIX_RTM_XIX_BMC_HV.Geltungsbereich_E3_1_2_Premium.SP_IF_BMC_IstTemperaturMin_Modul_ID_XIX_HV_Batterie_RTM_XIX_RTM_XIX_BMC_HV.DE_BMC_IstTemperaturMin_Modul_ID, system-signal=BMC_IstTemperaturMin_Modul_ID}
        sender-receiver-to-signal-mapping={communication-direction=OUT, data-element=HV_Batterie_RTM_XIX_RTM_XIX_BMC_HV.Geltungsbereich_E3_1_2_Premium.SP_IF_BMC_IstTemperaturMax_Sensor_ID_XIX_HV_Batterie_RTM_XIX_RTM_XIX_BMC_HV.DE_BMC_IstTemperaturMax_Sensor_ID, system-signal=BMC_IstTemperaturMax_Sensor_ID}
        sender-receiver-to-signal-mapping={communication-direction=OUT, data-element=HV_Batterie_RTM_XIX_RTM_XIX_BMC_HV.Geltungsbereich_E3_1_2_Premium.SP_IF_BMC_Temperatur_hoechste_XIX_HV_Batterie_RTM_XIX_RTM_XIX_BMC_HV.DE_BMC_Temperatur_hoechste, system-signal=BMC_Temperatur_hoechste}
        sender-receiver-to-signal-mapping={communication-direction=OUT, data-element=HV_Batterie_RTM_XIX_RTM_XIX_BMC_HV.Geltungsbereich_E3_1_2_Premium.SP_IF_BMC_Temperatur_niedrigste_XIX_HV_Batterie_RTM_XIX_RTM_XIX_BMC_HV.DE_BMC_Temperatur_niedrigste, system-signal=BMC_Temperatur_niedrigste}
        sender-receiver-to-signal-mapping={communication-direction=OUT, data-element=HV_Batterie_RTM_XIX_RTM_XIX_BMC_HV.Geltungsbereich_E3_1_2_Premium.SP_IF_BMC_IstZellspannungMax_XIX_HV_Batterie_RTM_XIX_RTM_XIX_BMC_HV.DE_BMC_IstZellspannungMax, system-signal=BMC_IstZellspannungMax}
        sender-receiver-to-signal-mapping={communication-direction=OUT, data-element=HV_Batterie_RTM_XIX_RTM_XIX_BMC_HV.Geltungsbereich_E3_1_2_Premium.SP_IF_BMC_IstZellspannungMin_XIX_HV_Batterie_RTM_XIX_RTM_XIX_BMC_HV.DE_BMC_IstZellspannungMin, system-signal=BMC_IstZellspannungMin}
        sender-receiver-to-signal-mapping={communication-direction=OUT, data-element=HV_Batterie_RTM_XIX_RTM_XIX_BMC_HV.Geltungsbereich_E3_1_2_Premium.SP_IF_BMC_Strom_Messzeit_XIX_HV_Batterie_RTM_XIX_RTM_XIX_BMC_HV.DE_BMC_Strom_Messzeit, system-signal=BMC_Strom_Messzeit}
        sender-receiver-to-signal-mapping={communication-direction=OUT, data-element=HV_Batterie_RTM_XIX_RTM_XIX_BMC_HV.Geltungsbereich_E3_1_2_Premium.SP_IF_BMC_Spannung_Messzeit_XIX_HV_Batterie_RTM_XIX_RTM_XIX_BMC_HV.DE_BMC_Spannung_Messzeit, system-signal=BMC_Spannung_Messzeit}
        sender-receiver-to-signal-mapping={communication-direction=OUT, data-element=HV_Batterie_RTM_XIX_RTM_XIX_BMC_HV.Geltungsbereich_E3_1_2_Premium.SP_IF_BMC_CMC_Zellspannung_{01..05}_Messzeit_XIX_HV_Batterie_RTM_XIX_RTM_XIX_BMC_HV.DE_BMC_CMC_Zellspannung_{01..05}_Messzeit, system-signal=BMC_CMC_Zellspannung_{01..05}_Messzeit}
        sender-receiver-to-signal-mapping={communication-direction=OUT, data-element=HV_Batterie_RTM_XIX_RTM_XIX_BMC_HV.Geltungsbereich_E3_1_2_Premium.SP_IF_BMC_CMC_Temperatur_01_Messzeit_XIX_HV_Batterie_RTM_XIX_RTM_XIX_BMC_HV.DE_BMC_CMC_Temperatur_01_Messzeit, system-signal=BMC_CMC_Temperatur_01_Messzeit}
        sender-receiver-to-signal-mapping={communication-direction=OUT, data-element=HV_Batterie_RTM_XIX_RTM_XIX_BMC_HV.Geltungsbereich_E3_1_2_Premium.SP_IF_BMC_CMC_Temperatur_02_Messzeit_XIX_HV_Batterie_RTM_XIX_RTM_XIX_BMC_HV.DE_BMC_CMC_Temperatur_02_Messzeit, system-signal=BMC_CMC_Temperatur_02_Messzeit}
        sender-receiver-to-signal-mapping={communication-direction=OUT, data-element=HV_Batterie_RTM_XIX_RTM_XIX_BMC_HV.Geltungsbereich_E3_1_2_Premium.SP_IF_BMC_CMC_Temperatur_{073..075}_XIX_HV_Batterie_RTM_XIX_RTM_XIX_BMC_HV.DE_BMC_CMC_Temperatur_{073..075}, system-signal=BMC_CMC_Temperatur_{073..075}}
        sender-receiver-to-signal-mapping={communication-direction=OUT, data-element=HV_Batterie_RTM_XIX_RTM_XIX_BMC_HV.Geltungsbereich_E3_1_2_Premium.SP_IF_BMC_CMC_Temperatur_078_XIX_HV_Batterie_RTM_XIX_RTM_XIX_BMC_HV.DE_BMC_CMC_Temperatur_078, system-signal=BMC_CMC_Temperatur_078}
        sender-receiver-to-signal-mapping={communication-direction=OUT, data-element=HV_Batterie_RTM_XIX_RTM_XIX_BMC_HV.Geltungsbereich_E3_1_2_Premium.SP_IF_BMC_CMC_Temperatur_076_XIX_HV_Batterie_RTM_XIX_RTM_XIX_BMC_HV.DE_BMC_CMC_Temperatur_076, system-signal=BMC_CMC_Temperatur_076}
        sender-receiver-to-signal-mapping={communication-direction=OUT, data-element=HV_Batterie_RTM_XIX_RTM_XIX_BMC_HV.Geltungsbereich_E3_1_2_Premium.SP_IF_BMC_CMC_Temperatur_077_XIX_HV_Batterie_RTM_XIX_RTM_XIX_BMC_HV.DE_BMC_CMC_Temperatur_077, system-signal=BMC_CMC_Temperatur_077}
        sender-receiver-to-signal-mapping={communication-direction=OUT, data-element=HV_Batterie_RTM_XIX_RTM_XIX_BMC_HV.Geltungsbereich_E3_1_2_Premium.SP_IF_BMC_CMC_Temperatur_{079..082}_XIX_HV_Batterie_RTM_XIX_RTM_XIX_BMC_HV.DE_BMC_CMC_Temperatur_{079..082}, system-signal=BMC_CMC_Temperatur_{079..082}}
        sender-receiver-to-signal-mapping={communication-direction=OUT, data-element=HV_Batterie_RTM_XIX_RTM_XIX_BMC_HV.Geltungsbereich_E3_1_2_Premium.SP_IF_BMC_CMC_Temperatur_{085..088}_XIX_HV_Batterie_RTM_XIX_RTM_XIX_BMC_HV.DE_BMC_CMC_Temperatur_{085..088}, system-signal=BMC_CMC_Temperatur_{085..088}}
        sender-receiver-to-signal-mapping={communication-direction=OUT, data-element=HV_Batterie_RTM_XIX_RTM_XIX_BMC_HV.Geltungsbereich_E3_1_2_Premium.SP_IF_BMC_CMC_Temperatur_084_XIX_HV_Batterie_RTM_XIX_RTM_XIX_BMC_HV.DE_BMC_CMC_Temperatur_084, system-signal=BMC_CMC_Temperatur_084}
        sender-receiver-to-signal-mapping={communication-direction=OUT, data-element=HV_Batterie_RTM_XIX_RTM_XIX_BMC_HV.Geltungsbereich_E3_1_2_Premium.SP_IF_BMC_CMC_Temperatur_083_XIX_HV_Batterie_RTM_XIX_RTM_XIX_BMC_HV.DE_BMC_CMC_Temperatur_083, system-signal=BMC_CMC_Temperatur_083}
        sender-receiver-to-signal-mapping={communication-direction=OUT, data-element=HV_Batterie_RTM_XIX_RTM_XIX_BMC_HV.Geltungsbereich_E3_1_2_Premium.SP_IF_BMC_CMC_Temperatur_090_XIX_HV_Batterie_RTM_XIX_RTM_XIX_BMC_HV.DE_BMC_CMC_Temperatur_090, system-signal=BMC_CMC_Temperatur_090}
        sender-receiver-to-signal-mapping={communication-direction=OUT, data-element=HV_Batterie_RTM_XIX_RTM_XIX_BMC_HV.Geltungsbereich_E3_1_2_Premium.SP_IF_BMC_CMC_Temperatur_092_XIX_HV_Batterie_RTM_XIX_RTM_XIX_BMC_HV.DE_BMC_CMC_Temperatur_092, system-signal=BMC_CMC_Temperatur_092}
        sender-receiver-to-signal-mapping={communication-direction=OUT, data-element=HV_Batterie_RTM_XIX_RTM_XIX_BMC_HV.Geltungsbereich_E3_1_2_Premium.SP_IF_BMC_CMC_Temperatur_091_XIX_HV_Batterie_RTM_XIX_RTM_XIX_BMC_HV.DE_BMC_CMC_Temperatur_091, system-signal=BMC_CMC_Temperatur_091}
        sender-receiver-to-signal-mapping={communication-direction=OUT, data-element=HV_Batterie_RTM_XIX_RTM_XIX_BMC_HV.Geltungsbereich_E3_1_2_Premium.SP_IF_BMC_CMC_Temperatur_093_XIX_HV_Batterie_RTM_XIX_RTM_XIX_BMC_HV.DE_BMC_CMC_Temperatur_093, system-signal=BMC_CMC_Temperatur_093}
        sender-receiver-to-signal-mapping={communication-direction=OUT, data-element=HV_Batterie_RTM_XIX_RTM_XIX_BMC_HV.Geltungsbereich_E3_1_2_Premium.SP_IF_BMC_CMC_Temperatur_089_XIX_HV_Batterie_RTM_XIX_RTM_XIX_BMC_HV.DE_BMC_CMC_Temperatur_089, system-signal=BMC_CMC_Temperatur_089}
        sender-receiver-to-signal-mapping={communication-direction=OUT, data-element=HV_Batterie_RTM_XIX_RTM_XIX_BMC_HV.Geltungsbereich_E3_1_2_Premium.SP_IF_BMC_CMC_Temperatur_{094..096}_XIX_HV_Batterie_RTM_XIX_RTM_XIX_BMC_HV.DE_BMC_CMC_Temperatur_{094..096}, system-signal=BMC_CMC_Temperatur_{094..096}}
        sender-receiver-to-signal-mapping={communication-direction=OUT, data-element=HV_Batterie_RTM_XIX_RTM_XIX_BMC_HV.Geltungsbereich_E3_1_2_Premium.SP_IF_BMC_CMC_Temperatur_03_Messzeit_XIX_HV_Batterie_RTM_XIX_RTM_XIX_BMC_HV.DE_BMC_CMC_Temperatur_03_Messzeit, system-signal=BMC_CMC_Temperatur_03_Messzeit}
        sender-receiver-to-signal-mapping={communication-direction=IN, data-element=VKMS_Participant_BMC_HV_XIX_VKMS_XIX_BMC_HV.Geltungsbereich_E3_1_2_Premium.RP_IF_VIN_15_XIX_VKMS_Participant_BMC_HV_XIX_VKMS_XIX_BMC_HV.DE_VIN_15, system-signal=VIN_15}
        sender-receiver-to-signal-mapping={communication-direction=IN, data-element=VKMS_Participant_BMC_HV_XIX_VKMS_XIX_BMC_HV.Geltungsbereich_E3_1_2_Premium.RP_IF_VIN_16_XIX_VKMS_Participant_BMC_HV_XIX_VKMS_XIX_BMC_HV.DE_VIN_16, system-signal=VIN_16}
        sender-receiver-to-signal-mapping={communication-direction=IN, data-element=VKMS_Participant_BMC_HV_XIX_VKMS_XIX_BMC_HV.Geltungsbereich_E3_1_2_Premium.RP_IF_VIN_9_XIX_VKMS_Participant_BMC_HV_XIX_VKMS_XIX_BMC_HV.DE_VIN_9, system-signal=VIN_9}
        sender-receiver-to-signal-mapping={communication-direction=IN, data-element=VKMS_Participant_BMC_HV_XIX_VKMS_XIX_BMC_HV.Geltungsbereich_E3_1_2_Premium.RP_IF_VIN_12_XIX_VKMS_Participant_BMC_HV_XIX_VKMS_XIX_BMC_HV.DE_VIN_12, system-signal=VIN_12}
        sender-receiver-to-signal-mapping={communication-direction=IN, data-element=VKMS_Participant_BMC_HV_XIX_VKMS_XIX_BMC_HV.Geltungsbereich_E3_1_2_Premium.RP_IF_VIN_8_XIX_VKMS_Participant_BMC_HV_XIX_VKMS_XIX_BMC_HV.DE_VIN_8, system-signal=VIN_8}
        sender-receiver-to-signal-mapping={communication-direction=IN, data-element=VKMS_Participant_BMC_HV_XIX_VKMS_XIX_BMC_HV.Geltungsbereich_E3_1_2_Premium.RP_IF_VIN_6_XIX_VKMS_Participant_BMC_HV_XIX_VKMS_XIX_BMC_HV.DE_VIN_6, system-signal=VIN_6}
        sender-receiver-to-signal-mapping={communication-direction=IN, data-element=VKMS_Participant_BMC_HV_XIX_VKMS_XIX_BMC_HV.Geltungsbereich_E3_1_2_Premium.RP_IF_VIN_13_XIX_VKMS_Participant_BMC_HV_XIX_VKMS_XIX_BMC_HV.DE_VIN_13, system-signal=VIN_13}
        sender-receiver-to-signal-mapping={communication-direction=IN, data-element=VKMS_Participant_BMC_HV_XIX_VKMS_XIX_BMC_HV.Geltungsbereich_E3_1_2_Premium.RP_IF_VIN_14_XIX_VKMS_Participant_BMC_HV_XIX_VKMS_XIX_BMC_HV.DE_VIN_14, system-signal=VIN_14}
        sender-receiver-to-signal-mapping={communication-direction=IN, data-element=VKMS_Participant_BMC_HV_XIX_VKMS_XIX_BMC_HV.Geltungsbereich_E3_1_2_Premium.RP_IF_VIN_2_XIX_VKMS_Participant_BMC_HV_XIX_VKMS_XIX_BMC_HV.DE_VIN_2, system-signal=VIN_2}
        sender-receiver-to-signal-mapping={communication-direction=IN, data-element=VKMS_Participant_BMC_HV_XIX_VKMS_XIX_BMC_HV.Geltungsbereich_E3_1_2_Premium.RP_IF_VIN_7_XIX_VKMS_Participant_BMC_HV_XIX_VKMS_XIX_BMC_HV.DE_VIN_7, system-signal=VIN_7}
        sender-receiver-to-signal-mapping={communication-direction=IN, data-element=VKMS_Participant_BMC_HV_XIX_VKMS_XIX_BMC_HV.Geltungsbereich_E3_1_2_Premium.RP_IF_VIN_17_XIX_VKMS_Participant_BMC_HV_XIX_VKMS_XIX_BMC_HV.DE_VIN_17, system-signal=VIN_17}
        sender-receiver-to-signal-mapping={communication-direction=IN, data-element=VKMS_Participant_BMC_HV_XIX_VKMS_XIX_BMC_HV.Geltungsbereich_E3_1_2_Premium.RP_IF_VIN_11_XIX_VKMS_Participant_BMC_HV_XIX_VKMS_XIX_BMC_HV.DE_VIN_11, system-signal=VIN_11}
        sender-receiver-to-signal-mapping={communication-direction=IN, data-element=VKMS_Participant_BMC_HV_XIX_VKMS_XIX_BMC_HV.Geltungsbereich_E3_1_2_Premium.RP_IF_VIN_10_XIX_VKMS_Participant_BMC_HV_XIX_VKMS_XIX_BMC_HV.DE_VIN_10, system-signal=VIN_10}
        sender-receiver-to-signal-mapping={communication-direction=IN, data-element=VKMS_Participant_BMC_HV_XIX_VKMS_XIX_BMC_HV.Geltungsbereich_E3_1_2_Premium.RP_IF_VIN_4_XIX_VKMS_Participant_BMC_HV_XIX_VKMS_XIX_BMC_HV.DE_VIN_4, system-signal=VIN_4}
        sender-receiver-to-signal-mapping={communication-direction=IN, data-element=VKMS_Participant_BMC_HV_XIX_VKMS_XIX_BMC_HV.Geltungsbereich_E3_1_2_Premium.RP_IF_VIN_5_XIX_VKMS_Participant_BMC_HV_XIX_VKMS_XIX_BMC_HV.DE_VIN_5, system-signal=VIN_5}
        sender-receiver-to-signal-mapping={communication-direction=IN, data-element=VKMS_Participant_BMC_HV_XIX_VKMS_XIX_BMC_HV.Geltungsbereich_E3_1_2_Premium.RP_IF_VIN_3_XIX_VKMS_Participant_BMC_HV_XIX_VKMS_XIX_BMC_HV.DE_VIN_3, system-signal=VIN_3}
        sender-receiver-to-signal-mapping={communication-direction=IN, data-element=VKMS_Participant_BMC_HV_XIX_VKMS_XIX_BMC_HV.Geltungsbereich_E3_1_2_Premium.RP_IF_VIN_1_XIX_VKMS_Participant_BMC_HV_XIX_VKMS_XIX_BMC_HV.DE_VIN_1, system-signal=VIN_1}
        sender-receiver-to-signal-group-mapping={communication-direction=IN, data-element=OTA_Infrastructure_Hybrid_01_XIX_ORU6_XIX_BMC_HV.Geltungsbereich_E3_1_2_Premium.RP_IF_SG_ORU_Control_A_01_XIX_OTA_Infrastructure_Hybrid_01_XIX_ORU6_XIX_BMC_HV.DE_SG_ORU_Control_A_01, signal-group=SG_ORU_Control_A_01, type-mapping=sender-rec-record-type-mapping=record-element-mappings=[{implementation-record-element=OruControlReleaseA, system-signal=OruControlReleaseA}, {implementation-record-element=ORU_Control_A_01_CRC, system-signal=ORU_Control_A_01_CRC}, {implementation-record-element=ORU_Control_A_01_BZ, system-signal=ORU_Control_A_01_BZ}, {implementation-record-element=OnlineRemoteUpdateControlA, system-signal=OnlineRemoteUpdateControlA}, {implementation-record-element=OnlineRemoteUpdateControlOldA, system-signal=OnlineRemoteUpdateControlOldA}]}
        sender-receiver-to-signal-group-mapping={communication-direction=IN, data-element=OTA_Infrastructure_Hybrid_01_XIX_ORU6_XIX_BMC_HV.Geltungsbereich_E3_1_2_Premium.RP_IF_SG_ORU_Control_D_01_XIX_OTA_Infrastructure_Hybrid_01_XIX_ORU6_XIX_BMC_HV.DE_SG_ORU_Control_D_01, signal-group=SG_ORU_Control_D_01, type-mapping=sender-rec-record-type-mapping=record-element-mappings=[{implementation-record-element=OruControlReleaseD, system-signal=OruControlReleaseD}, {implementation-record-element=OnlineRemoteUpdateControlOldD, system-signal=OnlineRemoteUpdateControlOldD}, {implementation-record-element=OnlineRemoteUpdateControlD, system-signal=OnlineRemoteUpdateControlD}, {implementation-record-element=ORU_Control_D_01_BZ, system-signal=ORU_Control_D_01_BZ}, {implementation-record-element=ORU_Control_D_01_CRC, system-signal=ORU_Control_D_01_CRC}]}
        sender-receiver-to-signal-group-mapping={communication-direction=IN, data-element=OTA_Infrastructure_Hybrid_01_XIX_ORU6_XIX_BMC_HV.Geltungsbereich_E3_1_2_Premium.RP_IF_SG_OTAMC_D_01_XIX_OTA_Infrastructure_Hybrid_01_XIX_ORU6_XIX_BMC_HV.DE_SG_OTAMC_D_01, signal-group=SG_OTAMC_D_01, type-mapping=sender-rec-record-type-mapping=record-element-mappings=[{implementation-record-element=VehicleProtectedEnvironment_D, system-signal=VehicleProtectedEnvironment_D}, {implementation-record-element=OTAMC_D_01_CRC, system-signal=OTAMC_D_01_CRC}, {implementation-record-element=OTAMC_D_01_BZ, system-signal=OTAMC_D_01_BZ}]}
        sender-receiver-to-signal-mapping={communication-direction=IN, data-element=ORU_Infrastructure_Hybrid_01_XIX_ORU6_XIX_BMC_HV.Geltungsbereich_E3_1_2_Premium.RP_IF_ORU_Status_XIX_ORU_Infrastructure_Hybrid_01_XIX_ORU6_XIX_BMC_HV.DE_ORU_Status, system-signal=ORU_Status}
        sender-receiver-to-signal-mapping={communication-direction=IN, data-element=DaapServer_BMC_HV_XIX_GDC_DAAP_XIX_BMC_HV.Geltungsbereich_E3_1_2_Premium.RP_IF_UH_Minute_XIX_DaapServer_BMC_HV_XIX_GDC_DAAP_XIX_BMC_HV.DE_UH_Minute, system-signal=UH_Minute}
        sender-receiver-to-signal-mapping={communication-direction=IN, data-element=DaapServer_BMC_HV_XIX_GDC_DAAP_XIX_BMC_HV.Geltungsbereich_E3_1_2_Premium.RP_IF_UH_Jahr_XIX_DaapServer_BMC_HV_XIX_GDC_DAAP_XIX_BMC_HV.DE_UH_Jahr, system-signal=UH_Jahr}
        sender-receiver-to-signal-mapping={communication-direction=IN, data-element=DaapServer_BMC_HV_XIX_GDC_DAAP_XIX_BMC_HV.Geltungsbereich_E3_1_2_Premium.RP_IF_UH_Monat_XIX_DaapServer_BMC_HV_XIX_GDC_DAAP_XIX_BMC_HV.DE_UH_Monat, system-signal=UH_Monat}
        sender-receiver-to-signal-mapping={communication-direction=IN, data-element=DaapServer_BMC_HV_XIX_GDC_DAAP_XIX_BMC_HV.Geltungsbereich_E3_1_2_Premium.RP_IF_UH_Stunde_XIX_DaapServer_BMC_HV_XIX_GDC_DAAP_XIX_BMC_HV.DE_UH_Stunde, system-signal=UH_Stunde}
        sender-receiver-to-signal-mapping={communication-direction=IN, data-element=DaapServer_BMC_HV_XIX_GDC_DAAP_XIX_BMC_HV.Geltungsbereich_E3_1_2_Premium.RP_IF_UH_Sekunde_XIX_DaapServer_BMC_HV_XIX_GDC_DAAP_XIX_BMC_HV.DE_UH_Sekunde, system-signal=UH_Sekunde}
        sender-receiver-to-signal-mapping={communication-direction=IN, data-element=DaapServer_BMC_HV_XIX_GDC_DAAP_XIX_BMC_HV.Geltungsbereich_E3_1_2_Premium.RP_IF_UH_Tag_XIX_DaapServer_BMC_HV_XIX_GDC_DAAP_XIX_BMC_HV.DE_UH_Tag, system-signal=UH_Tag}
        sender-receiver-to-signal-mapping={communication-direction=IN, data-element=HVB_Fehlerausgabe_SecondaryOBDECU_XIX_SoC_XIX_BMC_HV.Geltungsbereich_E3_1_2_Premium.RP_IF_DCDC_NV_Komponentenfehler_63_XIX_HVB_Fehlerausgabe_SecondaryOBDECU_XIX_SoC_XIX_BMC_HV.DE_DCDC_NV_Komponentenfehler_63, system-signal=DCDC_NV_Komponentenfehler_63}
        sender-receiver-to-signal-mapping={communication-direction=IN, data-element=HVB_Fehlerausgabe_SecondaryOBDECU_XIX_SoC_XIX_BMC_HV.Geltungsbereich_E3_1_2_Premium.RP_IF_DCDC_NV_Komponentenfehler_VLD_XIX_HVB_Fehlerausgabe_SecondaryOBDECU_XIX_SoC_XIX_BMC_HV.DE_DCDC_NV_Komponentenfehler_VLD, system-signal=DCDC_NV_Komponentenfehler_VLD}
        sender-receiver-to-signal-mapping={communication-direction=IN, data-element=HVB_Fehlerausgabe_SecondaryOBDECU_XIX_SoC_XIX_BMC_HV.Geltungsbereich_E3_1_2_Premium.RP_IF_DCDC_NV_Komponentenfehler_3_1_XIX_HVB_Fehlerausgabe_SecondaryOBDECU_XIX_SoC_XIX_BMC_HV.DE_DCDC_NV_Komponentenfehler_3_1, system-signal=DCDC_NV_Komponentenfehler_3_1}
        sender-receiver-to-signal-mapping={communication-direction=IN, data-element=HVB_Fehlerausgabe_SecondaryOBDECU_XIX_SoC_XIX_BMC_HV.Geltungsbereich_E3_1_2_Premium.RP_IF_DCDC_NV_Komponentenfehler_3_3_XIX_HVB_Fehlerausgabe_SecondaryOBDECU_XIX_SoC_XIX_BMC_HV.DE_DCDC_NV_Komponentenfehler_3_3, system-signal=DCDC_NV_Komponentenfehler_3_3}
        sender-receiver-to-signal-mapping={communication-direction=IN, data-element=HVB_Fehlerausgabe_SecondaryOBDECU_XIX_SoC_XIX_BMC_HV.Geltungsbereich_E3_1_2_Premium.RP_IF_DCDC_NV_Komponentenfehler_11_XIX_HVB_Fehlerausgabe_SecondaryOBDECU_XIX_SoC_XIX_BMC_HV.DE_DCDC_NV_Komponentenfehler_11, system-signal=DCDC_NV_Komponentenfehler_11}
        sender-receiver-to-signal-mapping={communication-direction=IN, data-element=HVB_Fehlerausgabe_SecondaryOBDECU_XIX_SoC_XIX_BMC_HV.Geltungsbereich_E3_1_2_Premium.RP_IF_DCDC_NV_Komponentenfehler_34_XIX_HVB_Fehlerausgabe_SecondaryOBDECU_XIX_SoC_XIX_BMC_HV.DE_DCDC_NV_Komponentenfehler_34, system-signal=DCDC_NV_Komponentenfehler_34}
        sender-receiver-to-signal-mapping={communication-direction=IN, data-element=HVB_Fehlerausgabe_SecondaryOBDECU_XIX_SoC_XIX_BMC_HV.Geltungsbereich_E3_1_2_Premium.RP_IF_DCDC_NV_Komponentenfehler_51_XIX_HVB_Fehlerausgabe_SecondaryOBDECU_XIX_SoC_XIX_BMC_HV.DE_DCDC_NV_Komponentenfehler_51, system-signal=DCDC_NV_Komponentenfehler_51}
        sender-receiver-to-signal-mapping={communication-direction=IN, data-element=HVB_Fehlerausgabe_SecondaryOBDECU_XIX_SoC_XIX_BMC_HV.Geltungsbereich_E3_1_2_Premium.RP_IF_DCDC_NV_Komponentenfehler_41_XIX_HVB_Fehlerausgabe_SecondaryOBDECU_XIX_SoC_XIX_BMC_HV.DE_DCDC_NV_Komponentenfehler_41, system-signal=DCDC_NV_Komponentenfehler_41}
        sender-receiver-to-signal-mapping={communication-direction=IN, data-element=HVB_Fehlerausgabe_SecondaryOBDECU_XIX_SoC_XIX_BMC_HV.Geltungsbereich_E3_1_2_Premium.RP_IF_DCDC_NV_Komponentenfehler_3_15_XIX_HVB_Fehlerausgabe_SecondaryOBDECU_XIX_SoC_XIX_BMC_HV.DE_DCDC_NV_Komponentenfehler_3_15, system-signal=DCDC_NV_Komponentenfehler_3_15}
        sender-receiver-to-signal-mapping={communication-direction=IN, data-element=HVB_Fehlerausgabe_SecondaryOBDECU_XIX_SoC_XIX_BMC_HV.Geltungsbereich_E3_1_2_Premium.RP_IF_DCDC_NV_Komponentenfehler_03_XIX_HVB_Fehlerausgabe_SecondaryOBDECU_XIX_SoC_XIX_BMC_HV.DE_DCDC_NV_Komponentenfehler_03, system-signal=DCDC_NV_Komponentenfehler_03}
        sender-receiver-to-signal-mapping={communication-direction=IN, data-element=HVB_Fehlerausgabe_SecondaryOBDECU_XIX_SoC_XIX_BMC_HV.Geltungsbereich_E3_1_2_Premium.RP_IF_DCDC_NV_Komponentenfehler_02_XIX_HVB_Fehlerausgabe_SecondaryOBDECU_XIX_SoC_XIX_BMC_HV.DE_DCDC_NV_Komponentenfehler_02, system-signal=DCDC_NV_Komponentenfehler_02}
        sender-receiver-to-signal-mapping={communication-direction=IN, data-element=HVB_Fehlerausgabe_SecondaryOBDECU_XIX_SoC_XIX_BMC_HV.Geltungsbereich_E3_1_2_Premium.RP_IF_DCDC_NV_Komponentenfehler_12_XIX_HVB_Fehlerausgabe_SecondaryOBDECU_XIX_SoC_XIX_BMC_HV.DE_DCDC_NV_Komponentenfehler_12, system-signal=DCDC_NV_Komponentenfehler_12}
        sender-receiver-to-signal-mapping={communication-direction=IN, data-element=HVB_Fehlerausgabe_SecondaryOBDECU_XIX_SoC_XIX_BMC_HV.Geltungsbereich_E3_1_2_Premium.RP_IF_DCDC_NV_Komponentenfehler_21_XIX_HVB_Fehlerausgabe_SecondaryOBDECU_XIX_SoC_XIX_BMC_HV.DE_DCDC_NV_Komponentenfehler_21, system-signal=DCDC_NV_Komponentenfehler_21}
        sender-receiver-to-signal-mapping={communication-direction=IN, data-element=HVB_Fehlerausgabe_SecondaryOBDECU_XIX_SoC_XIX_BMC_HV.Geltungsbereich_E3_1_2_Premium.RP_IF_DCDC_NV_Komponentenfehler_60_XIX_HVB_Fehlerausgabe_SecondaryOBDECU_XIX_SoC_XIX_BMC_HV.DE_DCDC_NV_Komponentenfehler_60, system-signal=DCDC_NV_Komponentenfehler_60}
        sender-receiver-to-signal-mapping={communication-direction=IN, data-element=HVB_Fehlerausgabe_SecondaryOBDECU_XIX_SoC_XIX_BMC_HV.Geltungsbereich_E3_1_2_Premium.RP_IF_DCDC_NV_Komponentenfehler_75_XIX_HVB_Fehlerausgabe_SecondaryOBDECU_XIX_SoC_XIX_BMC_HV.DE_DCDC_NV_Komponentenfehler_75, system-signal=DCDC_NV_Komponentenfehler_75}
        sender-receiver-to-signal-mapping={communication-direction=IN, data-element=HVB_Fehlerausgabe_SecondaryOBDECU_XIX_SoC_XIX_BMC_HV.Geltungsbereich_E3_1_2_Premium.RP_IF_DCDC_NV_Komponentenfehler_40_XIX_HVB_Fehlerausgabe_SecondaryOBDECU_XIX_SoC_XIX_BMC_HV.DE_DCDC_NV_Komponentenfehler_40, system-signal=DCDC_NV_Komponentenfehler_40}
        sender-receiver-to-signal-mapping={communication-direction=IN, data-element=HVB_Fehlerausgabe_SecondaryOBDECU_XIX_SoC_XIX_BMC_HV.Geltungsbereich_E3_1_2_Premium.RP_IF_DCDC_NV_Komponentenfehler_53_XIX_HVB_Fehlerausgabe_SecondaryOBDECU_XIX_SoC_XIX_BMC_HV.DE_DCDC_NV_Komponentenfehler_53, system-signal=DCDC_NV_Komponentenfehler_53}
        sender-receiver-to-signal-mapping={communication-direction=IN, data-element=HVB_Fehlerausgabe_SecondaryOBDECU_XIX_SoC_XIX_BMC_HV.Geltungsbereich_E3_1_2_Premium.RP_IF_DCDC_NV_Komponentenfehler_36_XIX_HVB_Fehlerausgabe_SecondaryOBDECU_XIX_SoC_XIX_BMC_HV.DE_DCDC_NV_Komponentenfehler_36, system-signal=DCDC_NV_Komponentenfehler_36}
        sender-receiver-to-signal-mapping={communication-direction=IN, data-element=HVB_Fehlerausgabe_SecondaryOBDECU_XIX_SoC_XIX_BMC_HV.Geltungsbereich_E3_1_2_Premium.RP_IF_DCDC_NV_Komponentenfehler_45_XIX_HVB_Fehlerausgabe_SecondaryOBDECU_XIX_SoC_XIX_BMC_HV.DE_DCDC_NV_Komponentenfehler_45, system-signal=DCDC_NV_Komponentenfehler_45}
        sender-receiver-to-signal-mapping={communication-direction=IN, data-element=HVB_Fehlerausgabe_SecondaryOBDECU_XIX_SoC_XIX_BMC_HV.Geltungsbereich_E3_1_2_Premium.RP_IF_DCDC_NV_Komponentenfehler_77_XIX_HVB_Fehlerausgabe_SecondaryOBDECU_XIX_SoC_XIX_BMC_HV.DE_DCDC_NV_Komponentenfehler_77, system-signal=DCDC_NV_Komponentenfehler_77}
        sender-receiver-to-signal-mapping={communication-direction=IN, data-element=HVB_Fehlerausgabe_SecondaryOBDECU_XIX_SoC_XIX_BMC_HV.Geltungsbereich_E3_1_2_Premium.RP_IF_DCDC_NV_Komponentenfehler_27_XIX_HVB_Fehlerausgabe_SecondaryOBDECU_XIX_SoC_XIX_BMC_HV.DE_DCDC_NV_Komponentenfehler_27, system-signal=DCDC_NV_Komponentenfehler_27}
        sender-receiver-to-signal-mapping={communication-direction=IN, data-element=HVB_Fehlerausgabe_SecondaryOBDECU_XIX_SoC_XIX_BMC_HV.Geltungsbereich_E3_1_2_Premium.RP_IF_DCDC_NV_Komponentenfehler_31_XIX_HVB_Fehlerausgabe_SecondaryOBDECU_XIX_SoC_XIX_BMC_HV.DE_DCDC_NV_Komponentenfehler_31, system-signal=DCDC_NV_Komponentenfehler_31}
        sender-receiver-to-signal-mapping={communication-direction=IN, data-element=HVB_Fehlerausgabe_SecondaryOBDECU_XIX_SoC_XIX_BMC_HV.Geltungsbereich_E3_1_2_Premium.RP_IF_DCDC_NV_Komponentenfehler_28_XIX_HVB_Fehlerausgabe_SecondaryOBDECU_XIX_SoC_XIX_BMC_HV.DE_DCDC_NV_Komponentenfehler_28, system-signal=DCDC_NV_Komponentenfehler_28}
        sender-receiver-to-signal-mapping={communication-direction=IN, data-element=HVB_Fehlerausgabe_SecondaryOBDECU_XIX_SoC_XIX_BMC_HV.Geltungsbereich_E3_1_2_Premium.RP_IF_DCDC_NV_Komponentenfehler_07_XIX_HVB_Fehlerausgabe_SecondaryOBDECU_XIX_SoC_XIX_BMC_HV.DE_DCDC_NV_Komponentenfehler_07, system-signal=DCDC_NV_Komponentenfehler_07}
        sender-receiver-to-signal-mapping={communication-direction=IN, data-element=HVB_Fehlerausgabe_SecondaryOBDECU_XIX_SoC_XIX_BMC_HV.Geltungsbereich_E3_1_2_Premium.RP_IF_DCDC_NV_Komponentenfehler_42_XIX_HVB_Fehlerausgabe_SecondaryOBDECU_XIX_SoC_XIX_BMC_HV.DE_DCDC_NV_Komponentenfehler_42, system-signal=DCDC_NV_Komponentenfehler_42}
        sender-receiver-to-signal-mapping={communication-direction=IN, data-element=HVB_Fehlerausgabe_SecondaryOBDECU_XIX_SoC_XIX_BMC_HV.Geltungsbereich_E3_1_2_Premium.RP_IF_DCDC_NV_Komponentenfehler_52_XIX_HVB_Fehlerausgabe_SecondaryOBDECU_XIX_SoC_XIX_BMC_HV.DE_DCDC_NV_Komponentenfehler_52, system-signal=DCDC_NV_Komponentenfehler_52}
        sender-receiver-to-signal-mapping={communication-direction=IN, data-element=HVB_Fehlerausgabe_SecondaryOBDECU_XIX_SoC_XIX_BMC_HV.Geltungsbereich_E3_1_2_Premium.RP_IF_DCDC_NV_Komponentenfehler_50_XIX_HVB_Fehlerausgabe_SecondaryOBDECU_XIX_SoC_XIX_BMC_HV.DE_DCDC_NV_Komponentenfehler_50, system-signal=DCDC_NV_Komponentenfehler_50}
        sender-receiver-to-signal-mapping={communication-direction=IN, data-element=HVB_Fehlerausgabe_SecondaryOBDECU_XIX_SoC_XIX_BMC_HV.Geltungsbereich_E3_1_2_Premium.RP_IF_DCDC_NV_Komponentenfehler_62_XIX_HVB_Fehlerausgabe_SecondaryOBDECU_XIX_SoC_XIX_BMC_HV.DE_DCDC_NV_Komponentenfehler_62, system-signal=DCDC_NV_Komponentenfehler_62}
        sender-receiver-to-signal-mapping={communication-direction=IN, data-element=HVB_Fehlerausgabe_SecondaryOBDECU_XIX_SoC_XIX_BMC_HV.Geltungsbereich_E3_1_2_Premium.RP_IF_DCDC_NV_Komponentenfehler_3_12_XIX_HVB_Fehlerausgabe_SecondaryOBDECU_XIX_SoC_XIX_BMC_HV.DE_DCDC_NV_Komponentenfehler_3_12, system-signal=DCDC_NV_Komponentenfehler_3_12}
        sender-receiver-to-signal-mapping={communication-direction=IN, data-element=HVB_Fehlerausgabe_SecondaryOBDECU_XIX_SoC_XIX_BMC_HV.Geltungsbereich_E3_1_2_Premium.RP_IF_DCDC_NV_Komponentenfehler_74_XIX_HVB_Fehlerausgabe_SecondaryOBDECU_XIX_SoC_XIX_BMC_HV.DE_DCDC_NV_Komponentenfehler_74, system-signal=DCDC_NV_Komponentenfehler_74}
        sender-receiver-to-signal-mapping={communication-direction=IN, data-element=HVB_Fehlerausgabe_SecondaryOBDECU_XIX_SoC_XIX_BMC_HV.Geltungsbereich_E3_1_2_Premium.RP_IF_DCDC_NV_Komponentenfehler_67_XIX_HVB_Fehlerausgabe_SecondaryOBDECU_XIX_SoC_XIX_BMC_HV.DE_DCDC_NV_Komponentenfehler_67, system-signal=DCDC_NV_Komponentenfehler_67}
        sender-receiver-to-signal-mapping={communication-direction=IN, data-element=HVB_Fehlerausgabe_SecondaryOBDECU_XIX_SoC_XIX_BMC_HV.Geltungsbereich_E3_1_2_Premium.RP_IF_DCDC_NV_Komponentenfehler_76_XIX_HVB_Fehlerausgabe_SecondaryOBDECU_XIX_SoC_XIX_BMC_HV.DE_DCDC_NV_Komponentenfehler_76, system-signal=DCDC_NV_Komponentenfehler_76}
        sender-receiver-to-signal-mapping={communication-direction=IN, data-element=HVB_Fehlerausgabe_SecondaryOBDECU_XIX_SoC_XIX_BMC_HV.Geltungsbereich_E3_1_2_Premium.RP_IF_DCDC_NV_Komponentenfehler_3_8_XIX_HVB_Fehlerausgabe_SecondaryOBDECU_XIX_SoC_XIX_BMC_HV.DE_DCDC_NV_Komponentenfehler_3_8, system-signal=DCDC_NV_Komponentenfehler_3_8}
        sender-receiver-to-signal-mapping={communication-direction=IN, data-element=HVB_Fehlerausgabe_SecondaryOBDECU_XIX_SoC_XIX_BMC_HV.Geltungsbereich_E3_1_2_Premium.RP_IF_DCDC_NV_Komponentenfehler_69_XIX_HVB_Fehlerausgabe_SecondaryOBDECU_XIX_SoC_XIX_BMC_HV.DE_DCDC_NV_Komponentenfehler_69, system-signal=DCDC_NV_Komponentenfehler_69}
        sender-receiver-to-signal-mapping={communication-direction=IN, data-element=HVB_Fehlerausgabe_SecondaryOBDECU_XIX_SoC_XIX_BMC_HV.Geltungsbereich_E3_1_2_Premium.RP_IF_DCDC_NV_Komponentenfehler_46_XIX_HVB_Fehlerausgabe_SecondaryOBDECU_XIX_SoC_XIX_BMC_HV.DE_DCDC_NV_Komponentenfehler_46, system-signal=DCDC_NV_Komponentenfehler_46}
        sender-receiver-to-signal-mapping={communication-direction=IN, data-element=HVB_Fehlerausgabe_SecondaryOBDECU_XIX_SoC_XIX_BMC_HV.Geltungsbereich_E3_1_2_Premium.RP_IF_DCDC_NV_Komponentenfehler_71_XIX_HVB_Fehlerausgabe_SecondaryOBDECU_XIX_SoC_XIX_BMC_HV.DE_DCDC_NV_Komponentenfehler_71, system-signal=DCDC_NV_Komponentenfehler_71}
        sender-receiver-to-signal-mapping={communication-direction=IN, data-element=HVB_Fehlerausgabe_SecondaryOBDECU_XIX_SoC_XIX_BMC_HV.Geltungsbereich_E3_1_2_Premium.RP_IF_DCDC_NV_Komponentenfehler_20_XIX_HVB_Fehlerausgabe_SecondaryOBDECU_XIX_SoC_XIX_BMC_HV.DE_DCDC_NV_Komponentenfehler_20, system-signal=DCDC_NV_Komponentenfehler_20}
        sender-receiver-to-signal-mapping={communication-direction=IN, data-element=HVB_Fehlerausgabe_SecondaryOBDECU_XIX_SoC_XIX_BMC_HV.Geltungsbereich_E3_1_2_Premium.RP_IF_DCDC_NV_Komponentenfehler_35_XIX_HVB_Fehlerausgabe_SecondaryOBDECU_XIX_SoC_XIX_BMC_HV.DE_DCDC_NV_Komponentenfehler_35, system-signal=DCDC_NV_Komponentenfehler_35}
        sender-receiver-to-signal-mapping={communication-direction=IN, data-element=HVB_Fehlerausgabe_SecondaryOBDECU_XIX_SoC_XIX_BMC_HV.Geltungsbereich_E3_1_2_Premium.RP_IF_DCDC_NV_Komponentenfehler_08_XIX_HVB_Fehlerausgabe_SecondaryOBDECU_XIX_SoC_XIX_BMC_HV.DE_DCDC_NV_Komponentenfehler_08, system-signal=DCDC_NV_Komponentenfehler_08}
        sender-receiver-to-signal-mapping={communication-direction=IN, data-element=HVB_Fehlerausgabe_SecondaryOBDECU_XIX_SoC_XIX_BMC_HV.Geltungsbereich_E3_1_2_Premium.RP_IF_DCDC_NV_Komponentenfehler_16_XIX_HVB_Fehlerausgabe_SecondaryOBDECU_XIX_SoC_XIX_BMC_HV.DE_DCDC_NV_Komponentenfehler_16, system-signal=DCDC_NV_Komponentenfehler_16}
        sender-receiver-to-signal-mapping={communication-direction=IN, data-element=HVB_Fehlerausgabe_SecondaryOBDECU_XIX_SoC_XIX_BMC_HV.Geltungsbereich_E3_1_2_Premium.RP_IF_DCDC_NV_Komponentenfehler_3_9_XIX_HVB_Fehlerausgabe_SecondaryOBDECU_XIX_SoC_XIX_BMC_HV.DE_DCDC_NV_Komponentenfehler_3_9, system-signal=DCDC_NV_Komponentenfehler_3_9}
        sender-receiver-to-signal-mapping={communication-direction=IN, data-element=HVB_Fehlerausgabe_SecondaryOBDECU_XIX_SoC_XIX_BMC_HV.Geltungsbereich_E3_1_2_Premium.RP_IF_DCDC_NV_Komponentenfehler_06_XIX_HVB_Fehlerausgabe_SecondaryOBDECU_XIX_SoC_XIX_BMC_HV.DE_DCDC_NV_Komponentenfehler_06, system-signal=DCDC_NV_Komponentenfehler_06}
        sender-receiver-to-signal-mapping={communication-direction=IN, data-element=HVB_Fehlerausgabe_SecondaryOBDECU_XIX_SoC_XIX_BMC_HV.Geltungsbereich_E3_1_2_Premium.RP_IF_DCDC_NV_Komponentenfehler_80_XIX_HVB_Fehlerausgabe_SecondaryOBDECU_XIX_SoC_XIX_BMC_HV.DE_DCDC_NV_Komponentenfehler_80, system-signal=DCDC_NV_Komponentenfehler_80}
        sender-receiver-to-signal-mapping={communication-direction=IN, data-element=HVB_Fehlerausgabe_SecondaryOBDECU_XIX_SoC_XIX_BMC_HV.Geltungsbereich_E3_1_2_Premium.RP_IF_DCDC_NV_Komponentenfehler_24_XIX_HVB_Fehlerausgabe_SecondaryOBDECU_XIX_SoC_XIX_BMC_HV.DE_DCDC_NV_Komponentenfehler_24, system-signal=DCDC_NV_Komponentenfehler_24}
        sender-receiver-to-signal-mapping={communication-direction=IN, data-element=HVB_Fehlerausgabe_SecondaryOBDECU_XIX_SoC_XIX_BMC_HV.Geltungsbereich_E3_1_2_Premium.RP_IF_DCDC_NV_Komponentenfehler_56_XIX_HVB_Fehlerausgabe_SecondaryOBDECU_XIX_SoC_XIX_BMC_HV.DE_DCDC_NV_Komponentenfehler_56, system-signal=DCDC_NV_Komponentenfehler_56}
        sender-receiver-to-signal-mapping={communication-direction=IN, data-element=HVB_Fehlerausgabe_SecondaryOBDECU_XIX_SoC_XIX_BMC_HV.Geltungsbereich_E3_1_2_Premium.RP_IF_DCDC_NV_Komponentenfehler_64_XIX_HVB_Fehlerausgabe_SecondaryOBDECU_XIX_SoC_XIX_BMC_HV.DE_DCDC_NV_Komponentenfehler_64, system-signal=DCDC_NV_Komponentenfehler_64}
        sender-receiver-to-signal-mapping={communication-direction=IN, data-element=HVB_Fehlerausgabe_SecondaryOBDECU_XIX_SoC_XIX_BMC_HV.Geltungsbereich_E3_1_2_Premium.RP_IF_DCDC_NV_Komponentenfehler_22_XIX_HVB_Fehlerausgabe_SecondaryOBDECU_XIX_SoC_XIX_BMC_HV.DE_DCDC_NV_Komponentenfehler_22, system-signal=DCDC_NV_Komponentenfehler_22}
        sender-receiver-to-signal-mapping={communication-direction=IN, data-element=HVB_Fehlerausgabe_SecondaryOBDECU_XIX_SoC_XIX_BMC_HV.Geltungsbereich_E3_1_2_Premium.RP_IF_DCDC_NV_Komponentenfehler_33_XIX_HVB_Fehlerausgabe_SecondaryOBDECU_XIX_SoC_XIX_BMC_HV.DE_DCDC_NV_Komponentenfehler_33, system-signal=DCDC_NV_Komponentenfehler_33}
        sender-receiver-to-signal-mapping={communication-direction=IN, data-element=HVB_Fehlerausgabe_SecondaryOBDECU_XIX_SoC_XIX_BMC_HV.Geltungsbereich_E3_1_2_Premium.RP_IF_DCDC_NV_Komponentenfehler_3_13_XIX_HVB_Fehlerausgabe_SecondaryOBDECU_XIX_SoC_XIX_BMC_HV.DE_DCDC_NV_Komponentenfehler_3_13, system-signal=DCDC_NV_Komponentenfehler_3_13}
        sender-receiver-to-signal-mapping={communication-direction=IN, data-element=HVB_Fehlerausgabe_SecondaryOBDECU_XIX_SoC_XIX_BMC_HV.Geltungsbereich_E3_1_2_Premium.RP_IF_DCDC_NV_Komponentenfehler_3_5_XIX_HVB_Fehlerausgabe_SecondaryOBDECU_XIX_SoC_XIX_BMC_HV.DE_DCDC_NV_Komponentenfehler_3_5, system-signal=DCDC_NV_Komponentenfehler_3_5}
        sender-receiver-to-signal-mapping={communication-direction=IN, data-element=HVB_Fehlerausgabe_SecondaryOBDECU_XIX_SoC_XIX_BMC_HV.Geltungsbereich_E3_1_2_Premium.RP_IF_DCDC_NV_Komponentenfehler_49_XIX_HVB_Fehlerausgabe_SecondaryOBDECU_XIX_SoC_XIX_BMC_HV.DE_DCDC_NV_Komponentenfehler_49, system-signal=DCDC_NV_Komponentenfehler_49}
        sender-receiver-to-signal-mapping={communication-direction=IN, data-element=HVB_Fehlerausgabe_SecondaryOBDECU_XIX_SoC_XIX_BMC_HV.Geltungsbereich_E3_1_2_Premium.RP_IF_DCDC_NV_Komponentenfehler_3_4_XIX_HVB_Fehlerausgabe_SecondaryOBDECU_XIX_SoC_XIX_BMC_HV.DE_DCDC_NV_Komponentenfehler_3_4, system-signal=DCDC_NV_Komponentenfehler_3_4}
        sender-receiver-to-signal-mapping={communication-direction=IN, data-element=HVB_Fehlerausgabe_SecondaryOBDECU_XIX_SoC_XIX_BMC_HV.Geltungsbereich_E3_1_2_Premium.RP_IF_DCDC_NV_Komponentenfehler_3_11_XIX_HVB_Fehlerausgabe_SecondaryOBDECU_XIX_SoC_XIX_BMC_HV.DE_DCDC_NV_Komponentenfehler_3_11, system-signal=DCDC_NV_Komponentenfehler_3_11}
        sender-receiver-to-signal-mapping={communication-direction=IN, data-element=HVB_Fehlerausgabe_SecondaryOBDECU_XIX_SoC_XIX_BMC_HV.Geltungsbereich_E3_1_2_Premium.RP_IF_DCDC_NV_Komponentenfehler_70_XIX_HVB_Fehlerausgabe_SecondaryOBDECU_XIX_SoC_XIX_BMC_HV.DE_DCDC_NV_Komponentenfehler_70, system-signal=DCDC_NV_Komponentenfehler_70}
        sender-receiver-to-signal-mapping={communication-direction=IN, data-element=HVB_Fehlerausgabe_SecondaryOBDECU_XIX_SoC_XIX_BMC_HV.Geltungsbereich_E3_1_2_Premium.RP_IF_DCDC_NV_Komponentenfehler_73_XIX_HVB_Fehlerausgabe_SecondaryOBDECU_XIX_SoC_XIX_BMC_HV.DE_DCDC_NV_Komponentenfehler_73, system-signal=DCDC_NV_Komponentenfehler_73}
        sender-receiver-to-signal-mapping={communication-direction=IN, data-element=HVB_Fehlerausgabe_SecondaryOBDECU_XIX_SoC_XIX_BMC_HV.Geltungsbereich_E3_1_2_Premium.RP_IF_DCDC_NV_Komponentenfehler_57_XIX_HVB_Fehlerausgabe_SecondaryOBDECU_XIX_SoC_XIX_BMC_HV.DE_DCDC_NV_Komponentenfehler_57, system-signal=DCDC_NV_Komponentenfehler_57}
        sender-receiver-to-signal-mapping={communication-direction=IN, data-element=HVB_Fehlerausgabe_SecondaryOBDECU_XIX_SoC_XIX_BMC_HV.Geltungsbereich_E3_1_2_Premium.RP_IF_DCDC_NV_Komponentenfehler_78_XIX_HVB_Fehlerausgabe_SecondaryOBDECU_XIX_SoC_XIX_BMC_HV.DE_DCDC_NV_Komponentenfehler_78, system-signal=DCDC_NV_Komponentenfehler_78}
        sender-receiver-to-signal-mapping={communication-direction=IN, data-element=HVB_Fehlerausgabe_SecondaryOBDECU_XIX_SoC_XIX_BMC_HV.Geltungsbereich_E3_1_2_Premium.RP_IF_DCDC_NV_Komponentenfehler_68_XIX_HVB_Fehlerausgabe_SecondaryOBDECU_XIX_SoC_XIX_BMC_HV.DE_DCDC_NV_Komponentenfehler_68, system-signal=DCDC_NV_Komponentenfehler_68}
        sender-receiver-to-signal-mapping={communication-direction=IN, data-element=HVB_Fehlerausgabe_SecondaryOBDECU_XIX_SoC_XIX_BMC_HV.Geltungsbereich_E3_1_2_Premium.RP_IF_DCDC_NV_Komponentenfehler_66_XIX_HVB_Fehlerausgabe_SecondaryOBDECU_XIX_SoC_XIX_BMC_HV.DE_DCDC_NV_Komponentenfehler_66, system-signal=DCDC_NV_Komponentenfehler_66}
        sender-receiver-to-signal-mapping={communication-direction=IN, data-element=HVB_Fehlerausgabe_SecondaryOBDECU_XIX_SoC_XIX_BMC_HV.Geltungsbereich_E3_1_2_Premium.RP_IF_DCDC_NV_Komponentenfehler_44_XIX_HVB_Fehlerausgabe_SecondaryOBDECU_XIX_SoC_XIX_BMC_HV.DE_DCDC_NV_Komponentenfehler_44, system-signal=DCDC_NV_Komponentenfehler_44}
        sender-receiver-to-signal-mapping={communication-direction=IN, data-element=HVB_Fehlerausgabe_SecondaryOBDECU_XIX_SoC_XIX_BMC_HV.Geltungsbereich_E3_1_2_Premium.RP_IF_DCDC_NV_Komponentenfehler_19_XIX_HVB_Fehlerausgabe_SecondaryOBDECU_XIX_SoC_XIX_BMC_HV.DE_DCDC_NV_Komponentenfehler_19, system-signal=DCDC_NV_Komponentenfehler_19}
        sender-receiver-to-signal-mapping={communication-direction=IN, data-element=HVB_Fehlerausgabe_SecondaryOBDECU_XIX_SoC_XIX_BMC_HV.Geltungsbereich_E3_1_2_Premium.RP_IF_DCDC_NV_Komponentenfehler_55_XIX_HVB_Fehlerausgabe_SecondaryOBDECU_XIX_SoC_XIX_BMC_HV.DE_DCDC_NV_Komponentenfehler_55, system-signal=DCDC_NV_Komponentenfehler_55}
        sender-receiver-to-signal-mapping={communication-direction=IN, data-element=HVB_Fehlerausgabe_SecondaryOBDECU_XIX_SoC_XIX_BMC_HV.Geltungsbereich_E3_1_2_Premium.RP_IF_DCDC_NV_Komponentenfehler_04_XIX_HVB_Fehlerausgabe_SecondaryOBDECU_XIX_SoC_XIX_BMC_HV.DE_DCDC_NV_Komponentenfehler_04, system-signal=DCDC_NV_Komponentenfehler_04}
        sender-receiver-to-signal-mapping={communication-direction=IN, data-element=HVB_Fehlerausgabe_SecondaryOBDECU_XIX_SoC_XIX_BMC_HV.Geltungsbereich_E3_1_2_Premium.RP_IF_DCDC_NV_Komponentenfehler_54_XIX_HVB_Fehlerausgabe_SecondaryOBDECU_XIX_SoC_XIX_BMC_HV.DE_DCDC_NV_Komponentenfehler_54, system-signal=DCDC_NV_Komponentenfehler_54}
        sender-receiver-to-signal-mapping={communication-direction=IN, data-element=HVB_Fehlerausgabe_SecondaryOBDECU_XIX_SoC_XIX_BMC_HV.Geltungsbereich_E3_1_2_Premium.RP_IF_DCDC_NV_Komponentenfehler_10_XIX_HVB_Fehlerausgabe_SecondaryOBDECU_XIX_SoC_XIX_BMC_HV.DE_DCDC_NV_Komponentenfehler_10, system-signal=DCDC_NV_Komponentenfehler_10}
        sender-receiver-to-signal-mapping={communication-direction=IN, data-element=HVB_Fehlerausgabe_SecondaryOBDECU_XIX_SoC_XIX_BMC_HV.Geltungsbereich_E3_1_2_Premium.RP_IF_DCDC_NV_Komponentenfehler_25_XIX_HVB_Fehlerausgabe_SecondaryOBDECU_XIX_SoC_XIX_BMC_HV.DE_DCDC_NV_Komponentenfehler_25, system-signal=DCDC_NV_Komponentenfehler_25}
        sender-receiver-to-signal-mapping={communication-direction=IN, data-element=HVB_Fehlerausgabe_SecondaryOBDECU_XIX_SoC_XIX_BMC_HV.Geltungsbereich_E3_1_2_Premium.RP_IF_DCDC_NV_Komponentenfehler_18_XIX_HVB_Fehlerausgabe_SecondaryOBDECU_XIX_SoC_XIX_BMC_HV.DE_DCDC_NV_Komponentenfehler_18, system-signal=DCDC_NV_Komponentenfehler_18}
        sender-receiver-to-signal-mapping={communication-direction=IN, data-element=HVB_Fehlerausgabe_SecondaryOBDECU_XIX_SoC_XIX_BMC_HV.Geltungsbereich_E3_1_2_Premium.RP_IF_DCDC_NV_Komponentenfehler_3_10_XIX_HVB_Fehlerausgabe_SecondaryOBDECU_XIX_SoC_XIX_BMC_HV.DE_DCDC_NV_Komponentenfehler_3_10, system-signal=DCDC_NV_Komponentenfehler_3_10}
        sender-receiver-to-signal-mapping={communication-direction=IN, data-element=HVB_Fehlerausgabe_SecondaryOBDECU_XIX_SoC_XIX_BMC_HV.Geltungsbereich_E3_1_2_Premium.RP_IF_DCDC_NV_Komponentenfehler_14_XIX_HVB_Fehlerausgabe_SecondaryOBDECU_XIX_SoC_XIX_BMC_HV.DE_DCDC_NV_Komponentenfehler_14, system-signal=DCDC_NV_Komponentenfehler_14}
        sender-receiver-to-signal-mapping={communication-direction=IN, data-element=HVB_Fehlerausgabe_SecondaryOBDECU_XIX_SoC_XIX_BMC_HV.Geltungsbereich_E3_1_2_Premium.RP_IF_DCDC_NV_Komponentenfehler_3_6_XIX_HVB_Fehlerausgabe_SecondaryOBDECU_XIX_SoC_XIX_BMC_HV.DE_DCDC_NV_Komponentenfehler_3_6, system-signal=DCDC_NV_Komponentenfehler_3_6}
        sender-receiver-to-signal-mapping={communication-direction=IN, data-element=HVB_Fehlerausgabe_SecondaryOBDECU_XIX_SoC_XIX_BMC_HV.Geltungsbereich_E3_1_2_Premium.RP_IF_DCDC_NV_Komponentenfehler_47_XIX_HVB_Fehlerausgabe_SecondaryOBDECU_XIX_SoC_XIX_BMC_HV.DE_DCDC_NV_Komponentenfehler_47, system-signal=DCDC_NV_Komponentenfehler_47}
        sender-receiver-to-signal-mapping={communication-direction=IN, data-element=HVB_Fehlerausgabe_SecondaryOBDECU_XIX_SoC_XIX_BMC_HV.Geltungsbereich_E3_1_2_Premium.RP_IF_DCDC_NV_Komponentenfehler_39_XIX_HVB_Fehlerausgabe_SecondaryOBDECU_XIX_SoC_XIX_BMC_HV.DE_DCDC_NV_Komponentenfehler_39, system-signal=DCDC_NV_Komponentenfehler_39}
        sender-receiver-to-signal-mapping={communication-direction=IN, data-element=HVB_Fehlerausgabe_SecondaryOBDECU_XIX_SoC_XIX_BMC_HV.Geltungsbereich_E3_1_2_Premium.RP_IF_DCDC_NV_Komponentenfehler_3_14_XIX_HVB_Fehlerausgabe_SecondaryOBDECU_XIX_SoC_XIX_BMC_HV.DE_DCDC_NV_Komponentenfehler_3_14, system-signal=DCDC_NV_Komponentenfehler_3_14}
        sender-receiver-to-signal-mapping={communication-direction=IN, data-element=HVB_Fehlerausgabe_SecondaryOBDECU_XIX_SoC_XIX_BMC_HV.Geltungsbereich_E3_1_2_Premium.RP_IF_DCDC_NV_Komponentenfehler_37_XIX_HVB_Fehlerausgabe_SecondaryOBDECU_XIX_SoC_XIX_BMC_HV.DE_DCDC_NV_Komponentenfehler_37, system-signal=DCDC_NV_Komponentenfehler_37}
        sender-receiver-to-signal-mapping={communication-direction=IN, data-element=HVB_Fehlerausgabe_SecondaryOBDECU_XIX_SoC_XIX_BMC_HV.Geltungsbereich_E3_1_2_Premium.RP_IF_DCDC_NV_Komponentenfehler_3_2_XIX_HVB_Fehlerausgabe_SecondaryOBDECU_XIX_SoC_XIX_BMC_HV.DE_DCDC_NV_Komponentenfehler_3_2, system-signal=DCDC_NV_Komponentenfehler_3_2}
        sender-receiver-to-signal-mapping={communication-direction=IN, data-element=HVB_Fehlerausgabe_SecondaryOBDECU_XIX_SoC_XIX_BMC_HV.Geltungsbereich_E3_1_2_Premium.RP_IF_DCDC_NV_Komponentenfehler_58_XIX_HVB_Fehlerausgabe_SecondaryOBDECU_XIX_SoC_XIX_BMC_HV.DE_DCDC_NV_Komponentenfehler_58, system-signal=DCDC_NV_Komponentenfehler_58}
        sender-receiver-to-signal-mapping={communication-direction=IN, data-element=HVB_Fehlerausgabe_SecondaryOBDECU_XIX_SoC_XIX_BMC_HV.Geltungsbereich_E3_1_2_Premium.RP_IF_DCDC_NV_Komponentenfehler_3_7_XIX_HVB_Fehlerausgabe_SecondaryOBDECU_XIX_SoC_XIX_BMC_HV.DE_DCDC_NV_Komponentenfehler_3_7, system-signal=DCDC_NV_Komponentenfehler_3_7}
        sender-receiver-to-signal-mapping={communication-direction=IN, data-element=HVB_Fehlerausgabe_SecondaryOBDECU_XIX_SoC_XIX_BMC_HV.Geltungsbereich_E3_1_2_Premium.RP_IF_DCDC_NV_Komponentenfehler_61_XIX_HVB_Fehlerausgabe_SecondaryOBDECU_XIX_SoC_XIX_BMC_HV.DE_DCDC_NV_Komponentenfehler_61, system-signal=DCDC_NV_Komponentenfehler_61}
        sender-receiver-to-signal-mapping={communication-direction=IN, data-element=HVB_Fehlerausgabe_SecondaryOBDECU_XIX_SoC_XIX_BMC_HV.Geltungsbereich_E3_1_2_Premium.RP_IF_DCDC_NV_Komponentenfehler_72_XIX_HVB_Fehlerausgabe_SecondaryOBDECU_XIX_SoC_XIX_BMC_HV.DE_DCDC_NV_Komponentenfehler_72, system-signal=DCDC_NV_Komponentenfehler_72}
        sender-receiver-to-signal-mapping={communication-direction=IN, data-element=HVB_Fehlerausgabe_SecondaryOBDECU_XIX_SoC_XIX_BMC_HV.Geltungsbereich_E3_1_2_Premium.RP_IF_DCDC_NV_Komponentenfehler_43_XIX_HVB_Fehlerausgabe_SecondaryOBDECU_XIX_SoC_XIX_BMC_HV.DE_DCDC_NV_Komponentenfehler_43, system-signal=DCDC_NV_Komponentenfehler_43}
        sender-receiver-to-signal-mapping={communication-direction=IN, data-element=HVB_Fehlerausgabe_SecondaryOBDECU_XIX_SoC_XIX_BMC_HV.Geltungsbereich_E3_1_2_Premium.RP_IF_DCDC_NV_Komponentenfehler_65_XIX_HVB_Fehlerausgabe_SecondaryOBDECU_XIX_SoC_XIX_BMC_HV.DE_DCDC_NV_Komponentenfehler_65, system-signal=DCDC_NV_Komponentenfehler_65}
        sender-receiver-to-signal-mapping={communication-direction=IN, data-element=HVB_Fehlerausgabe_SecondaryOBDECU_XIX_SoC_XIX_BMC_HV.Geltungsbereich_E3_1_2_Premium.RP_IF_DCDC_NV_Komponentenfehler_17_XIX_HVB_Fehlerausgabe_SecondaryOBDECU_XIX_SoC_XIX_BMC_HV.DE_DCDC_NV_Komponentenfehler_17, system-signal=DCDC_NV_Komponentenfehler_17}
        sender-receiver-to-signal-mapping={communication-direction=IN, data-element=HVB_Fehlerausgabe_SecondaryOBDECU_XIX_SoC_XIX_BMC_HV.Geltungsbereich_E3_1_2_Premium.RP_IF_DCDC_NV_Komponentenfehler_01_XIX_HVB_Fehlerausgabe_SecondaryOBDECU_XIX_SoC_XIX_BMC_HV.DE_DCDC_NV_Komponentenfehler_01, system-signal=DCDC_NV_Komponentenfehler_01}
        sender-receiver-to-signal-mapping={communication-direction=IN, data-element=HVB_Fehlerausgabe_SecondaryOBDECU_XIX_SoC_XIX_BMC_HV.Geltungsbereich_E3_1_2_Premium.RP_IF_DCDC_NV_Komponentenfehler_30_XIX_HVB_Fehlerausgabe_SecondaryOBDECU_XIX_SoC_XIX_BMC_HV.DE_DCDC_NV_Komponentenfehler_30, system-signal=DCDC_NV_Komponentenfehler_30}
        sender-receiver-to-signal-mapping={communication-direction=IN, data-element=HVB_Fehlerausgabe_SecondaryOBDECU_XIX_SoC_XIX_BMC_HV.Geltungsbereich_E3_1_2_Premium.RP_IF_DCDC_NV_Komponentenfehler_09_XIX_HVB_Fehlerausgabe_SecondaryOBDECU_XIX_SoC_XIX_BMC_HV.DE_DCDC_NV_Komponentenfehler_09, system-signal=DCDC_NV_Komponentenfehler_09}
        sender-receiver-to-signal-mapping={communication-direction=IN, data-element=HVB_Fehlerausgabe_SecondaryOBDECU_XIX_SoC_XIX_BMC_HV.Geltungsbereich_E3_1_2_Premium.RP_IF_DCDC_NV_Komponentenfehler_3_16_XIX_HVB_Fehlerausgabe_SecondaryOBDECU_XIX_SoC_XIX_BMC_HV.DE_DCDC_NV_Komponentenfehler_3_16, system-signal=DCDC_NV_Komponentenfehler_3_16}
        sender-receiver-to-signal-mapping={communication-direction=IN, data-element=HVB_Fehlerausgabe_SecondaryOBDECU_XIX_SoC_XIX_BMC_HV.Geltungsbereich_E3_1_2_Premium.RP_IF_DCDC_NV_Komponentenfehler_59_XIX_HVB_Fehlerausgabe_SecondaryOBDECU_XIX_SoC_XIX_BMC_HV.DE_DCDC_NV_Komponentenfehler_59, system-signal=DCDC_NV_Komponentenfehler_59}
        sender-receiver-to-signal-mapping={communication-direction=IN, data-element=HVB_Fehlerausgabe_SecondaryOBDECU_XIX_SoC_XIX_BMC_HV.Geltungsbereich_E3_1_2_Premium.RP_IF_DCDC_NV_Komponentenfehler_13_XIX_HVB_Fehlerausgabe_SecondaryOBDECU_XIX_SoC_XIX_BMC_HV.DE_DCDC_NV_Komponentenfehler_13, system-signal=DCDC_NV_Komponentenfehler_13}
        sender-receiver-to-signal-mapping={communication-direction=IN, data-element=HVB_Fehlerausgabe_SecondaryOBDECU_XIX_SoC_XIX_BMC_HV.Geltungsbereich_E3_1_2_Premium.RP_IF_DCDC_NV_Komponentenfehler_38_XIX_HVB_Fehlerausgabe_SecondaryOBDECU_XIX_SoC_XIX_BMC_HV.DE_DCDC_NV_Komponentenfehler_38, system-signal=DCDC_NV_Komponentenfehler_38}
        sender-receiver-to-signal-mapping={communication-direction=IN, data-element=HVB_Fehlerausgabe_SecondaryOBDECU_XIX_SoC_XIX_BMC_HV.Geltungsbereich_E3_1_2_Premium.RP_IF_DCDC_NV_Komponentenfehler_48_XIX_HVB_Fehlerausgabe_SecondaryOBDECU_XIX_SoC_XIX_BMC_HV.DE_DCDC_NV_Komponentenfehler_48, system-signal=DCDC_NV_Komponentenfehler_48}
        sender-receiver-to-signal-mapping={communication-direction=IN, data-element=HVB_Fehlerausgabe_SecondaryOBDECU_XIX_SoC_XIX_BMC_HV.Geltungsbereich_E3_1_2_Premium.RP_IF_DCDC_NV_Komponentenfehler_05_XIX_HVB_Fehlerausgabe_SecondaryOBDECU_XIX_SoC_XIX_BMC_HV.DE_DCDC_NV_Komponentenfehler_05, system-signal=DCDC_NV_Komponentenfehler_05}
        sender-receiver-to-signal-mapping={communication-direction=IN, data-element=HVB_Fehlerausgabe_SecondaryOBDECU_XIX_SoC_XIX_BMC_HV.Geltungsbereich_E3_1_2_Premium.RP_IF_DCDC_NV_Komponentenfehler_15_XIX_HVB_Fehlerausgabe_SecondaryOBDECU_XIX_SoC_XIX_BMC_HV.DE_DCDC_NV_Komponentenfehler_15, system-signal=DCDC_NV_Komponentenfehler_15}
        sender-receiver-to-signal-mapping={communication-direction=IN, data-element=HVB_Fehlerausgabe_SecondaryOBDECU_XIX_SoC_XIX_BMC_HV.Geltungsbereich_E3_1_2_Premium.RP_IF_DCDC_NV_Komponentenfehler_79_XIX_HVB_Fehlerausgabe_SecondaryOBDECU_XIX_SoC_XIX_BMC_HV.DE_DCDC_NV_Komponentenfehler_79, system-signal=DCDC_NV_Komponentenfehler_79}
        sender-receiver-to-signal-mapping={communication-direction=IN, data-element=HVB_Fehlerausgabe_SecondaryOBDECU_XIX_SoC_XIX_BMC_HV.Geltungsbereich_E3_1_2_Premium.RP_IF_DCDC_NV_Komponentenfehler_32_XIX_HVB_Fehlerausgabe_SecondaryOBDECU_XIX_SoC_XIX_BMC_HV.DE_DCDC_NV_Komponentenfehler_32, system-signal=DCDC_NV_Komponentenfehler_32}
        sender-receiver-to-signal-mapping={communication-direction=IN, data-element=HVB_Fehlerausgabe_SecondaryOBDECU_XIX_SoC_XIX_BMC_HV.Geltungsbereich_E3_1_2_Premium.RP_IF_DCDC_NV_Komponentenfehler_29_XIX_HVB_Fehlerausgabe_SecondaryOBDECU_XIX_SoC_XIX_BMC_HV.DE_DCDC_NV_Komponentenfehler_29, system-signal=DCDC_NV_Komponentenfehler_29}
        sender-receiver-to-signal-mapping={communication-direction=IN, data-element=HVB_Fehlerausgabe_SecondaryOBDECU_XIX_SoC_XIX_BMC_HV.Geltungsbereich_E3_1_2_Premium.RP_IF_DCDC_NV_Komponentenfehler_23_XIX_HVB_Fehlerausgabe_SecondaryOBDECU_XIX_SoC_XIX_BMC_HV.DE_DCDC_NV_Komponentenfehler_23, system-signal=DCDC_NV_Komponentenfehler_23}
        sender-receiver-to-signal-mapping={communication-direction=IN, data-element=HVB_Fehlerausgabe_SecondaryOBDECU_XIX_SoC_XIX_BMC_HV.Geltungsbereich_E3_1_2_Premium.RP_IF_DCDC_NV_Komponentenfehler_26_XIX_HVB_Fehlerausgabe_SecondaryOBDECU_XIX_SoC_XIX_BMC_HV.DE_DCDC_NV_Komponentenfehler_26, system-signal=DCDC_NV_Komponentenfehler_26}
        sender-receiver-to-signal-group-mapping={communication-direction=IN, data-element=BMC_SafetyDataStorage_XIX_SoC_XIX_BMC_HV.Geltungsbereich_E3_1_2_Premium.RP_IF_SG_BJB_11_XIX_BMC_SafetyDataStorage_XIX_SoC_XIX_BMC_HV.DE_SG_BJB_11, signal-group=SG_BJB_11, type-mapping=sender-rec-record-type-mapping=record-element-mappings=[{implementation-record-element=BJB_Uebertemperaturzaehler_CMC02, system-signal=BJB_Uebertemperaturzaehler_CMC02}, {implementation-record-element=BJB_Ueberspannungszaehler_CMC01, system-signal=BJB_Ueberspannungszaehler_CMC01}, {implementation-record-element=BJB_Sperrung_Ueberspannung, system-signal=BJB_Sperrung_Ueberspannung}, {implementation-record-element=BJB_Ueberspannungszaehler_CMC02, system-signal=BJB_Ueberspannungszaehler_CMC02}, {implementation-record-element=BJB_Uebertemperaturzaehler_CMC01, system-signal=BJB_Uebertemperaturzaehler_CMC01}, {implementation-record-element=BJB_11_CRC, system-signal=BJB_11_CRC}, {implementation-record-element=BJB_11_BZ, system-signal=BJB_11_BZ}]}
        sender-receiver-to-signal-group-mapping={communication-direction=IN, data-element=BMC_SafetyDataStorage_XIX_SoC_XIX_BMC_HV.Geltungsbereich_E3_1_2_Premium.RP_IF_SG_BJB_10_XIX_BMC_SafetyDataStorage_XIX_SoC_XIX_BMC_HV.DE_SG_BJB_10, signal-group=SG_BJB_10, type-mapping=sender-rec-record-type-mapping=record-element-mappings=[{implementation-record-element=BJB_Lebensdauer_Trennelemente, system-signal=BJB_Lebensdauer_Trennelemente}, {implementation-record-element=BJB_Sperrung_Unterspannung, system-signal=BJB_Sperrung_Unterspannung}, {implementation-record-element=BJB_Status_Trennelemente, system-signal=BJB_Status_Trennelemente}, {implementation-record-element=BJB_Status_HV_Spannungssensorik, system-signal=BJB_Status_HV_Spannungssensorik}, {implementation-record-element=BJB_10_CRC, system-signal=BJB_10_CRC}, {implementation-record-element=BJB_10_BZ, system-signal=BJB_10_BZ}]}
        sender-receiver-to-signal-group-mapping={communication-direction=IN, data-element=BMC_SafetyDataStorage_XIX_SoC_XIX_BMC_HV.Geltungsbereich_E3_1_2_Premium.RP_IF_SG_BJB_12_XIX_BMC_SafetyDataStorage_XIX_SoC_XIX_BMC_HV.DE_SG_BJB_12, signal-group=SG_BJB_12, type-mapping=sender-rec-record-type-mapping=record-element-mappings=[{implementation-record-element=BJB_Ueberspannungszaehler_CMC04, system-signal=BJB_Ueberspannungszaehler_CMC04}, {implementation-record-element=BJB_Uebertemperaturzaehler_CMC03, system-signal=BJB_Uebertemperaturzaehler_CMC03}, {implementation-record-element=BJB_Ueberspannungszaehler_CMC03, system-signal=BJB_Ueberspannungszaehler_CMC03}, {implementation-record-element=BJB_Sperrung_Uebertemperatur, system-signal=BJB_Sperrung_Uebertemperatur}, {implementation-record-element=BJB_Uebertemperaturzaehler_CMC04, system-signal=BJB_Uebertemperaturzaehler_CMC04}, {implementation-record-element=BJB_12_CRC, system-signal=BJB_12_CRC}, {implementation-record-element=BJB_12_BZ, system-signal=BJB_12_BZ}]}
        sender-receiver-to-signal-group-mapping={communication-direction=IN, data-element=BMC_SafetyDataStorage_XIX_SoC_XIX_BMC_HV.Geltungsbereich_E3_1_2_Premium.RP_IF_SG_BJB_13_XIX_BMC_SafetyDataStorage_XIX_SoC_XIX_BMC_HV.DE_SG_BJB_13, signal-group=SG_BJB_13, type-mapping=sender-rec-record-type-mapping=record-element-mappings=[{implementation-record-element=BJB_Unterspannungszaehler_CMC03, system-signal=BJB_Unterspannungszaehler_CMC03}, {implementation-record-element=BJB_Unterspannungszaehler_CMC01, system-signal=BJB_Unterspannungszaehler_CMC01}, {implementation-record-element=BJB_Unterspannungszaehler_CMC02, system-signal=BJB_Unterspannungszaehler_CMC02}, {implementation-record-element=BJB_Unterspannungszaehler_CMC04, system-signal=BJB_Unterspannungszaehler_CMC04}, {implementation-record-element=BJB_13_CRC, system-signal=BJB_13_CRC}, {implementation-record-element=BJB_13_BZ, system-signal=BJB_13_BZ}]}
        sender-receiver-to-signal-mapping={communication-direction=OUT, data-element=BMC_SafetyDataStorage_XIX_SoC_XIX_BMC_HV.Geltungsbereich_E3_1_2_Premium.SP_IF_BMC_Lebensdauer_Trennelemente_XIX_BMC_SafetyDataStorage_XIX_SoC_XIX_BMC_HV.DE_BMC_Lebensdauer_Trennelemente, system-signal=BMC_Lebensdauer_Trennelemente}
        sender-receiver-to-signal-mapping={communication-direction=OUT, data-element=BMC_SafetyDataStorage_XIX_SoC_XIX_BMC_HV.Geltungsbereich_E3_1_2_Premium.SP_IF_BMC_HV_10_BZ_XIX_BMC_SafetyDataStorage_XIX_SoC_XIX_BMC_HV.DE_BMC_HV_10_BZ, system-signal=BMC_HV_10_BZ}
        sender-receiver-to-signal-mapping={communication-direction=OUT, data-element=BMC_SafetyDataStorage_XIX_SoC_XIX_BMC_HV.Geltungsbereich_E3_1_2_Premium.SP_IF_BMC_Status_Trennelemente_XIX_BMC_SafetyDataStorage_XIX_SoC_XIX_BMC_HV.DE_BMC_Status_Trennelemente, system-signal=BMC_Status_Trennelemente}
        sender-receiver-to-signal-mapping={communication-direction=OUT, data-element=BMC_SafetyDataStorage_XIX_SoC_XIX_BMC_HV.Geltungsbereich_E3_1_2_Premium.SP_IF_BMC_Status_HV_Spannungssensorik_XIX_BMC_SafetyDataStorage_XIX_SoC_XIX_BMC_HV.DE_BMC_Status_HV_Spannungssensorik, system-signal=BMC_Status_HV_Spannungssensorik}
        sender-receiver-to-signal-mapping={communication-direction=OUT, data-element=BMC_SafetyDataStorage_XIX_SoC_XIX_BMC_HV.Geltungsbereich_E3_1_2_Premium.SP_IF_BMC_HV_10_CRC_XIX_BMC_SafetyDataStorage_XIX_SoC_XIX_BMC_HV.DE_BMC_HV_10_CRC, system-signal=BMC_HV_10_CRC}
        sender-receiver-to-signal-mapping={communication-direction=OUT, data-element=BMC_SafetyDataStorage_XIX_SoC_XIX_BMC_HV.Geltungsbereich_E3_1_2_Premium.SP_IF_BMC_Sperrung_Unterspannung_XIX_BMC_SafetyDataStorage_XIX_SoC_XIX_BMC_HV.DE_BMC_Sperrung_Unterspannung, system-signal=BMC_Sperrung_Unterspannung}
        sender-receiver-to-signal-mapping={communication-direction=OUT, data-element=BMC_SafetyDataStorage_XIX_SoC_XIX_BMC_HV.Geltungsbereich_E3_1_2_Premium.SP_IF_BMC_Datenuebernahme_Anf_XIX_BMC_SafetyDataStorage_XIX_SoC_XIX_BMC_HV.DE_BMC_Datenuebernahme_Anf, system-signal=BMC_Datenuebernahme_Anf}
        sender-receiver-to-signal-mapping={communication-direction=OUT, data-element=BMC_SafetyDataStorage_XIX_SoC_XIX_BMC_HV.Geltungsbereich_E3_1_2_Premium.SP_IF_BMC_Uebertemperaturzaehler_CMC01_XIX_BMC_SafetyDataStorage_XIX_SoC_XIX_BMC_HV.DE_BMC_Uebertemperaturzaehler_CMC01, system-signal=BMC_Uebertemperaturzaehler_CMC01}
        sender-receiver-to-signal-mapping={communication-direction=OUT, data-element=BMC_SafetyDataStorage_XIX_SoC_XIX_BMC_HV.Geltungsbereich_E3_1_2_Premium.SP_IF_BMC_Ueberspannungszaehler_CMC04_XIX_BMC_SafetyDataStorage_XIX_SoC_XIX_BMC_HV.DE_BMC_Ueberspannungszaehler_CMC04, system-signal=BMC_Ueberspannungszaehler_CMC04}
        sender-receiver-to-signal-mapping={communication-direction=OUT, data-element=BMC_SafetyDataStorage_XIX_SoC_XIX_BMC_HV.Geltungsbereich_E3_1_2_Premium.SP_IF_BMC_Sperrung_Uebertemperatur_XIX_BMC_SafetyDataStorage_XIX_SoC_XIX_BMC_HV.DE_BMC_Sperrung_Uebertemperatur, system-signal=BMC_Sperrung_Uebertemperatur}
        sender-receiver-to-signal-mapping={communication-direction=OUT, data-element=BMC_SafetyDataStorage_XIX_SoC_XIX_BMC_HV.Geltungsbereich_E3_1_2_Premium.SP_IF_BMC_Uebertemperaturzaehler_CMC03_XIX_BMC_SafetyDataStorage_XIX_SoC_XIX_BMC_HV.DE_BMC_Uebertemperaturzaehler_CMC03, system-signal=BMC_Uebertemperaturzaehler_CMC03}
        sender-receiver-to-signal-mapping={communication-direction=OUT, data-element=BMC_SafetyDataStorage_XIX_SoC_XIX_BMC_HV.Geltungsbereich_E3_1_2_Premium.SP_IF_BMC_Ueberspannungszaehler_CMC01_XIX_BMC_SafetyDataStorage_XIX_SoC_XIX_BMC_HV.DE_BMC_Ueberspannungszaehler_CMC01, system-signal=BMC_Ueberspannungszaehler_CMC01}
        sender-receiver-to-signal-mapping={communication-direction=OUT, data-element=BMC_SafetyDataStorage_XIX_SoC_XIX_BMC_HV.Geltungsbereich_E3_1_2_Premium.SP_IF_BMC_Uebertemperaturzaehler_CMC02_XIX_BMC_SafetyDataStorage_XIX_SoC_XIX_BMC_HV.DE_BMC_Uebertemperaturzaehler_CMC02, system-signal=BMC_Uebertemperaturzaehler_CMC02}
        sender-receiver-to-signal-mapping={communication-direction=OUT, data-element=BMC_SafetyDataStorage_XIX_SoC_XIX_BMC_HV.Geltungsbereich_E3_1_2_Premium.SP_IF_BMC_HV_12_BZ_XIX_BMC_SafetyDataStorage_XIX_SoC_XIX_BMC_HV.DE_BMC_HV_12_BZ, system-signal=BMC_HV_12_BZ}
        sender-receiver-to-signal-mapping={communication-direction=OUT, data-element=BMC_SafetyDataStorage_XIX_SoC_XIX_BMC_HV.Geltungsbereich_E3_1_2_Premium.SP_IF_BMC_Ueberspannungszaehler_CMC02_XIX_BMC_SafetyDataStorage_XIX_SoC_XIX_BMC_HV.DE_BMC_Ueberspannungszaehler_CMC02, system-signal=BMC_Ueberspannungszaehler_CMC02}
        sender-receiver-to-signal-mapping={communication-direction=OUT, data-element=BMC_SafetyDataStorage_XIX_SoC_XIX_BMC_HV.Geltungsbereich_E3_1_2_Premium.SP_IF_BMC_Uebertemperaturzaehler_CMC04_XIX_BMC_SafetyDataStorage_XIX_SoC_XIX_BMC_HV.DE_BMC_Uebertemperaturzaehler_CMC04, system-signal=BMC_Uebertemperaturzaehler_CMC04}
        sender-receiver-to-signal-mapping={communication-direction=OUT, data-element=BMC_SafetyDataStorage_XIX_SoC_XIX_BMC_HV.Geltungsbereich_E3_1_2_Premium.SP_IF_BMC_Ueberspannungszaehler_CMC03_XIX_BMC_SafetyDataStorage_XIX_SoC_XIX_BMC_HV.DE_BMC_Ueberspannungszaehler_CMC03, system-signal=BMC_Ueberspannungszaehler_CMC03}
        sender-receiver-to-signal-mapping={communication-direction=OUT, data-element=BMC_SafetyDataStorage_XIX_SoC_XIX_BMC_HV.Geltungsbereich_E3_1_2_Premium.SP_IF_BMC_HV_11_CRC_XIX_BMC_SafetyDataStorage_XIX_SoC_XIX_BMC_HV.DE_BMC_HV_11_CRC, system-signal=BMC_HV_11_CRC}
        sender-receiver-to-signal-mapping={communication-direction=OUT, data-element=BMC_SafetyDataStorage_XIX_SoC_XIX_BMC_HV.Geltungsbereich_E3_1_2_Premium.SP_IF_BMC_Sperrung_Ueberspannung_XIX_BMC_SafetyDataStorage_XIX_SoC_XIX_BMC_HV.DE_BMC_Sperrung_Ueberspannung, system-signal=BMC_Sperrung_Ueberspannung}
        sender-receiver-to-signal-mapping={communication-direction=OUT, data-element=BMC_SafetyDataStorage_XIX_SoC_XIX_BMC_HV.Geltungsbereich_E3_1_2_Premium.SP_IF_BMC_HV_12_CRC_XIX_BMC_SafetyDataStorage_XIX_SoC_XIX_BMC_HV.DE_BMC_HV_12_CRC, system-signal=BMC_HV_12_CRC}
        sender-receiver-to-signal-mapping={communication-direction=OUT, data-element=BMC_SafetyDataStorage_XIX_SoC_XIX_BMC_HV.Geltungsbereich_E3_1_2_Premium.SP_IF_BMC_HV_11_BZ_XIX_BMC_SafetyDataStorage_XIX_SoC_XIX_BMC_HV.DE_BMC_HV_11_BZ, system-signal=BMC_HV_11_BZ}
        sender-receiver-to-signal-mapping={communication-direction=OUT, data-element=BMC_SafetyDataStorage_XIX_SoC_XIX_BMC_HV.Geltungsbereich_E3_1_2_Premium.SP_IF_BMC_HV_13_CRC_XIX_BMC_SafetyDataStorage_XIX_SoC_XIX_BMC_HV.DE_BMC_HV_13_CRC, system-signal=BMC_HV_13_CRC}
        sender-receiver-to-signal-mapping={communication-direction=OUT, data-element=BMC_SafetyDataStorage_XIX_SoC_XIX_BMC_HV.Geltungsbereich_E3_1_2_Premium.SP_IF_BMC_HV_13_BZ_XIX_BMC_SafetyDataStorage_XIX_SoC_XIX_BMC_HV.DE_BMC_HV_13_BZ, system-signal=BMC_HV_13_BZ}
        sender-receiver-to-signal-mapping={communication-direction=OUT, data-element=BMC_SafetyDataStorage_XIX_SoC_XIX_BMC_HV.Geltungsbereich_E3_1_2_Premium.SP_IF_BMC_Unterspannungszaehler_CMC01_XIX_BMC_SafetyDataStorage_XIX_SoC_XIX_BMC_HV.DE_BMC_Unterspannungszaehler_CMC01, system-signal=BMC_Unterspannungszaehler_CMC01}
        sender-receiver-to-signal-mapping={communication-direction=OUT, data-element=BMC_SafetyDataStorage_XIX_SoC_XIX_BMC_HV.Geltungsbereich_E3_1_2_Premium.SP_IF_BMC_Unterspannungszaehler_CMC03_XIX_BMC_SafetyDataStorage_XIX_SoC_XIX_BMC_HV.DE_BMC_Unterspannungszaehler_CMC03, system-signal=BMC_Unterspannungszaehler_CMC03}
        sender-receiver-to-signal-mapping={communication-direction=OUT, data-element=BMC_SafetyDataStorage_XIX_SoC_XIX_BMC_HV.Geltungsbereich_E3_1_2_Premium.SP_IF_BMC_Unterspannungszaehler_CMC02_XIX_BMC_SafetyDataStorage_XIX_SoC_XIX_BMC_HV.DE_BMC_Unterspannungszaehler_CMC02, system-signal=BMC_Unterspannungszaehler_CMC02}
        sender-receiver-to-signal-mapping={communication-direction=OUT, data-element=BMC_SafetyDataStorage_XIX_SoC_XIX_BMC_HV.Geltungsbereich_E3_1_2_Premium.SP_IF_BMC_Unterspannungszaehler_CMC04_XIX_BMC_SafetyDataStorage_XIX_SoC_XIX_BMC_HV.DE_BMC_Unterspannungszaehler_CMC04, system-signal=BMC_Unterspannungszaehler_CMC04}
      pnc-mapping pnc-group=BMC_HV_XIX_PNC_01_CarWakeUp_Tx, pnc-identifier=8, wakeup-frame=[FT_NMH_Hybrid_01, FT_NM_AWC, FT_NM_Gateway, FT_NM_HVZB, FT_NM_Hybrid_01, FT_NM_SACID_1, FT_NM_SACID_2]:
        ident PNC_01_CarWakeUp
      pnc-mapping pnc-group=BMC_HV_XIX_PNC_02_Basefunction_Powertrain_Rx, pnc-identifier=9, wakeup-frame=FT_NM_Gateway:
        ident PNC_02_Basefunction_Powertrain
      pnc-mapping pnc-identifier=10, wakeup-frame=FT_NM_Gateway:
        ident PNC_03_Basefunction_Chassis
      pnc-mapping pnc-identifier=11, wakeup-frame=FT_NM_Gateway:
        ident PNC_04_Basefunction_DrivingAssistance
      pnc-mapping pnc-identifier=12, wakeup-frame=FT_NM_Gateway:
        ident PNC_05_Basefunction_Infotainment
      pnc-mapping pnc-group=BMC_HV_XIX_PNC_06_Basefunction_ComfortLight_Rx, pnc-identifier=13, wakeup-frame=FT_NM_Gateway:
        ident PNC_06_Basefunction_ComfortLight
      pnc-mapping pnc-group=BMC_HV_XIX_PNC_07_Basefunction_CrossSection_Rx, pnc-identifier=14, wakeup-frame=FT_NM_Gateway:
        ident PNC_07_Basefunction_CrossSection
      pnc-mapping pnc-identifier=15, wakeup-frame=FT_NM_Gateway:
        ident PNC_08_Basefunction_Connectivity
      pnc-mapping pnc-group=BMC_HV_XIX_PNC_10_Powertrain_Rx, pnc-identifier=17, wakeup-frame=FT_NM_Gateway:
        ident PNC_10_Powertrain
      pnc-mapping pnc-group=BMC_HV_XIX_PNC_11_Chassis_Rx, pnc-identifier=18, wakeup-frame=FT_NM_Gateway:
        ident PNC_11_Chassis
      pnc-mapping pnc-identifier=19, wakeup-frame=FT_NM_Gateway:
        ident PNC_12_GearSelector
      pnc-mapping pnc-group=BMC_HV_XIX_PNC_13_Airbag_Rx, pnc-identifier=20, wakeup-frame=FT_NM_Gateway:
        ident PNC_13_Airbag
      pnc-mapping pnc-identifier=21, wakeup-frame=FT_NM_Gateway:
        ident PNC_14_InfotainmentExtensions
      pnc-mapping pnc-identifier=22, wakeup-frame=FT_NM_Gateway:
        ident PNC_15_InstrumentclusterDisplay
      pnc-mapping pnc-identifier=23, wakeup-frame=FT_NM_Gateway:
        ident PNC_16_InfotainmentDisplay
      pnc-mapping pnc-identifier=24, wakeup-frame=FT_NM_Gateway:
        ident PNC_17_Audio
      pnc-mapping pnc-identifier=25, wakeup-frame=FT_NM_Gateway:
        ident PNC_18_VirtualSideMirrors
      pnc-mapping pnc-identifier=26, wakeup-frame=FT_NM_Gateway:
        ident PNC_19_Doors_Hatches
      pnc-mapping pnc-identifier=27, wakeup-frame=FT_NM_Gateway:
        ident PNC_20_OptionalComfort
      pnc-mapping pnc-identifier=28, wakeup-frame=FT_NM_Gateway:
        ident PNC_21_AirSuspension
      pnc-mapping pnc-identifier=29, wakeup-frame=FT_NM_Gateway:
        ident PNC_22_ExteriorLights
      pnc-mapping pnc-identifier=30, wakeup-frame=FT_NM_Gateway:
        ident PNC_23_Climate
      pnc-mapping pnc-group=BMC_HV_XIX_PNC_24_ThermoManagement_Rx, pnc-identifier=31, wakeup-frame=FT_NM_Gateway:
        ident PNC_24_ThermoManagement
      pnc-mapping pnc-identifier=32, wakeup-frame=FT_NM_Gateway:
        ident PNC_25_AccessSystemSensors
      pnc-mapping pnc-group=[BMC_HV_XIX_PNC_26_HighVoltage_Charging_Rx, BMC_HV_XIX_PNC_26_HighVoltage_Charging_Tx], pnc-identifier=33, wakeup-frame=FT_NM_Gateway:
        ident PNC_26_HighVoltage_Charging
      pnc-mapping pnc-group=BMC_HV_XIX_PNC_27_Timemaster_Timer_Rx, pnc-identifier=34, wakeup-frame=FT_NM_Gateway:
        ident PNC_27_Timemaster_Timer
      pnc-mapping pnc-identifier=35, wakeup-frame=FT_NM_Gateway:
        ident PNC_28_OnboardTester_DataCollector
      pnc-mapping pnc-identifier=36, wakeup-frame=FT_NM_Gateway:
        ident PNC_29_SteeringColumnLock
      pnc-mapping pnc-group=[BMC_HV_XIX_PNC_30_EnergyManagement_Rx, BMC_HV_XIX_PNC_30_EnergyManagement_Tx], pnc-identifier=37, wakeup-frame=FT_NM_Gateway:
        ident PNC_30_EnergyManagement
      pnc-mapping pnc-identifier=38, wakeup-frame=FT_NM_Gateway:
        ident PNC_31_MultifunctionalSteeringWheel
      pnc-mapping pnc-identifier=39, wakeup-frame=FT_NM_Gateway:
        ident PNC_32_OnlineAccess
      pnc-mapping pnc-identifier=40, wakeup-frame=FT_NM_Gateway:
        ident PNC_33_ExternalWirelessCommunication
      pnc-mapping pnc-identifier=41, wakeup-frame=FT_NM_Gateway:
        ident PNC_34_GPS_Lokalization
      pnc-mapping pnc-identifier=42, wakeup-frame=FT_NM_Gateway:
        ident PNC_35_ExteriorSound
      pnc-mapping pnc-identifier=43, wakeup-frame=FT_NM_Gateway:
        ident PNC_36_Preheater
      pnc-mapping pnc-identifier=44, wakeup-frame=FT_NM_Gateway:
        ident PNC_37_HighVoltage_WirelessChargingStation
      pnc-mapping pnc-group=[BMC_HV_XIX_PNC_40_Diagnosis_Energy_Rx, BMC_HV_XIX_PNC_40_Diagnosis_Energy_Tx], pnc-identifier=47, wakeup-frame=FT_NM_Gateway:
        ident PNC_40_Diagnosis_Energy
      pnc-mapping pnc-identifier=48, wakeup-frame=FT_NM_Gateway:
        ident PNC_41_Diagnosis_Powertrain
      pnc-mapping pnc-identifier=49, wakeup-frame=FT_NM_Gateway:
        ident PNC_42_Diagnosis_FlexRay
      pnc-mapping pnc-identifier=50, wakeup-frame=FT_NM_Gateway:
        ident PNC_43_Diagnosis_DrivingAssistance
      pnc-mapping pnc-identifier=51, wakeup-frame=FT_NM_Gateway:
        ident PNC_44_Diagnosis_Infotainment
      pnc-mapping pnc-identifier=52, wakeup-frame=FT_NM_Gateway:
        ident PNC_45_Diagnosis_Comfort
      pnc-mapping pnc-identifier=53, wakeup-frame=FT_NM_Gateway:
        ident PNC_46_Diagnosis_Light
      pnc-mapping pnc-identifier=54, wakeup-frame=FT_NM_Gateway:
        ident PNC_47_Diagnosis_ComfortLINs
      pnc-mapping pnc-identifier=55, wakeup-frame=FT_NM_Gateway:
        ident PNC_48_Diagnosis_ClimateTmeLINs
      pnc-mapping pnc-identifier=60, wakeup-frame=FT_NM_Gateway:
        ident PNC_53_Lock_Unlock
      pnc-mapping pnc-identifier=62, wakeup-frame=FT_NM_Gateway:
        ident PNC_55_Dimming
      pnc-mapping pnc-identifier=63, wakeup-frame=FT_NM_Gateway:
        ident PNC_56_Charging_Status
      sw-mappings:
        15 x swc to ecu mapping, all with ecu-instance=BMC_HV:
          MAPPING_Infrastructure_Hybrid_01_XIX_network_infrastructure_XIX_BMC_HV: component=Geltungsbereich_E3_1_2_Premium.Infrastructure_Hybrid_01_XIX_network_infrastructure_XIX_BMC_HV
          MAPPING_HochvoltBatterieManagement_XIX_SoC_XIX_BMC_HV: component=Geltungsbereich_E3_1_2_Premium.HochvoltBatterieManagement_XIX_SoC_XIX_BMC_HV
          MAPPING_diagnosis_infrastructure_Hybrid_01_XIX_diagnosis_infrastructure_XIX_BMC_HV: component=Geltungsbereich_E3_1_2_Premium.diagnosis_infrastructure_Hybrid_01_XIX_diagnosis_infrastructure_XIX_BMC_HV
          MAPPING_KS_BMC_HV_XIX_KSGen3_XIX_BMC_HV: component=Geltungsbereich_E3_1_2_Premium.KS_BMC_HV_XIX_KSGen3_XIX_BMC_HV
          MAPPING_BMC_HV_Netzsteuerung_XIX_NV_SD_XIX_BMC_HV: component=Geltungsbereich_E3_1_2_Premium.BMC_HV_Netzsteuerung_XIX_NV_SD_XIX_BMC_HV
          MAPPING_SOK_Participant_BMC_HV_XIX_SOK_XIX_BMC_HV: component=Geltungsbereich_E3_1_2_Premium.SOK_Participant_BMC_HV_XIX_SOK_XIX_BMC_HV
          MAPPING_BMC_Berechnung_SOC_XIX_SoC_XIX_BMC_HV: component=Geltungsbereich_E3_1_2_Premium.BMC_Berechnung_SOC_XIX_SoC_XIX_BMC_HV
          MAPPING_BMC_HVS_Slave_XIX_SoC_XIX_BMC_HV: component=Geltungsbereich_E3_1_2_Premium.BMC_HVS_Slave_XIX_SoC_XIX_BMC_HV
          MAPPING_HV_Batterie_RTM_XIX_RTM_XIX_BMC_HV: component=Geltungsbereich_E3_1_2_Premium.HV_Batterie_RTM_XIX_RTM_XIX_BMC_HV
          MAPPING_VKMS_Participant_BMC_HV_XIX_VKMS_XIX_BMC_HV: component=Geltungsbereich_E3_1_2_Premium.VKMS_Participant_BMC_HV_XIX_VKMS_XIX_BMC_HV
          MAPPING_OTA_Infrastructure_Hybrid_01_XIX_ORU6_XIX_BMC_HV: component=Geltungsbereich_E3_1_2_Premium.OTA_Infrastructure_Hybrid_01_XIX_ORU6_XIX_BMC_HV
          MAPPING_ORU_Infrastructure_Hybrid_01_XIX_ORU6_XIX_BMC_HV: component=Geltungsbereich_E3_1_2_Premium.ORU_Infrastructure_Hybrid_01_XIX_ORU6_XIX_BMC_HV
          MAPPING_DaapServer_BMC_HV_XIX_GDC_DAAP_XIX_BMC_HV: component=Geltungsbereich_E3_1_2_Premium.DaapServer_BMC_HV_XIX_GDC_DAAP_XIX_BMC_HV
          MAPPING_HVB_Fehlerausgabe_SecondaryOBDECU_XIX_SoC_XIX_BMC_HV: component=Geltungsbereich_E3_1_2_Premium.HVB_Fehlerausgabe_SecondaryOBDECU_XIX_SoC_XIX_BMC_HV
          MAPPING_BMC_SafetyDataStorage_XIX_SoC_XIX_BMC_HV: component=Geltungsbereich_E3_1_2_Premium.BMC_SafetyDataStorage_XIX_SoC_XIX_BMC_HV
    root-software-compositions:
      root sw composition prototype Geltungsbereich_E3_1_2_Premium: software-composition=Geltungsbereich_E3_1_2_Premium
package /ECU
  ecu instance BMC_HV:  # HV Batterie Management Control DFL-Kürzel: Hybrid_01
    associated-com-i-pdu-group=[BMC_HV_XIX_HCP5_CANFD01_Tx, BMC_HV_XIX_HCP5_CANFD01_Rx, BMC_HV_XIX_BMC_CAN01_Tx, BMC_HV_XIX_BMC_CAN01_Rx, BMC_HV_XIX_PNC_01_CarWakeUp_Tx, BMC_HV_XIX_PNC_02_Basefunction_Powertrain_Rx, BMC_HV_XIX_PNC_07_Basefunction_CrossSection_Rx, BMC_HV_XIX_PNC_06_Basefunction_ComfortLight_Rx, BMC_HV_XIX_PNC_10_Powertrain_Rx, BMC_HV_XIX_PNC_11_Chassis_Rx, BMC_HV_XIX_PNC_13_Airbag_Rx, BMC_HV_XIX_PNC_24_ThermoManagement_Rx, BMC_HV_XIX_PNC_26_HighVoltage_Charging_Tx, BMC_HV_XIX_PNC_26_HighVoltage_Charging_Rx, BMC_HV_XIX_PNC_30_EnergyManagement_Tx, BMC_HV_XIX_PNC_30_EnergyManagement_Rx, BMC_HV_XIX_PNC_27_Timemaster_Timer_Rx, BMC_HV_XIX_PNC_40_Diagnosis_Energy_Tx, BMC_HV_XIX_PNC_40_Diagnosis_Energy_Rx, PduGroup_afac5c56b3b64c7983bb0f7ebfc92c5a_Tx, PduGroup_7d6a32fb6b5340f18c0d3a0826764630_Tx, PduGroup_bd14174e250b400999f7534078763f9f_Rx]
    diagnostic-address=140
    pn-reset-time=0.5
    pnc-prepare-sleep-timer=0
    sleep-mode-supported=true
    wake-up-over-bus-supported=true
    can communication controller CT_HCP5_CANFD01: wake-up-by-controller-supported=true, can-controller-attributes=can-controller-configuration-requirements={can-controller-fd-requirements={max-number-of-time-quanta-per-bit=20, max-sample-point=70, max-sync-jump-width=30, max-trcv-delay-compensation-offset=3.5E-07, min-number-of-time-quanta-per-bit=20, min-sample-point=70, min-sync-jump-width=30, min-trcv-delay-compensation-offset=3.5E-07, tx-bit-rate-switch=true}, max-number-of-time-quanta-per-bit=80, max-sample-point=80, max-sync-jump-width=20, min-number-of-time-quanta-per-bit=80, min-sample-point=80, min-sync-jump-width=20}
    can communication controller CT_BMC_CAN01: wake-up-by-controller-supported=true, can-controller-attributes=can-controller-configuration-requirements={max-number-of-time-quanta-per-bit=20, max-sample-point=84, max-sync-jump-width=20, min-number-of-time-quanta-per-bit=10, min-sample-point=80, min-sync-jump-width=20}
    can communication connector CN_HCP5_CANFD01: comm-controller=CT_HCP5_CANFD01, pnc-gateway-type=NONE
    can communication connector CN_BMC_CAN01: comm-controller=CT_BMC_CAN01
package /Cluster
  can cluster HCP5_CANFD01: baudrate=500000, protocol-name=CAN, protocol-version=2.0, bus-off-recovery={bor-counter-l-1-to-l-2=1, bor-time-l-1=0.05, bor-time-l-2=0.2}, can-fd-baudrate=2000000  # HV
    can physical channel CHNL: comm-connectors=CN_HCP5_CANFD01
      frame Airbag_10_XIX_HCP5_CANFD01: id 0x11F, to BMC_HV, frame-length=20, can-addressing-mode=STANDARD, can-frame-rx-behavior=CAN-FD, can-frame-tx-behavior=CAN-FD
        pdu Airbag_10_XIX_HCP5_CANFD01: length=16, minimum-delay=0.01, transmission-mode-true-timing={cyclic-timing={time-offset=0, time-period=0.04}, event-controlled-timing={number-of-repetitions=5, repetition-period=0.01}}, unused-bit-pattern=0
          signal Airbag_10_CRC_XIX_Airbag_10_XIX_HCP5_CANFD01: start 0, 8 bit, little-endian, data-type-policy=OVERRIDE, i-signal-type=PRIMITIVE, init-value=0, base-type=BT_Airbag_10_CRC, compu {phys=raw for raw 0..255}, range phys 0..255, raw 0..255, transfer-property=PENDING  # Für MLB: Berechnung siehe Lastenheft "Kommunikationsabsicherung für FlexRay und CAN" Ab MQB und MLBevo: Berechnung siehe Lastenheft "End-to-End Kommunikationsabsicherung" Endwerte siehe Begleitdokument "S-PDU Kennungsfolgen"
          signal Airbag_10_BZ_XIX_Airbag_10_XIX_HCP5_CANFD01: start 8, 4 bit, little-endian, data-type-policy=OVERRIDE, i-signal-type=PRIMITIVE, init-value=0, base-type=BT_Airbag_10_BZ, compu {phys=raw for raw 0..15}, range phys 0..15, raw 0..15, transfer-property=PENDING  # 4bit-Botschaftszaehler, wird in jeder Sendebotschaft inkrementiert
          signal AB_VRU_Crash_XIX_Airbag_10_XIX_HCP5_CANFD01: start 12, 1 bit, little-endian, data-type-policy=OVERRIDE, i-signal-type=PRIMITIVE, init-value=0, base-type=BT_AB_VRU_Crash, compu {0=Cx0_No_VRU_Crash (CM_AB_VRU_Crash_Cx0_No_VRU_Crash), 1=Cx1_VRU_Crash (CM_AB_VRU_Crash_Cx1_VRU_Crash)}, range raw 0..1, transfer-property=TRIGGERED-ON-CHANGE  # Anprall eines Passanten erkannt
          signal AB_Lampe_XIX_Airbag_10_XIX_HCP5_CANFD01: start 13, 1 bit, little-endian, data-type-policy=OVERRIDE, i-signal-type=PRIMITIVE, init-value=1, base-type=BT_AB_Lampe, compu {0=Cx0_Aus (CM_AB_Lampe_Cx0_Aus), 1=Cx1_Ein (CM_AB_Lampe_Cx1_Ein)}, range raw 0..1, transfer-property=PENDING  # Sicherheitswarnlampe im Kombi wird vom Airbag-SG angesteuert; Zustand der Lampe wird auf dem CAN-Bus ausgegeben (auch Blinkinformation).
          signal AB_Front_Crash_XIX_Airbag_10_XIX_HCP5_CANFD01: start 14, 1 bit, little-endian, data-type-policy=OVERRIDE, i-signal-type=PRIMITIVE, init-value=0, base-type=BT_AB_Front_Crash, compu {0=Cx0_kein_Front_Crash (CM_AB_Front_Crash_Cx0_kein_Front_Crash), 1=Cx1_Front_Crash (CM_AB_Front_Crash_Cx1_Front_Crash)}, range raw 0..1, transfer-property=TRIGGERED-ON-CHANGE  # Bit wird bei Überschreitung der Gurtstraffer-, US- und RdW-Schwelle gesetzt
          signal AB_Heck_Crash_XIX_Airbag_10_XIX_HCP5_CANFD01: start 15, 1 bit, little-endian, data-type-policy=OVERRIDE, i-signal-type=PRIMITIVE, init-value=0, base-type=BT_AB_Heck_Crash, compu {0=Cx0_kein_Heck_Crash (CM_AB_Heck_Crash_Cx0_kein_Heck_Crash), 1=Cx1_Heck_Crash (CM_AB_Heck_Crash_Cx1_Heck_Crash)}, range raw 0..1, transfer-property=TRIGGERED-ON-CHANGE  # Wird für alle neu anlaufenden Projekte umgesetzt: AB8.4, Audi8/VW8
          signal AB_SF_Crash_XIX_Airbag_10_XIX_HCP5_CANFD01: start 16, 1 bit, little-endian, data-type-policy=OVERRIDE, i-signal-type=PRIMITIVE, init-value=0, base-type=BT_AB_SF_Crash, compu {0=Cx0_kein_Seiten_Crash_Fahrer (CM_AB_SF_Crash_Cx0_kein_Seiten_Crash_Fahrer), 1=Cx1_Seiten_Crash_Fahrer (CM_AB_SF_Crash_Cx1_Seiten_Crash_Fahrer)}, range raw 0..1, transfer-property=TRIGGERED-ON-CHANGE  # Z.Zt. nur in Verbindung mit Crash-Intensität >= 100b (Kraftstoffpumpenabschaltung) verwendet.
          signal AB_SB_Crash_XIX_Airbag_10_XIX_HCP5_CANFD01: start 17, 1 bit, little-endian, data-type-policy=OVERRIDE, i-signal-type=PRIMITIVE, init-value=0, base-type=BT_AB_SB_Crash, compu {0=Cx0_kein_Seiten_Crash_Beifahrer (CM_AB_SB_Crash_Cx0_kein_Seiten_Crash_Beifahrer), 1=Cx1_Seiten_Crash_Beifahrer (CM_AB_SB_Crash_Cx1_Seiten_Crash_Beifahrer)}, range raw 0..1, transfer-property=TRIGGERED-ON-CHANGE  # Z.Zt. nur in Verbindung mit Crash-Intensität >= 100b (Kraftstoffpumpenabschaltung) verwendet.
          signal AB_Rollover_Crash_XIX_Airbag_10_XIX_HCP5_CANFD01: start 18, 1 bit, little-endian, data-type-policy=OVERRIDE, i-signal-type=PRIMITIVE, init-value=0, base-type=BT_AB_Rollover_Crash, compu {0=Cx0_kein_Rollover (CM_AB_Rollover_Crash_Cx0_kein_Rollover), 1=Cx1_Rollover (CM_AB_Rollover_Crash_Cx1_Rollover)}, range raw 0..1, transfer-property=TRIGGERED-ON-CHANGE  # Wird im B6/B7 Cabrio und New Beetle Cabrio bedient.
          signal AB_Crash_Int_XIX_Airbag_10_XIX_HCP5_CANFD01: start 19, 3 bit, little-endian, data-type-policy=OVERRIDE, i-signal-type=PRIMITIVE, init-value=0, base-type=BT_AB_Crash_Int, compu {0=Cx0_kein_Crash (CM_AB_Crash_Int_Cx0_kein_Crash), 1=Cx1_Crash_Intensitaet_1 (CM_AB_Crash_Int_Cx1_Crash_Intensitaet_1), 2=Cx2_Crash_Intensitaet_2_nur_Stellgliedtest_MLB_B8 (CM_AB_Crash_Int_Cx2_Crash_Intensitaet_2_nur_Stellgliedtest_MLB_B8) (Crash_Intensitaet_2_(nur_Stellgliedtest_MLB_B8)), 3=Cx3_Crash_Intensitaet_2_nur_D4_C7_Colorado_NF_PAG_Crash_im_MLB_B8 (CM_AB_Crash_Int_Cx3_Crash_Intensitaet_2_nur_D4_C7_Colorado_NF_PAG_Crash_im_MLB_B8) (Crash_Intensitaet_2_(nur_D4_C7_Colorado_NF_PAG__Crash_im_MLB_B8)), 4=Cx4_Crash_Intensitaet_3_alt_VW_AUDI_Stellgliedtest_MLB_B8 (CM_AB_Crash_Int_Cx4_Crash_Intensitaet_3_alt_VW_AUDI_Stellgliedtest_MLB_B8) (Crash_Intensitaet_3_(alt_VW/AUDI__Stellgliedtest_MLB_B8)), 5=Cx5_Crash_Intensitaet_3_alt_PAG (CM_AB_Crash_Int_Cx5_Crash_Intensitaet_3_alt_PAG) (Crash_Intensitaet_3_(alt_PAG)), 7=Cx7_Crash_Intensitaet_3 (CM_AB_Crash_Int_Cx7_Crash_Intensitaet_3)}, range raw 0..7, transfer-property=TRIGGERED-ON-CHANGE  # Crash_Intensität_1 = fahrzeugabhängige Reaktionen im Crash Crash_Intensität_2 = fahrzeugabhängige Reaktionen im Crash Crash_Intensität_3 = fahrzeugabhängige Reaktionen im Crash Die jeweiligen fahrzeugabhängigen Reaktionen im Crash sind in einem separaten Doors Modul im Airbag-SG beschrieben. Die Information bleibt bei jeder Schwellwert-überschreitung für ~10 s bestehen (Achtung: Energiereserve bei abgetrennter Batterie reicht worstcase nur für 150 ms)
          signal AB_Systemfehler_XIX_Airbag_10_XIX_HCP5_CANFD01: start 22, 1 bit, little-endian, data-type-policy=OVERRIDE, i-signal-type=PRIMITIVE, init-value=0, base-type=BT_AB_Systemfehler, compu {0=Cx0_kein_Fehler (CM_AB_Systemfehler_Cx0_kein_Fehler), 1=Cx1_Airbag_Systemfehler (CM_AB_Systemfehler_Cx1_Airbag_Systemfehler)}, range raw 0..1, transfer-property=PENDING  # Systemfehler Ggf. wird Warnlampe dauernd eingeschaltet.
          signal AB_Stellgliedtest_XIX_Airbag_10_XIX_HCP5_CANFD01: start 23, 1 bit, little-endian, data-type-policy=OVERRIDE, i-signal-type=PRIMITIVE, init-value=0, base-type=BT_AB_Stellgliedtest, compu {0=Cx0_nicht_im_Stellgliedtest (CM_AB_Stellgliedtest_Cx0_nicht_im_Stellgliedtest), 1=Cx1_Airbag_im_Stellgliedtest (CM_AB_Stellgliedtest_Cx1_Airbag_im_Stellgliedtest)}, range raw 0..1, transfer-property=PENDING  # Information, ob Airbag im Stellgliedtest ist, um eine Notrufauflösung beim Stellgliedtest zu verhindern
          signal AB_Erh_Auf_VB_XIX_Airbag_10_XIX_HCP5_CANFD01: start 24, 2 bit, little-endian, data-type-policy=OVERRIDE, i-signal-type=PRIMITIVE, init-value=0, base-type=BT_AB_Erh_Auf_VB, compu {0=Cx0_keine_Anzeige (CM_AB_Erh_Auf_VB_Cx0_keine_Anzeige), 1=Cx1_Beifahrerairbag_deaktiviert (CM_AB_Erh_Auf_VB_Cx1_Beifahrerairbag_deaktiviert), 2=Cx2_Beifahrerairbag_aktiviert (CM_AB_Erh_Auf_VB_Cx2_Beifahrerairbag_aktiviert), 3=Cx3_nicht_definiert (CM_AB_Erh_Auf_VB_Cx3_nicht_definiert)}, range raw 0..3, transfer-property=PENDING  # Der Fahrer soll bei einem Statuswechsel des Beifahrerairbags (ausgelöst durch die Beifahrerinsassenerkennung oder den Schlüsselschloßschalter) aufmerksam gemacht werden durch eine Anzeige im Kombi. Nur Audi: gültig für: AB2 (4-Türer AU352), B7, C6, D3
          signal AB_Gurtwarn_VF_XIX_Airbag_10_XIX_HCP5_CANFD01: start 26, 1 bit, little-endian, data-type-policy=OVERRIDE, i-signal-type=PRIMITIVE, init-value=0, base-type=BT_AB_Gurtwarn_VF, compu {0=Cx0_keine_Warnung (CM_AB_Gurtwarn_VF_Cx0_keine_Warnung), 1=Cx1_Gurtwarnung_ausloesen (CM_AB_Gurtwarn_VF_Cx1_Gurtwarnung_ausloesen)}, range raw 0..1, transfer-property=TRIGGERED-ON-CHANGE-WITHOUT-REPETITION  # Fahrer hat Gurt nicht gesteckt, Anzeige im Kombi
          signal AB_Gurtwarn_VB_XIX_Airbag_10_XIX_HCP5_CANFD01: start 27, 1 bit, little-endian, data-type-policy=OVERRIDE, i-signal-type=PRIMITIVE, init-value=0, base-type=BT_AB_Gurtwarn_VB, compu {0=Cx0_keine_Warnung (CM_AB_Gurtwarn_VB_Cx0_keine_Warnung), 1=Cx1_Gurtwarnung_ausloesen (CM_AB_Gurtwarn_VB_Cx1_Gurtwarnung_ausloesen)}, range raw 0..1, transfer-property=TRIGGERED-ON-CHANGE-WITHOUT-REPETITION  # Beifahrer hat Gurt nicht gesteckt, Anzeige im Kombi
          signal AB_Anzeige_Fussg_XIX_Airbag_10_XIX_HCP5_CANFD01: start 28, 2 bit, little-endian, data-type-policy=OVERRIDE, i-signal-type=PRIMITIVE, init-value=0, base-type=BT_AB_Anzeige_Fussg, compu {0=Cx0_keine_FSG_Aktion_ausgeloest (CM_AB_Anzeige_Fussg_Cx0_keine_FSG_Aktion_ausgeloest), 1=Cx1_Motorhaube_offen (CM_AB_Anzeige_Fussg_Cx1_Motorhaube_offen), 2=Cx2_Systemfehler (CM_AB_Anzeige_Fussg_Cx2_Systemfehler)}, range raw 0..2, transfer-property=PENDING  # Anzeige für ausgelöste Fussgängerschutz-Aktuatorik
          signal AB_Belegung_VB_XIX_Airbag_10_XIX_HCP5_CANFD01: start 30, 2 bit, little-endian, data-type-policy=OVERRIDE, i-signal-type=PRIMITIVE, init-value=0, base-type=BT_AB_Belegung_VB, invalid-value=Invalid_AB_Belegung_VB_XIX_Airbag_10_XIX_HCP5_CANFD01:1, compu {0=Cx0_nicht_verfuegbar (CM_AB_Belegung_VB_Cx0_nicht_verfuegbar), 1=Cx1_Fehler (CM_AB_Belegung_VB_Cx1_Fehler), 2=Cx2_nicht_belegt (CM_AB_Belegung_VB_Cx2_nicht_belegt), 3=Cx3_belegt (CM_AB_Belegung_VB_Cx3_belegt)}, range raw 0..3, transfer-property=TRIGGERED-ON-CHANGE-WITHOUT-REPETITION  # Belegungserkennung vorne Beifahrer. Wird in US-Steuergeräten über Bladder-Matte bedient, optional bei RdW, falls SBE_EuroNCAP entschieden wird.
          signal AB_Versorgungsspannung_XIX_Airbag_10_XIX_HCP5_CANFD01: start 32, 1 bit, little-endian, data-type-policy=OVERRIDE, i-signal-type=PRIMITIVE, init-value=0, base-type=BT_AB_Versorgungsspannung, compu {0=Cx0_plausibel (CM_AB_Versorgungsspannung_Cx0_plausibel), 1=Cx1_unplausibel (CM_AB_Versorgungsspannung_Cx1_unplausibel)}, range raw 0..1, transfer-property=TRIGGERED-ON-CHANGE-WITHOUT-REPETITION  # Übertragung der Plausibilitätsinformation Kl.15-Last vs. Kl.15-CAN. Bedienung im Fall Kl.15-Last "EIN" und Kl.15-CAN "AUS" mit Ausgabe Warnung/Akustik im Kombi.
          signal AB_Sitzpos_Sens_BF_XIX_Airbag_10_XIX_HCP5_CANFD01: start 33, 2 bit, little-endian, data-type-policy=OVERRIDE, i-signal-type=PRIMITIVE, init-value=0, base-type=BT_AB_Sitzpos_Sens_BF, invalid-value=Invalid_AB_Sitzpos_Sens_BF_XIX_Airbag_10_XIX_HCP5_CANFD01:1, compu {0=Cx0_nicht_verfuegbar (CM_AB_Sitzpos_Sens_BF_Cx0_nicht_verfuegbar) (nicht verfügbar), 1=Cx1_Fehler (CM_AB_Sitzpos_Sens_BF_Cx1_Fehler), 2=Cx2_Sitz_nicht_vorne (CM_AB_Sitzpos_Sens_BF_Cx2_Sitz_nicht_vorne) (Sitz nicht vorne), 3=Cx3_Sitz_vorne (CM_AB_Sitzpos_Sens_BF_Cx3_Sitz_vorne) (Sitz vorne)}, range raw 0..3, transfer-property=PENDING  # Ausgabe Sitzposition Beifahrer
          signal AB_Sitzpos_Sens_FA_XIX_Airbag_10_XIX_HCP5_CANFD01: start 35, 2 bit, little-endian, data-type-policy=OVERRIDE, i-signal-type=PRIMITIVE, init-value=0, base-type=BT_AB_Sitzpos_Sens_FA, invalid-value=Invalid_AB_Sitzpos_Sens_FA_XIX_Airbag_10_XIX_HCP5_CANFD01:1, compu {0=Cx0_nicht_verfuegbar (CM_AB_Sitzpos_Sens_FA_Cx0_nicht_verfuegbar) (nicht verfügbar), 1=Cx1_Fehler (CM_AB_Sitzpos_Sens_FA_Cx1_Fehler), 2=Cx2_Sitz_nicht_vorne (CM_AB_Sitzpos_Sens_FA_Cx2_Sitz_nicht_vorne) (Sitz nicht vorne), 3=Cx3_Sitz_vorne (CM_AB_Sitzpos_Sens_FA_Cx3_Sitz_vorne) (Sitz vorne)}, range raw 0..3, transfer-property=PENDING  # Ausgabe Sitzposition Fahrer
          signal AB_Gurtschloss_FA_ext_XIX_Airbag_10_XIX_HCP5_CANFD01: start 37, 3 bit, little-endian, data-type-policy=OVERRIDE, i-signal-type=PRIMITIVE, init-value=6, base-type=BT_AB_Gurtschloss_FA_ext, invalid-value=Invalid_AB_Gurtschloss_FA_ext_XIX_Airbag_10_XIX_HCP5_CANFD01:7, compu {0=Cx0_nicht_verbaut (CM_AB_Gurtschloss_FA_ext_Cx0_nicht_verbaut), 1=Cx1_reserviert (CM_AB_Gurtschloss_FA_ext_Cx1_reserviert), 2=Cx2_nicht_gesteckt (CM_AB_Gurtschloss_FA_ext_Cx2_nicht_gesteckt), 3=Cx3_gesteckt (CM_AB_Gurtschloss_FA_ext_Cx3_gesteckt), 4=Cx4_dauerhaft_nicht_gesteckt (CM_AB_Gurtschloss_FA_ext_Cx4_dauerhaft_nicht_gesteckt), 5=Cx5_dauerhaft_gesteckt (CM_AB_Gurtschloss_FA_ext_Cx5_dauerhaft_gesteckt), 6=Cx6_Init (CM_AB_Gurtschloss_FA_ext_Cx6_Init), 7=Cx7_Fehler (CM_AB_Gurtschloss_FA_ext_Cx7_Fehler)}, range raw 0..7, transfer-property=TRIGGERED-ON-CHANGE-WITHOUT-REPETITION  # Das Ergebnis der Basisfunktion "Plausibilisierung Gurtschloss" des Verlassenskonzepts wird im Signal dargestellt.
          signal AB_Gurtschloss_FA_ext_aktiv_XIX_Airbag_10_XIX_HCP5_CANFD01: start 40, 1 bit, little-endian, data-type-policy=OVERRIDE, i-signal-type=PRIMITIVE, init-value=0, base-type=BT_AB_Gurtschloss_FA_ext_aktiv, compu {0=Cx0_inaktiv (CM_AB_Gurtschloss_FA_ext_aktiv_Cx0_inaktiv), 1=Cx1_aktiv (CM_AB_Gurtschloss_FA_ext_aktiv_Cx1_aktiv)}, range raw 0..1, transfer-property=TRIGGERED-ON-CHANGE-WITHOUT-REPETITION  # Über dieses Signal wird signalisiert ob die Erweiterte Gurtdiagnose (Ergebnis wird im Signal AB_Gurtschloss_FA_ext dargestellt) aktiviert oder deaktiviert ist.
          signal AB_Gurtschloss_BF_XIX_Airbag_10_XIX_HCP5_CANFD01: start 41, 2 bit, little-endian, data-type-policy=OVERRIDE, i-signal-type=PRIMITIVE, init-value=1, base-type=BT_AB_Gurtschloss_BF, compu {0=Cx0_nicht_verbaut (CM_AB_Gurtschloss_BF_Cx0_nicht_verbaut), 1=Cx1_nicht_verfuegbar_Fehler_oder_Init (CM_AB_Gurtschloss_BF_Cx1_nicht_verfuegbar_Fehler_oder_Init) (nicht_verfügbar (Fehler oder Init)), 2=Cx2_nicht_gesteckt (CM_AB_Gurtschloss_BF_Cx2_nicht_gesteckt), 3=Cx3_gesteckt (CM_AB_Gurtschloss_BF_Cx3_gesteckt)}, range raw 0..3, transfer-property=TRIGGERED-ON-CHANGE-WITHOUT-REPETITION  # Gurtschlossstatus Beifahrerseite
          signal AB_Gurtschloss_FA_XIX_Airbag_10_XIX_HCP5_CANFD01: start 43, 2 bit, little-endian, data-type-policy=OVERRIDE, i-signal-type=PRIMITIVE, init-value=1, base-type=BT_AB_Gurtschloss_FA, compu {0=Cx0_nicht_verbaut (CM_AB_Gurtschloss_FA_Cx0_nicht_verbaut), 1=Cx1_nicht_verfuegbar_Fehler_oder_Init (CM_AB_Gurtschloss_FA_Cx1_nicht_verfuegbar_Fehler_oder_Init) (nicht_verfügbar (Fehler oder Init)), 2=Cx2_nicht_gesteckt (CM_AB_Gurtschloss_FA_Cx2_nicht_gesteckt), 3=Cx3_gesteckt (CM_AB_Gurtschloss_FA_Cx3_gesteckt)}, range raw 0..3, transfer-property=TRIGGERED-ON-CHANGE-WITHOUT-REPETITION  # Gurtschlosstatatus Fahrerseite
          signal AB_Gurtschloss_Reihe3_BF_XIX_Airbag_10_XIX_HCP5_CANFD01: start 45, 2 bit, little-endian, data-type-policy=OVERRIDE, i-signal-type=PRIMITIVE, init-value=1, base-type=BT_AB_Gurtschloss_Reihe3_BF, compu {0=Cx0_nicht_verbaut (CM_AB_Gurtschloss_Reihe3_BF_Cx0_nicht_verbaut), 1=Cx1_nicht_verfuegbar_Fehler_oder_Init (CM_AB_Gurtschloss_Reihe3_BF_Cx1_nicht_verfuegbar_Fehler_oder_Init) (nicht_verfügbar (Fehler oder Init)), 2=Cx2_nicht_gesteckt (CM_AB_Gurtschloss_Reihe3_BF_Cx2_nicht_gesteckt), 3=Cx3_gesteckt (CM_AB_Gurtschloss_Reihe3_BF_Cx3_gesteckt)}, range raw 0..3, transfer-property=TRIGGERED-ON-CHANGE-WITHOUT-REPETITION  # Gurtschlossstatus 3. Reihe Beifahrerseite, Mehrausstattung
          signal AB_Gurtschloss_Reihe2_BF_XIX_Airbag_10_XIX_HCP5_CANFD01: start 47, 2 bit, little-endian, data-type-policy=OVERRIDE, i-signal-type=PRIMITIVE, init-value=1, base-type=BT_AB_Gurtschloss_Reihe2_BF, compu {0=Cx0_nicht_verbaut (CM_AB_Gurtschloss_Reihe2_BF_Cx0_nicht_verbaut), 1=Cx1_nicht_verfuegbar_Fehler_oder_Init (CM_AB_Gurtschloss_Reihe2_BF_Cx1_nicht_verfuegbar_Fehler_oder_Init) (nicht_verfügbar (Fehler oder Init)), 2=Cx2_nicht_gesteckt (CM_AB_Gurtschloss_Reihe2_BF_Cx2_nicht_gesteckt), 3=Cx3_gesteckt (CM_AB_Gurtschloss_Reihe2_BF_Cx3_gesteckt)}, range raw 0..3, transfer-property=TRIGGERED-ON-CHANGE-WITHOUT-REPETITION  # Gurtschlossstatus 2. Reihe Beifahrerseite, Mehrausstattung
          signal AB_Gurtschloss_Reihe2_FA_XIX_Airbag_10_XIX_HCP5_CANFD01: start 49, 2 bit, little-endian, data-type-policy=OVERRIDE, i-signal-type=PRIMITIVE, init-value=1, base-type=BT_AB_Gurtschloss_Reihe2_FA, compu {0=Cx0_nicht_verbaut (CM_AB_Gurtschloss_Reihe2_FA_Cx0_nicht_verbaut), 1=Cx1_nicht_verfuegbar_Fehler_oder_Init (CM_AB_Gurtschloss_Reihe2_FA_Cx1_nicht_verfuegbar_Fehler_oder_Init) (nicht_verfügbar (Fehler oder Init)), 2=Cx2_nicht_gesteckt (CM_AB_Gurtschloss_Reihe2_FA_Cx2_nicht_gesteckt), 3=Cx3_gesteckt (CM_AB_Gurtschloss_Reihe2_FA_Cx3_gesteckt)}, range raw 0..3, transfer-property=TRIGGERED-ON-CHANGE-WITHOUT-REPETITION  # Gurtschlossstatus 2. Reihe Fahrerseite, Mehrausstattung
          signal AB_Gurtschloss_Reihe2_MI_XIX_Airbag_10_XIX_HCP5_CANFD01: start 51, 2 bit, little-endian, data-type-policy=OVERRIDE, i-signal-type=PRIMITIVE, init-value=1, base-type=BT_AB_Gurtschloss_Reihe2_MI, compu {0=Cx0_nicht_verbaut (CM_AB_Gurtschloss_Reihe2_MI_Cx0_nicht_verbaut), 1=Cx1_nicht_verfuegbar_Fehler_oder_Init (CM_AB_Gurtschloss_Reihe2_MI_Cx1_nicht_verfuegbar_Fehler_oder_Init) (nicht_verfügbar (Fehler oder Init)), 2=Cx2_nicht_gesteckt (CM_AB_Gurtschloss_Reihe2_MI_Cx2_nicht_gesteckt), 3=Cx3_gesteckt (CM_AB_Gurtschloss_Reihe2_MI_Cx3_gesteckt)}, range raw 0..3, transfer-property=TRIGGERED-ON-CHANGE-WITHOUT-REPETITION  # Gurtschlossstatus 2. Reihe Mitte, Mehrausstattung
          signal AB_Gurtschloss_Reihe4_FA_XIX_Airbag_10_XIX_HCP5_CANFD01: start 53, 2 bit, little-endian, data-type-policy=OVERRIDE, i-signal-type=PRIMITIVE, init-value=1, base-type=BT_AB_Gurtschloss_Reihe4_FA, compu {0=Cx0_nicht_verbaut (CM_AB_Gurtschloss_Reihe4_FA_Cx0_nicht_verbaut), 1=Cx1_nicht_verfuegbar_Fehler_oder_Init (CM_AB_Gurtschloss_Reihe4_FA_Cx1_nicht_verfuegbar_Fehler_oder_Init) (nicht_verfügbar (Fehler oder Init)), 2=Cx2_nicht_gesteckt (CM_AB_Gurtschloss_Reihe4_FA_Cx2_nicht_gesteckt), 3=Cx3_gesteckt (CM_AB_Gurtschloss_Reihe4_FA_Cx3_gesteckt)}, range raw 0..3, transfer-property=TRIGGERED-ON-CHANGE-WITHOUT-REPETITION  # Gurtschlossstatus 4. Reihe Fahrerseite, Mehrausstattung
          signal AB_Gurtschloss_Reihe3_FA_XIX_Airbag_10_XIX_HCP5_CANFD01: start 55, 2 bit, little-endian, data-type-policy=OVERRIDE, i-signal-type=PRIMITIVE, init-value=1, base-type=BT_AB_Gurtschloss_Reihe3_FA, compu {0=Cx0_nicht_verbaut (CM_AB_Gurtschloss_Reihe3_FA_Cx0_nicht_verbaut), 1=Cx1_nicht_verfuegbar_Fehler_oder_Init (CM_AB_Gurtschloss_Reihe3_FA_Cx1_nicht_verfuegbar_Fehler_oder_Init) (nicht_verfügbar (Fehler oder Init)), 2=Cx2_nicht_gesteckt (CM_AB_Gurtschloss_Reihe3_FA_Cx2_nicht_gesteckt), 3=Cx3_gesteckt (CM_AB_Gurtschloss_Reihe3_FA_Cx3_gesteckt)}, range raw 0..3, transfer-property=TRIGGERED-ON-CHANGE-WITHOUT-REPETITION  # Gurtschlossstatus 3. Reihe Fahrerseite, Mehrausstattung
          signal AB_Gurtschloss_Reihe3_MI_XIX_Airbag_10_XIX_HCP5_CANFD01: start 57, 2 bit, little-endian, data-type-policy=OVERRIDE, i-signal-type=PRIMITIVE, init-value=1, base-type=BT_AB_Gurtschloss_Reihe3_MI, compu {0=Cx0_nicht_verbaut (CM_AB_Gurtschloss_Reihe3_MI_Cx0_nicht_verbaut), 1=Cx1_nicht_verfuegbar_Fehler_oder_Init (CM_AB_Gurtschloss_Reihe3_MI_Cx1_nicht_verfuegbar_Fehler_oder_Init) (nicht_verfügbar (Fehler oder Init)), 2=Cx2_nicht_gesteckt (CM_AB_Gurtschloss_Reihe3_MI_Cx2_nicht_gesteckt), 3=Cx3_gesteckt (CM_AB_Gurtschloss_Reihe3_MI_Cx3_gesteckt)}, range raw 0..3, transfer-property=TRIGGERED-ON-CHANGE-WITHOUT-REPETITION  # Gurtschlossstatus 3. Reihe Mitte, Mehrausstattung
          signal AB_Gurtschloss_Reihe4_BF_XIX_Airbag_10_XIX_HCP5_CANFD01: start 59, 2 bit, little-endian, data-type-policy=OVERRIDE, i-signal-type=PRIMITIVE, init-value=1, base-type=BT_AB_Gurtschloss_Reihe4_BF, compu {0=Cx0_nicht_verbaut (CM_AB_Gurtschloss_Reihe4_BF_Cx0_nicht_verbaut), 1=Cx1_nicht_verfuegbar_Fehler_oder_Init (CM_AB_Gurtschloss_Reihe4_BF_Cx1_nicht_verfuegbar_Fehler_oder_Init) (nicht_verfügbar (Fehler oder Init)), 2=Cx2_nicht_gesteckt (CM_AB_Gurtschloss_Reihe4_BF_Cx2_nicht_gesteckt), 3=Cx3_gesteckt (CM_AB_Gurtschloss_Reihe4_BF_Cx3_gesteckt)}, range raw 0..3, transfer-property=TRIGGERED-ON-CHANGE-WITHOUT-REPETITION  # Gurtschlossstatus 4. Reihe Beifahrerseite, Mehrausstattung
          signal AB_Gurtwarn_Reihe2_MI_XIX_Airbag_10_XIX_HCP5_CANFD01: start 61, 2 bit, little-endian, data-type-policy=OVERRIDE, i-signal-type=PRIMITIVE, init-value=0, base-type=BT_AB_Gurtwarn_Reihe2_MI, compu {0=Cx0_nicht_verbaut (CM_AB_Gurtwarn_Reihe2_MI_Cx0_nicht_verbaut), 1=Cx1_keine_Gurtwarnung_Sitz_leer (CM_AB_Gurtwarn_Reihe2_MI_Cx1_keine_Gurtwarnung_Sitz_leer), 2=Cx2_keine_Gurtwarnung_Sitz_belegt (CM_AB_Gurtwarn_Reihe2_MI_Cx2_keine_Gurtwarnung_Sitz_belegt), 3=Cx3_Gurtwarnung_Sitz_belegt (CM_AB_Gurtwarn_Reihe2_MI_Cx3_Gurtwarnung_Sitz_belegt)}, range raw 0..3, transfer-property=TRIGGERED-ON-CHANGE-WITHOUT-REPETITION  # Status Gurtwarnung 2. Sitzreihe Mitte
          signal AB_Gurtschloss_Reihe4_MI_XIX_Airbag_10_XIX_HCP5_CANFD01: start 63, 2 bit, little-endian, data-type-policy=OVERRIDE, i-signal-type=PRIMITIVE, init-value=1, base-type=BT_AB_Gurtschloss_Reihe4_MI, compu {0=Cx0_nicht_verbaut (CM_AB_Gurtschloss_Reihe4_MI_Cx0_nicht_verbaut), 1=Cx1_nicht_verfuegbar_Fehler_oder_Init (CM_AB_Gurtschloss_Reihe4_MI_Cx1_nicht_verfuegbar_Fehler_oder_Init) (nicht_verfügbar (Fehler oder Init)), 2=Cx2_nicht_gesteckt (CM_AB_Gurtschloss_Reihe4_MI_Cx2_nicht_gesteckt), 3=Cx3_gesteckt (CM_AB_Gurtschloss_Reihe4_MI_Cx3_gesteckt)}, range raw 0..3, transfer-property=TRIGGERED-ON-CHANGE-WITHOUT-REPETITION  # Gurtschlossstatus 4. Reihe Mitte, Mehrausstattung
          signal AB_Gurtwarn_Reihe2_BF_XIX_Airbag_10_XIX_HCP5_CANFD01: start 65, 2 bit, little-endian, data-type-policy=OVERRIDE, i-signal-type=PRIMITIVE, init-value=0, base-type=BT_AB_Gurtwarn_Reihe2_BF, compu {0=Cx0_nicht_verbaut (CM_AB_Gurtwarn_Reihe2_BF_Cx0_nicht_verbaut), 1=Cx1_keine_Gurtwarnung_Sitz_leer (CM_AB_Gurtwarn_Reihe2_BF_Cx1_keine_Gurtwarnung_Sitz_leer), 2=Cx2_keine_Gurtwarnung_Sitz_belegt (CM_AB_Gurtwarn_Reihe2_BF_Cx2_keine_Gurtwarnung_Sitz_belegt), 3=Cx3_Gurtwarnung_Sitz_belegt (CM_AB_Gurtwarn_Reihe2_BF_Cx3_Gurtwarnung_Sitz_belegt)}, range raw 0..3, transfer-property=TRIGGERED-ON-CHANGE-WITHOUT-REPETITION  # Status Gurtwarnung 2. Sitzreihe Beifahrerseite
          signal AB_Gurtwarn_Reihe2_FA_XIX_Airbag_10_XIX_HCP5_CANFD01: start 67, 2 bit, little-endian, data-type-policy=OVERRIDE, i-signal-type=PRIMITIVE, init-value=0, base-type=BT_AB_Gurtwarn_Reihe2_FA, compu {0=Cx0_nicht_verbaut (CM_AB_Gurtwarn_Reihe2_FA_Cx0_nicht_verbaut), 1=Cx1_keine_Gurtwarnung_Sitz_leer (CM_AB_Gurtwarn_Reihe2_FA_Cx1_keine_Gurtwarnung_Sitz_leer), 2=Cx2_keine_Gurtwarnung_Sitz_belegt (CM_AB_Gurtwarn_Reihe2_FA_Cx2_keine_Gurtwarnung_Sitz_belegt), 3=Cx3_Gurtwarnung_Sitz_belegt (CM_AB_Gurtwarn_Reihe2_FA_Cx3_Gurtwarnung_Sitz_belegt)}, range raw 0..3, transfer-property=TRIGGERED-ON-CHANGE-WITHOUT-REPETITION  # Status Gurtwarnung 2. Sitzreihe Fahrerseite
          signal AB_Belegung_VF_ext_aktiv_XIX_Airbag_10_XIX_HCP5_CANFD01: start 69, 1 bit, little-endian, data-type-policy=OVERRIDE, i-signal-type=PRIMITIVE, init-value=0, base-type=BT_AB_Belegung_VF_ext_aktiv, compu {0=Cx0_inaktiv (CM_AB_Belegung_VF_ext_aktiv_Cx0_inaktiv), 1=Cx1_aktiv (CM_AB_Belegung_VF_ext_aktiv_Cx1_aktiv)}, range raw 0..1, transfer-property=PENDING  # Kennzeichnet aktive Funktion "Erweiterte Sitzbelegdiagnose" für Signal AB_Belegung_VF_ext
          signal AB_Belegung_VF_ext_XIX_Airbag_10_XIX_HCP5_CANFD01: start 70, 3 bit, little-endian, data-type-policy=OVERRIDE, i-signal-type=PRIMITIVE, init-value=6, base-type=BT_AB_Belegung_VF_ext, invalid-value=Invalid_AB_Belegung_VF_ext_XIX_Airbag_10_XIX_HCP5_CANFD01:7, compu {0=Cx0_nicht_verbaut (CM_AB_Belegung_VF_ext_Cx0_nicht_verbaut), 1=Cx1_reserviert (CM_AB_Belegung_VF_ext_Cx1_reserviert), 2=Cx2_nicht_belegt (CM_AB_Belegung_VF_ext_Cx2_nicht_belegt), 3=Cx3_belegt (CM_AB_Belegung_VF_ext_Cx3_belegt), 4=Cx4_dauerhaft_nicht_belegt (CM_AB_Belegung_VF_ext_Cx4_dauerhaft_nicht_belegt), 5=Cx5_dauerhaft_belegt (CM_AB_Belegung_VF_ext_Cx5_dauerhaft_belegt), 6=Cx6_Init (CM_AB_Belegung_VF_ext_Cx6_Init), 7=Cx7_Fehler (CM_AB_Belegung_VF_ext_Cx7_Fehler)}, range raw 0..7, transfer-property=TRIGGERED-ON-CHANGE-WITHOUT-REPETITION  # Das Signal kommuniziert den Status des Sitzbelegsensors Fahrer incl. dauerhafter Zustände mit Signalqualität ASIL A.
          signal AB_Abschaltanf_SIH_BF_XIX_Airbag_10_XIX_HCP5_CANFD01: start 73, 1 bit, little-endian, data-type-policy=OVERRIDE, i-signal-type=PRIMITIVE, init-value=0, base-type=BT_AB_Abschaltanf_SIH_BF, compu {0=Cx0_Normalbetrieb (CM_AB_Abschaltanf_SIH_BF_Cx0_Normalbetrieb), 1=Cx1_Abschaltung_angefordert (CM_AB_Abschaltanf_SIH_BF_Cx1_Abschaltung_angefordert)}, range raw 0..1, transfer-property=TRIGGERED-ON-CHANGE-WITHOUT-REPETITION  # Die Insassenerkennung auf der Beifahrerseite fordert bei Übertemperatur eine Abschaltung der Sitzheizung an. Die Übertemperatur kann bei niederohmigen Nebenschlüssen der Sitzheizungsmatte als Folge von zu hohem resultierenden Strom auftreten.
          signal AB_Gurtwarn_Reihe3_BF_XIX_Airbag_10_XIX_HCP5_CANFD01: start 74, 2 bit, little-endian, data-type-policy=OVERRIDE, i-signal-type=PRIMITIVE, init-value=0, base-type=BT_AB_Gurtwarn_Reihe3_BF, compu {0=Cx0_nicht_verbaut (CM_AB_Gurtwarn_Reihe3_BF_Cx0_nicht_verbaut), 1=Cx1_keine_Gurtwarnung_Sitz_leer (CM_AB_Gurtwarn_Reihe3_BF_Cx1_keine_Gurtwarnung_Sitz_leer), 2=Cx2_keine_Gurtwarnung_Sitz_belegt (CM_AB_Gurtwarn_Reihe3_BF_Cx2_keine_Gurtwarnung_Sitz_belegt), 3=Cx3_Gurtwarnung_Sitz_belegt (CM_AB_Gurtwarn_Reihe3_BF_Cx3_Gurtwarnung_Sitz_belegt)}, range raw 0..3, transfer-property=TRIGGERED-ON-CHANGE-WITHOUT-REPETITION  # Status Gurtwarnung 3. Sitzreihe Beifahrerseite
          signal AB_Gurtwarn_Reihe3_FA_XIX_Airbag_10_XIX_HCP5_CANFD01: start 76, 2 bit, little-endian, data-type-policy=OVERRIDE, i-signal-type=PRIMITIVE, init-value=0, base-type=BT_AB_Gurtwarn_Reihe3_FA, compu {0=Cx0_nicht_verbaut (CM_AB_Gurtwarn_Reihe3_FA_Cx0_nicht_verbaut), 1=Cx1_keine_Gurtwarnung_Sitz_leer (CM_AB_Gurtwarn_Reihe3_FA_Cx1_keine_Gurtwarnung_Sitz_leer), 2=Cx2_keine_Gurtwarnung_Sitz_belegt (CM_AB_Gurtwarn_Reihe3_FA_Cx2_keine_Gurtwarnung_Sitz_belegt), 3=Cx3_Gurtwarnung_Sitz_belegt (CM_AB_Gurtwarn_Reihe3_FA_Cx3_Gurtwarnung_Sitz_belegt)}, range raw 0..3, transfer-property=TRIGGERED-ON-CHANGE-WITHOUT-REPETITION  # Status Gurtwarnung 3. Sitzreihe Fahrerseite
          signal AB_Gurtwarn_Reihe3_MI_XIX_Airbag_10_XIX_HCP5_CANFD01: start 78, 2 bit, little-endian, data-type-policy=OVERRIDE, i-signal-type=PRIMITIVE, init-value=0, base-type=BT_AB_Gurtwarn_Reihe3_MI, compu {0=Cx0_nicht_verbaut (CM_AB_Gurtwarn_Reihe3_MI_Cx0_nicht_verbaut), 1=Cx1_keine_Gurtwarnung_Sitz_leer (CM_AB_Gurtwarn_Reihe3_MI_Cx1_keine_Gurtwarnung_Sitz_leer), 2=Cx2_keine_Gurtwarnung_Sitz_belegt (CM_AB_Gurtwarn_Reihe3_MI_Cx2_keine_Gurtwarnung_Sitz_belegt), 3=Cx3_Gurtwarnung_Sitz_belegt (CM_AB_Gurtwarn_Reihe3_MI_Cx3_Gurtwarnung_Sitz_belegt)}, range raw 0..3, transfer-property=TRIGGERED-ON-CHANGE-WITHOUT-REPETITION  # Status Gurtwarnung 3. Sitzreihe Mitte
          signal AB_PSS_SollZustand_XIX_Airbag_10_XIX_HCP5_CANFD01: start 80, 1 bit, little-endian, data-type-policy=OVERRIDE, i-signal-type=PRIMITIVE, init-value=0, base-type=BT_AB_PSS_SollZustand, compu {0=Cx0_disabled (CM_AB_PSS_SollZustand_Cx0_disabled), 1=Cx1_enabled (CM_AB_PSS_SollZustand_Cx1_enabled)}, range raw 0..1, transfer-property=TRIGGERED-ON-CHANGE  # Erwartete Auslösefähigkeit
          signal AB_EDR_Trigger_XIX_Airbag_10_XIX_HCP5_CANFD01: start 81, 2 bit, little-endian, data-type-policy=OVERRIDE, i-signal-type=PRIMITIVE, init-value=0, base-type=BT_AB_EDR_Trigger, compu {0=Cx0_No_Event (CM_AB_EDR_Trigger_Cx0_No_Event), 1=Cx1_Start_Event (CM_AB_EDR_Trigger_Cx1_Start_Event), 2=Cx2_NonDeployment_Event (CM_AB_EDR_Trigger_Cx2_NonDeployment_Event), 3=Cx3_Deployment_Event (CM_AB_EDR_Trigger_Cx3_Deployment_Event)}, range raw 0..3, transfer-property=TRIGGERED-ON-CHANGE-WITHOUT-REPETITION  # Triggerbedingung zur dezentralen Aufzeichnung unfallrelevanter Daten im Event Data Recorder
          signal AB_Deaktivierung_HV_XIX_Airbag_10_XIX_HCP5_CANFD01: start 83, 3 bit, little-endian, data-type-policy=OVERRIDE, i-signal-type=PRIMITIVE, init-value=0, base-type=BT_AB_Deaktivierung_HV, invalid-value=Invalid_AB_Deaktivierung_HV_XIX_Airbag_10_XIX_HCP5_CANFD01:7, compu {0=Cx0_keine_Deaktivierung (CM_AB_Deaktivierung_HV_Cx0_keine_Deaktivierung), 1=Cx1_Deaktivierung_1 (CM_AB_Deaktivierung_HV_Cx1_Deaktivierung_1), 2=Cx2_Deaktivierung_2 (CM_AB_Deaktivierung_HV_Cx2_Deaktivierung_2), 3=Cx3_Deaktivierung_3 (CM_AB_Deaktivierung_HV_Cx3_Deaktivierung_3), 4=Cx4_Deaktivierung_4 (CM_AB_Deaktivierung_HV_Cx4_Deaktivierung_4), 5=Cx5_Deaktivierung_5 (CM_AB_Deaktivierung_HV_Cx5_Deaktivierung_5), 6=Cx6_Deaktivierung_6 (CM_AB_Deaktivierung_HV_Cx6_Deaktivierung_6), 7=Cx7_Fehler (CM_AB_Deaktivierung_HV_Cx7_Fehler)}, range raw 0..7, transfer-property=TRIGGERED, to BMC_HV(timeout 0.5 s)  # Deaktivierung des HV-Systems und der HV-Teilnehmer im Crash (u.a. Hybrid- und Elektrofahrzeuge)
          signal AB_Belegung_VF_XIX_Airbag_10_XIX_HCP5_CANFD01: start 86, 2 bit, little-endian, data-type-policy=OVERRIDE, i-signal-type=PRIMITIVE, init-value=0, base-type=BT_AB_Belegung_VF, invalid-value=Invalid_AB_Belegung_VF_XIX_Airbag_10_XIX_HCP5_CANFD01:1, compu {0=Cx0_nicht_verfuegbar (CM_AB_Belegung_VF_Cx0_nicht_verfuegbar), 1=Cx1_Fehler (CM_AB_Belegung_VF_Cx1_Fehler), 2=Cx2_nicht_belegt (CM_AB_Belegung_VF_Cx2_nicht_belegt), 3=Cx3_belegt (CM_AB_Belegung_VF_Cx3_belegt)}, range raw 0..3, transfer-property=TRIGGERED-ON-CHANGE-WITHOUT-REPETITION  # Belegungserkennung vorne Fahrer.
          signal AB_SBR_hinten_verbau_XIX_Airbag_10_XIX_HCP5_CANFD01: start 88, 2 bit, little-endian, data-type-policy=OVERRIDE, i-signal-type=PRIMITIVE, init-value=3, base-type=BT_AB_SBR_hinten_verbau, compu {0=Cx0_ohne_SBR_hinten (CM_AB_SBR_hinten_verbau_Cx0_ohne_SBR_hinten), 1=Cx1_mit_SBR_hinten (CM_AB_SBR_hinten_verbau_Cx1_mit_SBR_hinten), 2=Cx2_nicht_definiert (CM_AB_SBR_hinten_verbau_Cx2_nicht_definiert), 3=Cx3_Init (CM_AB_SBR_hinten_verbau_Cx3_Init)}, range raw 0..3, transfer-property=PENDING  # Verbauinformation Sitzbelegungssensor hinten (2. und 3. Sitzreihe)
          signal MKB_ScndCllsnMtgtn_StAbo_XIX_Airbag_10_XIX_HCP5_CANFD01: start 90, 1 bit, little-endian, data-type-policy=OVERRIDE, i-signal-type=PRIMITIVE, init-value=0, base-type=BT_MKB_ScndCllsnMtgtn_StAbo, compu {0=Cx0_NoRequest (CM_MKB_ScndCllsnMtgtn_StAbo_Cx0_NoRequest), 1=Cx1_Abort (CM_MKB_ScndCllsnMtgtn_StAbo_Cx1_Abort)}, range raw 0..1, transfer-property=TRIGGERED-ON-CHANGE  # Request to abort second collision mitigation
          signal MKB_ScndCllsnMtgtn_StReq_XIX_Airbag_10_XIX_HCP5_CANFD01: start 91, 1 bit, little-endian, data-type-policy=OVERRIDE, i-signal-type=PRIMITIVE, init-value=0, base-type=BT_MKB_ScndCllsnMtgtn_StReq, compu {0=Cx0_NoRequest (CM_MKB_ScndCllsnMtgtn_StReq_Cx0_NoRequest), 1=Cx1_SecondCollisionMitigation (CM_MKB_ScndCllsnMtgtn_StReq_Cx1_SecondCollisionMitigation)}, range raw 0..1, transfer-property=TRIGGERED-ON-CHANGE  # Request to trigger second collision mitigation
          signal AB_DeltaV_X_eCall_XIX_Airbag_10_XIX_HCP5_CANFD01: start 92, 8 bit, little-endian, data-type-policy=OVERRIDE, i-signal-type=PRIMITIVE, init-value=0, base-type=BT_AB_DeltaV_X_eCall, compu {0=Cx0_Init_no_DeltaV_X_detected (CM_AB_DeltaV_X_eCall_Cx0_Init_no_DeltaV_X_detected) (Init/no_DeltaV_X_detected), 1=Cx1_DeltaV_X_less_than_neg126km_h (CM_AB_DeltaV_X_eCall_Cx1_DeltaV_X_less_than_neg126km_h) (DeltaV_X_less_than_neg126km/h), phys=raw-128 for raw 2..254, 255=Cxff_DeltaV_X_larger_than_pos126km_h (CM_AB_DeltaV_X_eCall_Cxff_DeltaV_X_larger_than_pos126km_h) (DeltaV_X_larger_than_pos126km/h); unit Unit_KiloMeterPerHour}, range phys -126..126 Unit_KiloMeterPerHour, raw 0..255, unit=Unit_KiloMeterPerHour, transfer-property=TRIGGERED-ON-CHANGE-WITHOUT-REPETITION  # Transmission of the DeltaV longitudinal during Crash (0-250ms) as additional information for eCall
          signal AB_DeltaV_Y_eCall_XIX_Airbag_10_XIX_HCP5_CANFD01: start 100, 8 bit, little-endian, data-type-policy=OVERRIDE, i-signal-type=PRIMITIVE, init-value=0, base-type=BT_AB_DeltaV_Y_eCall, compu {0=Cx0_Init_no_DeltaV_Y_detected (CM_AB_DeltaV_Y_eCall_Cx0_Init_no_DeltaV_Y_detected) (Init/no_DeltaV_Y_detected), 1=Cx1_DeltaV_Y_less_than_neg126km_h (CM_AB_DeltaV_Y_eCall_Cx1_DeltaV_Y_less_than_neg126km_h) (DeltaV_Y_less_than_neg126km/h), phys=raw-128 for raw 2..254, 255=Cxff_DeltaV_Y_larger_than_pos126km_h (CM_AB_DeltaV_Y_eCall_Cxff_DeltaV_Y_larger_than_pos126km_h) (DeltaV_Y_larger_than_pos126km/h); unit Unit_KiloMeterPerHour}, range phys -126..126 Unit_KiloMeterPerHour, raw 0..255, unit=Unit_KiloMeterPerHour, transfer-property=TRIGGERED-ON-CHANGE-WITHOUT-REPETITION  # Transmission of the DeltaV lateral during Crash (0-250ms) as additional information for eCall
      frame BMC_CMC_Temperatur_01_XIX_HCP5_CANFD01: id 0x1A55562A, from BMC_HV, frame-length=64, can-addressing-mode=EXTENDED, can-frame-rx-behavior=CAN-FD, can-frame-tx-behavior=CAN-FD
        pdu BMC_CMC_Temperatur_01_XIX_HCP5_CANFD01: length=64, transmission-mode-true-timing=cyclic-timing={time-offset=0, time-period=1}, unused-bit-pattern=0
          signal BMC_CMC_Temperatur_001_XIX_BMC_CMC_Temperatur_01_XIX_HCP5_CANFD01: start 16, 8 bit, little-endian, data-type-policy=OVERRIDE, i-signal-type=PRIMITIVE, init-value=254, base-type=BT_BMC_CMC_Temperatur_001, invalid-value=Invalid_BMC_CMC_Temperatur_001_XIX_BMC_CMC_Temperatur_01_XIX_HCP5_CANFD01:255, compu {phys=raw*0.5-40 for raw 0..252, 253=Cxfd_nicht_vorhanden (CM_BMC_CMC_Temperatur_001_Cxfd_nicht_vorhanden), 254=Cxfe_Init (CM_BMC_CMC_Temperatur_001_Cxfe_Init), 255=Cxff_Fehler (CM_BMC_CMC_Temperatur_001_Cxff_Fehler); unit Unit_DegreCelsi}, range phys -40..86 Unit_DegreCelsi, raw 0..255, unit=Unit_DegreCelsi, transfer-property=PENDING  # Temperatur Zellmodul fuer die Uebertragung per RTM
          signal BMC_CMC_Temperatur_002_XIX_BMC_CMC_Temperatur_01_XIX_HCP5_CANFD01: start 24, 8 bit, little-endian, data-type-policy=OVERRIDE, i-signal-type=PRIMITIVE, init-value=254, base-type=BT_BMC_CMC_Temperatur_002, invalid-value=Invalid_BMC_CMC_Temperatur_002_XIX_BMC_CMC_Temperatur_01_XIX_HCP5_CANFD01:255, compu {phys=raw*0.5-40 for raw 0..252, 253=Cxfd_nicht_vorhanden (CM_BMC_CMC_Temperatur_002_Cxfd_nicht_vorhanden), 254=Cxfe_Init (CM_BMC_CMC_Temperatur_002_Cxfe_Init), 255=Cxff_Fehler (CM_BMC_CMC_Temperatur_002_Cxff_Fehler); unit Unit_DegreCelsi}, range phys -40..86 Unit_DegreCelsi, raw 0..255, unit=Unit_DegreCelsi, transfer-property=PENDING  # Temperatur Zellmodul fuer die Uebertragung per RTM
          signal BMC_CMC_Temperatur_003_XIX_BMC_CMC_Temperatur_01_XIX_HCP5_CANFD01: start 32, 8 bit, little-endian, data-type-policy=OVERRIDE, i-signal-type=PRIMITIVE, init-value=254, base-type=BT_BMC_CMC_Temperatur_003, invalid-value=Invalid_BMC_CMC_Temperatur_003_XIX_BMC_CMC_Temperatur_01_XIX_HCP5_CANFD01:255, compu {phys=raw*0.5-40 for raw 0..252, 253=Cxfd_nicht_vorhanden (CM_BMC_CMC_Temperatur_003_Cxfd_nicht_vorhanden), 254=Cxfe_Init (CM_BMC_CMC_Temperatur_003_Cxfe_Init), 255=Cxff_Fehler (CM_BMC_CMC_Temperatur_003_Cxff_Fehler); unit Unit_DegreCelsi}, range phys -40..86 Unit_DegreCelsi, raw 0..255, unit=Unit_DegreCelsi, transfer-property=PENDING  # Temperatur Zellmodul fuer die Uebertragung per RTM
          signal BMC_CMC_Temperatur_004_XIX_BMC_CMC_Temperatur_01_XIX_HCP5_CANFD01: start 40, 8 bit, little-endian, data-type-policy=OVERRIDE, i-signal-type=PRIMITIVE, init-value=254, base-type=BT_BMC_CMC_Temperatur_004, invalid-value=Invalid_BMC_CMC_Temperatur_004_XIX_BMC_CMC_Temperatur_01_XIX_HCP5_CANFD01:255, compu {phys=raw*0.5-40 for raw 0..252, 253=Cxfd_nicht_vorhanden (CM_BMC_CMC_Temperatur_004_Cxfd_nicht_vorhanden), 254=Cxfe_Init (CM_BMC_CMC_Temperatur_004_Cxfe_Init), 255=Cxff_Fehler (CM_BMC_CMC_Temperatur_004_Cxff_Fehler); unit Unit_DegreCelsi}, range phys -40..86 Unit_DegreCelsi, raw 0..255, unit=Unit_DegreCelsi, transfer-property=PENDING  # Temperatur Zellmodul fuer die Uebertragung per RTM
          signal BMC_CMC_Temperatur_005_XIX_BMC_CMC_Temperatur_01_XIX_HCP5_CANFD01: start 48, 8 bit, little-endian, data-type-policy=OVERRIDE, i-signal-type=PRIMITIVE, init-value=254, base-type=BT_BMC_CMC_Temperatur_005, invalid-value=Invalid_BMC_CMC_Temperatur_005_XIX_BMC_CMC_Temperatur_01_XIX_HCP5_CANFD01:255, compu {phys=raw*0.5-40 for raw 0..252, 253=Cxfd_nicht_vorhanden (CM_BMC_CMC_Temperatur_005_Cxfd_nicht_vorhanden), 254=Cxfe_Init (CM_BMC_CMC_Temperatur_005_Cxfe_Init), 255=Cxff_Fehler (CM_BMC_CMC_Temperatur_005_Cxff_Fehler); unit Unit_DegreCelsi}, range phys -40..86 Unit_DegreCelsi, raw 0..255, unit=Unit_DegreCelsi, transfer-property=PENDING  # Temperatur Zellmodul fuer die Uebertragung per RTM
          signal BMC_CMC_Temperatur_006_XIX_BMC_CMC_Temperatur_01_XIX_HCP5_CANFD01: start 56, 8 bit, little-endian, data-type-policy=OVERRIDE, i-signal-type=PRIMITIVE, init-value=254, base-type=BT_BMC_CMC_Temperatur_006, invalid-value=Invalid_BMC_CMC_Temperatur_006_XIX_BMC_CMC_Temperatur_01_XIX_HCP5_CANFD01:255, compu {phys=raw*0.5-40 for raw 0..252, 253=Cxfd_nicht_vorhanden (CM_BMC_CMC_Temperatur_006_Cxfd_nicht_vorhanden), 254=Cxfe_Init (CM_BMC_CMC_Temperatur_006_Cxfe_Init), 255=Cxff_Fehler (CM_BMC_CMC_Temperatur_006_Cxff_Fehler); unit Unit_DegreCelsi}, range phys -40..86 Unit_DegreCelsi, raw 0..255, unit=Unit_DegreCelsi, transfer-property=PENDING  # Temperatur Zellmodul fuer die Uebertragung per RTM
          signal BMC_CMC_Temperatur_007_XIX_BMC_CMC_Temperatur_01_XIX_HCP5_CANFD01: start 64, 8 bit, little-endian, data-type-policy=OVERRIDE, i-signal-type=PRIMITIVE, init-value=254, base-type=BT_BMC_CMC_Temperatur_007, invalid-value=Invalid_BMC_CMC_Temperatur_007_XIX_BMC_CMC_Temperatur_01_XIX_HCP5_CANFD01:255, compu {phys=raw*0.5-40 for raw 0..252, 253=Cxfd_nicht_vorhanden (CM_BMC_CMC_Temperatur_007_Cxfd_nicht_vorhanden), 254=Cxfe_Init (CM_BMC_CMC_Temperatur_007_Cxfe_Init), 255=Cxff_Fehler (CM_BMC_CMC_Temperatur_007_Cxff_Fehler); unit Unit_DegreCelsi}, range phys -40..86 Unit_DegreCelsi, raw 0..255, unit=Unit_DegreCelsi, transfer-property=PENDING  # Temperatur Zellmodul fuer die Uebertragung per RTM
          signal BMC_CMC_Temperatur_008_XIX_BMC_CMC_Temperatur_01_XIX_HCP5_CANFD01: start 72, 8 bit, little-endian, data-type-policy=OVERRIDE, i-signal-type=PRIMITIVE, init-value=254, base-type=BT_BMC_CMC_Temperatur_008, invalid-value=Invalid_BMC_CMC_Temperatur_008_XIX_BMC_CMC_Temperatur_01_XIX_HCP5_CANFD01:255, compu {phys=raw*0.5-40 for raw 0..252, 253=Cxfd_nicht_vorhanden (CM_BMC_CMC_Temperatur_008_Cxfd_nicht_vorhanden), 254=Cxfe_Init (CM_BMC_CMC_Temperatur_008_Cxfe_Init), 255=Cxff_Fehler (CM_BMC_CMC_Temperatur_008_Cxff_Fehler); unit Unit_DegreCelsi}, range phys -40..86 Unit_DegreCelsi, raw 0..255, unit=Unit_DegreCelsi, transfer-property=PENDING  # Temperatur Zellmodul fuer die Uebertragung per RTM
          signal BMC_CMC_Temperatur_009_XIX_BMC_CMC_Temperatur_01_XIX_HCP5_CANFD01: start 80, 8 bit, little-endian, data-type-policy=OVERRIDE, i-signal-type=PRIMITIVE, init-value=254, base-type=BT_BMC_CMC_Temperatur_009, invalid-value=Invalid_BMC_CMC_Temperatur_009_XIX_BMC_CMC_Temperatur_01_XIX_HCP5_CANFD01:255, compu {phys=raw*0.5-40 for raw 0..252, 253=Cxfd_nicht_vorhanden (CM_BMC_CMC_Temperatur_009_Cxfd_nicht_vorhanden), 254=Cxfe_Init (CM_BMC_CMC_Temperatur_009_Cxfe_Init), 255=Cxff_Fehler (CM_BMC_CMC_Temperatur_009_Cxff_Fehler); unit Unit_DegreCelsi}, range phys -40..86 Unit_DegreCelsi, raw 0..255, unit=Unit_DegreCelsi, transfer-property=PENDING  # Temperatur Zellmodul fuer die Uebertragung per RTM
          signal BMC_CMC_Temperatur_010_XIX_BMC_CMC_Temperatur_01_XIX_HCP5_CANFD01: start 88, 8 bit, little-endian, data-type-policy=OVERRIDE, i-signal-type=PRIMITIVE, init-value=254, base-type=BT_BMC_CMC_Temperatur_010, invalid-value=Invalid_BMC_CMC_Temperatur_010_XIX_BMC_CMC_Temperatur_01_XIX_HCP5_CANFD01:255, compu {phys=raw*0.5-40 for raw 0..252, 253=Cxfd_nicht_vorhanden (CM_BMC_CMC_Temperatur_010_Cxfd_nicht_vorhanden), 254=Cxfe_Init (CM_BMC_CMC_Temperatur_010_Cxfe_Init), 255=Cxff_Fehler (CM_BMC_CMC_Temperatur_010_Cxff_Fehler); unit Unit_DegreCelsi}, range phys -40..86 Unit_DegreCelsi, raw 0..255, unit=Unit_DegreCelsi, transfer-property=PENDING  # Temperatur Zellmodul fuer die Uebertragung per RTM
          signal BMC_CMC_Temperatur_011_XIX_BMC_CMC_Temperatur_01_XIX_HCP5_CANFD01: start 96, 8 bit, little-endian, data-type-policy=OVERRIDE, i-signal-type=PRIMITIVE, init-value=254, base-type=BT_BMC_CMC_Temperatur_011, invalid-value=Invalid_BMC_CMC_Temperatur_011_XIX_BMC_CMC_Temperatur_01_XIX_HCP5_CANFD01:255, compu {phys=raw*0.5-40 for raw 0..252, 253=Cxfd_nicht_vorhanden (CM_BMC_CMC_Temperatur_011_Cxfd_nicht_vorhanden), 254=Cxfe_Init (CM_BMC_CMC_Temperatur_011_Cxfe_Init), 255=Cxff_Fehler (CM_BMC_CMC_Temperatur_011_Cxff_Fehler); unit Unit_DegreCelsi}, range phys -40..86 Unit_DegreCelsi, raw 0..255, unit=Unit_DegreCelsi, transfer-property=PENDING  # Temperatur Zellmodul fuer die Uebertragung per RTM
          signal BMC_CMC_Temperatur_012_XIX_BMC_CMC_Temperatur_01_XIX_HCP5_CANFD01: start 104, 8 bit, little-endian, data-type-policy=OVERRIDE, i-signal-type=PRIMITIVE, init-value=254, base-type=BT_BMC_CMC_Temperatur_012, invalid-value=Invalid_BMC_CMC_Temperatur_012_XIX_BMC_CMC_Temperatur_01_XIX_HCP5_CANFD01:255, compu {phys=raw*0.5-40 for raw 0..252, 253=Cxfd_nicht_vorhanden (CM_BMC_CMC_Temperatur_012_Cxfd_nicht_vorhanden), 254=Cxfe_Init (CM_BMC_CMC_Temperatur_012_Cxfe_Init), 255=Cxff_Fehler (CM_BMC_CMC_Temperatur_012_Cxff_Fehler); unit Unit_DegreCelsi}, range phys -40..86 Unit_DegreCelsi, raw 0..255, unit=Unit_DegreCelsi, transfer-property=PENDING  # Temperatur Zellmodul fuer die Uebertragung per RTM
          signal BMC_CMC_Temperatur_013_XIX_BMC_CMC_Temperatur_01_XIX_HCP5_CANFD01: start 112, 8 bit, little-endian, data-type-policy=OVERRIDE, i-signal-type=PRIMITIVE, init-value=254, base-type=BT_BMC_CMC_Temperatur_013, invalid-value=Invalid_BMC_CMC_Temperatur_013_XIX_BMC_CMC_Temperatur_01_XIX_HCP5_CANFD01:255, compu {phys=raw*0.5-40 for raw 0..252, 253=Cxfd_nicht_vorhanden (CM_BMC_CMC_Temperatur_013_Cxfd_nicht_vorhanden), 254=Cxfe_Init (CM_BMC_CMC_Temperatur_013_Cxfe_Init), 255=Cxff_Fehler (CM_BMC_CMC_Temperatur_013_Cxff_Fehler); unit Unit_DegreCelsi}, range phys -40..86 Unit_DegreCelsi, raw 0..255, unit=Unit_DegreCelsi, transfer-property=PENDING  # Temperatur Zellmodul fuer die Uebertragung per RTM
          signal BMC_CMC_Temperatur_014_XIX_BMC_CMC_Temperatur_01_XIX_HCP5_CANFD01: start 120, 8 bit, little-endian, data-type-policy=OVERRIDE, i-signal-type=PRIMITIVE, init-value=254, base-type=BT_BMC_CMC_Temperatur_014, invalid-value=Invalid_BMC_CMC_Temperatur_014_XIX_BMC_CMC_Temperatur_01_XIX_HCP5_CANFD01:255, compu {phys=raw*0.5-40 for raw 0..252, 253=Cxfd_nicht_vorhanden (CM_BMC_CMC_Temperatur_014_Cxfd_nicht_vorhanden), 254=Cxfe_Init (CM_BMC_CMC_Temperatur_014_Cxfe_Init), 255=Cxff_Fehler (CM_BMC_CMC_Temperatur_014_Cxff_Fehler); unit Unit_DegreCelsi}, range phys -40..86 Unit_DegreCelsi, raw 0..255, unit=Unit_DegreCelsi, transfer-property=PENDING  # Temperatur Zellmodul fuer die Uebertragung per RTM
          signal BMC_CMC_Temperatur_015_XIX_BMC_CMC_Temperatur_01_XIX_HCP5_CANFD01: start 128, 8 bit, little-endian, data-type-policy=OVERRIDE, i-signal-type=PRIMITIVE, init-value=254, base-type=BT_BMC_CMC_Temperatur_015, invalid-value=Invalid_BMC_CMC_Temperatur_015_XIX_BMC_CMC_Temperatur_01_XIX_HCP5_CANFD01:255, compu {phys=raw*0.5-40 for raw 0..252, 253=Cxfd_nicht_vorhanden (CM_BMC_CMC_Temperatur_015_Cxfd_nicht_vorhanden), 254=Cxfe_Init (CM_BMC_CMC_Temperatur_015_Cxfe_Init), 255=Cxff_Fehler (CM_BMC_CMC_Temperatur_015_Cxff_Fehler); unit Unit_DegreCelsi}, range phys -40..86 Unit_DegreCelsi, raw 0..255, unit=Unit_DegreCelsi, transfer-property=PENDING  # Temperatur Zellmodul fuer die Uebertragung per RTM
          signal BMC_CMC_Temperatur_016_XIX_BMC_CMC_Temperatur_01_XIX_HCP5_CANFD01: start 136, 8 bit, little-endian, data-type-policy=OVERRIDE, i-signal-type=PRIMITIVE, init-value=254, base-type=BT_BMC_CMC_Temperatur_016, invalid-value=Invalid_BMC_CMC_Temperatur_016_XIX_BMC_CMC_Temperatur_01_XIX_HCP5_CANFD01:255, compu {phys=raw*0.5-40 for raw 0..252, 253=Cxfd_nicht_vorhanden (CM_BMC_CMC_Temperatur_016_Cxfd_nicht_vorhanden), 254=Cxfe_Init (CM_BMC_CMC_Temperatur_016_Cxfe_Init), 255=Cxff_Fehler (CM_BMC_CMC_Temperatur_016_Cxff_Fehler); unit Unit_DegreCelsi}, range phys -40..86 Unit_DegreCelsi, raw 0..255, unit=Unit_DegreCelsi, transfer-property=PENDING  # Temperatur Zellmodul fuer die Uebertragung per RTM
          signal BMC_CMC_Temperatur_017_XIX_BMC_CMC_Temperatur_01_XIX_HCP5_CANFD01: start 144, 8 bit, little-endian, data-type-policy=OVERRIDE, i-signal-type=PRIMITIVE, init-value=254, base-type=BT_BMC_CMC_Temperatur_017, invalid-value=Invalid_BMC_CMC_Temperatur_017_XIX_BMC_CMC_Temperatur_01_XIX_HCP5_CANFD01:255, compu {phys=raw*0.5-40 for raw 0..252, 253=Cxfd_nicht_vorhanden (CM_BMC_CMC_Temperatur_017_Cxfd_nicht_vorhanden), 254=Cxfe_Init (CM_BMC_CMC_Temperatur_017_Cxfe_Init), 255=Cxff_Fehler (CM_BMC_CMC_Temperatur_017_Cxff_Fehler); unit Unit_DegreCelsi}, range phys -40..86 Unit_DegreCelsi, raw 0..255, unit=Unit_DegreCelsi, transfer-property=PENDING  # Temperatur Zellmodul fuer die Uebertragung per RTM
          signal BMC_CMC_Temperatur_018_XIX_BMC_CMC_Temperatur_01_XIX_HCP5_CANFD01: start 152, 8 bit, little-endian, data-type-policy=OVERRIDE, i-signal-type=PRIMITIVE, init-value=254, base-type=BT_BMC_CMC_Temperatur_018, invalid-value=Invalid_BMC_CMC_Temperatur_018_XIX_BMC_CMC_Temperatur_01_XIX_HCP5_CANFD01:255, compu {phys=raw*0.5-40 for raw 0..252, 253=Cxfd_nicht_vorhanden (CM_BMC_CMC_Temperatur_018_Cxfd_nicht_vorhanden), 254=Cxfe_Init (CM_BMC_CMC_Temperatur_018_Cxfe_Init), 255=Cxff_Fehler (CM_BMC_CMC_Temperatur_018_Cxff_Fehler); unit Unit_DegreCelsi}, range phys -40..86 Unit_DegreCelsi, raw 0..255, unit=Unit_DegreCelsi, transfer-property=PENDING  # Temperatur Zellmodul fuer die Uebertragung per RTM
          signal BMC_CMC_Temperatur_019_XIX_BMC_CMC_Temperatur_01_XIX_HCP5_CANFD01: start 160, 8 bit, little-endian, data-type-policy=OVERRIDE, i-signal-type=PRIMITIVE, init-value=254, base-type=BT_BMC_CMC_Temperatur_019, invalid-value=Invalid_BMC_CMC_Temperatur_019_XIX_BMC_CMC_Temperatur_01_XIX_HCP5_CANFD01:255, compu {phys=raw*0.5-40 for raw 0..252, 253=Cxfd_nicht_vorhanden (CM_BMC_CMC_Temperatur_019_Cxfd_nicht_vorhanden), 254=Cxfe_Init (CM_BMC_CMC_Temperatur_019_Cxfe_Init), 255=Cxff_Fehler (CM_BMC_CMC_Temperatur_019_Cxff_Fehler); unit Unit_DegreCelsi}, range phys -40..86 Unit_DegreCelsi, raw 0..255, unit=Unit_DegreCelsi, transfer-property=PENDING  # Temperatur Zellmodul fuer die Uebertragung per RTM
          signal BMC_CMC_Temperatur_020_XIX_BMC_CMC_Temperatur_01_XIX_HCP5_CANFD01: start 168, 8 bit, little-endian, data-type-policy=OVERRIDE, i-signal-type=PRIMITIVE, init-value=254, base-type=BT_BMC_CMC_Temperatur_020, invalid-value=Invalid_BMC_CMC_Temperatur_020_XIX_BMC_CMC_Temperatur_01_XIX_HCP5_CANFD01:255, compu {phys=raw*0.5-40 for raw 0..252, 253=Cxfd_nicht_vorhanden (CM_BMC_CMC_Temperatur_020_Cxfd_nicht_vorhanden), 254=Cxfe_Init (CM_BMC_CMC_Temperatur_020_Cxfe_Init), 255=Cxff_Fehler (CM_BMC_CMC_Temperatur_020_Cxff_Fehler); unit Unit_DegreCelsi}, range phys -40..86 Unit_DegreCelsi, raw 0..255, unit=Unit_DegreCelsi, transfer-property=PENDING  # Temperatur Zellmodul fuer die Uebertragung per RTM
          signal BMC_CMC_Temperatur_021_XIX_BMC_CMC_Temperatur_01_XIX_HCP5_CANFD01: start 176, 8 bit, little-endian, data-type-policy=OVERRIDE, i-signal-type=PRIMITIVE, init-value=254, base-type=BT_BMC_CMC_Temperatur_021, invalid-value=Invalid_BMC_CMC_Temperatur_021_XIX_BMC_CMC_Temperatur_01_XIX_HCP5_CANFD01:255, compu {phys=raw*0.5-40 for raw 0..252, 253=Cxfd_nicht_vorhanden (CM_BMC_CMC_Temperatur_021_Cxfd_nicht_vorhanden), 254=Cxfe_Init (CM_BMC_CMC_Temperatur_021_Cxfe_Init), 255=Cxff_Fehler (CM_BMC_CMC_Temperatur_021_Cxff_Fehler); unit Unit_DegreCelsi}, range phys -40..86 Unit_DegreCelsi, raw 0..255, unit=Unit_DegreCelsi, transfer-property=PENDING  # Temperatur Zellmodul fuer die Uebertragung per RTM
          signal BMC_CMC_Temperatur_022_XIX_BMC_CMC_Temperatur_01_XIX_HCP5_CANFD01: start 184, 8 bit, little-endian, data-type-policy=OVERRIDE, i-signal-type=PRIMITIVE, init-value=254, base-type=BT_BMC_CMC_Temperatur_022, invalid-value=Invalid_BMC_CMC_Temperatur_022_XIX_BMC_CMC_Temperatur_01_XIX_HCP5_CANFD01:255, compu {phys=raw*0.5-40 for raw 0..252, 253=Cxfd_nicht_vorhanden (CM_BMC_CMC_Temperatur_022_Cxfd_nicht_vorhanden), 254=Cxfe_Init (CM_BMC_CMC_Temperatur_022_Cxfe_Init), 255=Cxff_Fehler (CM_BMC_CMC_Temperatur_022_Cxff_Fehler); unit Unit_DegreCelsi}, range phys -40..86 Unit_DegreCelsi, raw 0..255, unit=Unit_DegreCelsi, transfer-property=PENDING  # Temperatur Zellmodul fuer die Uebertragung per RTM
          signal BMC_CMC_Temperatur_023_XIX_BMC_CMC_Temperatur_01_XIX_HCP5_CANFD01: start 192, 8 bit, little-endian, data-type-policy=OVERRIDE, i-signal-type=PRIMITIVE, init-value=254, base-type=BT_BMC_CMC_Temperatur_023, invalid-value=Invalid_BMC_CMC_Temperatur_023_XIX_BMC_CMC_Temperatur_01_XIX_HCP5_CANFD01:255, compu {phys=raw*0.5-40 for raw 0..252, 253=Cxfd_nicht_vorhanden (CM_BMC_CMC_Temperatur_023_Cxfd_nicht_vorhanden), 254=Cxfe_Init (CM_BMC_CMC_Temperatur_023_Cxfe_Init), 255=Cxff_Fehler (CM_BMC_CMC_Temperatur_023_Cxff_Fehler); unit Unit_DegreCelsi}, range phys -40..86 Unit_DegreCelsi, raw 0..255, unit=Unit_DegreCelsi, transfer-property=PENDING  # Temperatur Zellmodul fuer die Uebertragung per RTM
          signal BMC_CMC_Temperatur_024_XIX_BMC_CMC_Temperatur_01_XIX_HCP5_CANFD01: start 200, 8 bit, little-endian, data-type-policy=OVERRIDE, i-signal-type=PRIMITIVE, init-value=254, base-type=BT_BMC_CMC_Temperatur_024, invalid-value=Invalid_BMC_CMC_Temperatur_024_XIX_BMC_CMC_Temperatur_01_XIX_HCP5_CANFD01:255, compu {phys=raw*0.5-40 for raw 0..252, 253=Cxfd_nicht_vorhanden (CM_BMC_CMC_Temperatur_024_Cxfd_nicht_vorhanden), 254=Cxfe_Init (CM_BMC_CMC_Temperatur_024_Cxfe_Init), 255=Cxff_Fehler (CM_BMC_CMC_Temperatur_024_Cxff_Fehler); unit Unit_DegreCelsi}, range phys -40..86 Unit_DegreCelsi, raw 0..255, unit=Unit_DegreCelsi, transfer-property=PENDING  # Temperatur Zellmodul fuer die Uebertragung per RTM
          signal BMC_CMC_Temperatur_025_XIX_BMC_CMC_Temperatur_01_XIX_HCP5_CANFD01: start 208, 8 bit, little-endian, data-type-policy=OVERRIDE, i-signal-type=PRIMITIVE, init-value=254, base-type=BT_BMC_CMC_Temperatur_025, invalid-value=Invalid_BMC_CMC_Temperatur_025_XIX_BMC_CMC_Temperatur_01_XIX_HCP5_CANFD01:255, compu {phys=raw*0.5-40 for raw 0..252, 253=Cxfd_nicht_vorhanden (CM_BMC_CMC_Temperatur_025_Cxfd_nicht_vorhanden), 254=Cxfe_Init (CM_BMC_CMC_Temperatur_025_Cxfe_Init), 255=Cxff_Fehler (CM_BMC_CMC_Temperatur_025_Cxff_Fehler); unit Unit_DegreCelsi}, range phys -40..86 Unit_DegreCelsi, raw 0..255, unit=Unit_DegreCelsi, transfer-property=PENDING  # Temperatur Zellmodul fuer die Uebertragung per RTM
          signal BMC_CMC_Temperatur_026_XIX_BMC_CMC_Temperatur_01_XIX_HCP5_CANFD01: start 216, 8 bit, little-endian, data-type-policy=OVERRIDE, i-signal-type=PRIMITIVE, init-value=254, base-type=BT_BMC_CMC_Temperatur_026, invalid-value=Invalid_BMC_CMC_Temperatur_026_XIX_BMC_CMC_Temperatur_01_XIX_HCP5_CANFD01:255, compu {phys=raw*0.5-40 for raw 0..252, 253=Cxfd_nicht_vorhanden (CM_BMC_CMC_Temperatur_026_Cxfd_nicht_vorhanden), 254=Cxfe_Init (CM_BMC_CMC_Temperatur_026_Cxfe_Init), 255=Cxff_Fehler (CM_BMC_CMC_Temperatur_026_Cxff_Fehler); unit Unit_DegreCelsi}, range phys -40..86 Unit_DegreCelsi, raw 0..255, unit=Unit_DegreCelsi, transfer-property=PENDING  # Temperatur Zellmodul fuer die Uebertragung per RTM
          signal BMC_CMC_Temperatur_027_XIX_BMC_CMC_Temperatur_01_XIX_HCP5_CANFD01: start 224, 8 bit, little-endian, data-type-policy=OVERRIDE, i-signal-type=PRIMITIVE, init-value=254, base-type=BT_BMC_CMC_Temperatur_027, invalid-value=Invalid_BMC_CMC_Temperatur_027_XIX_BMC_CMC_Temperatur_01_XIX_HCP5_CANFD01:255, compu {phys=raw*0.5-40 for raw 0..252, 253=Cxfd_nicht_vorhanden (CM_BMC_CMC_Temperatur_027_Cxfd_nicht_vorhanden), 254=Cxfe_Init (CM_BMC_CMC_Temperatur_027_Cxfe_Init), 255=Cxff_Fehler (CM_BMC_CMC_Temperatur_027_Cxff_Fehler); unit Unit_DegreCelsi}, range phys -40..86 Unit_DegreCelsi, raw 0..255, unit=Unit_DegreCelsi, transfer-property=PENDING  # Temperatur Zellmodul fuer die Uebertragung per RTM
          signal BMC_CMC_Temperatur_028_XIX_BMC_CMC_Temperatur_01_XIX_HCP5_CANFD01: start 232, 8 bit, little-endian, data-type-policy=OVERRIDE, i-signal-type=PRIMITIVE, init-value=254, base-type=BT_BMC_CMC_Temperatur_028, invalid-value=Invalid_BMC_CMC_Temperatur_028_XIX_BMC_CMC_Temperatur_01_XIX_HCP5_CANFD01:255, compu {phys=raw*0.5-40 for raw 0..252, 253=Cxfd_nicht_vorhanden (CM_BMC_CMC_Temperatur_028_Cxfd_nicht_vorhanden), 254=Cxfe_Init (CM_BMC_CMC_Temperatur_028_Cxfe_Init), 255=Cxff_Fehler (CM_BMC_CMC_Temperatur_028_Cxff_Fehler); unit Unit_DegreCelsi}, range phys -40..86 Unit_DegreCelsi, raw 0..255, unit=Unit_DegreCelsi, transfer-property=PENDING  # Temperatur Zellmodul fuer die Uebertragung per RTM
          signal BMC_CMC_Temperatur_029_XIX_BMC_CMC_Temperatur_01_XIX_HCP5_CANFD01: start 240, 8 bit, little-endian, data-type-policy=OVERRIDE, i-signal-type=PRIMITIVE, init-value=254, base-type=BT_BMC_CMC_Temperatur_029, invalid-value=Invalid_BMC_CMC_Temperatur_029_XIX_BMC_CMC_Temperatur_01_XIX_HCP5_CANFD01:255, compu {phys=raw*0.5-40 for raw 0..252, 253=Cxfd_nicht_vorhanden (CM_BMC_CMC_Temperatur_029_Cxfd_nicht_vorhanden), 254=Cxfe_Init (CM_BMC_CMC_Temperatur_029_Cxfe_Init), 255=Cxff_Fehler (CM_BMC_CMC_Temperatur_029_Cxff_Fehler); unit Unit_DegreCelsi}, range phys -40..86 Unit_DegreCelsi, raw 0..255, unit=Unit_DegreCelsi, transfer-property=PENDING  # Temperatur Zellmodul fuer die Uebertragung per RTM
          signal BMC_CMC_Temperatur_030_XIX_BMC_CMC_Temperatur_01_XIX_HCP5_CANFD01: start 248, 8 bit, little-endian, data-type-policy=OVERRIDE, i-signal-type=PRIMITIVE, init-value=254, base-type=BT_BMC_CMC_Temperatur_030, invalid-value=Invalid_BMC_CMC_Temperatur_030_XIX_BMC_CMC_Temperatur_01_XIX_HCP5_CANFD01:255, compu {phys=raw*0.5-40 for raw 0..252, 253=Cxfd_nicht_vorhanden (CM_BMC_CMC_Temperatur_030_Cxfd_nicht_vorhanden), 254=Cxfe_Init (CM_BMC_CMC_Temperatur_030_Cxfe_Init), 255=Cxff_Fehler (CM_BMC_CMC_Temperatur_030_Cxff_Fehler); unit Unit_DegreCelsi}, range phys -40..86 Unit_DegreCelsi, raw 0..255, unit=Unit_DegreCelsi, transfer-property=PENDING  # Temperatur Zellmodul fuer die Uebertragung per RTM
          signal BMC_CMC_Temperatur_031_XIX_BMC_CMC_Temperatur_01_XIX_HCP5_CANFD01: start 256, 8 bit, little-endian, data-type-policy=OVERRIDE, i-signal-type=PRIMITIVE, init-value=254, base-type=BT_BMC_CMC_Temperatur_031, invalid-value=Invalid_BMC_CMC_Temperatur_031_XIX_BMC_CMC_Temperatur_01_XIX_HCP5_CANFD01:255, compu {phys=raw*0.5-40 for raw 0..252, 253=Cxfd_nicht_vorhanden (CM_BMC_CMC_Temperatur_031_Cxfd_nicht_vorhanden), 254=Cxfe_Init (CM_BMC_CMC_Temperatur_031_Cxfe_Init), 255=Cxff_Fehler (CM_BMC_CMC_Temperatur_031_Cxff_Fehler); unit Unit_DegreCelsi}, range phys -40..86 Unit_DegreCelsi, raw 0..255, unit=Unit_DegreCelsi, transfer-property=PENDING  # Temperatur Zellmodul fuer die Uebertragung per RTM
          signal BMC_CMC_Temperatur_032_XIX_BMC_CMC_Temperatur_01_XIX_HCP5_CANFD01: start 264, 8 bit, little-endian, data-type-policy=OVERRIDE, i-signal-type=PRIMITIVE, init-value=254, base-type=BT_BMC_CMC_Temperatur_032, invalid-value=Invalid_BMC_CMC_Temperatur_032_XIX_BMC_CMC_Temperatur_01_XIX_HCP5_CANFD01:255, compu {phys=raw*0.5-40 for raw 0..252, 253=Cxfd_nicht_vorhanden (CM_BMC_CMC_Temperatur_032_Cxfd_nicht_vorhanden), 254=Cxfe_Init (CM_BMC_CMC_Temperatur_032_Cxfe_Init), 255=Cxff_Fehler (CM_BMC_CMC_Temperatur_032_Cxff_Fehler); unit Unit_DegreCelsi}, range phys -40..86 Unit_DegreCelsi, raw 0..255, unit=Unit_DegreCelsi, transfer-property=PENDING  # Temperatur Zellmodul fuer die Uebertragung per RTM
          signal BMC_CMC_Temperatur_033_XIX_BMC_CMC_Temperatur_01_XIX_HCP5_CANFD01: start 272, 8 bit, little-endian, data-type-policy=OVERRIDE, i-signal-type=PRIMITIVE, init-value=254, base-type=BT_BMC_CMC_Temperatur_033, invalid-value=Invalid_BMC_CMC_Temperatur_033_XIX_BMC_CMC_Temperatur_01_XIX_HCP5_CANFD01:255, compu {phys=raw*0.5-40 for raw 0..252, 253=Cxfd_nicht_vorhanden (CM_BMC_CMC_Temperatur_033_Cxfd_nicht_vorhanden), 254=Cxfe_Init (CM_BMC_CMC_Temperatur_033_Cxfe_Init), 255=Cxff_Fehler (CM_BMC_CMC_Temperatur_033_Cxff_Fehler); unit Unit_DegreCelsi}, range phys -40..86 Unit_DegreCelsi, raw 0..255, unit=Unit_DegreCelsi, transfer-property=PENDING  # Temperatur Zellmodul fuer die Uebertragung per RTM
          signal BMC_CMC_Temperatur_034_XIX_BMC_CMC_Temperatur_01_XIX_HCP5_CANFD01: start 280, 8 bit, little-endian, data-type-policy=OVERRIDE, i-signal-type=PRIMITIVE, init-value=254, base-type=BT_BMC_CMC_Temperatur_034, invalid-value=Invalid_BMC_CMC_Temperatur_034_XIX_BMC_CMC_Temperatur_01_XIX_HCP5_CANFD01:255, compu {phys=raw*0.5-40 for raw 0..252, 253=Cxfd_nicht_vorhanden (CM_BMC_CMC_Temperatur_034_Cxfd_nicht_vorhanden), 254=Cxfe_Init (CM_BMC_CMC_Temperatur_034_Cxfe_Init), 255=Cxff_Fehler (CM_BMC_CMC_Temperatur_034_Cxff_Fehler); unit Unit_DegreCelsi}, range phys -40..86 Unit_DegreCelsi, raw 0..255, unit=Unit_DegreCelsi, transfer-property=PENDING  # Temperatur Zellmodul fuer die Uebertragung per RTM
          signal BMC_CMC_Temperatur_035_XIX_BMC_CMC_Temperatur_01_XIX_HCP5_CANFD01: start 288, 8 bit, little-endian, data-type-policy=OVERRIDE, i-signal-type=PRIMITIVE, init-value=254, base-type=BT_BMC_CMC_Temperatur_035, invalid-value=Invalid_BMC_CMC_Temperatur_035_XIX_BMC_CMC_Temperatur_01_XIX_HCP5_CANFD01:255, compu {phys=raw*0.5-40 for raw 0..252, 253=Cxfd_nicht_vorhanden (CM_BMC_CMC_Temperatur_035_Cxfd_nicht_vorhanden), 254=Cxfe_Init (CM_BMC_CMC_Temperatur_035_Cxfe_Init), 255=Cxff_Fehler (CM_BMC_CMC_Temperatur_035_Cxff_Fehler); unit Unit_DegreCelsi}, range phys -40..86 Unit_DegreCelsi, raw 0..255, unit=Unit_DegreCelsi, transfer-property=PENDING  # Temperatur Zellmodul fuer die Uebertragung per RTM
          signal BMC_CMC_Temperatur_036_XIX_BMC_CMC_Temperatur_01_XIX_HCP5_CANFD01: start 296, 8 bit, little-endian, data-type-policy=OVERRIDE, i-signal-type=PRIMITIVE, init-value=254, base-type=BT_BMC_CMC_Temperatur_036, invalid-value=Invalid_BMC_CMC_Temperatur_036_XIX_BMC_CMC_Temperatur_01_XIX_HCP5_CANFD01:255, compu {phys=raw*0.5-40 for raw 0..252, 253=Cxfd_nicht_vorhanden (CM_BMC_CMC_Temperatur_036_Cxfd_nicht_vorhanden), 254=Cxfe_Init (CM_BMC_CMC_Temperatur_036_Cxfe_Init), 255=Cxff_Fehler (CM_BMC_CMC_Temperatur_036_Cxff_Fehler); unit Unit_DegreCelsi}, range phys -40..86 Unit_DegreCelsi, raw 0..255, unit=Unit_DegreCelsi, transfer-property=PENDING  # Temperatur Zellmodul fuer die Uebertragung per RTM
          signal BMC_CMC_Temperatur_037_XIX_BMC_CMC_Temperatur_01_XIX_HCP5_CANFD01: start 304, 8 bit, little-endian, data-type-policy=OVERRIDE, i-signal-type=PRIMITIVE, init-value=254, base-type=BT_BMC_CMC_Temperatur_037, invalid-value=Invalid_BMC_CMC_Temperatur_037_XIX_BMC_CMC_Temperatur_01_XIX_HCP5_CANFD01:255, compu {phys=raw*0.5-40 for raw 0..252, 253=Cxfd_nicht_vorhanden (CM_BMC_CMC_Temperatur_037_Cxfd_nicht_vorhanden), 254=Cxfe_Init (CM_BMC_CMC_Temperatur_037_Cxfe_Init), 255=Cxff_Fehler (CM_BMC_CMC_Temperatur_037_Cxff_Fehler); unit Unit_DegreCelsi}, range phys -40..86 Unit_DegreCelsi, raw 0..255, unit=Unit_DegreCelsi, transfer-property=PENDING  # Temperatur Zellmodul fuer die Uebertragung per RTM
          signal BMC_CMC_Temperatur_038_XIX_BMC_CMC_Temperatur_01_XIX_HCP5_CANFD01: start 312, 8 bit, little-endian, data-type-policy=OVERRIDE, i-signal-type=PRIMITIVE, init-value=254, base-type=BT_BMC_CMC_Temperatur_038, invalid-value=Invalid_BMC_CMC_Temperatur_038_XIX_BMC_CMC_Temperatur_01_XIX_HCP5_CANFD01:255, compu {phys=raw*0.5-40 for raw 0..252, 253=Cxfd_nicht_vorhanden (CM_BMC_CMC_Temperatur_038_Cxfd_nicht_vorhanden), 254=Cxfe_Init (CM_BMC_CMC_Temperatur_038_Cxfe_Init), 255=Cxff_Fehler (CM_BMC_CMC_Temperatur_038_Cxff_Fehler); unit Unit_DegreCelsi}, range phys -40..86 Unit_DegreCelsi, raw 0..255, unit=Unit_DegreCelsi, transfer-property=PENDING  # Temperatur Zellmodul fuer die Uebertragung per RTM
          signal BMC_CMC_Temperatur_039_XIX_BMC_CMC_Temperatur_01_XIX_HCP5_CANFD01: start 320, 8 bit, little-endian, data-type-policy=OVERRIDE, i-signal-type=PRIMITIVE, init-value=254, base-type=BT_BMC_CMC_Temperatur_039, invalid-value=Invalid_BMC_CMC_Temperatur_039_XIX_BMC_CMC_Temperatur_01_XIX_HCP5_CANFD01:255, compu {phys=raw*0.5-40 for raw 0..252, 253=Cxfd_nicht_vorhanden (CM_BMC_CMC_Temperatur_039_Cxfd_nicht_vorhanden), 254=Cxfe_Init (CM_BMC_CMC_Temperatur_039_Cxfe_Init), 255=Cxff_Fehler (CM_BMC_CMC_Temperatur_039_Cxff_Fehler); unit Unit_DegreCelsi}, range phys -40..86 Unit_DegreCelsi, raw 0..255, unit=Unit_DegreCelsi, transfer-property=PENDING  # Temperatur Zellmodul fuer die Uebertragung per RTM
          signal BMC_CMC_Temperatur_040_XIX_BMC_CMC_Temperatur_01_XIX_HCP5_CANFD01: start 328, 8 bit, little-endian, data-type-policy=OVERRIDE, i-signal-type=PRIMITIVE, init-value=254, base-type=BT_BMC_CMC_Temperatur_040, invalid-value=Invalid_BMC_CMC_Temperatur_040_XIX_BMC_CMC_Temperatur_01_XIX_HCP5_CANFD01:255, compu {phys=raw*0.5-40 for raw 0..252, 253=Cxfd_nicht_vorhanden (CM_BMC_CMC_Temperatur_040_Cxfd_nicht_vorhanden), 254=Cxfe_Init (CM_BMC_CMC_Temperatur_040_Cxfe_Init), 255=Cxff_Fehler (CM_BMC_CMC_Temperatur_040_Cxff_Fehler); unit Unit_DegreCelsi}, range phys -40..86 Unit_DegreCelsi, raw 0..255, unit=Unit_DegreCelsi, transfer-property=PENDING  # Temperatur Zellmodul fuer die Uebertragung per RTM
          signal BMC_CMC_Temperatur_041_XIX_BMC_CMC_Temperatur_01_XIX_HCP5_CANFD01: start 336, 8 bit, little-endian, data-type-policy=OVERRIDE, i-signal-type=PRIMITIVE, init-value=254, base-type=BT_BMC_CMC_Temperatur_041, invalid-value=Invalid_BMC_CMC_Temperatur_041_XIX_BMC_CMC_Temperatur_01_XIX_HCP5_CANFD01:255, compu {phys=raw*0.5-40 for raw 0..252, 253=Cxfd_nicht_vorhanden (CM_BMC_CMC_Temperatur_041_Cxfd_nicht_vorhanden), 254=Cxfe_Init (CM_BMC_CMC_Temperatur_041_Cxfe_Init), 255=Cxff_Fehler (CM_BMC_CMC_Temperatur_041_Cxff_Fehler); unit Unit_DegreCelsi}, range phys -40..86 Unit_DegreCelsi, raw 0..255, unit=Unit_DegreCelsi, transfer-property=PENDING  # Temperatur Zellmodul fuer die Uebertragung per RTM
          signal BMC_CMC_Temperatur_042_XIX_BMC_CMC_Temperatur_01_XIX_HCP5_CANFD01: start 344, 8 bit, little-endian, data-type-policy=OVERRIDE, i-signal-type=PRIMITIVE, init-value=254, base-type=BT_BMC_CMC_Temperatur_042, invalid-value=Invalid_BMC_CMC_Temperatur_042_XIX_BMC_CMC_Temperatur_01_XIX_HCP5_CANFD01:255, compu {phys=raw*0.5-40 for raw 0..252, 253=Cxfd_nicht_vorhanden (CM_BMC_CMC_Temperatur_042_Cxfd_nicht_vorhanden), 254=Cxfe_Init (CM_BMC_CMC_Temperatur_042_Cxfe_Init), 255=Cxff_Fehler (CM_BMC_CMC_Temperatur_042_Cxff_Fehler); unit Unit_DegreCelsi}, range phys -40..86 Unit_DegreCelsi, raw 0..255, unit=Unit_DegreCelsi, transfer-property=PENDING  # Temperatur Zellmodul fuer die Uebertragung per RTM
          signal BMC_CMC_Temperatur_043_XIX_BMC_CMC_Temperatur_01_XIX_HCP5_CANFD01: start 352, 8 bit, little-endian, data-type-policy=OVERRIDE, i-signal-type=PRIMITIVE, init-value=254, base-type=BT_BMC_CMC_Temperatur_043, invalid-value=Invalid_BMC_CMC_Temperatur_043_XIX_BMC_CMC_Temperatur_01_XIX_HCP5_CANFD01:255, compu {phys=raw*0.5-40 for raw 0..252, 253=Cxfd_nicht_vorhanden (CM_BMC_CMC_Temperatur_043_Cxfd_nicht_vorhanden), 254=Cxfe_Init (CM_BMC_CMC_Temperatur_043_Cxfe_Init), 255=Cxff_Fehler (CM_BMC_CMC_Temperatur_043_Cxff_Fehler); unit Unit_DegreCelsi}, range phys -40..86 Unit_DegreCelsi, raw 0..255, unit=Unit_DegreCelsi, transfer-property=PENDING  # Temperatur Zellmodul fuer die Uebertragung per RTM
          signal BMC_CMC_Temperatur_044_XIX_BMC_CMC_Temperatur_01_XIX_HCP5_CANFD01: start 360, 8 bit, little-endian, data-type-policy=OVERRIDE, i-signal-type=PRIMITIVE, init-value=254, base-type=BT_BMC_CMC_Temperatur_044, invalid-value=Invalid_BMC_CMC_Temperatur_044_XIX_BMC_CMC_Temperatur_01_XIX_HCP5_CANFD01:255, compu {phys=raw*0.5-40 for raw 0..252, 253=Cxfd_nicht_vorhanden (CM_BMC_CMC_Temperatur_044_Cxfd_nicht_vorhanden), 254=Cxfe_Init (CM_BMC_CMC_Temperatur_044_Cxfe_Init), 255=Cxff_Fehler (CM_BMC_CMC_Temperatur_044_Cxff_Fehler); unit Unit_DegreCelsi}, range phys -40..86 Unit_DegreCelsi, raw 0..255, unit=Unit_DegreCelsi, transfer-property=PENDING  # Temperatur Zellmodul fuer die Uebertragung per RTM
          signal BMC_CMC_Temperatur_045_XIX_BMC_CMC_Temperatur_01_XIX_HCP5_CANFD01: start 368, 8 bit, little-endian, data-type-policy=OVERRIDE, i-signal-type=PRIMITIVE, init-value=254, base-type=BT_BMC_CMC_Temperatur_045, invalid-value=Invalid_BMC_CMC_Temperatur_045_XIX_BMC_CMC_Temperatur_01_XIX_HCP5_CANFD01:255, compu {phys=raw*0.5-40 for raw 0..252, 253=Cxfd_nicht_vorhanden (CM_BMC_CMC_Temperatur_045_Cxfd_nicht_vorhanden), 254=Cxfe_Init (CM_BMC_CMC_Temperatur_045_Cxfe_Init), 255=Cxff_Fehler (CM_BMC_CMC_Temperatur_045_Cxff_Fehler); unit Unit_DegreCelsi}, range phys -40..86 Unit_DegreCelsi, raw 0..255, unit=Unit_DegreCelsi, transfer-property=PENDING  # Temperatur Zellmodul fuer die Uebertragung per RTM
          signal BMC_CMC_Temperatur_046_XIX_BMC_CMC_Temperatur_01_XIX_HCP5_CANFD01: start 376, 8 bit, little-endian, data-type-policy=OVERRIDE, i-signal-type=PRIMITIVE, init-value=254, base-type=BT_BMC_CMC_Temperatur_046, invalid-value=Invalid_BMC_CMC_Temperatur_046_XIX_BMC_CMC_Temperatur_01_XIX_HCP5_CANFD01:255, compu {phys=raw*0.5-40 for raw 0..252, 253=Cxfd_nicht_vorhanden (CM_BMC_CMC_Temperatur_046_Cxfd_nicht_vorhanden), 254=Cxfe_Init (CM_BMC_CMC_Temperatur_046_Cxfe_Init), 255=Cxff_Fehler (CM_BMC_CMC_Temperatur_046_Cxff_Fehler); unit Unit_DegreCelsi}, range phys -40..86 Unit_DegreCelsi, raw 0..255, unit=Unit_DegreCelsi, transfer-property=PENDING  # Temperatur Zellmodul fuer die Uebertragung per RTM
          signal BMC_CMC_Temperatur_047_XIX_BMC_CMC_Temperatur_01_XIX_HCP5_CANFD01: start 384, 8 bit, little-endian, data-type-policy=OVERRIDE, i-signal-type=PRIMITIVE, init-value=254, base-type=BT_BMC_CMC_Temperatur_047, invalid-value=Invalid_BMC_CMC_Temperatur_047_XIX_BMC_CMC_Temperatur_01_XIX_HCP5_CANFD01:255, compu {phys=raw*0.5-40 for raw 0..252, 253=Cxfd_nicht_vorhanden (CM_BMC_CMC_Temperatur_047_Cxfd_nicht_vorhanden), 254=Cxfe_Init (CM_BMC_CMC_Temperatur_047_Cxfe_Init), 255=Cxff_Fehler (CM_BMC_CMC_Temperatur_047_Cxff_Fehler); unit Unit_DegreCelsi}, range phys -40..86 Unit_DegreCelsi, raw 0..255, unit=Unit_DegreCelsi, transfer-property=PENDING  # Temperatur Zellmodul fuer die Uebertragung per RTM
          signal BMC_CMC_Temperatur_048_XIX_BMC_CMC_Temperatur_01_XIX_HCP5_CANFD01: start 392, 8 bit, little-endian, data-type-policy=OVERRIDE, i-signal-type=PRIMITIVE, init-value=254, base-type=BT_BMC_CMC_Temperatur_048, invalid-value=Invalid_BMC_CMC_Temperatur_048_XIX_BMC_CMC_Temperatur_01_XIX_HCP5_CANFD01:255, compu {phys=raw*0.5-40 for raw 0..252, 253=Cxfd_nicht_vorhanden (CM_BMC_CMC_Temperatur_048_Cxfd_nicht_vorhanden), 254=Cxfe_Init (CM_BMC_CMC_Temperatur_048_Cxfe_Init), 255=Cxff_Fehler (CM_BMC_CMC_Temperatur_048_Cxff_Fehler); unit Unit_DegreCelsi}, range phys -40..86 Unit_DegreCelsi, raw 0..255, unit=Unit_DegreCelsi, transfer-property=PENDING  # Temperatur Zellmodul fuer die Uebertragung per RTM
          signal BMC_CMC_Temperatur_049_XIX_BMC_CMC_Temperatur_01_XIX_HCP5_CANFD01: start 400, 8 bit, little-endian, data-type-policy=OVERRIDE, i-signal-type=PRIMITIVE, init-value=254, base-type=BT_BMC_CMC_Temperatur_049, invalid-value=Invalid_BMC_CMC_Temperatur_049_XIX_BMC_CMC_Temperatur_01_XIX_HCP5_CANFD01:255, compu {phys=raw*0.5-40 for raw 0..252, 253=Cxfd_nicht_vorhanden (CM_BMC_CMC_Temperatur_049_Cxfd_nicht_vorhanden), 254=Cxfe_Init (CM_BMC_CMC_Temperatur_049_Cxfe_Init), 255=Cxff_Fehler (CM_BMC_CMC_Temperatur_049_Cxff_Fehler); unit Unit_DegreCelsi}, range phys -40..86 Unit_DegreCelsi, raw 0..255, unit=Unit_DegreCelsi, transfer-property=PENDING  # Temperatur Zellmodul fuer die Uebertragung per RTM
          signal BMC_CMC_Temperatur_050_XIX_BMC_CMC_Temperatur_01_XIX_HCP5_CANFD01: start 408, 8 bit, little-endian, data-type-policy=OVERRIDE, i-signal-type=PRIMITIVE, init-value=254, base-type=BT_BMC_CMC_Temperatur_050, invalid-value=Invalid_BMC_CMC_Temperatur_050_XIX_BMC_CMC_Temperatur_01_XIX_HCP5_CANFD01:255, compu {phys=raw*0.5-40 for raw 0..252, 253=Cxfd_nicht_vorhanden (CM_BMC_CMC_Temperatur_050_Cxfd_nicht_vorhanden), 254=Cxfe_Init (CM_BMC_CMC_Temperatur_050_Cxfe_Init), 255=Cxff_Fehler (CM_BMC_CMC_Temperatur_050_Cxff_Fehler); unit Unit_DegreCelsi}, range phys -40..86 Unit_DegreCelsi, raw 0..255, unit=Unit_DegreCelsi, transfer-property=PENDING  # Temperatur Zellmodul fuer die Uebertragung per RTM
          signal BMC_CMC_Temperatur_051_XIX_BMC_CMC_Temperatur_01_XIX_HCP5_CANFD01: start 416, 8 bit, little-endian, data-type-policy=OVERRIDE, i-signal-type=PRIMITIVE, init-value=254, base-type=BT_BMC_CMC_Temperatur_051, invalid-value=Invalid_BMC_CMC_Temperatur_051_XIX_BMC_CMC_Temperatur_01_XIX_HCP5_CANFD01:255, compu {phys=raw*0.5-40 for raw 0..252, 253=Cxfd_nicht_vorhanden (CM_BMC_CMC_Temperatur_051_Cxfd_nicht_vorhanden), 254=Cxfe_Init (CM_BMC_CMC_Temperatur_051_Cxfe_Init), 255=Cxff_Fehler (CM_BMC_CMC_Temperatur_051_Cxff_Fehler); unit Unit_DegreCelsi}, range phys -40..86 Unit_DegreCelsi, raw 0..255, unit=Unit_DegreCelsi, transfer-property=PENDING  # Temperatur Zellmodul fuer die Uebertragung per RTM
          signal BMC_CMC_Temperatur_052_XIX_BMC_CMC_Temperatur_01_XIX_HCP5_CANFD01: start 424, 8 bit, little-endian, data-type-policy=OVERRIDE, i-signal-type=PRIMITIVE, init-value=254, base-type=BT_BMC_CMC_Temperatur_052, invalid-value=Invalid_BMC_CMC_Temperatur_052_XIX_BMC_CMC_Temperatur_01_XIX_HCP5_CANFD01:255, compu {phys=raw*0.5-40 for raw 0..252, 253=Cxfd_nicht_vorhanden (CM_BMC_CMC_Temperatur_052_Cxfd_nicht_vorhanden), 254=Cxfe_Init (CM_BMC_CMC_Temperatur_052_Cxfe_Init), 255=Cxff_Fehler (CM_BMC_CMC_Temperatur_052_Cxff_Fehler); unit Unit_DegreCelsi}, range phys -40..86 Unit_DegreCelsi, raw 0..255, unit=Unit_DegreCelsi, transfer-property=PENDING  # Temperatur Zellmodul fuer die Uebertragung per RTM
          signal BMC_CMC_Temperatur_053_XIX_BMC_CMC_Temperatur_01_XIX_HCP5_CANFD01: start 432, 8 bit, little-endian, data-type-policy=OVERRIDE, i-signal-type=PRIMITIVE, init-value=254, base-type=BT_BMC_CMC_Temperatur_053, invalid-value=Invalid_BMC_CMC_Temperatur_053_XIX_BMC_CMC_Temperatur_01_XIX_HCP5_CANFD01:255, compu {phys=raw*0.5-40 for raw 0..252, 253=Cxfd_nicht_vorhanden (CM_BMC_CMC_Temperatur_053_Cxfd_nicht_vorhanden), 254=Cxfe_Init (CM_BMC_CMC_Temperatur_053_Cxfe_Init), 255=Cxff_Fehler (CM_BMC_CMC_Temperatur_053_Cxff_Fehler); unit Unit_DegreCelsi}, range phys -40..86 Unit_DegreCelsi, raw 0..255, unit=Unit_DegreCelsi, transfer-property=PENDING  # Temperatur Zellmodul fuer die Uebertragung per RTM
          signal BMC_CMC_Temperatur_054_XIX_BMC_CMC_Temperatur_01_XIX_HCP5_CANFD01: start 440, 8 bit, little-endian, data-type-policy=OVERRIDE, i-signal-type=PRIMITIVE, init-value=254, base-type=BT_BMC_CMC_Temperatur_054, invalid-value=Invalid_BMC_CMC_Temperatur_054_XIX_BMC_CMC_Temperatur_01_XIX_HCP5_CANFD01:255, compu {phys=raw*0.5-40 for raw 0..252, 253=Cxfd_nicht_vorhanden (CM_BMC_CMC_Temperatur_054_Cxfd_nicht_vorhanden), 254=Cxfe_Init (CM_BMC_CMC_Temperatur_054_Cxfe_Init), 255=Cxff_Fehler (CM_BMC_CMC_Temperatur_054_Cxff_Fehler); unit Unit_DegreCelsi}, range phys -40..86 Unit_DegreCelsi, raw 0..255, unit=Unit_DegreCelsi, transfer-property=PENDING  # Temperatur Zellmodul fuer die Uebertragung per RTM
          signal BMC_CMC_Temperatur_055_XIX_BMC_CMC_Temperatur_01_XIX_HCP5_CANFD01: start 448, 8 bit, little-endian, data-type-policy=OVERRIDE, i-signal-type=PRIMITIVE, init-value=254, base-type=BT_BMC_CMC_Temperatur_055, invalid-value=Invalid_BMC_CMC_Temperatur_055_XIX_BMC_CMC_Temperatur_01_XIX_HCP5_CANFD01:255, compu {phys=raw*0.5-40 for raw 0..252, 253=Cxfd_nicht_vorhanden (CM_BMC_CMC_Temperatur_055_Cxfd_nicht_vorhanden), 254=Cxfe_Init (CM_BMC_CMC_Temperatur_055_Cxfe_Init), 255=Cxff_Fehler (CM_BMC_CMC_Temperatur_055_Cxff_Fehler); unit Unit_DegreCelsi}, range phys -40..86 Unit_DegreCelsi, raw 0..255, unit=Unit_DegreCelsi, transfer-property=PENDING  # Temperatur Zellmodul fuer die Uebertragung per RTM
          signal BMC_CMC_Temperatur_056_XIX_BMC_CMC_Temperatur_01_XIX_HCP5_CANFD01: start 456, 8 bit, little-endian, data-type-policy=OVERRIDE, i-signal-type=PRIMITIVE, init-value=254, base-type=BT_BMC_CMC_Temperatur_056, invalid-value=Invalid_BMC_CMC_Temperatur_056_XIX_BMC_CMC_Temperatur_01_XIX_HCP5_CANFD01:255, compu {phys=raw*0.5-40 for raw 0..252, 253=Cxfd_nicht_vorhanden (CM_BMC_CMC_Temperatur_056_Cxfd_nicht_vorhanden), 254=Cxfe_Init (CM_BMC_CMC_Temperatur_056_Cxfe_Init), 255=Cxff_Fehler (CM_BMC_CMC_Temperatur_056_Cxff_Fehler); unit Unit_DegreCelsi}, range phys -40..86 Unit_DegreCelsi, raw 0..255, unit=Unit_DegreCelsi, transfer-property=PENDING  # Temperatur Zellmodul fuer die Uebertragung per RTM
          signal BMC_CMC_Temperatur_057_XIX_BMC_CMC_Temperatur_01_XIX_HCP5_CANFD01: start 464, 8 bit, little-endian, data-type-policy=OVERRIDE, i-signal-type=PRIMITIVE, init-value=254, base-type=BT_BMC_CMC_Temperatur_057, invalid-value=Invalid_BMC_CMC_Temperatur_057_XIX_BMC_CMC_Temperatur_01_XIX_HCP5_CANFD01:255, compu {phys=raw*0.5-40 for raw 0..252, 253=Cxfd_nicht_vorhanden (CM_BMC_CMC_Temperatur_057_Cxfd_nicht_vorhanden), 254=Cxfe_Init (CM_BMC_CMC_Temperatur_057_Cxfe_Init), 255=Cxff_Fehler (CM_BMC_CMC_Temperatur_057_Cxff_Fehler); unit Unit_DegreCelsi}, range phys -40..86 Unit_DegreCelsi, raw 0..255, unit=Unit_DegreCelsi, transfer-property=PENDING  # Temperatur Zellmodul fuer die Uebertragung per RTM
          signal BMC_CMC_Temperatur_058_XIX_BMC_CMC_Temperatur_01_XIX_HCP5_CANFD01: start 472, 8 bit, little-endian, data-type-policy=OVERRIDE, i-signal-type=PRIMITIVE, init-value=254, base-type=BT_BMC_CMC_Temperatur_058, invalid-value=Invalid_BMC_CMC_Temperatur_058_XIX_BMC_CMC_Temperatur_01_XIX_HCP5_CANFD01:255, compu {phys=raw*0.5-40 for raw 0..252, 253=Cxfd_nicht_vorhanden (CM_BMC_CMC_Temperatur_058_Cxfd_nicht_vorhanden), 254=Cxfe_Init (CM_BMC_CMC_Temperatur_058_Cxfe_Init), 255=Cxff_Fehler (CM_BMC_CMC_Temperatur_058_Cxff_Fehler); unit Unit_DegreCelsi}, range phys -40..86 Unit_DegreCelsi, raw 0..255, unit=Unit_DegreCelsi, transfer-property=PENDING  # Temperatur Zellmodul fuer die Uebertragung per RTM
          signal BMC_CMC_Temperatur_01_Messzeit_XIX_BMC_CMC_Temperatur_01_XIX_HCP5_CANFD01: start 480, 8 bit, little-endian, data-type-policy=OVERRIDE, i-signal-type=PRIMITIVE, init-value=254, base-type=BT_BMC_CMC_Temperatur_01_Messzeit, invalid-value=Invalid_BMC_CMC_Temperatur_01_Messzeit_XIX_BMC_CMC_Temperatur_01_XIX_HCP5_CANFD01:255, compu {phys=raw for raw 0..253, 254=Cxfe_Init (CM_BMC_CMC_Temperatur_01_Messzeit_Cxfe_Init), 255=Cxff_Fehler (CM_BMC_CMC_Temperatur_01_Messzeit_Cxff_Fehler); unit Unit_None}, range phys 0..253 Unit_None, raw 0..255, unit=Unit_None, transfer-property=PENDING  # Messzeit zu Botschaft BMC_CMC_Temperatur_01
