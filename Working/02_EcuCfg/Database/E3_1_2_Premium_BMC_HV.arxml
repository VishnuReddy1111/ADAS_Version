[part 9 of 12: packages /ISignal to /DiagnosticServices]
AUTOSAR XML (schema 4-3-0)
package /ISignal
  29 x i signal group:
    SG_BJB_10_XIX_BMC_CAN01: i-signal=[BJB_10_CRC_XIX_BJB_10_XIX_BMC_CAN01, BJB_10_BZ_XIX_BJB_10_XIX_BMC_CAN01, BJB_Sperrung_Unterspannung_XIX_BJB_10_XIX_BMC_CAN01, BJB_Status_HV_Spannungssensorik_XIX_BJB_10_XIX_BMC_CAN01, BJB_Lebensdauer_Trennelemente_XIX_BJB_10_XIX_BMC_CAN01, BJB_Status_Trennelemente_XIX_BJB_10_XIX_BMC_CAN01, ISignalVoid_BJB_10_XIX_BMC_CAN01_0, ISignalVoid_BJB_10_XIX_BMC_CAN01_1, ISignalVoid_BJB_10_XIX_BMC_CAN01_2, ISignalVoid_BJB_10_XIX_BMC_CAN01_3], system-signal-group=SG_BJB_10  # Kennungsfolge: K_1960-0x91,0xf6,0xe0,0xe4,0xdd,0xfa,0x7b,0xe7,0xf3,0x38,0x74,0x29,0x30,0x0f,0x81,0x8d
    SG_BJB_11_XIX_BMC_CAN01: i-signal=[BJB_11_CRC_XIX_BJB_11_XIX_BMC_CAN01, BJB_11_BZ_XIX_BJB_11_XIX_BMC_CAN01, BJB_Sperrung_Ueberspannung_XIX_BJB_11_XIX_BMC_CAN01, BJB_Ueberspannungszaehler_CMC01_XIX_BJB_11_XIX_BMC_CAN01, BJB_Ueberspannungszaehler_CMC02_XIX_BJB_11_XIX_BMC_CAN01, BJB_Uebertemperaturzaehler_CMC01_XIX_BJB_11_XIX_BMC_CAN01, BJB_Uebertemperaturzaehler_CMC02_XIX_BJB_11_XIX_BMC_CAN01], system-signal-group=SG_BJB_11  # Kennungsfolge: K_1945-0xf6,0xe4,0xfa,0xe7,0x38,0x29,0x0f,0x8d,0x08,0x26,0x9d,0xec,0x44,0xa6,0x55,0xd5
    SG_BJB_12_XIX_BMC_CAN01: i-signal=[BJB_12_CRC_XIX_BJB_12_XIX_BMC_CAN01, BJB_12_BZ_XIX_BJB_12_XIX_BMC_CAN01, BJB_Sperrung_Uebertemperatur_XIX_BJB_12_XIX_BMC_CAN01, BJB_Ueberspannungszaehler_CMC03_XIX_BJB_12_XIX_BMC_CAN01, BJB_Ueberspannungszaehler_CMC04_XIX_BJB_12_XIX_BMC_CAN01, BJB_Uebertemperaturzaehler_CMC03_XIX_BJB_12_XIX_BMC_CAN01, BJB_Uebertemperaturzaehler_CMC04_XIX_BJB_12_XIX_BMC_CAN01], system-signal-group=SG_BJB_12  # Kennungsfolge: K_1947-0x07,0x62,0x06,0xe8,0x91,0x35,0x47,0x0d,0x54,0xf6,0x4d,0xaa,0x21,0x04,0xe0,0xce
    SG_BJB_13_XIX_BMC_CAN01: i-signal=[BJB_13_CRC_XIX_BJB_13_XIX_BMC_CAN01, BJB_13_BZ_XIX_BJB_13_XIX_BMC_CAN01, BJB_Unterspannungszaehler_CMC01_XIX_BJB_13_XIX_BMC_CAN01, BJB_Unterspannungszaehler_CMC02_XIX_BJB_13_XIX_BMC_CAN01, BJB_Unterspannungszaehler_CMC03_XIX_BJB_13_XIX_BMC_CAN01, BJB_Unterspannungszaehler_CMC04_XIX_BJB_13_XIX_BMC_CAN01, ISignalVoid_BJB_13_XIX_BMC_CAN01_0, ISignalVoid_BJB_13_XIX_BMC_CAN01_1], system-signal-group=SG_BJB_13  # Kennungsfolge: K_1950-0x6b,0x6c,0x7a,0x91,0x4f,0x6a,0xaf,0xf6,0xcd,0x11,0x20,0xe0,0x7f,0x2b,0x1c,0xe4
    SG_BMC_HV_01_XIX_HCP5_CANFD01: i-signal=[BMC_HV_01_CRC_XIX_BMC_HV_01_XIX_HCP5_CANFD01, BMC_HV_01_BZ_XIX_BMC_HV_01_XIX_HCP5_CANFD01, BMC_Bankstatus_XIX_BMC_HV_01_XIX_HCP5_CANFD01, BMC_Spannung_XIX_BMC_HV_01_XIX_HCP5_CANFD01, BMC_HVK_EoHVL_Status_XIX_BMC_HV_01_XIX_HCP5_CANFD01, BMC_Modus_XIX_BMC_HV_01_XIX_HCP5_CANFD01, BMC_HVK_Fehler_Intern_XIX_BMC_HV_01_XIX_HCP5_CANFD01, BMC_HVK_Fehler_SD_XIX_BMC_HV_01_XIX_HCP5_CANFD01, BMC_Spannung_ZwischenKreis_XIX_BMC_HV_01_XIX_HCP5_CANFD01, BMC_HVK_Fehler_HVIL_XIX_BMC_HV_01_XIX_HCP5_CANFD01, BMC_Strom_XIX_BMC_HV_01_XIX_HCP5_CANFD01, BMC_Spannung_ZwischenKreis_2_XIX_BMC_HV_01_XIX_HCP5_CANFD01, BMC_Status_Spgfreiheit_XIX_BMC_HV_01_XIX_HCP5_CANFD01, BMC_Strom_Messzeit_XIX_BMC_HV_01_XIX_HCP5_CANFD01, BMC_Spannung_Messzeit_XIX_BMC_HV_01_XIX_HCP5_CANFD01, BMC_Strom_02_XIX_BMC_HV_01_XIX_HCP5_CANFD01, ISignalVoid_BMC_HV_01_XIX_HCP5_CANFD01_0], system-signal-group=SG_BMC_HV_01  # Kennungsfolge: K_291-0x18,0x71,0x10,0x8d,0xd7,0xaa,0xb0,0x78,0xac,0x12,0xae,0x0c,0xdd,0xf1,0x85,0x68
    SG_BMC_HV_02_XIX_HCP5_CANFD01: i-signal=[BMC_HV_02_CRC_XIX_BMC_HV_02_XIX_HCP5_CANFD01, BMC_HV_02_BZ_XIX_BMC_HV_02_XIX_HCP5_CANFD01, BMC_Vorlade_Zielspannung_XIX_BMC_HV_02_XIX_HCP5_CANFD01, BMC_PerfInd_Laden_XIX_BMC_HV_02_XIX_HCP5_CANFD01, BMC_Max_Entladeleistung_XIX_BMC_HV_02_XIX_HCP5_CANFD01, BMC_Status_DCLS_XIX_BMC_HV_02_XIX_HCP5_CANFD01, BMC_Bank_Notlauf_erlaubt_XIX_BMC_HV_02_XIX_HCP5_CANFD01, BMC_Energieinhalt_XIX_BMC_HV_02_XIX_HCP5_CANFD01, BMC_Max_Ladeleistung_XIX_BMC_HV_02_XIX_HCP5_CANFD01, BMC_PerfInd_Entladen_XIX_BMC_HV_02_XIX_HCP5_CANFD01, BMC_Bank_parallel_erlaubt_XIX_BMC_HV_02_XIX_HCP5_CANFD01, BMC_Bank_seriell_erlaubt_XIX_BMC_HV_02_XIX_HCP5_CANFD01, BMC_Spannung_DC_Ladesaeule_XIX_BMC_HV_02_XIX_HCP5_CANFD01, BMC_Max_Ladestrom_XIX_BMC_HV_02_XIX_HCP5_CANFD01, BMC_Max_Entladestrom_XIX_BMC_HV_02_XIX_HCP5_CANFD01, BMC_IWU_Status_XIX_BMC_HV_02_XIX_HCP5_CANFD01, BMC_Verbauinfo_ACSchuetz_XIX_BMC_HV_02_XIX_HCP5_CANFD01, Hybrid_01_OBD_Lampe_Anf_XIX_BMC_HV_02_XIX_HCP5_CANFD01, BMC_Fehler_Warnung_XIX_BMC_HV_02_XIX_HCP5_CANFD01, BMC_MMTR_Status_XIX_BMC_HV_02_XIX_HCP5_CANFD01, ISignalVoid_BMC_HV_02_XIX_HCP5_CANFD01_0, BMC_DC_Laden_XIX_BMC_HV_02_XIX_HCP5_CANFD01, BMC_AC_Laden_XIX_BMC_HV_02_XIX_HCP5_CANFD01, BMC_NutzbarerSOC_XIX_BMC_HV_02_XIX_HCP5_CANFD01, BMC_IWU_Wert_neg_XIX_BMC_HV_02_XIX_HCP5_CANFD01, BMC_IWU_Wert_pos_XIX_BMC_HV_02_XIX_HCP5_CANFD01, Anzeige_SOC_XIX_BMC_HV_02_XIX_HCP5_CANFD01, BMC_Verbauinfo_Bank_XIX_BMC_HV_02_XIX_HCP5_CANFD01, BMC_Fehler_Leistungsred_XIX_BMC_HV_02_XIX_HCP5_CANFD01, BMC_Unterboden_Warnung_XIX_BMC_HV_02_XIX_HCP5_CANFD01, BMC_MinDyn_Entladespannung_XIX_BMC_HV_02_XIX_HCP5_CANFD01, BMC_MinDyn_Ladespannung_XIX_BMC_HV_02_XIX_HCP5_CANFD01, BMC_Leerlaufspannung_XIX_BMC_HV_02_XIX_HCP5_CANFD01, BMC_IstZellspannungMax_XIX_BMC_HV_02_XIX_HCP5_CANFD01, BMC_IstZellspannungMin_XIX_BMC_HV_02_XIX_HCP5_CANFD01, BMC_PredLeistung_StuetzungNV_XIX_BMC_HV_02_XIX_HCP5_CANFD01, BMC_TechnischerSOC_XIX_BMC_HV_02_XIX_HCP5_CANFD01, BMC_Energie_Sockel_SoC_XIX_BMC_HV_02_XIX_HCP5_CANFD01, BMC_ZellTemp_virtuell_min_XIX_BMC_HV_02_XIX_HCP5_CANFD01, BMC_ZellTemp_virtuell_max_XIX_BMC_HV_02_XIX_HCP5_CANFD01, ISignalVoid_BMC_HV_02_XIX_HCP5_CANFD01_1, ISignalVoid_BMC_HV_02_XIX_HCP5_CANFD01_2, ISignalVoid_BMC_HV_02_XIX_HCP5_CANFD01_3, ISignalVoid_BMC_HV_02_XIX_HCP5_CANFD01_4, ISignalVoid_BMC_HV_02_XIX_HCP5_CANFD01_5], system-signal-group=SG_BMC_HV_02  # Kennungsfolge: K_351-0x50,0xa6,0x7d,0x6b,0x9f,0xa9,0xc6,0x3e,0x46,0x72,0x94,0x4d,0x49,0x40,0x71,0x9d
    SG_BMC_HV_04_XIX_BMC_CAN01: i-signal=[BMC_HV_04_CRC_XIX_BMC_HV_04_XIX_BMC_CAN01, BMC_HV_04_BZ_XIX_BMC_HV_04_XIX_BMC_CAN01, BMC_Iso_Mode_Anf_XIX_BMC_HV_04_XIX_BMC_CAN01, BMC_UI1_Spannung1_Schalt_Anf_XIX_BMC_HV_04_XIX_BMC_CAN01, BMC_UI1_Spannung2_Schalt_Anf_XIX_BMC_HV_04_XIX_BMC_CAN01, BMC_UI2_Spannung1_Schalt_Anf_XIX_BMC_HV_04_XIX_BMC_CAN01, BMC_UI2_Spannung2_Schalt_Anf_XIX_BMC_HV_04_XIX_BMC_CAN01, BMC_Flash_Freigabe_XIX_BMC_HV_04_XIX_BMC_CAN01, BMC_Dev_Freigabe_XIX_BMC_HV_04_XIX_BMC_CAN01, ISignalVoid_BMC_HV_04_XIX_BMC_CAN01_0, ISignalVoid_BMC_HV_04_XIX_BMC_CAN01_1, ISignalVoid_BMC_HV_04_XIX_BMC_CAN01_2, ISignalVoid_BMC_HV_04_XIX_BMC_CAN01_3, ISignalVoid_BMC_HV_04_XIX_BMC_CAN01_4, ISignalVoid_BMC_HV_04_XIX_BMC_CAN01_5], system-signal-group=SG_BMC_HV_04  # Kennungsfolge: K_1518-0x20,0x05,0xcc,0x08,0xef,0x69,0xb0,0xc8,0x3c,0x60,0xeb,0x76,0x91,0x27,0x04,0x02
    SG_BMC_HV_10_XIX_BMC_CAN01: i-signal=[BMC_HV_10_CRC_XIX_BMC_HV_10_XIX_BMC_CAN01, BMC_HV_10_BZ_XIX_BMC_HV_10_XIX_BMC_CAN01, BMC_Sperrung_Unterspannung_XIX_BMC_HV_10_XIX_BMC_CAN01, BMC_Status_HV_Spannungssensorik_XIX_BMC_HV_10_XIX_BMC_CAN01, BMC_Lebensdauer_Trennelemente_XIX_BMC_HV_10_XIX_BMC_CAN01, BMC_Status_Trennelemente_XIX_BMC_HV_10_XIX_BMC_CAN01, BMC_Datenuebernahme_Anf_XIX_BMC_HV_10_XIX_BMC_CAN01, ISignalVoid_BMC_HV_10_XIX_BMC_CAN01_0, ISignalVoid_BMC_HV_10_XIX_BMC_CAN01_1, ISignalVoid_BMC_HV_10_XIX_BMC_CAN01_2, ISignalVoid_BMC_HV_10_XIX_BMC_CAN01_3], system-signal-group=SG_BMC_HV_10  # Kennungsfolge: K_1968-0x9c,0x6d,0x7d,0x88,0x4e,0x13,0x3c,0x45,0x74,0xd9,0x09,0x77,0xc5,0xf0,0x0d,0xad
    SG_BMC_HV_11_XIX_BMC_CAN01: i-signal=[BMC_HV_11_CRC_XIX_BMC_HV_11_XIX_BMC_CAN01, BMC_HV_11_BZ_XIX_BMC_HV_11_XIX_BMC_CAN01, BMC_Sperrung_Ueberspannung_XIX_BMC_HV_11_XIX_BMC_CAN01, BMC_Ueberspannungszaehler_CMC01_XIX_BMC_HV_11_XIX_BMC_CAN01, BMC_Ueberspannungszaehler_CMC02_XIX_BMC_HV_11_XIX_BMC_CAN01, BMC_Uebertemperaturzaehler_CMC01_XIX_BMC_HV_11_XIX_BMC_CAN01, BMC_Uebertemperaturzaehler_CMC02_XIX_BMC_HV_11_XIX_BMC_CAN01], system-signal-group=SG_BMC_HV_11  # Kennungsfolge: K_1951-0xb8,0x47,0x88,0x04,0x2b,0x45,0x55,0x96,0x77,0x7b,0xdb,0xad,0x32,0x94,0x50,0x84
    SG_BMC_HV_12_XIX_BMC_CAN01: i-signal=[BMC_HV_12_CRC_XIX_BMC_HV_12_XIX_BMC_CAN01, BMC_HV_12_BZ_XIX_BMC_HV_12_XIX_BMC_CAN01, BMC_Sperrung_Uebertemperatur_XIX_BMC_HV_12_XIX_BMC_CAN01, BMC_Ueberspannungszaehler_CMC03_XIX_BMC_HV_12_XIX_BMC_CAN01, BMC_Ueberspannungszaehler_CMC04_XIX_BMC_HV_12_XIX_BMC_CAN01, BMC_Uebertemperaturzaehler_CMC03_XIX_BMC_HV_12_XIX_BMC_CAN01, BMC_Uebertemperaturzaehler_CMC04_XIX_BMC_HV_12_XIX_BMC_CAN01], system-signal-group=SG_BMC_HV_12  # Kennungsfolge: K_1952-0xde,0x17,0x02,0x7a,0xc9,0x6f,0xd2,0x6a,0x4a,0xb0,0x9f,0xcd,0x65,0x4e,0xb4,0xe0
    SG_BMC_HV_13_XIX_BMC_CAN01: i-signal=[BMC_HV_13_CRC_XIX_BMC_HV_13_XIX_BMC_CAN01, BMC_HV_13_BZ_XIX_BMC_HV_13_XIX_BMC_CAN01, BMC_Unterspannungszaehler_CMC01_XIX_BMC_HV_13_XIX_BMC_CAN01, BMC_Unterspannungszaehler_CMC02_XIX_BMC_HV_13_XIX_BMC_CAN01, BMC_Unterspannungszaehler_CMC03_XIX_BMC_HV_13_XIX_BMC_CAN01, BMC_Unterspannungszaehler_CMC04_XIX_BMC_HV_13_XIX_BMC_CAN01, ISignalVoid_BMC_HV_13_XIX_BMC_CAN01_0, ISignalVoid_BMC_HV_13_XIX_BMC_CAN01_1], system-signal-group=SG_BMC_HV_13  # Kennungsfolge: K_1954-0x86,0x49,0xd2,0xaf,0x9e,0x4e,0xcf,0x2b,0xe8,0xf9,0xe5,0xd9,0xc6,0xd4,0x68,0x7b
    SG_HVK_03_XIX_HCP5_CANFD01: i-signal=[HVK_03_CRC_XIX_HVK_03_XIX_HCP5_CANFD01, HVK_03_BZ_XIX_HVK_03_XIX_HCP5_CANFD01, HVK_Istmodus_Anf_XIX_HVK_03_XIX_HCP5_CANFD01, HVK_BMC_Sollmodus_XIX_HVK_03_XIX_HCP5_CANFD01, HVK_BMC_Spannung_Anf_XIX_HVK_03_XIX_HCP5_CANFD01, HVK_HVHL_Sollmodus_XIX_HVK_03_XIX_HCP5_CANFD01, HVK_HVHW_Sollmodus_XIX_HVK_03_XIX_HCP5_CANFD01, HVK_DCDC_Sollmodus_XIX_HVK_03_XIX_HCP5_CANFD01, HVK_EKK_Sollmodus_XIX_HVK_03_XIX_HCP5_CANFD01, HVK_ETM_Freigabe_XIX_HVK_03_XIX_HCP5_CANFD01, HVK_HV_Netz_Zustand_XIX_HVK_03_XIX_HCP5_CANFD01, HVK_Iso_Messung_Start_XIX_HVK_03_XIX_HCP5_CANFD01, HVK_Vorladung_aktiv_XIX_HVK_03_XIX_HCP5_CANFD01, HVK_Gesamtst_Spgfreiheit_XIX_HVK_03_XIX_HCP5_CANFD01, HVK_HV_Netz_Warnungen_XIX_HVK_03_XIX_HCP5_CANFD01, HVK_eKAT_Sollmodus_XIX_HVK_03_XIX_HCP5_CANFD01, HVK_AIAD_Sollmodus_XIX_HVK_03_XIX_HCP5_CANFD01, HVK_HVLM_Sollmodus_XIX_HVK_03_XIX_HCP5_CANFD01, HV_Bordnetz_aktiv_XIX_HVK_03_XIX_HCP5_CANFD01, HVK_AktiveEntladung_Anf_XIX_HVK_03_XIX_HCP5_CANFD01, HV_Bordnetz_Fehler_XIX_HVK_03_XIX_HCP5_CANFD01, ISignalVoid_HVK_03_XIX_HCP5_CANFD01_0, ISignalVoid_HVK_03_XIX_HCP5_CANFD01_1], system-signal-group=SG_HVK_03  # Kennungsfolge: K_1389-0xe4,0xcb,0xc4,0x5a,0x4c,0x4d,0x03,0x2e,0xb3,0xbb,0x62,0xc6,0x36,0x93,0xf3,0x98
    SG_HVLM_14_XIX_HCP5_CANFD01: i-signal=[HVLM_14_CRC_XIX_HVLM_14_XIX_HCP5_CANFD01, HVLM_14_BZ_XIX_HVLM_14_XIX_HCP5_CANFD01, HVLM_Aktive_Ladeart_XIX_HVLM_14_XIX_HCP5_CANFD01, HVLM_Grundladen_Anf_XIX_HVLM_14_XIX_HCP5_CANFD01, ISignalVoid_HVLM_14_XIX_HCP5_CANFD01_0, HVLM_Pulsierstufe_XIX_HVLM_14_XIX_HCP5_CANFD01, HVLM_Intensitaet_Lk2_XIX_HVLM_14_XIX_HCP5_CANFD01, HVLM_PrkCtl_StAlyReq_XIX_HVLM_14_XIX_HCP5_CANFD01, HVLM_PrkCtl_StPrkLockReq_XIX_HVLM_14_XIX_HCP5_CANFD01, HVLM_WakeUpZaehlerResetAnf_XIX_HVLM_14_XIX_HCP5_CANFD01, ISignalVoid_HVLM_14_XIX_HCP5_CANFD01_1, HVLM_Steckerstatus_XIX_HVLM_14_XIX_HCP5_CANFD01, HVLM_Ladeniveau_Anf_XIX_HVLM_14_XIX_HCP5_CANFD01, HVLM_Ladenaktiv_Standzyklus_XIX_HVLM_14_XIX_HCP5_CANFD01, HVLM_Start_Pulserkennung_XIX_HVLM_14_XIX_HCP5_CANFD01, HVLM_ZustandLadeablauf_XIX_HVLM_14_XIX_HCP5_CANFD01, HVLM_DC_Aufstartmodus_XIX_HVLM_14_XIX_HCP5_CANFD01, HVLM_Ladeszenario_XIX_HVLM_14_XIX_HCP5_CANFD01, HVLM_Ladevorgang_Anf_XIX_HVLM_14_XIX_HCP5_CANFD01, HVLM_Intensitaet_Lk1_XIX_HVLM_14_XIX_HCP5_CANFD01, HVLM_Laden_ISO_Messung_Anf_XIX_HVLM_14_XIX_HCP5_CANFD01], system-signal-group=SG_HVLM_14  # Kennungsfolge: K_1460-0xc1,0x3b,0x72,0xe3,0x93,0x7d,0x8c,0x86,0x60,0x65,0x12,0x31,0xe1,0xbc,0x01,0x59
    SG_KS_Hybrid_01_Challenge_K_XIX_HCP5_CANFD01: i-signal=[KS_Hybrid_01_ChK_SID_XIX_KS_Hybrid_01_Challenge_K_XIX_HCP5_CANFD01, KS_Hybrid_01_ChK_IKACtr_XIX_KS_Hybrid_01_Challenge_K_XIX_HCP5_CANFD01, KS_Hybrid_01_ChK_XIX_KS_Hybrid_01_Challenge_K_XIX_HCP5_CANFD01], system-signal-group=SG_KS_Hybrid_01_Challenge_K  # custom ECU specified i-signal group
    SG_KS_Hybrid_01_Challenge_M_XIX_HCP5_CANFD01: i-signal=[KS_Hybrid_01_ChM_SID_XIX_KS_Hybrid_01_Challenge_M_XIX_HCP5_CANFD01, KS_Hybrid_01_ChM_IKACtr_XIX_KS_Hybrid_01_Challenge_M_XIX_HCP5_CANFD01, KS_Hybrid_01_ChM_XIX_KS_Hybrid_01_Challenge_M_XIX_HCP5_CANFD01], system-signal-group=SG_KS_Hybrid_01_Challenge_M  # custom ECU specified i-signal group
    SG_KS_Hybrid_01_ReqFrame_XIX_HCP5_CANFD01: i-signal=[KS_Hybrid_01_Req_SID_XIX_KS_Hybrid_01_ReqFrame_XIX_HCP5_CANFD01, KS_Hybrid_01_Req_Prio_XIX_KS_Hybrid_01_ReqFrame_XIX_HCP5_CANFD01, KS_Hybrid_01_Req_VKMS_Err_XIX_KS_Hybrid_01_ReqFrame_XIX_HCP5_CANFD01, KS_Hybrid_01_Req_IKA_Retry_XIX_KS_Hybrid_01_ReqFrame_XIX_HCP5_CANFD01, KS_Hybrid_01_Req_ErrCtr_XIX_KS_Hybrid_01_ReqFrame_XIX_HCP5_CANFD01, KS_Hybrid_01_Req_SWMaj_XIX_KS_Hybrid_01_ReqFrame_XIX_HCP5_CANFD01, KS_Hybrid_01_Req_SWMin_XIX_KS_Hybrid_01_ReqFrame_XIX_HCP5_CANFD01, KS_Hybrid_01_Req_SWPat_XIX_KS_Hybrid_01_ReqFrame_XIX_HCP5_CANFD01], system-signal-group=SG_KS_Hybrid_01_ReqFrame  # custom ECU specified i-signal group
    SG_KS_Hybrid_01_Response_K_XIX_HCP5_CANFD01: i-signal=[KS_Hybrid_01_ReK_SID_XIX_KS_Hybrid_01_Response_K_XIX_HCP5_CANFD01, KS_Hybrid_01_ReK_IKACtr_XIX_KS_Hybrid_01_Response_K_XIX_HCP5_CANFD01, KS_Hybrid_01_ReK_XIX_KS_Hybrid_01_Response_K_XIX_HCP5_CANFD01], system-signal-group=SG_KS_Hybrid_01_Response_K  # custom ECU specified i-signal group
    SG_KS_Hybrid_01_Response_M_XIX_HCP5_CANFD01: i-signal=[KS_Hybrid_01_ReM_SID_XIX_KS_Hybrid_01_Response_M_XIX_HCP5_CANFD01, KS_Hybrid_01_ReM_IKACtr_XIX_KS_Hybrid_01_Response_M_XIX_HCP5_CANFD01, KS_Hybrid_01_ReM_XIX_KS_Hybrid_01_Response_M_XIX_HCP5_CANFD01], system-signal-group=SG_KS_Hybrid_01_Response_M  # custom ECU specified i-signal group
    SG_ORU_Control_A_01_XIX_BMC_CAN01: i-signal=[ORU_Control_A_01_CRC_XIX_ORU_Control_A_01_XIX_BMC_CAN01, ORU_Control_A_01_BZ_XIX_ORU_Control_A_01_XIX_BMC_CAN01, OnlineRemoteUpdateControlA_XIX_ORU_Control_A_01_XIX_BMC_CAN01, OnlineRemoteUpdateControlOldA_XIX_ORU_Control_A_01_XIX_BMC_CAN01, OruVehicleLockRequestA_XIX_ORU_Control_A_01_XIX_BMC_CAN01, OruIntegrityCheckActiveA_XIX_ORU_Control_A_01_XIX_BMC_CAN01, OruControlReleaseA_XIX_ORU_Control_A_01_XIX_BMC_CAN01, OruControlStateA_XIX_ORU_Control_A_01_XIX_BMC_CAN01, OruReleasePartitionSwitchA_XIX_ORU_Control_A_01_XIX_BMC_CAN01, OruHostUpdateA_XIX_ORU_Control_A_01_XIX_BMC_CAN01, ISignalVoid_ORU_Control_A_01_XIX_BMC_CAN01_0, ISignalVoid_ORU_Control_A_01_XIX_BMC_CAN01_1], system-signal-group=SG_ORU_Control_A_01  # Kennungsfolge: K_1449-0x97,0x70,0x84,0xb4,0xb8,0xe7,0x20,0x7c,0x0e,0x40,0x93,0x0d,0x4e,0x05,0x5b,0x95
    SG_ORU_Control_A_01_XIX_HCP5_CANFD01: i-signal=[ORU_Control_A_01_CRC_XIX_ORU_Control_A_01_XIX_HCP5_CANFD01, ORU_Control_A_01_BZ_XIX_ORU_Control_A_01_XIX_HCP5_CANFD01, OnlineRemoteUpdateControlA_XIX_ORU_Control_A_01_XIX_HCP5_CANFD01, OnlineRemoteUpdateControlOldA_XIX_ORU_Control_A_01_XIX_HCP5_CANFD01, OruVehicleLockRequestA_XIX_ORU_Control_A_01_XIX_HCP5_CANFD01, OruIntegrityCheckActiveA_XIX_ORU_Control_A_01_XIX_HCP5_CANFD01, OruControlReleaseA_XIX_ORU_Control_A_01_XIX_HCP5_CANFD01, OruControlStateA_XIX_ORU_Control_A_01_XIX_HCP5_CANFD01, OruReleasePartitionSwitchA_XIX_ORU_Control_A_01_XIX_HCP5_CANFD01, OruHostUpdateA_XIX_ORU_Control_A_01_XIX_HCP5_CANFD01, ISignalVoid_ORU_Control_A_01_XIX_HCP5_CANFD01_0, ISignalVoid_ORU_Control_A_01_XIX_HCP5_CANFD01_1], system-signal-group=SG_ORU_Control_A_01  # Kennungsfolge: K_1449-0x97,0x70,0x84,0xb4,0xb8,0xe7,0x20,0x7c,0x0e,0x40,0x93,0x0d,0x4e,0x05,0x5b,0x95
    SG_ORU_Control_D_01_XIX_BMC_CAN01: i-signal=[ORU_Control_D_01_CRC_XIX_ORU_Control_D_01_XIX_BMC_CAN01, ORU_Control_D_01_BZ_XIX_ORU_Control_D_01_XIX_BMC_CAN01, OnlineRemoteUpdateControlD_XIX_ORU_Control_D_01_XIX_BMC_CAN01, OnlineRemoteUpdateControlOldD_XIX_ORU_Control_D_01_XIX_BMC_CAN01, OruVehicleLockRequestD_XIX_ORU_Control_D_01_XIX_BMC_CAN01, OruIntegrityCheckActiveD_XIX_ORU_Control_D_01_XIX_BMC_CAN01, OruControlReleaseD_XIX_ORU_Control_D_01_XIX_BMC_CAN01, OruControlStateD_XIX_ORU_Control_D_01_XIX_BMC_CAN01, OruReleasePartitionSwitchD_XIX_ORU_Control_D_01_XIX_BMC_CAN01, OruHostUpdateD_XIX_ORU_Control_D_01_XIX_BMC_CAN01, ISignalVoid_ORU_Control_D_01_XIX_BMC_CAN01_0, ISignalVoid_ORU_Control_D_01_XIX_BMC_CAN01_1], system-signal-group=SG_ORU_Control_D_01  # Kennungsfolge: K_1646-0x92,0x1b,0xc6,0x91,0x29,0x5a,0x4e,0xf0,0x6e,0x43,0x80,0x28,0xee,0xa3,0xc8,0x3e
    SG_ORU_Control_D_01_XIX_HCP5_CANFD01: i-signal=[ORU_Control_D_01_CRC_XIX_ORU_Control_D_01_XIX_HCP5_CANFD01, ORU_Control_D_01_BZ_XIX_ORU_Control_D_01_XIX_HCP5_CANFD01, OnlineRemoteUpdateControlD_XIX_ORU_Control_D_01_XIX_HCP5_CANFD01, OnlineRemoteUpdateControlOldD_XIX_ORU_Control_D_01_XIX_HCP5_CANFD01, OruVehicleLockRequestD_XIX_ORU_Control_D_01_XIX_HCP5_CANFD01, OruIntegrityCheckActiveD_XIX_ORU_Control_D_01_XIX_HCP5_CANFD01, OruControlReleaseD_XIX_ORU_Control_D_01_XIX_HCP5_CANFD01, OruControlStateD_XIX_ORU_Control_D_01_XIX_HCP5_CANFD01, OruReleasePartitionSwitchD_XIX_ORU_Control_D_01_XIX_HCP5_CANFD01, OruHostUpdateD_XIX_ORU_Control_D_01_XIX_HCP5_CANFD01, ISignalVoid_ORU_Control_D_01_XIX_HCP5_CANFD01_0, ISignalVoid_ORU_Control_D_01_XIX_HCP5_CANFD01_1], system-signal-group=SG_ORU_Control_D_01  # Kennungsfolge: K_1646-0x92,0x1b,0xc6,0x91,0x29,0x5a,0x4e,0xf0,0x6e,0x43,0x80,0x28,0xee,0xa3,0xc8,0x3e
    SG_OTAMC_D_01_XIX_BMC_CAN01: i-signal=[OTAMC_D_01_CRC_XIX_OTAMC_D_01_XIX_BMC_CAN01, OTAMC_D_01_BZ_XIX_OTAMC_D_01_XIX_BMC_CAN01, VehicleProtectedEnvironment_D_XIX_OTAMC_D_01_XIX_BMC_CAN01, ISignalVoid_OTAMC_D_01_XIX_BMC_CAN01_0, ISignalVoid_OTAMC_D_01_XIX_BMC_CAN01_1, ISignalVoid_OTAMC_D_01_XIX_BMC_CAN01_2], system-signal-group=SG_OTAMC_D_01  # Kennungsfolge: K_309-0x5f,0x18,0xf5,0x71,0x82,0x10,0x93,0x8d,0x4c,0xd7,0x6e,0xaa,0xd6,0xb0,0xb7,0x78
    SG_OTAMC_D_01_XIX_HCP5_CANFD01: i-signal=[OTAMC_D_01_CRC_XIX_OTAMC_D_01_XIX_HCP5_CANFD01, OTAMC_D_01_BZ_XIX_OTAMC_D_01_XIX_HCP5_CANFD01, VehicleProtectedEnvironment_D_XIX_OTAMC_D_01_XIX_HCP5_CANFD01, ISignalVoid_OTAMC_D_01_XIX_HCP5_CANFD01_0, ISignalVoid_OTAMC_D_01_XIX_HCP5_CANFD01_1, ISignalVoid_OTAMC_D_01_XIX_HCP5_CANFD01_2], system-signal-group=SG_OTAMC_D_01  # Kennungsfolge: K_309-0x5f,0x18,0xf5,0x71,0x82,0x10,0x93,0x8d,0x4c,0xd7,0x6e,0xaa,0xd6,0xb0,0xb7,0x78
    SG_UI1_01_XIX_BMC_CAN01: i-signal=[UISensorIso_01_CRC_XIX_UI1_01_XIX_BMC_CAN01, UISensorIso_01_BZ_XIX_UI1_01_XIX_BMC_CAN01, UI1_Strom_XIX_UI1_01_XIX_BMC_CAN01, UI1_KL30_Spannung_XIX_UI1_01_XIX_BMC_CAN01, ISignalVoid_UI1_01_XIX_BMC_CAN01_0, ISignalVoid_UI1_01_XIX_BMC_CAN01_1, ISignalVoid_UI1_01_XIX_BMC_CAN01_2], system-signal-group=SG_UI1_01  # Kennungsfolge: K_1509-0xc0,0xc7,0x38,0x03,0x0b,0x96,0xca,0x93,0x35,0x39,0x81,0xb2,0x02,0xa3,0xed,0x65
    SG_UI1_02_XIX_BMC_CAN01: i-signal=[UISensorIso_02_CRC_XIX_UI1_02_XIX_BMC_CAN01, UISensorIso_02_BZ_XIX_UI1_02_XIX_BMC_CAN01, UI1_Spannung1_XIX_UI1_02_XIX_BMC_CAN01, UI1_Spannung2_XIX_UI1_02_XIX_BMC_CAN01, UI1_Spannung3_XIX_UI1_02_XIX_BMC_CAN01, UI1_Spannung1_Schalt_Status_XIX_UI1_02_XIX_BMC_CAN01, UI1_Spannung2_Schalt_Status_XIX_UI1_02_XIX_BMC_CAN01, ISignalVoid_UI1_02_XIX_BMC_CAN01_0], system-signal-group=SG_UI1_02  # Kennungsfolge: K_1516-0x13,0xd2,0xb5,0x5c,0xc2,0x16,0x5b,0x56,0x91,0xe1,0x53,0x55,0xcf,0x3e,0xd3,0x5d
    SG_UI2_01_XIX_BMC_CAN01: i-signal=[UISensorPyro_01_CRC_XIX_UI2_01_XIX_BMC_CAN01, UISensorPyro_01_BZ_XIX_UI2_01_XIX_BMC_CAN01, UI2_Strom_XIX_UI2_01_XIX_BMC_CAN01, UI2_KL30_Spannung_XIX_UI2_01_XIX_BMC_CAN01, ISignalVoid_UI2_01_XIX_BMC_CAN01_0, ISignalVoid_UI2_01_XIX_BMC_CAN01_1, ISignalVoid_UI2_01_XIX_BMC_CAN01_2], system-signal-group=SG_UI2_01  # Kennungsfolge: K_1530-0x25,0x0d,0x57,0x89,0xb5,0xc3,0x8b,0x67,0xac,0x01,0x6a,0x0b,0x90,0x92,0xc1,0x4c
    SG_UI2_02_XIX_BMC_CAN01: i-signal=[UISensorPyro_02_CRC_XIX_UI2_02_XIX_BMC_CAN01, UISensorPyro_02_BZ_XIX_UI2_02_XIX_BMC_CAN01, UI2_Spannung1_XIX_UI2_02_XIX_BMC_CAN01, UI2_Spannung2_XIX_UI2_02_XIX_BMC_CAN01, UI2_Spannung3_XIX_UI2_02_XIX_BMC_CAN01, UI2_Spannung1_Schalt_Status_XIX_UI2_02_XIX_BMC_CAN01, UI2_Spannung2_Schalt_Status_XIX_UI2_02_XIX_BMC_CAN01, ISignalVoid_UI2_02_XIX_BMC_CAN01_0], system-signal-group=SG_UI2_02  # Kennungsfolge: K_1524-0x4e,0xa3,0x1f,0x0f,0x13,0x72,0xd0,0xda,0x3c,0x33,0xe8,0x11,0x45,0xbd,0x7e,0x4b
    SG_UI2_03_XIX_BMC_CAN01: i-signal=[UISensorPyro_03_CRC_XIX_UI2_03_XIX_BMC_CAN01, UISensorPyro_03_BZ_XIX_UI2_03_XIX_BMC_CAN01, UI2_Spannung4_XIX_UI2_03_XIX_BMC_CAN01, UI2_Spannung5_XIX_UI2_03_XIX_BMC_CAN01, UI2_Spannung6_XIX_UI2_03_XIX_BMC_CAN01, UI2_HW_Crashleitung_Status_XIX_UI2_03_XIX_BMC_CAN01, UI2_Pyro_Status_XIX_UI2_03_XIX_BMC_CAN01, ISignalVoid_UI2_03_XIX_BMC_CAN01_0], system-signal-group=SG_UI2_03  # Kennungsfolge: K_1517-0x5e,0xed,0x2e,0x2d,0xde,0x98,0x8b,0x8a,0x7f,0x0e,0xef,0xf5,0x9d,0x74,0xa7,0x87
package /BaseType
  1525 x base type, all with category=FIXED_LENGTH:
    BT_AB_Abschaltanf_SIH_BF: base-type-size=0, base-type-encoding=NONE
    BT_AB_Anzeige_Fussg: base-type-size=0, base-type-encoding=NONE
    BT_AB_Belegung_VB: base-type-size=0, base-type-encoding=NONE
    BT_AB_Belegung_VF: base-type-size=0, base-type-encoding=NONE
    BT_AB_Belegung_VF_ext: base-type-size=0, base-type-encoding=NONE
    BT_AB_Belegung_VF_ext_aktiv: base-type-size=0, base-type-encoding=NONE
    BT_AB_Crash_Int: base-type-size=0, base-type-encoding=NONE
    BT_AB_Deaktivierung_HV: base-type-size=0, base-type-encoding=NONE
    BT_AB_DeltaV_X_eCall: base-type-size=0, base-type-encoding=NONE
    BT_AB_DeltaV_Y_eCall: base-type-size=0, base-type-encoding=NONE
    BT_AB_EDR_Trigger: base-type-size=0, base-type-encoding=NONE
    BT_AB_Erh_Auf_VB: base-type-size=0, base-type-encoding=NONE
    BT_AB_Front_Crash: base-type-size=0, base-type-encoding=NONE
    BT_AB_Gurtschloss_BF: base-type-size=0, base-type-encoding=NONE
    BT_AB_Gurtschloss_FA: base-type-size=0, base-type-encoding=NONE
    BT_AB_Gurtschloss_FA_ext: base-type-size=0, base-type-encoding=NONE
    BT_AB_Gurtschloss_FA_ext_aktiv: base-type-size=0, base-type-encoding=NONE
    BT_AB_Gurtschloss_Reihe2_BF: base-type-size=0, base-type-encoding=NONE
    BT_AB_Gurtschloss_Reihe2_FA: base-type-size=0, base-type-encoding=NONE
    BT_AB_Gurtschloss_Reihe2_MI: base-type-size=0, base-type-encoding=NONE
    BT_AB_Gurtschloss_Reihe3_BF: base-type-size=0, base-type-encoding=NONE
    BT_AB_Gurtschloss_Reihe3_FA: base-type-size=0, base-type-encoding=NONE
    BT_AB_Gurtschloss_Reihe3_MI: base-type-size=0, base-type-encoding=NONE
    BT_AB_Gurtschloss_Reihe4_BF: base-type-size=0, base-type-encoding=NONE
    BT_AB_Gurtschloss_Reihe4_FA: base-type-size=0, base-type-encoding=NONE
    BT_AB_Gurtschloss_Reihe4_MI: base-type-size=0, base-type-encoding=NONE
    BT_AB_Gurtwarn_Reihe2_BF: base-type-size=0, base-type-encoding=NONE
    BT_AB_Gurtwarn_Reihe2_FA: base-type-size=0, base-type-encoding=NONE
    BT_AB_Gurtwarn_Reihe2_MI: base-type-size=0, base-type-encoding=NONE
    BT_AB_Gurtwarn_Reihe3_BF: base-type-size=0, base-type-encoding=NONE
    BT_AB_Gurtwarn_Reihe3_FA: base-type-size=0, base-type-encoding=NONE
    BT_AB_Gurtwarn_Reihe3_MI: base-type-size=0, base-type-encoding=NONE
    BT_AB_Gurtwarn_VB: base-type-size=0, base-type-encoding=NONE
    BT_AB_Gurtwarn_VF: base-type-size=0, base-type-encoding=NONE
    BT_AB_Heck_Crash: base-type-size=0, base-type-encoding=NONE
    BT_AB_Lampe: base-type-size=0, base-type-encoding=NONE
    BT_AB_PSS_SollZustand: base-type-size=0, base-type-encoding=NONE
    BT_AB_Rollover_Crash: base-type-size=0, base-type-encoding=NONE
    BT_AB_SB_Crash: base-type-size=0, base-type-encoding=NONE
    BT_AB_SBR_hinten_verbau: base-type-size=0, base-type-encoding=NONE
    BT_AB_SF_Crash: base-type-size=0, base-type-encoding=NONE
    BT_AB_Sitzpos_Sens_BF: base-type-size=0, base-type-encoding=NONE
    BT_AB_Sitzpos_Sens_FA: base-type-size=0, base-type-encoding=NONE
    BT_AB_Stellgliedtest: base-type-size=0, base-type-encoding=NONE
    BT_AB_Systemfehler: base-type-size=0, base-type-encoding=NONE
    BT_AB_Versorgungsspannung: base-type-size=0, base-type-encoding=NONE
    BT_AB_VRU_Crash: base-type-size=0, base-type-encoding=NONE
    BT_Airbag_10_BZ: base-type-size=0, base-type-encoding=NONE
    BT_Airbag_10_CRC: base-type-size=0, base-type-encoding=NONE
    BT_Anzeige_SOC: base-type-size=0, base-type-encoding=NONE
    BT_BEM_Batt_Ab: base-type-size=0, base-type-encoding=NONE
    BT_BEM_Generatordiagnose: base-type-size=0, base-type-encoding=NONE
    BT_BEM_HL_Regelung_Status: base-type-size=0, base-type-encoding=NONE
    BT_BEM_Red_Innengeblaese: base-type-size=0, base-type-encoding=NONE
    BT_BEM_STH_Einschaltverbot: base-type-size=0, base-type-encoding=NONE
    BT_BEM_STH_Zielzeit: base-type-size=0, base-type-encoding=NONE
    BT_BJB_10_BZ: base-type-size=0, base-type-encoding=NONE
    BT_BJB_10_CRC: base-type-size=0, base-type-encoding=NONE
    BT_BJB_11_BZ: base-type-size=0, base-type-encoding=NONE
    BT_BJB_11_CRC: base-type-size=0, base-type-encoding=NONE
    BT_BJB_12_BZ: base-type-size=0, base-type-encoding=NONE
    BT_BJB_12_CRC: base-type-size=0, base-type-encoding=NONE
    BT_BJB_13_BZ: base-type-size=0, base-type-encoding=NONE
    BT_BJB_13_CRC: base-type-size=0, base-type-encoding=NONE
    BT_BJB_CALID_Index_{01..16}: base-type-size=0, base-type-encoding=NONE
    BT_BJB_CVN_Byte_{1..4}: base-type-size=0, base-type-encoding=NONE
    BT_BJB_CVN_VLD: base-type-size=0, base-type-encoding=NONE
    BT_BJB_ErrMem_State: base-type-size=0, base-type-encoding=NONE
    BT_BJB_Lebensdauer_Trennelemente: base-type-size=0, base-type-encoding=NONE
    BT_BJB_Sperrung_Ueberspannung: base-type-size=0, base-type-encoding=NONE
    BT_BJB_Sperrung_Uebertemperatur: base-type-size=0, base-type-encoding=NONE
    BT_BJB_Sperrung_Unterspannung: base-type-size=0, base-type-encoding=NONE
    BT_BJB_Status_HV_Spannungssensorik: base-type-size=0, base-type-encoding=NONE
    BT_BJB_Status_Trennelemente: base-type-size=0, base-type-encoding=NONE
    BT_BJB_Ueberspannungszaehler_CMC{01..04}: base-type-size=0, base-type-encoding=NONE
    BT_BJB_Uebertemperaturzaehler_CMC{01..04}: base-type-size=0, base-type-encoding=NONE
    BT_BJB_Unterspannungszaehler_CMC{01..04}: base-type-size=0, base-type-encoding=NONE
    BT_BMC_Abschaltankuendigung: base-type-size=0, base-type-encoding=NONE
    BT_BMC_AC_Laden: base-type-size=0, base-type-encoding=NONE
    BT_BMC_Bank_Notlauf_erlaubt: base-type-size=0, base-type-encoding=NONE
    BT_BMC_Bank_parallel_erlaubt: base-type-size=0, base-type-encoding=NONE
    BT_BMC_Bank_seriell_erlaubt: base-type-size=0, base-type-encoding=NONE
    BT_BMC_Bankstatus: base-type-size=0, base-type-encoding=NONE
    BT_BMC_Bidi_Energie_Absolut: base-type-size=0, base-type-encoding=NONE
    BT_BMC_Bidi_Freigabe: base-type-size=0, base-type-encoding=NONE
    BT_BMC_Bidi_GenutzteEnergie: base-type-size=0, base-type-encoding=NONE
    BT_BMC_Bidi_Max_SoC: base-type-size=0, base-type-encoding=NONE
    BT_BMC_Bidi_Min_SoC: base-type-size=0, base-type-encoding=NONE
    BT_BMC_Bidi_Veto_Energie: base-type-size=0, base-type-encoding=NONE
    BT_BMC_Bidi_Veto_Temp: base-type-size=0, base-type-encoding=NONE
    BT_BMC_CMC_Temperatur_{001..019}: base-type-size=0, base-type-encoding=NONE
    BT_BMC_CMC_Temperatur_01_Messzeit: base-type-size=0, base-type-encoding=NONE
    BT_BMC_CMC_Temperatur_{020..029}: base-type-size=0, base-type-encoding=NONE
    BT_BMC_CMC_Temperatur_02_Messzeit: base-type-size=0, base-type-encoding=NONE
    BT_BMC_CMC_Temperatur_{030..039}: base-type-size=0, base-type-encoding=NONE
    BT_BMC_CMC_Temperatur_03_Messzeit: base-type-size=0, base-type-encoding=NONE
    BT_BMC_CMC_Temperatur_{040..096}: base-type-size=0, base-type-encoding=NONE
    BT_BMC_CMC_Zellspannung_{001..019}: base-type-size=0, base-type-encoding=NONE
    BT_BMC_CMC_Zellspannung_01_Messzeit: base-type-size=0, base-type-encoding=NONE
    BT_BMC_CMC_Zellspannung_{020..029}: base-type-size=0, base-type-encoding=NONE
    BT_BMC_CMC_Zellspannung_02_Messzeit: base-type-size=0, base-type-encoding=NONE
    BT_BMC_CMC_Zellspannung_{030..039}: base-type-size=0, base-type-encoding=NONE
    BT_BMC_CMC_Zellspannung_03_Messzeit: base-type-size=0, base-type-encoding=NONE
    BT_BMC_CMC_Zellspannung_{040..049}: base-type-size=0, base-type-encoding=NONE
    BT_BMC_CMC_Zellspannung_04_Messzeit: base-type-size=0, base-type-encoding=NONE
    BT_BMC_CMC_Zellspannung_{050..059}: base-type-size=0, base-type-encoding=NONE
    BT_BMC_CMC_Zellspannung_05_Messzeit: base-type-size=0, base-type-encoding=NONE
    BT_BMC_CMC_Zellspannung_{060..192}: base-type-size=0, base-type-encoding=NONE
    BT_BMC_Datenuebernahme_Anf: base-type-size=0, base-type-encoding=NONE
    BT_BMC_Dauer_Entladeleistung: base-type-size=0, base-type-encoding=NONE
    BT_BMC_Dauer_Entladeleistung_02: base-type-size=0, base-type-encoding=NONE
    BT_BMC_Dauer_Ladeleistung: base-type-size=0, base-type-encoding=NONE
    BT_BMC_Dauer_Ladeleistung_02: base-type-size=0, base-type-encoding=NONE
    BT_BMC_DC_Laden: base-type-size=0, base-type-encoding=NONE
    BT_BMC_Dev_Freigabe: base-type-size=0, base-type-encoding=NONE
    BT_BMC_Energie_Entladen: base-type-size=0, base-type-encoding=NONE
    BT_BMC_Energie_Laden: base-type-size=0, base-type-encoding=NONE
    BT_BMC_Energie_Sockel_SoC: base-type-size=0, base-type-encoding=NONE
    BT_BMC_Energieinhalt: base-type-size=0, base-type-encoding=NONE
    BT_BMC_EnergieVorhalt: base-type-size=0, base-type-encoding=NONE
    BT_BMC_ExtLadeleistung: base-type-size=0, base-type-encoding=NONE
    BT_BMC_Fehler_Leistungsred: base-type-size=0, base-type-encoding=NONE
    BT_BMC_Fehler_Warnung: base-type-size=0, base-type-encoding=NONE
    BT_BMC_Flash_Freigabe: base-type-size=0, base-type-encoding=NONE
    BT_BMC_HV_01_BZ: base-type-size=0, base-type-encoding=NONE
    BT_BMC_HV_01_CRC: base-type-size=0, base-type-encoding=NONE
    BT_BMC_HV_02_BZ: base-type-size=0, base-type-encoding=NONE
    BT_BMC_HV_02_CRC: base-type-size=0, base-type-encoding=NONE
    BT_BMC_HV_04_BZ: base-type-size=0, base-type-encoding=NONE
    BT_BMC_HV_04_CRC: base-type-size=0, base-type-encoding=NONE
    BT_BMC_HV_10_BZ: base-type-size=0, base-type-encoding=NONE
    BT_BMC_HV_10_CRC: base-type-size=0, base-type-encoding=NONE
    BT_BMC_HV_11_BZ: base-type-size=0, base-type-encoding=NONE
    BT_BMC_HV_11_CRC: base-type-size=0, base-type-encoding=NONE
    BT_BMC_HV_12_BZ: base-type-size=0, base-type-encoding=NONE
    BT_BMC_HV_12_CRC: base-type-size=0, base-type-encoding=NONE
    BT_BMC_HV_13_BZ: base-type-size=0, base-type-encoding=NONE
    BT_BMC_HV_13_CRC: base-type-size=0, base-type-encoding=NONE
    BT_BMC_HVK_EoHVL_Status: base-type-size=0, base-type-encoding=NONE
    BT_BMC_HVK_Fehler_HVIL: base-type-size=0, base-type-encoding=NONE
    BT_BMC_HVK_Fehler_Intern: base-type-size=0, base-type-encoding=NONE
    BT_BMC_HVK_Fehler_SD: base-type-size=0, base-type-encoding=NONE
    BT_BMC_Iso_Mode_Anf: base-type-size=0, base-type-encoding=NONE
    BT_BMC_IstTemperaturMax_Modul_ID: base-type-size=0, base-type-encoding=NONE
    BT_BMC_IstTemperaturMax_Sensor_ID: base-type-size=0, base-type-encoding=NONE
    BT_BMC_IstTemperaturMin_Modul_ID: base-type-size=0, base-type-encoding=NONE
    BT_BMC_IstTemperaturMin_Sensor_ID: base-type-size=0, base-type-encoding=NONE
    BT_BMC_IstZellspannungMax: base-type-size=0, base-type-encoding=NONE
    BT_BMC_IstZellSpannungMax_Modul_ID: base-type-size=0, base-type-encoding=NONE
    BT_BMC_IstZellSpannungMax_Zell_ID: base-type-size=0, base-type-encoding=NONE
    BT_BMC_IstZellspannungMin: base-type-size=0, base-type-encoding=NONE
    BT_BMC_IstZellSpannungMin_Modul_ID: base-type-size=0, base-type-encoding=NONE
    BT_BMC_IstZellSpannungMin_Zell_ID: base-type-size=0, base-type-encoding=NONE
    BT_BMC_IWU_Status: base-type-size=0, base-type-encoding=NONE
    BT_BMC_IWU_Wert_neg: base-type-size=0, base-type-encoding=NONE
    BT_BMC_IWU_Wert_pos: base-type-size=0, base-type-encoding=NONE
    BT_BMC_Konditionierung_Anf: base-type-size=0, base-type-encoding=NONE
    BT_BMC_KundenWarnung: base-type-size=0, base-type-encoding=NONE
    BT_BMC_Lebensdauer_Trennelemente: base-type-size=0, base-type-encoding=NONE
    BT_BMC_Leerlaufspannung: base-type-size=0, base-type-encoding=NONE
    BT_BMC_Max_Entladeleistung: base-type-size=0, base-type-encoding=NONE
    BT_BMC_Max_Entladeleistung_02: base-type-size=0, base-type-encoding=NONE
    BT_BMC_Max_Entladestrom: base-type-size=0, base-type-encoding=NONE
    BT_BMC_Max_Entladestrom_02: base-type-size=0, base-type-encoding=NONE
    BT_BMC_Max_Ladeleistung: base-type-size=0, base-type-encoding=NONE
    BT_BMC_Max_Ladeleistung_02: base-type-size=0, base-type-encoding=NONE
    BT_BMC_Max_Ladestrom: base-type-size=0, base-type-encoding=NONE
    BT_BMC_Max_Ladestrom_02: base-type-size=0, base-type-encoding=NONE
    BT_BMC_Max_Spannung: base-type-size=0, base-type-encoding=NONE
    BT_BMC_MaxEnergieinhalt: base-type-size=0, base-type-encoding=NONE
    BT_BMC_Min_Spannung: base-type-size=0, base-type-encoding=NONE
    BT_BMC_MinDyn_Entladespannung: base-type-size=0, base-type-encoding=NONE
    BT_BMC_MinDyn_Ladespannung: base-type-size=0, base-type-encoding=NONE
    BT_BMC_MMTR_Status: base-type-size=0, base-type-encoding=NONE
    BT_BMC_Modus: base-type-size=0, base-type-encoding=NONE
    BT_BMC_NutzbareKapazitaet: base-type-size=0, base-type-encoding=NONE
    BT_BMC_NutzbarerSOC: base-type-size=0, base-type-encoding=NONE
    BT_BMC_Pack_SN_{01..26}: base-type-size=0, base-type-encoding=NONE
    BT_BMC_PCM_VTD_Freeze_Req: base-type-size=0, base-type-encoding=NONE
    BT_BMC_PCM_VTD_LifeTimeReset_Req: base-type-size=0, base-type-encoding=NONE
    BT_BMC_PCM_VTD_LifeTimeReset_Resp: base-type-size=0, base-type-encoding=NONE
    BT_BMC_PCM_VTD_RecentReset_Req: base-type-size=0, base-type-encoding=NONE
    BT_BMC_PerfInd_Entladen: base-type-size=0, base-type-encoding=NONE
    BT_BMC_PerfInd_Laden: base-type-size=0, base-type-encoding=NONE
    BT_BMC_PredLeistung_StuetzungNV: base-type-size=0, base-type-encoding=NONE
    BT_BMC_Range_Indikator: base-type-size=0, base-type-encoding=NONE
    BT_BMC_Rekuperation: base-type-size=0, base-type-encoding=NONE
    BT_BMC_Rekuperation_Ueberlauf: base-type-size=0, base-type-encoding=NONE
    BT_BMC_RtmWarnBattUnautorisiert: base-type-size=0, base-type-encoding=NONE
    BT_BMC_RtmWarnPackKommunikation: base-type-size=0, base-type-encoding=NONE
    BT_BMC_RtmWarnPackUeberladen: base-type-size=0, base-type-encoding=NONE
    BT_BMC_RtmWarnSocHoch: base-type-size=0, base-type-encoding=NONE
    BT_BMC_RtmWarnSocNiedrig: base-type-size=0, base-type-encoding=NONE
    BT_BMC_RtmWarnSocSprung: base-type-size=0, base-type-encoding=NONE
    BT_BMC_RtmWarnTZelleDiff: base-type-size=0, base-type-encoding=NONE
    BT_BMC_RtmWarnTZelleMax: base-type-size=0, base-type-encoding=NONE
    BT_BMC_RtmWarnTZelleMin: base-type-size=0, base-type-encoding=NONE
    BT_BMC_RtmWarnUeberstrom: base-type-size=0, base-type-encoding=NONE
    BT_BMC_RtmWarnUPackMax: base-type-size=0, base-type-encoding=NONE
    BT_BMC_RtmWarnUPackMin: base-type-size=0, base-type-encoding=NONE
    BT_BMC_RtmWarnUZelleMax: base-type-size=0, base-type-encoding=NONE
    BT_BMC_RtmWarnUZelleMin: base-type-size=0, base-type-encoding=NONE
    BT_BMC_RtmWarnZelleZustand: base-type-size=0, base-type-encoding=NONE
    BT_BMC_RuecklaufTemperatur: base-type-size=0, base-type-encoding=NONE
    BT_BMC_Spannung: base-type-size=0, base-type-encoding=NONE
    BT_BMC_Spannung_DC_Ladesaeule: base-type-size=0, base-type-encoding=NONE
    BT_BMC_Spannung_Messzeit: base-type-size=0, base-type-encoding=NONE
    BT_BMC_Spannung_ZwischenKreis: base-type-size=0, base-type-encoding=NONE
    BT_BMC_Spannung_ZwischenKreis_2: base-type-size=0, base-type-encoding=NONE
    BT_BMC_Sperrung_Ueberspannung: base-type-size=0, base-type-encoding=NONE
    BT_BMC_Sperrung_Uebertemperatur: base-type-size=0, base-type-encoding=NONE
    BT_BMC_Sperrung_Unterspannung: base-type-size=0, base-type-encoding=NONE
    BT_BMC_Status_DCLS: base-type-size=0, base-type-encoding=NONE
    BT_BMC_Status_HV_Spannungssensorik: base-type-size=0, base-type-encoding=NONE
    BT_BMC_Status_Spgfreiheit: base-type-size=0, base-type-encoding=NONE
    BT_BMC_Status_Trennelemente: base-type-size=0, base-type-encoding=NONE
    BT_BMC_Strom: base-type-size=0, base-type-encoding=NONE
    BT_BMC_Strom_02: base-type-size=0, base-type-encoding=NONE
    BT_BMC_Strom_Messzeit: base-type-size=0, base-type-encoding=NONE
    BT_BMC_TechnischerSOC: base-type-size=0, base-type-encoding=NONE
    BT_BMC_Temperatur: base-type-size=0, base-type-encoding=NONE
    BT_BMC_Temperatur_hoechste: base-type-size=0, base-type-encoding=NONE
    BT_BMC_Temperatur_niedrigste: base-type-size=0, base-type-encoding=NONE
    BT_BMC_ThermAuslastung: base-type-size=0, base-type-encoding=NONE
    BT_BMC_ThermSpreizung: base-type-size=0, base-type-encoding=NONE
    BT_BMC_UBE_Indik_last_update_km: base-type-size=0, base-type-encoding=NONE
    BT_BMC_UBE_Indikator: base-type-size=0, base-type-encoding=NONE
    BT_BMC_Ueberspannungszaehler_CMC{01..04}: base-type-size=0, base-type-encoding=NONE
    BT_BMC_Uebertemperaturzaehler_CMC{01..04}: base-type-size=0, base-type-encoding=NONE
    BT_BMC_UI1_Spannung1_Schalt_Anf: base-type-size=0, base-type-encoding=NONE
    BT_BMC_UI1_Spannung2_Schalt_Anf: base-type-size=0, base-type-encoding=NONE
    BT_BMC_UI2_Spannung1_Schalt_Anf: base-type-size=0, base-type-encoding=NONE
    BT_BMC_UI2_Spannung2_Schalt_Anf: base-type-size=0, base-type-encoding=NONE
    BT_BMC_Unterboden_Warnung: base-type-size=0, base-type-encoding=NONE
    BT_BMC_Unterspannungszaehler_CMC{01..04}: base-type-size=0, base-type-encoding=NONE
    BT_BMC_Verbauinfo_ACSchuetz: base-type-size=0, base-type-encoding=NONE
    BT_BMC_Verbauinfo_Bank: base-type-size=0, base-type-encoding=NONE
    BT_BMC_Verbrauch: base-type-size=0, base-type-encoding=NONE
    BT_BMC_Verbrauch_Ueberlauf: base-type-size=0, base-type-encoding=NONE
    BT_BMC_VerlustEnergie: base-type-size=0, base-type-encoding=NONE
    BT_BMC_Vorlade_Zielspannung: base-type-size=0, base-type-encoding=NONE
    BT_BMC_VorlaufTemperatur: base-type-size=0, base-type-encoding=NONE
    BT_BMC_ZellTemp_virtuell_max: base-type-size=0, base-type-encoding=NONE
    BT_BMC_ZellTemp_virtuell_min: base-type-size=0, base-type-encoding=NONE
    BT_CHA_CurProf: base-type-size=0, base-type-encoding=NONE
    BT_CHA_FlgEndOfList: base-type-size=0, base-type-encoding=NONE
    BT_CHA_FlgGlbFallBkIdc: base-type-size=0, base-type-encoding=NONE
    BT_CHA_ProfChanged: base-type-size=0, base-type-encoding=NONE
    BT_CHA_ReqPrgAcc: base-type-size=0, base-type-encoding=NONE
    BT_CHA_ReqPrgAcvChassis: base-type-size=0, base-type-encoding=NONE
    BT_CHA_ReqPrgAcvStg: base-type-size=0, base-type-encoding=NONE
    BT_CHA_ReqPrgBms: base-type-size=0, base-type-encoding=NONE
    BT_CHA_ReqPrgCMM: base-type-size=0, base-type-encoding=NONE
    BT_CHA_ReqPrgDC: base-type-size=0, base-type-encoding=NONE
    BT_CHA_ReqPrgDispSetup: base-type-size=0, base-type-encoding=NONE
    BT_CHA_ReqPrgDt: base-type-size=0, base-type-encoding=NONE
    BT_CHA_ReqPrgDynTqCtrl: base-type-size=0, base-type-encoding=NONE
    BT_CHA_ReqPrgEps: base-type-size=0, base-type-encoding=NONE
    BT_CHA_ReqPrgEsc: base-type-size=0, base-type-encoding=NONE
    BT_CHA_ReqPrgExtrLight: base-type-size=0, base-type-encoding=NONE
    BT_CHA_ReqPrgExtrSound: base-type-size=0, base-type-encoding=NONE
    BT_CHA_ReqPrgHdc: base-type-size=0, base-type-encoding=NONE
    BT_CHA_ReqPrgHdUpDisp: base-type-size=0, base-type-encoding=NONE
    BT_CHA_ReqPrgHsp: base-type-size=0, base-type-encoding=NONE
    BT_CHA_ReqPrgIntrLight: base-type-size=0, base-type-encoding=NONE
    BT_CHA_ReqPrgIntrSound: base-type-size=0, base-type-encoding=NONE
    BT_CHA_ReqPrgKl: base-type-size=0, base-type-encoding=NONE
    BT_CHA_ReqPrgLC: base-type-size=0, base-type-encoding=NONE
    BT_CHA_ReqPrgPreCrash: base-type-size=0, base-type-encoding=NONE
    BT_CHA_ReqPrgRcp: base-type-size=0, base-type-encoding=NONE
    BT_CHA_ReqPrgRwb: base-type-size=0, base-type-encoding=NONE
    BT_CHA_ReqPrgTqVect: base-type-size=0, base-type-encoding=NONE
    BT_CHA_ReqPrgVLim: base-type-size=0, base-type-encoding=NONE
    BT_CHA_ReqPrgWarnBrk: base-type-size=0, base-type-encoding=NONE
    BT_CHA_StCurProfDft: base-type-size=0, base-type-encoding=NONE
    BT_ClampControl_01_BZ: base-type-size=0, base-type-encoding=NONE
    BT_ClampControl_01_CRC: base-type-size=0, base-type-encoding=NONE
    BT_CMM_FlgCHAFctDC: base-type-size=0, base-type-encoding=NONE
    BT_CMM_FlgCHAFctLC: base-type-size=0, base-type-encoding=NONE
    BT_CMM_FlgGlbFallBkIdc: base-type-size=0, base-type-encoding=NONE
    BT_DC_Fehler_extern: base-type-size=0, base-type-encoding=NONE
    BT_DC_Fehler_intern: base-type-size=0, base-type-encoding=NONE
    BT_DC_IstLeistung_HV: base-type-size=0, base-type-encoding=NONE
    BT_DC_IstModus_02: base-type-size=0, base-type-encoding=NONE
    BT_DC_Vorladung_Status: base-type-size=0, base-type-encoding=NONE
    BT_DCDC_HVK_EoHVL_Status: base-type-size=0, base-type-encoding=NONE
    BT_DCDC_HVK_Fehler_AE: base-type-size=0, base-type-encoding=NONE
    BT_DCDC_HVK_Fehler_SD: base-type-size=0, base-type-encoding=NONE
    BT_DCDC_NV_CALID_Index_{01..16}: base-type-size=0, base-type-encoding=NONE
    BT_DCDC_NV_CVN_Byte_{1..4}: base-type-size=0, base-type-encoding=NONE
    BT_DCDC_NV_CVN_VLD: base-type-size=0, base-type-encoding=NONE
    BT_DCDC_NV_Komponentenfehler_{01..39}: base-type-size=0, base-type-encoding=NONE
    BT_DCDC_NV_Komponentenfehler_3_1: base-type-size=0, base-type-encoding=NONE
    BT_DCDC_NV_Komponentenfehler_3_{10..16}: base-type-size=0, base-type-encoding=NONE
    BT_DCDC_NV_Komponentenfehler_3_{2..9}: base-type-size=0, base-type-encoding=NONE
    BT_DCDC_NV_Komponentenfehler_{40..80}: base-type-size=0, base-type-encoding=NONE
    BT_DCDC_NV_Komponentenfehler_VLD: base-type-size=0, base-type-encoding=NONE
    BT_DEV_Hybrid_01_Req_00_FD_Data: base-type-size=8, base-type-encoding=ISO-8859-1
    BT_DEV_Hybrid_01_Resp_FF_FD_Data: base-type-size=8, base-type-encoding=ISO-8859-1
    BT_DGN_Verlernzaehler: base-type-size=0, base-type-encoding=NONE
    BT_DS_Hybrid_01_ConfDTCChanged: base-type-size=0, base-type-encoding=NONE
    BT_DS_Hybrid_01_DiagAdr: base-type-size=0, base-type-encoding=NONE
    BT_DS_Hybrid_01_IdentValid: base-type-size=0, base-type-encoding=NONE
    BT_DS_Hybrid_01_Lokalaktiv: base-type-size=0, base-type-encoding=NONE
    BT_DS_Hybrid_01_MemSel10Changed: base-type-size=0, base-type-encoding=NONE
    BT_DS_Hybrid_01_MemSelChanged: base-type-size=0, base-type-encoding=NONE
    BT_DS_Hybrid_01_StMemChanged: base-type-size=0, base-type-encoding=NONE
    BT_DS_Hybrid_01_Subsystemaktiv: base-type-size=0, base-type-encoding=NONE
    BT_DS_Hybrid_01_TestFailedChanged: base-type-size=0, base-type-encoding=NONE
    BT_DS_Hybrid_01_WIRChanged: base-type-size=0, base-type-encoding=NONE
    BT_DW_Kilometerstand: base-type-size=0, base-type-encoding=NONE
    BT_EKK_HVK_EoHVL_Status: base-type-size=0, base-type-encoding=NONE
    BT_EKK_HVK_Fehler_intern: base-type-size=0, base-type-encoding=NONE
    BT_EKK_HVK_Status_Spgfreiheit: base-type-size=0, base-type-encoding=NONE
    BT_ELF_GeplEndeLadevorgangJahr: base-type-size=0, base-type-encoding=NONE
    BT_ELF_GeplEndeLadevorgangMinute: base-type-size=0, base-type-encoding=NONE
    BT_ELF_GeplEndeLadevorgangMonat: base-type-size=0, base-type-encoding=NONE
    BT_ELF_GeplEndeLadevorgangStatus: base-type-size=0, base-type-encoding=NONE
    BT_ELF_GeplEndeLadevorgangStunde: base-type-size=0, base-type-encoding=NONE
    BT_ELF_GeplEndeLadevorgangTag: base-type-size=0, base-type-encoding=NONE
    BT_HCP1_Indc_StChk: base-type-size=0, base-type-encoding=NONE
    BT_HCP1_Indc_StFail: base-type-size=0, base-type-encoding=NONE
    BT_HV_Bordnetz_aktiv: base-type-size=0, base-type-encoding=NONE
    BT_HV_Bordnetz_Fehler: base-type-size=0, base-type-encoding=NONE
    BT_HV_Heizer_Status: base-type-size=0, base-type-encoding=NONE
    BT_HVEM_Abschaltstufe: base-type-size=0, base-type-encoding=NONE
    BT_HVEM_AIAD_Energieinhalt: base-type-size=0, base-type-encoding=NONE
    BT_HVEM_AIAD_Leistungsvorgabe: base-type-size=0, base-type-encoding=NONE
    BT_HVEM_AIAD_RekuVerbot: base-type-size=0, base-type-encoding=NONE
    BT_HVEM_BMC_CHA_Wunschleistung: base-type-size=0, base-type-encoding=NONE
    BT_HVEM_BMC_CHA_Wunschleistung_02: base-type-size=0, base-type-encoding=NONE
    BT_HVEM_ETM_Max_Entladeleistung: base-type-size=0, base-type-encoding=NONE
    BT_HVEM_ETM_Max_Entladeleistung_02: base-type-size=0, base-type-encoding=NONE
    BT_HVEM_ETM_Max_Ladeleistung: base-type-size=0, base-type-encoding=NONE
    BT_HVEM_ETM_Max_Ladeleistung_02: base-type-size=0, base-type-encoding=NONE
    BT_HVEM_ETM_Max_Leistung_Verteiler: base-type-size=0, base-type-encoding=NONE
    BT_HVEM_IstLeistung_HVVerbraucher: base-type-size=0, base-type-encoding=NONE
    BT_HVEM_IstStrom_HVVerbraucher: base-type-size=0, base-type-encoding=NONE
    BT_HVEM_Leistungsvorhalt_Entladen: base-type-size=0, base-type-encoding=NONE
    BT_HVEM_Leistungsvorhalt_Laden: base-type-size=0, base-type-encoding=NONE
    BT_HVEM_MMTR_State: base-type-size=0, base-type-encoding=NONE
    BT_HVEM_Nachlad_Status: base-type-size=0, base-type-encoding=NONE
    BT_HVEM_Nachladen_Anf: base-type-size=0, base-type-encoding=NONE
    BT_HVEM_StCpbDrv: base-type-size=0, base-type-encoding=NONE
    BT_HVEM_StCpbElAcy: base-type-size=0, base-type-encoding=NONE
    BT_HVEM_STK_Leistung_verfuegbar: base-type-size=0, base-type-encoding=NONE
    BT_HVEM_StLimElAcy: base-type-size=0, base-type-encoding=NONE
    BT_HVEM_SystemMinLeistungsgrenze: base-type-size=0, base-type-encoding=NONE
    BT_HVEM_TME_Energie_Vorgabe: base-type-size=0, base-type-encoding=NONE
    BT_HVEM_TME_Leistung_Vorgabe: base-type-size=0, base-type-encoding=NONE
    BT_HVEM_TME_MSF_aktiv: base-type-size=0, base-type-encoding=NONE
    BT_HVEM_TME_Sollstatus: base-type-size=0, base-type-encoding=NONE
    BT_HVHL_HVK_EoHVL_Status: base-type-size=0, base-type-encoding=NONE
    BT_HVHL_HVK_Fehler_intern: base-type-size=0, base-type-encoding=NONE
    BT_HVHL_HVK_Status_Spgfreiheit: base-type-size=0, base-type-encoding=NONE
    BT_HVK_03_BZ: base-type-size=0, base-type-encoding=NONE
    BT_HVK_03_CRC: base-type-size=0, base-type-encoding=NONE
    BT_HVK_AIAD_Sollmodus: base-type-size=0, base-type-encoding=NONE
    BT_HVK_AktiveEntladung_Anf: base-type-size=0, base-type-encoding=NONE
    BT_HVK_BMC_Sollmodus: base-type-size=0, base-type-encoding=NONE
    BT_HVK_BMC_Spannung_Anf: base-type-size=0, base-type-encoding=NONE
    BT_HVK_DCDC_Sollmodus: base-type-size=0, base-type-encoding=NONE
    BT_HVK_eKAT_Sollmodus: base-type-size=0, base-type-encoding=NONE
    BT_HVK_EKK_Sollmodus: base-type-size=0, base-type-encoding=NONE
    BT_HVK_ETM_Freigabe: base-type-size=0, base-type-encoding=NONE
    BT_HVK_Gesamtst_Spgfreiheit: base-type-size=0, base-type-encoding=NONE
    BT_HVK_HV_Netz_Warnungen: base-type-size=0, base-type-encoding=NONE
    BT_HVK_HV_Netz_Zustand: base-type-size=0, base-type-encoding=NONE
    BT_HVK_HVHL_Sollmodus: base-type-size=0, base-type-encoding=NONE
    BT_HVK_HVHW_Sollmodus: base-type-size=0, base-type-encoding=NONE
    BT_HVK_HVLM_Sollmodus: base-type-size=0, base-type-encoding=NONE
    BT_HVK_Iso_Messung_Start: base-type-size=0, base-type-encoding=NONE
    BT_HVK_Istmodus_Anf: base-type-size=0, base-type-encoding=NONE
    BT_HVK_Vorladung_aktiv: base-type-size=0, base-type-encoding=NONE
    BT_HVLE_AnzahlVerwendeterPhasen: base-type-size=0, base-type-encoding=NONE
    BT_HVLE_AsymmetrischLadenMoeglich: base-type-size=0, base-type-encoding=NONE
    BT_HVLE_Derating_Temperatur: base-type-size=0, base-type-encoding=NONE
    BT_HVLE_Energiemenge_Laden: base-type-size=0, base-type-encoding=NONE
    BT_HVLE_I_istAC_Netz_L{1..3}: base-type-size=0, base-type-encoding=NONE
    BT_HVLE_Ist_Wirkungsgrad: base-type-size=0, base-type-encoding=NONE
    BT_HVLE_IstSpannung_HV: base-type-size=0, base-type-encoding=NONE
    BT_HVLE_Netzfrequenz_EVU: base-type-size=0, base-type-encoding=NONE
    BT_HVLE_Netzmodus: base-type-size=0, base-type-encoding=NONE
    BT_HVLE_OBG_AC_maxSpannung: base-type-size=0, base-type-encoding=NONE
    BT_HVLE_OBG_AC_maxStrom: base-type-size=0, base-type-encoding=NONE
    BT_HVLE_OBG_ACDC_IstLeistung: base-type-size=0, base-type-encoding=NONE
    BT_HVLE_OBG_ACDC_MaxLeistung: base-type-size=0, base-type-encoding=NONE
    BT_HVLE_OBG_DC_IstStrom: base-type-size=0, base-type-encoding=NONE
    BT_HVLE_OBG_DC_MaxStrom: base-type-size=0, base-type-encoding=NONE
    BT_HVLE_OBG_Fehlerstatus: base-type-size=0, base-type-encoding=NONE
    BT_HVLE_OBG_Fehlerstrom: base-type-size=0, base-type-encoding=NONE
    BT_HVLE_OBG_IstModus: base-type-size=0, base-type-encoding=NONE
    BT_HVLE_OBG_Typ_verbaut: base-type-size=0, base-type-encoding=NONE
    BT_HVLE_OBG_Warnzustand: base-type-size=0, base-type-encoding=NONE
    BT_HVLE_PE_Monitor: base-type-size=0, base-type-encoding=NONE
    BT_HVLE_U_istAC_Netz_L{1..3}: base-type-size=0, base-type-encoding=NONE
    BT_HVLM_13_BZ: base-type-size=0, base-type-encoding=NONE
    BT_HVLM_13_CRC: base-type-size=0, base-type-encoding=NONE
    BT_HVLM_14_BZ: base-type-size=0, base-type-encoding=NONE
    BT_HVLM_14_CRC: base-type-size=0, base-type-encoding=NONE
    BT_HVLM_Aktive_Ladeart: base-type-size=0, base-type-encoding=NONE
    BT_HVLM_ALF_AktiverLadeniveauwunsch: base-type-size=0, base-type-encoding=NONE
    BT_HVLM_ALF_Ladestatus_Niveau: base-type-size=0, base-type-encoding=NONE
    BT_HVLM_ALF_PosAnforderung: base-type-size=0, base-type-encoding=NONE
    BT_HVLM_ALF_PosLadeart: base-type-size=0, base-type-encoding=NONE
    BT_HVLM_ALF_PosStatus: base-type-size=0, base-type-encoding=NONE
    BT_HVLM_BCAM_Aktiv: base-type-size=0, base-type-encoding=NONE
    BT_HVLM_BidiLadeModus: base-type-size=0, base-type-encoding=NONE
    BT_HVLM_CP_Fehlerzustand_A: base-type-size=0, base-type-encoding=NONE
    BT_HVLM_CP_Fehlerzustand_B: base-type-size=0, base-type-encoding=NONE
    BT_HVLM_CP_KommProtokoll_A: base-type-size=0, base-type-encoding=NONE
    BT_HVLM_CP_KommProtokoll_B: base-type-size=0, base-type-encoding=NONE
    BT_HVLM_CP_MaxStrom_A: base-type-size=0, base-type-encoding=NONE
    BT_HVLM_CP_MaxStrom_B: base-type-size=0, base-type-encoding=NONE
    BT_HVLM_CP_State_A: base-type-size=0, base-type-encoding=NONE
    BT_HVLM_CP_State_B: base-type-size=0, base-type-encoding=NONE
    BT_HVLM_DC_Aufstartmodus: base-type-size=0, base-type-encoding=NONE
    BT_HVLM_DC_SollStrom: base-type-size=0, base-type-encoding=NONE
    BT_HVLM_GAFrequenz: base-type-size=0, base-type-encoding=NONE
    BT_HVLM_GASpulenstrom: base-type-size=0, base-type-encoding=NONE
    BT_HVLM_Grundladen_Anf: base-type-size=0, base-type-encoding=NONE
    BT_HVLM_Intensitaet_Lk{1..3}: base-type-size=0, base-type-encoding=NONE
    BT_HVLM_LadedosenSuchlicht: base-type-size=0, base-type-encoding=NONE
    BT_HVLM_Ladeklappe_VerEntriegeAnf_{1..3}: base-type-size=0, base-type-encoding=NONE
    BT_HVLM_Laden_ISO_Messung_Anf: base-type-size=0, base-type-encoding=NONE
    BT_HVLM_Ladenaktiv_Standzyklus: base-type-size=0, base-type-encoding=NONE
    BT_HVLM_Ladeniveau_Anf: base-type-size=0, base-type-encoding=NONE
    BT_HVLM_Ladeszenario: base-type-size=0, base-type-encoding=NONE
    BT_HVLM_Ladevorgang_Anf: base-type-size=0, base-type-encoding=NONE
    BT_HVLM_Max_Strom_Netz_L{1..3}: base-type-size=0, base-type-encoding=NONE
    BT_HVLM_MaxSpannung_OBG_HV: base-type-size=0, base-type-encoding=NONE
    BT_HVLM_OBG_SollModus: base-type-size=0, base-type-encoding=NONE
    BT_HVLM_PrkCtl_StAlyReq: base-type-size=0, base-type-encoding=NONE
    BT_HVLM_PrkCtl_StPrkLockReq: base-type-size=0, base-type-encoding=NONE
    BT_HVLM_Pulsierstufe: base-type-size=0, base-type-encoding=NONE
    BT_HVLM_S2SchliessenAnf_A: base-type-size=0, base-type-encoding=NONE
    BT_HVLM_S2SchliessenAnf_B: base-type-size=0, base-type-encoding=NONE
    BT_HVLM_Schluessel_Anfrage: base-type-size=0, base-type-encoding=NONE
    BT_HVLM_SF4OeffnenAnf_A: base-type-size=0, base-type-encoding=NONE
    BT_HVLM_SF4OeffnenAnf_B: base-type-size=0, base-type-encoding=NONE
    BT_HVLM_SpannungsModusDc_Anf: base-type-size=0, base-type-encoding=NONE
    BT_HVLM_Start_Pulserkennung: base-type-size=0, base-type-encoding=NONE
    BT_HVLM_Stecker_Notentriegeln_Anf_A: base-type-size=0, base-type-encoding=NONE
    BT_HVLM_Stecker_Notentriegeln_Anf_B: base-type-size=0, base-type-encoding=NONE
    BT_HVLM_Stecker_Notentriegeln_Anf_C: base-type-size=0, base-type-encoding=NONE
    BT_HVLM_Stecker_VerEntriegelnAnf_A: base-type-size=0, base-type-encoding=NONE
    BT_HVLM_Stecker_VerEntriegelnAnf_B: base-type-size=0, base-type-encoding=NONE
    BT_HVLM_Stecker_VerEntriegelnAnf_C: base-type-size=0, base-type-encoding=NONE
    BT_HVLM_Steckerstatus: base-type-size=0, base-type-encoding=NONE
    BT_HVLM_VA_Sollmodus: base-type-size=0, base-type-encoding=NONE
    BT_HVLM_VALeistungFzg: base-type-size=0, base-type-encoding=NONE
    BT_HVLM_VASpannungFzg: base-type-size=0, base-type-encoding=NONE
    BT_HVLM_VAStromFzg: base-type-size=0, base-type-encoding=NONE
    BT_HVLM_WakeUpZaehlerResetAnf: base-type-size=0, base-type-encoding=NONE
    BT_HVLM_WLAN_Aktivieren: base-type-size=0, base-type-encoding=NONE
    BT_HVLM_WLAN_Verbinden: base-type-size=0, base-type-encoding=NONE
    BT_HVLM_ZustandLadeablauf: base-type-size=0, base-type-encoding=NONE
    BT_Hybrid_01_Abschaltstufe: base-type-size=0, base-type-encoding=NONE
    BT_Hybrid_01_Indc_StChk: base-type-size=0, base-type-encoding=NONE
    BT_Hybrid_01_Indc_StFail: base-type-size=0, base-type-encoding=NONE
    BT_Hybrid_01_KD_Fehler: base-type-size=0, base-type-encoding=NONE
    BT_Hybrid_01_KompSchutz: base-type-size=0, base-type-encoding=NONE
    BT_Hybrid_01_Nachlauftyp: base-type-size=0, base-type-encoding=NONE
    BT_Hybrid_01_OBD_Lampe_Anf: base-type-size=0, base-type-encoding=NONE
    BT_Hybrid_01_SNI_10: base-type-size=0, base-type-encoding=NONE
    BT_Hybrid_01_Transport_Mode: base-type-size=0, base-type-encoding=NONE
    BT_IMMO_ClampPermStatus: base-type-size=0, base-type-encoding=NONE
    BT_IMMO_Display: base-type-size=0, base-type-encoding=NONE
    BT_ISO_ALL_01_Req_Data: base-type-size=0, base-type-encoding=NONE
    BT_KL_Verdampfertemperatur: base-type-size=0, base-type-encoding=NONE
    BT_KN_Hybrid_01_BusKnockOut: base-type-size=0, base-type-encoding=NONE
    BT_KN_Hybrid_01_BusKnockOutTimer: base-type-size=0, base-type-encoding=NONE
    BT_KN_Hybrid_01_DiagPfad_V12: base-type-size=0, base-type-encoding=NONE
    BT_KN_Hybrid_01_ECUKnockOut: base-type-size=0, base-type-encoding=NONE
    BT_KN_Hybrid_01_ECUKnockOutTimer: base-type-size=0, base-type-encoding=NONE
    BT_Kompressor_Status: base-type-size=0, base-type-encoding=NONE
    BT_KS_Hybrid_01_ChK: base-type-size=8, base-type-encoding=ISO-8859-1
    BT_KS_Hybrid_01_ChK_IKACtr: base-type-size=0, base-type-encoding=NONE
    BT_KS_Hybrid_01_ChK_SID: base-type-size=0, base-type-encoding=NONE
    BT_KS_Hybrid_01_ChM: base-type-size=8, base-type-encoding=ISO-8859-1
    BT_KS_Hybrid_01_ChM_IKACtr: base-type-size=0, base-type-encoding=NONE
    BT_KS_Hybrid_01_ChM_SID: base-type-size=0, base-type-encoding=NONE
    BT_KS_Hybrid_01_ReK: base-type-size=8, base-type-encoding=ISO-8859-1
    BT_KS_Hybrid_01_ReK_IKACtr: base-type-size=0, base-type-encoding=NONE
    BT_KS_Hybrid_01_ReK_SID: base-type-size=0, base-type-encoding=NONE
    BT_KS_Hybrid_01_ReM: base-type-size=8, base-type-encoding=ISO-8859-1
    BT_KS_Hybrid_01_ReM_IKACtr: base-type-size=0, base-type-encoding=NONE
    BT_KS_Hybrid_01_ReM_SID: base-type-size=0, base-type-encoding=NONE
    BT_KS_Hybrid_01_Req_ErrCtr: base-type-size=0, base-type-encoding=NONE
    BT_KS_Hybrid_01_Req_IKA_Retry: base-type-size=0, base-type-encoding=NONE
    BT_KS_Hybrid_01_Req_Prio: base-type-size=0, base-type-encoding=NONE
    BT_KS_Hybrid_01_Req_SID: base-type-size=0, base-type-encoding=NONE
    BT_KS_Hybrid_01_Req_SWMaj: base-type-size=0, base-type-encoding=NONE
    BT_KS_Hybrid_01_Req_SWMin: base-type-size=0, base-type-encoding=NONE
    BT_KS_Hybrid_01_Req_SWPat: base-type-size=0, base-type-encoding=NONE
    BT_KS_Hybrid_01_Req_VKMS_Err: base-type-size=0, base-type-encoding=NONE
    BT_KST_Anf_Klemmenfreigabe_ELV: base-type-size=0, base-type-encoding=NONE
    BT_KST_Ausparken_Betrieb: base-type-size=0, base-type-encoding=NONE
    BT_KST_Ausstiegswunsch_Status: base-type-size=0, base-type-encoding=NONE
    BT_KST_aut_Abschaltung_Zuendung: base-type-size=0, base-type-encoding=NONE
    BT_KST_BulbCheckReq: base-type-size=0, base-type-encoding=NONE
    BT_KST_ComfortReadyStatus: base-type-size=0, base-type-encoding=NONE
    BT_KST_Deaktivierungs_Trigger: base-type-size=0, base-type-encoding=NONE
    BT_KST_Fahrerhinweis_{1..6}: base-type-size=0, base-type-encoding=NONE
    BT_KST_KL_15: base-type-size=0, base-type-encoding=NONE
    BT_KST_Kl_50_Startanforderung: base-type-size=0, base-type-encoding=NONE
    BT_KST_Kl_S: base-type-size=0, base-type-encoding=NONE
    BT_KST_Kl_X: base-type-size=0, base-type-encoding=NONE
    BT_KST_Sonderzustand_Anforderung: base-type-size=0, base-type-encoding=NONE
    BT_KST_Sonderzustand_Status: base-type-size=0, base-type-encoding=NONE
    BT_KST_StPtAcvReq: base-type-size=0, base-type-encoding=NONE
    BT_KST_StPtDeacReq: base-type-size=0, base-type-encoding=NONE
    BT_KST_Txt_Panikabschaltung: base-type-size=0, base-type-encoding=NONE
    BT_KST_Warn_P1_ZAT_def: base-type-size=0, base-type-encoding=NONE
    BT_KST_Warn_P2_ZAT_def: base-type-size=0, base-type-encoding=NONE
    BT_KST_WFS_Fahrfreigabe_Anforderung: base-type-size=0, base-type-encoding=NONE
    BT_KST_ZAT_betaetigt: base-type-size=0, base-type-encoding=NONE
    BT_LR_StDiagPrcd: base-type-size=0, base-type-encoding=NONE
    BT_LVB_Ladegeschw: base-type-size=0, base-type-encoding=NONE
    BT_LVB_Ladegeschw_VZ: base-type-size=0, base-type-encoding=NONE
    BT_LVB_LadegeschwEinheit: base-type-size=0, base-type-encoding=NONE
    BT_LVB_Restladezeit: base-type-size=0, base-type-encoding=NONE
    BT_LVB_StatusLadegeschw: base-type-size=0, base-type-encoding=NONE
    BT_LVB_StatusRestladezeit: base-type-size=0, base-type-encoding=NONE
    BT_MKB_ScndCllsnMtgtn_StAbo: base-type-size=0, base-type-encoding=NONE
    BT_MKB_ScndCllsnMtgtn_StReq: base-type-size=0, base-type-encoding=NONE
    BT_MM_PropulsionSystemActive: base-type-size=0, base-type-encoding=NONE
    BT_NM_aktiv_AutomotiveEdge_{1..5}: base-type-size=0, base-type-encoding=NONE
    BT_NM_aktiv_Backend_KomGW: base-type-size=0, base-type-encoding=NONE
    BT_NM_aktiv_Batteriekonditionierung: base-type-size=0, base-type-encoding=NONE
    BT_NM_aktiv_Bedienung_an_Ladedose_1: base-type-size=0, base-type-encoding=NONE
    BT_NM_aktiv_Bedienung_an_Ladedose_2: base-type-size=0, base-type-encoding=NONE
    BT_NM_aktiv_Call: base-type-size=0, base-type-encoding=NONE
    BT_NM_aktiv_ConnectVerbund_UseCase{1..6}: base-type-size=0, base-type-encoding=NONE
    BT_NM_aktiv_E3_SW_Plattform_{1..5}: base-type-size=0, base-type-encoding=NONE
    BT_NM_aktiv_Erw_HV_Ladefunktion: base-type-size=0, base-type-encoding=NONE
    BT_NM_aktiv_Gefahreninfo: base-type-size=0, base-type-encoding=NONE
    BT_NM_aktiv_HV_Laden: base-type-size=0, base-type-encoding=NONE
    BT_NM_aktiv_HVEM: base-type-size=0, base-type-encoding=NONE
    BT_NM_aktiv_HVK: base-type-size=0, base-type-encoding=NONE
    BT_NM_aktiv_HVLM: base-type-size=0, base-type-encoding=NONE
    BT_NM_aktiv_Key_Authentifiz_SMS: base-type-size=0, base-type-encoding=NONE
    BT_NM_aktiv_Konditionierung_Track: base-type-size=0, base-type-encoding=NONE
    BT_NM_aktiv_Konditionierungsbedarf: base-type-size=0, base-type-encoding=NONE
    BT_NM_aktiv_Ladestecker_erkannt_1: base-type-size=0, base-type-encoding=NONE
    BT_NM_aktiv_Ladestecker_erkannt_2: base-type-size=0, base-type-encoding=NONE
    BT_NM_aktiv_Ladezustand: base-type-size=0, base-type-encoding=NONE
    BT_NM_aktiv_MVEM_Fremdladung: base-type-size=0, base-type-encoding=NONE
    BT_NM_aktiv_MVEM_Pos_RSG: base-type-size=0, base-type-encoding=NONE
    BT_NM_aktiv_NVEM: base-type-size=0, base-type-encoding=NONE
    BT_NM_aktiv_NVEM2: base-type-size=0, base-type-encoding=NONE
    BT_NM_aktiv_OnlineRemoteUpdate: base-type-size=0, base-type-encoding=NONE
    BT_NM_aktiv_Remote_Repair: base-type-size=0, base-type-encoding=NONE
    BT_NM_aktiv_Remote_Unlock_Lock: base-type-size=0, base-type-encoding=NONE
    BT_NM_aktiv_RemoteDiensteGW: base-type-size=0, base-type-encoding=NONE
    BT_NM_aktiv_RemoteStart: base-type-size=0, base-type-encoding=NONE
    BT_NM_aktiv_RemoteVehicleTracking: base-type-size=0, base-type-encoding=NONE
    BT_NM_aktiv_RequestWirelessCharging: base-type-size=0, base-type-encoding=NONE
    BT_NM_aktiv_SmartCharging_Aktiv: base-type-size=0, base-type-encoding=NONE
    BT_NM_aktiv_SubbusSteuerung_BMC_HV: base-type-size=0, base-type-encoding=NONE
    BT_NM_aktiv_SubbusSteuerung_HCP5: base-type-size=0, base-type-encoding=NONE
    BT_NM_aktiv_Timer_abgelaufen: base-type-size=0, base-type-encoding=NONE
    BT_NM_aktiv_VehicleStatReport_Main: base-type-size=0, base-type-encoding=NONE
    BT_NM_aktiv_WarnblinkerInfo: base-type-size=0, base-type-encoding=NONE
    BT_NM_AWC_CBV_AWB: base-type-size=0, base-type-encoding=NONE
    BT_NM_AWC_CBV_CRI: base-type-size=0, base-type-encoding=NONE
    BT_NM_AWC_FCAB: base-type-size=0, base-type-encoding=ISO-8859-1
    BT_NM_AWC_NM_aktiv_Diag: base-type-size=0, base-type-encoding=NONE
    BT_NM_AWC_NM_aktiv_KL15: base-type-size=0, base-type-encoding=NONE
    BT_NM_AWC_NM_aktiv_Tmin: base-type-size=0, base-type-encoding=NONE
    BT_NM_AWC_NM_State: base-type-size=0, base-type-encoding=NONE
    BT_NM_AWC_SNI_10: base-type-size=0, base-type-encoding=NONE
    BT_NM_AWC_UDS_CC: base-type-size=0, base-type-encoding=NONE
    BT_NM_AWC_Wakeup_V12: base-type-size=0, base-type-encoding=NONE
    BT_NM_Dummy01_CAB: base-type-size=0, base-type-encoding=ISO-8859-1
    BT_NM_Dummy01_CBV_AWB: base-type-size=0, base-type-encoding=NONE
    BT_NM_Dummy01_CBV_CRI: base-type-size=0, base-type-encoding=NONE
    BT_NM_Dummy01_NM_State: base-type-size=0, base-type-encoding=NONE
    BT_NM_Gateway_CBV_AWB: base-type-size=0, base-type-encoding=NONE
    BT_NM_Gateway_CBV_CRI: base-type-size=0, base-type-encoding=NONE
    BT_NM_Gateway_FCAB: base-type-size=0, base-type-encoding=ISO-8859-1
    BT_NM_Gateway_NM_aktiv_CABaktiv: base-type-size=0, base-type-encoding=NONE
    BT_NM_Gateway_NM_aktiv_Diag: base-type-size=0, base-type-encoding=NONE
    BT_NM_Gateway_NM_aktiv_KL15: base-type-size=0, base-type-encoding=NONE
    BT_NM_Gateway_NM_aktiv_Tmin: base-type-size=0, base-type-encoding=NONE
    BT_NM_Gateway_NM_State: base-type-size=0, base-type-encoding=NONE
    BT_NM_Gateway_SNI_10: base-type-size=0, base-type-encoding=NONE
    BT_NM_Gateway_UDS_CC: base-type-size=0, base-type-encoding=NONE
    BT_NM_Gateway_Wakeup_V12: base-type-size=0, base-type-encoding=NONE
    BT_NM_HVZB_CBV_AWB: base-type-size=0, base-type-encoding=NONE
    BT_NM_HVZB_CBV_CRI: base-type-size=0, base-type-encoding=NONE
    BT_NM_HVZB_FCAB: base-type-size=0, base-type-encoding=ISO-8859-1
    BT_NM_HVZB_NM_aktiv_Diag: base-type-size=0, base-type-encoding=NONE
    BT_NM_HVZB_NM_aktiv_KL15: base-type-size=0, base-type-encoding=NONE
    BT_NM_HVZB_NM_aktiv_Tmin: base-type-size=0, base-type-encoding=NONE
    BT_NM_HVZB_NM_State: base-type-size=0, base-type-encoding=NONE
    BT_NM_HVZB_SNI_10: base-type-size=0, base-type-encoding=NONE
    BT_NM_HVZB_UDS_CC: base-type-size=0, base-type-encoding=NONE
    BT_NM_HVZB_Wakeup_V12: base-type-size=0, base-type-encoding=NONE
    BT_NM_Hybrid_01_CAB_V12: base-type-size=0, base-type-encoding=ISO-8859-1
    BT_NM_Hybrid_01_CBV_AWB: base-type-size=0, base-type-encoding=NONE
    BT_NM_Hybrid_01_CBV_CRI: base-type-size=0, base-type-encoding=NONE
    BT_NM_Hybrid_01_FCAB: base-type-size=0, base-type-encoding=ISO-8859-1
    BT_NM_Hybrid_01_FCIB: base-type-size=0, base-type-encoding=ISO-8859-1
    BT_NM_Hybrid_01_Lokalaktiv: base-type-size=0, base-type-encoding=NONE
    BT_NM_Hybrid_01_NM_aktiv_Diag: base-type-size=0, base-type-encoding=NONE
    BT_NM_Hybrid_01_NM_aktiv_KL15: base-type-size=0, base-type-encoding=NONE
    BT_NM_Hybrid_01_NM_aktiv_KondAnf: base-type-size=0, base-type-encoding=NONE
    BT_NM_Hybrid_01_NM_aktiv_Tmin: base-type-size=0, base-type-encoding=NONE
    BT_NM_Hybrid_01_NM_State: base-type-size=0, base-type-encoding=NONE
    BT_NM_Hybrid_01_SNI_10: base-type-size=0, base-type-encoding=NONE
    BT_NM_Hybrid_01_Subsystemaktiv: base-type-size=0, base-type-encoding=NONE
    BT_NM_Hybrid_01_UDS_CC: base-type-size=0, base-type-encoding=NONE
    BT_NM_Hybrid_01_Wakeup_V12: base-type-size=0, base-type-encoding=NONE
    BT_NM_Ladegeraet_CBV_AWB: base-type-size=0, base-type-encoding=NONE
    BT_NM_Ladegeraet_CBV_CRI: base-type-size=0, base-type-encoding=NONE
    BT_NM_Ladegeraet_FCAB: base-type-size=0, base-type-encoding=ISO-8859-1
    BT_NM_Ladegeraet_NM_aktiv_Diag: base-type-size=0, base-type-encoding=NONE
    BT_NM_Ladegeraet_NM_aktiv_KL15: base-type-size=0, base-type-encoding=NONE
    BT_NM_Ladegeraet_NM_aktiv_Tmin: base-type-size=0, base-type-encoding=NONE
    BT_NM_Ladegeraet_NM_State: base-type-size=0, base-type-encoding=NONE
    BT_NM_Ladegeraet_SNI_10: base-type-size=0, base-type-encoding=NONE
    BT_NM_Ladegeraet_UDS_CC: base-type-size=0, base-type-encoding=NONE
    BT_NM_Ladegeraet_Wakeup_V12: base-type-size=0, base-type-encoding=NONE
    BT_NM_SACID_1_CBV_AWB: base-type-size=0, base-type-encoding=NONE
    BT_NM_SACID_1_CBV_CRI: base-type-size=0, base-type-encoding=NONE
    BT_NM_SACID_1_FCAB: base-type-size=0, base-type-encoding=ISO-8859-1
    BT_NM_SACID_1_NM_aktiv_Diag: base-type-size=0, base-type-encoding=NONE
    BT_NM_SACID_1_NM_aktiv_KL15: base-type-size=0, base-type-encoding=NONE
    BT_NM_SACID_1_NM_aktiv_Tmin: base-type-size=0, base-type-encoding=NONE
    BT_NM_SACID_1_NM_State: base-type-size=0, base-type-encoding=NONE
    BT_NM_SACID_1_SNI_10: base-type-size=0, base-type-encoding=NONE
    BT_NM_SACID_1_UDS_CC: base-type-size=0, base-type-encoding=NONE
    BT_NM_SACID_1_Wakeup_V12: base-type-size=0, base-type-encoding=NONE
    BT_NM_SACID_2_CBV_AWB: base-type-size=0, base-type-encoding=NONE
    BT_NM_SACID_2_CBV_CRI: base-type-size=0, base-type-encoding=NONE
    BT_NM_SACID_2_FCAB: base-type-size=0, base-type-encoding=ISO-8859-1
    BT_NM_SACID_2_NM_aktiv_Diag: base-type-size=0, base-type-encoding=NONE
    BT_NM_SACID_2_NM_aktiv_KL15: base-type-size=0, base-type-encoding=NONE
    BT_NM_SACID_2_NM_aktiv_Tmin: base-type-size=0, base-type-encoding=NONE
    BT_NM_SACID_2_NM_State: base-type-size=0, base-type-encoding=NONE
    BT_NM_SACID_2_SNI_10: base-type-size=0, base-type-encoding=NONE
    BT_NM_SACID_2_UDS_CC: base-type-size=0, base-type-encoding=NONE
    BT_NM_SACID_2_Wakeup_V12: base-type-size=0, base-type-encoding=NONE
    BT_NVEM3_Absch_SCR: base-type-size=0, base-type-encoding=NONE
    BT_NVEM_12_BZ: base-type-size=0, base-type-encoding=NONE
    BT_NVEM_12_CRC: base-type-size=0, base-type-encoding=NONE
    BT_NVEM_Abschaltstufe: base-type-size=0, base-type-encoding=NONE
    BT_NVEM_Bordnetz_Information: base-type-size=0, base-type-encoding=NONE
    BT_NVEM_Bordnetzdiagnose: base-type-size=0, base-type-encoding=NONE
    BT_NVEM_DC_iSoll_NV: base-type-size=0, base-type-encoding=NONE
    BT_NVEM_DC_uMin_NV: base-type-size=0, base-type-encoding=NONE
    BT_NVEM_DC_uSoll_NV: base-type-size=0, base-type-encoding=NONE
    BT_NVEM_Freigabe_OTA: base-type-size=0, base-type-encoding=NONE
    BT_NVEM_Last_Anf: base-type-size=0, base-type-encoding=NONE
    BT_NVEM_MV_DC_iSoll_NV: base-type-size=0, base-type-encoding=NONE
    BT_NVEM_MV_DC_uMinLV: base-type-size=0, base-type-encoding=NONE
    BT_NVEM_MV_DC_uSollLV: base-type-size=0, base-type-encoding=NONE
    BT_NVEM_NV_BAT_ZellStatus_Index_Anf: base-type-size=0, base-type-encoding=NONE
    BT_NVEM_NV_BAT_ZellStatus_Typ_Anf: base-type-size=0, base-type-encoding=NONE
    BT_NVEM_Verbraucher_Information: base-type-size=0, base-type-encoding=NONE
    BT_OBD_Abs_Pedal_Pos: base-type-size=0, base-type-encoding=NONE
    BT_OBD_Aussen_Temp_gef: base-type-size=0, base-type-encoding=NONE
    BT_OBD_Barometric_Pressure: base-type-size=0, base-type-encoding=NONE
    BT_OBD_Calc_Load_Val: base-type-size=0, base-type-encoding=NONE
    BT_OBD_ClearMem_Inhibit: base-type-size=0, base-type-encoding=NONE
    BT_OBD_Driving_Cycle: base-type-size=0, base-type-encoding=NONE
    BT_OBD_Eng_Cool_Temp: base-type-size=0, base-type-encoding=NONE
    BT_OBD_Engine_RPM: base-type-size=0, base-type-encoding=NONE
    BT_OBD_Kaltstart_Denominator: base-type-size=0, base-type-encoding=NONE
    BT_OBD_MIL: base-type-size=0, base-type-encoding=NONE
    BT_OBD_Minimum_Trip: base-type-size=0, base-type-encoding=NONE
    BT_OBD_Normed_Trip: base-type-size=0, base-type-encoding=NONE
    BT_OBD_Normed_Trip_Wout_Fu_Cdn: base-type-size=0, base-type-encoding=NONE
    BT_OBD_NumDcyMilOnReq: base-type-size=0, base-type-encoding=NONE
    BT_OBD_QBit_Aussen_Temp: base-type-size=0, base-type-encoding=NONE
    BT_OBD_Sperrung_IUMPR: base-type-size=0, base-type-encoding=NONE
    BT_OBD_Sperrung_Kaltstart_Denom: base-type-size=0, base-type-encoding=NONE
    BT_OBD_Typ: base-type-size=0, base-type-encoding=NONE
    BT_OBD_Warm_Up_Cycle: base-type-size=0, base-type-encoding=NONE
    BT_OBDProtocol_Hybrid_01: base-type-size=0, base-type-encoding=NONE
    BT_OBDProtocol_req: base-type-size=0, base-type-encoding=NONE
    BT_OBG_01_BZ: base-type-size=0, base-type-encoding=NONE
    BT_OnlineRemoteUpdateControlA: base-type-size=0, base-type-encoding=NONE
    BT_OnlineRemoteUpdateControlD: base-type-size=0, base-type-encoding=NONE
    BT_OnlineRemoteUpdateControlOldA: base-type-size=0, base-type-encoding=NONE
    BT_OnlineRemoteUpdateControlOldD: base-type-size=0, base-type-encoding=NONE
    BT_ORU_AgLgtSdsl: base-type-size=0, base-type-encoding=NONE
    BT_ORU_Control_A_01_BZ: base-type-size=0, base-type-encoding=NONE
    BT_ORU_Control_A_01_CRC: base-type-size=0, base-type-encoding=NONE
    BT_ORU_Control_D_01_BZ: base-type-size=0, base-type-encoding=NONE
    BT_ORU_Control_D_01_CRC: base-type-size=0, base-type-encoding=NONE
    BT_ORU_Status: base-type-size=0, base-type-encoding=NONE
    BT_OruControlReleaseA: base-type-size=0, base-type-encoding=NONE
    BT_OruControlReleaseD: base-type-size=0, base-type-encoding=NONE
    BT_OruControlStateA: base-type-size=0, base-type-encoding=NONE
    BT_OruControlStateD: base-type-size=0, base-type-encoding=NONE
    BT_OruHostUpdateA: base-type-size=0, base-type-encoding=NONE
    BT_OruHostUpdateD: base-type-size=0, base-type-encoding=NONE
    BT_OruIntegrityCheckActiveA: base-type-size=0, base-type-encoding=NONE
    BT_OruIntegrityCheckActiveD: base-type-size=0, base-type-encoding=NONE
    BT_OruReleasePartitionSwitchA: base-type-size=0, base-type-encoding=NONE
    BT_OruReleasePartitionSwitchD: base-type-size=0, base-type-encoding=NONE
    BT_OruVehicleLockRequestA: base-type-size=0, base-type-encoding=NONE
    BT_OruVehicleLockRequestD: base-type-size=0, base-type-encoding=NONE
    BT_OTAMC_D_01_BZ: base-type-size=0, base-type-encoding=NONE
    BT_OTAMC_D_01_CRC: base-type-size=0, base-type-encoding=NONE
    BT_OTP_01_BZ: base-type-size=0, base-type-encoding=NONE
    BT_OTP_01_CRC: base-type-size=0, base-type-encoding=NONE
    BT_OTP_Aussen_Temp_FStatus: base-type-size=0, base-type-encoding=NONE
    BT_OTP_Aussen_Temp_gef: base-type-size=0, base-type-encoding=NONE
    BT_OTP_Aussen_Temp_OBD: base-type-size=0, base-type-encoding=NONE
    BT_OTP_Aussen_Temp_ungef: base-type-size=0, base-type-encoding=NONE
    BT_PCM_BMC_VTD_Freeze_Req: base-type-size=0, base-type-encoding=NONE
    BT_PCM_BMC_VTD_LifeTimeReset_Req: base-type-size=0, base-type-encoding=NONE
    BT_PCM_BMC_VTD_LifeTimeReset_Resp: base-type-size=0, base-type-encoding=NONE
    BT_PCM_BMC_VTD_RecentReset_Req: base-type-size=0, base-type-encoding=NONE
    BT_PLC_StCpbPrkLockUnit: base-type-size=0, base-type-encoding=NONE
    BT_PTCfgSrv_PwrPtSysMax: base-type-size=0, base-type-encoding=NONE
    BT_PTERM_MdElEgyMng: base-type-size=0, base-type-encoding=NONE
    BT_PTOVeh_FlgTqWhlPos: base-type-size=0, base-type-encoding=NONE
    BT_SI_Diagnose_Aktiv: base-type-size=0, base-type-encoding=NONE
    BT_SI_NWDF: base-type-size=0, base-type-encoding=NONE
    BT_SI_NWDF_30: base-type-size=0, base-type-encoding=NONE
    BT_SI_NWDF_gueltig: base-type-size=0, base-type-encoding=NONE
    BT_SI_P_Mode: base-type-size=0, base-type-encoding=NONE
    BT_SI_P_Mode_gueltig: base-type-size=0, base-type-encoding=NONE
    BT_SI_QRS_Mode: base-type-size=0, base-type-encoding=NONE
    BT_SI_T_Mode: base-type-size=0, base-type-encoding=NONE
    BT_SI_T_Schutz: base-type-size=0, base-type-encoding=NONE
    BT_SignalVoid: base-type-size=0, base-type-encoding=NONE
    BT_SOK_ungeschuetzte_Zeit: base-type-size=8, base-type-encoding=ISO-8859-1
    BT_SOK_Zeit_Hybrid_01_Challenge: base-type-size=8, base-type-encoding=ISO-8859-1
    BT_SOK_Zeit_Hybrid_01_Zeit: base-type-size=8, base-type-encoding=ISO-8859-1
    BT_Thermo_Verbrauch_BTL: base-type-size=0, base-type-encoding=NONE
    BT_Thermo_Verbrauch_BTL_Ueberlauf: base-type-size=0, base-type-encoding=NONE
    BT_Thermo_Verbrauch_Innen: base-type-size=0, base-type-encoding=NONE
    BT_Thermo_Verbrauch_Innen_Ueberlauf: base-type-size=0, base-type-encoding=NONE
    BT_TME_Anforderung_Heizkreispumpe: base-type-size=0, base-type-encoding=NONE
    BT_TME_Antriebszustand_Anf: base-type-size=0, base-type-encoding=NONE
    BT_TME_Batt_Kond_status: base-type-size=0, base-type-encoding=NONE
    BT_TME_Batt_Kond_Verf: base-type-size=0, base-type-encoding=NONE
    BT_TME_DCDC_HV_Status_Kuehlung: base-type-size=0, base-type-encoding=NONE
    BT_TME_EKK_HVK_Fehler_AE: base-type-size=0, base-type-encoding=NONE
    BT_TME_EKK_Istmodus: base-type-size=0, base-type-encoding=NONE
    BT_TME_eKMV_Istmodus: base-type-size=0, base-type-encoding=NONE
    BT_TME_eKMV_Spannung: base-type-size=0, base-type-encoding=NONE
    BT_TME_eKMV_Strom: base-type-size=0, base-type-encoding=NONE
    BT_TME_ELM{1..3}_IstVolumenstrom: base-type-size=0, base-type-encoding=NONE
    BT_TME_ETV_IstVolumenstrom: base-type-size=0, base-type-encoding=NONE
    BT_TME_Heizanforderung_Innenraum: base-type-size=0, base-type-encoding=NONE
    BT_TME_HT_Kuehlmittel_Sensor: base-type-size=0, base-type-encoding=NONE
    BT_TME_HV_Anf: base-type-size=0, base-type-encoding=NONE
    BT_TME_HV_IstLeistung: base-type-size=0, base-type-encoding=NONE
    BT_TME_HV_IstLeistung_BTL: base-type-size=0, base-type-encoding=NONE
    BT_TME_HV_IstLeistung_EKK: base-type-size=0, base-type-encoding=NONE
    BT_TME_HV_IstLeistung_HVHL: base-type-size=0, base-type-encoding=NONE
    BT_TME_HV_IstLeistung_HVHW: base-type-size=0, base-type-encoding=NONE
    BT_TME_HV_IstLeistung_Komfort: base-type-size=0, base-type-encoding=NONE
    BT_TME_HVEM_Abschaltleistung: base-type-size=0, base-type-encoding=NONE
    BT_TME_HVEM_HV_Anf: base-type-size=0, base-type-encoding=NONE
    BT_TME_HVEM_Minleistung: base-type-size=0, base-type-encoding=NONE
    BT_TME_HVEM_Rekuleistung: base-type-size=0, base-type-encoding=NONE
    BT_TME_HVEM_Vorhaltleistung: base-type-size=0, base-type-encoding=NONE
    BT_TME_HVEM_Wunschleistung: base-type-size=0, base-type-encoding=NONE
    BT_TME_HVHL_Istmodus: base-type-size=0, base-type-encoding=NONE
    BT_TME_HVHL_NTC_Warnung: base-type-size=0, base-type-encoding=NONE
    BT_TME_HVHL_Verbauinfo: base-type-size=0, base-type-encoding=NONE
    BT_TME_HVHL_verfuegbar: base-type-size=0, base-type-encoding=NONE
    BT_TME_HVHW_Ansteuerung_Soll: base-type-size=0, base-type-encoding=NONE
    BT_TME_HVHW_HVK_EoHVL_Status: base-type-size=0, base-type-encoding=NONE
    BT_TME_HVHW_HVK_Fehler_AE: base-type-size=0, base-type-encoding=NONE
    BT_TME_HVHW_HVK_Fehler_HVIL: base-type-size=0, base-type-encoding=NONE
    BT_TME_HVHW_HVK_Fehler_intern: base-type-size=0, base-type-encoding=NONE
    BT_TME_HVHW_HVK_IstModus: base-type-size=0, base-type-encoding=NONE
    BT_TME_HVHW_HVK_Status_Spgfreiheit: base-type-size=0, base-type-encoding=NONE
    BT_TME_HVHW_SollModus: base-type-size=0, base-type-encoding=NONE
    BT_TME_HVHW_Verbauinfo: base-type-size=0, base-type-encoding=NONE
    BT_TME_IPB_Status_Kuehlung: base-type-size=0, base-type-encoding=NONE
    BT_TME_Klima_Heizleistung_reduziert: base-type-size=0, base-type-encoding=NONE
    BT_TME_Klima_Red_Heizleistung_HVHL: base-type-size=0, base-type-encoding=NONE
    BT_TME_Klimaanforderung: base-type-size=0, base-type-encoding=NONE
    BT_TME_Kompressorlastmoment: base-type-size=0, base-type-encoding=NONE
    BT_TME_Kuehlerjalousie_Ausfall: base-type-size=0, base-type-encoding=NONE
    BT_TME_Kuehlerluefter_Totalausfall: base-type-size=0, base-type-encoding=NONE
    BT_TME_LED_STK: base-type-size=0, base-type-encoding=NONE
    BT_TME_LED_STK_Timer: base-type-size=0, base-type-encoding=NONE
    BT_TME_Min_Fahrdrehzahl: base-type-size=0, base-type-encoding=NONE
    BT_TME_Min_Leerlaufdrehzahl: base-type-size=0, base-type-encoding=NONE
    BT_TME_MSF_Stufe: base-type-size=0, base-type-encoding=NONE
    BT_TME_MVEM_MinLeistung: base-type-size=0, base-type-encoding=NONE
    BT_TME_MVEM_Wunschleistung: base-type-size=0, base-type-encoding=NONE
    BT_TME_MVH_L_Istmodus: base-type-size=0, base-type-encoding=NONE
    BT_TME_MVH_L_Spannung: base-type-size=0, base-type-encoding=NONE
    BT_TME_MVH_L_Strom: base-type-size=0, base-type-encoding=NONE
    BT_TME_MVH_L_Verbauinfo: base-type-size=0, base-type-encoding=NONE
    BT_TME_Notbelueftung_Aktivierung: base-type-size=0, base-type-encoding=NONE
    BT_TME_NT_Kreis_Status: base-type-size=0, base-type-encoding=NONE
    BT_TME_NT_Kuehlmittel_Sensor_02: base-type-size=0, base-type-encoding=NONE
    BT_TME_OBD_Lampe_Anf: base-type-size=0, base-type-encoding=NONE
    BT_TME_PTC_Leistung_Ist: base-type-size=0, base-type-encoding=NONE
    BT_TME_PTC_stufig_Status: base-type-size=0, base-type-encoding=NONE
    BT_TME_PTC_Verbauinfo: base-type-size=0, base-type-encoding=NONE
    BT_TME_Temp_KM_vor_LE: base-type-size=0, base-type-encoding=NONE
    BT_TME_Temp_nach_Heizregister: base-type-size=0, base-type-encoding=NONE
    BT_TME_Temp_nach_Heizung_Front: base-type-size=0, base-type-encoding=NONE
    BT_TME_Temp_nach_HVH_Heizk1_1: base-type-size=0, base-type-encoding=NONE
    BT_TME_Temp_nach_HVH_Heizk1_2: base-type-size=0, base-type-encoding=NONE
    BT_TME_Temp_nach_HVH_Heizk2_1: base-type-size=0, base-type-encoding=NONE
    BT_TME_Temp_nach_HVH_Heizk2_2: base-type-size=0, base-type-encoding=NONE
    BT_TME_Temp_nach_HVH_Heizk3_1: base-type-size=0, base-type-encoding=NONE
    BT_TME_Temp_nach_HVH_Heizk3_2: base-type-size=0, base-type-encoding=NONE
    BT_TME_Temp_nach_HVH_Heizk4_1: base-type-size=0, base-type-encoding=NONE
    BT_TME_Temp_nach_HVH_Heizk4_2: base-type-size=0, base-type-encoding=NONE
    BT_TME_Temp_nach_Verdampfer_Front: base-type-size=0, base-type-encoding=NONE
    BT_TME_Therm_IstLeistung_HVBatterie: base-type-size=0, base-type-encoding=NONE
    BT_TME_Verbrauch_gesamt: base-type-size=0, base-type-encoding=NONE
    BT_TME_Verbrauch_gesamt_Ueberlauf: base-type-size=0, base-type-encoding=NONE
    BT_TME_Vorwarn_Komp_ein: base-type-size=0, base-type-encoding=NONE
    BT_TME_ZR_Anforderung: base-type-size=0, base-type-encoding=NONE
    BT_UH_Jahr: base-type-size=0, base-type-encoding=NONE
    BT_UH_Minute: base-type-size=0, base-type-encoding=NONE
    BT_UH_Monat: base-type-size=0, base-type-encoding=NONE
    BT_UH_Sekunde: base-type-size=0, base-type-encoding=NONE
    BT_UH_Stunde: base-type-size=0, base-type-encoding=NONE
    BT_UH_Tag: base-type-size=0, base-type-encoding=NONE
    BT_UI1_Iso_Neg: base-type-size=0, base-type-encoding=NONE
    BT_UI1_Iso_Pos: base-type-size=0, base-type-encoding=NONE
    BT_UI1_Iso_Status: base-type-size=0, base-type-encoding=NONE
    BT_UI1_KL30_Spannung: base-type-size=0, base-type-encoding=NONE
    BT_UI1_KompFehlerModus2_{01..26}: base-type-size=0, base-type-encoding=NONE
    BT_UI1_KompFehlerModus4_{01..16}: base-type-size=0, base-type-encoding=NONE
    BT_UI1_Spannung1: base-type-size=0, base-type-encoding=NONE
    BT_UI1_Spannung1_Schalt_Status: base-type-size=0, base-type-encoding=NONE
    BT_UI1_Spannung2: base-type-size=0, base-type-encoding=NONE
    BT_UI1_Spannung2_Schalt_Status: base-type-size=0, base-type-encoding=NONE
    BT_UI1_Spannung{3..6}: base-type-size=0, base-type-encoding=NONE
    BT_UI1_Status: base-type-size=0, base-type-encoding=NONE
    BT_UI1_Strom: base-type-size=0, base-type-encoding=NONE
    BT_UI1_Stromintegral_Entladen: base-type-size=0, base-type-encoding=NONE
    BT_UI1_Stromintegral_Laden: base-type-size=0, base-type-encoding=NONE
    BT_UI1_Temperatur_1: base-type-size=0, base-type-encoding=NONE
    BT_UI1_Temperatur_2: base-type-size=0, base-type-encoding=NONE
    BT_UI2_HW_Crashleitung_Status: base-type-size=0, base-type-encoding=NONE
    BT_UI2_KL30_Spannung: base-type-size=0, base-type-encoding=NONE
    BT_UI2_KompFehlerModus2_{01..26}: base-type-size=0, base-type-encoding=NONE
    BT_UI2_KompFehlerModus4_{01..16}: base-type-size=0, base-type-encoding=NONE
    BT_UI2_Pyro_Status: base-type-size=0, base-type-encoding=NONE
    BT_UI2_Spannung1: base-type-size=0, base-type-encoding=NONE
    BT_UI2_Spannung1_Schalt_Status: base-type-size=0, base-type-encoding=NONE
    BT_UI2_Spannung2: base-type-size=0, base-type-encoding=NONE
    BT_UI2_Spannung2_Schalt_Status: base-type-size=0, base-type-encoding=NONE
    BT_UI2_Spannung{3..6}: base-type-size=0, base-type-encoding=NONE
    BT_UI2_Status: base-type-size=0, base-type-encoding=NONE
    BT_UI2_Strom: base-type-size=0, base-type-encoding=NONE
    BT_UI2_Stromintegral_Entladen: base-type-size=0, base-type-encoding=NONE
    BT_UI2_Stromintegral_Laden: base-type-size=0, base-type-encoding=NONE
    BT_UI2_Temperatur_1: base-type-size=0, base-type-encoding=NONE
    BT_UI2_Temperatur_2: base-type-size=0, base-type-encoding=NONE
    BT_UI2Sens01_CALID_Index_{01..16}: base-type-size=0, base-type-encoding=NONE
    BT_UI2Sens01_CVN_Byte_{1..4}: base-type-size=0, base-type-encoding=NONE
    BT_UI2Sens01_CVN_VLD: base-type-size=0, base-type-encoding=NONE
    BT_UI2Sens01_ErrMem_State: base-type-size=0, base-type-encoding=NONE
    BT_UI2Sens02_CALID_Index_{01..16}: base-type-size=0, base-type-encoding=NONE
    BT_UI2Sens02_CVN_Byte_{1..4}: base-type-size=0, base-type-encoding=NONE
    BT_UI2Sens02_CVN_VLD: base-type-size=0, base-type-encoding=NONE
    BT_UI2Sens02_ErrMem_State: base-type-size=0, base-type-encoding=NONE
    BT_UISensorIso_01_BZ: base-type-size=0, base-type-encoding=NONE
    BT_UISensorIso_01_CRC: base-type-size=0, base-type-encoding=NONE
    BT_UISensorIso_02_BZ: base-type-size=0, base-type-encoding=NONE
    BT_UISensorIso_02_CRC: base-type-size=0, base-type-encoding=NONE
    BT_UISensorPyro_01_BZ: base-type-size=0, base-type-encoding=NONE
    BT_UISensorPyro_01_CRC: base-type-size=0, base-type-encoding=NONE
    BT_UISensorPyro_02_BZ: base-type-size=0, base-type-encoding=NONE
    BT_UISensorPyro_02_CRC: base-type-size=0, base-type-encoding=NONE
    BT_UISensorPyro_03_BZ: base-type-size=0, base-type-encoding=NONE
    BT_UISensorPyro_03_CRC: base-type-size=0, base-type-encoding=NONE
    BT_VDSO_05_BZ: base-type-size=0, base-type-encoding=NONE
    BT_VDSO_05_CRC: base-type-size=0, base-type-encoding=NONE
    BT_VDSO_BasTi200_NumClc_05: base-type-size=0, base-type-encoding=NONE
    BT_VDSO_Vx3d: base-type-size=0, base-type-encoding=NONE
    BT_VDSO_Vx3dDisp: base-type-size=0, base-type-encoding=NONE
    BT_VDSO_Vx3dKmph: base-type-size=0, base-type-encoding=NONE
    BT_VehicleProtectedEnvironment_D: base-type-size=0, base-type-encoding=NONE
    BT_VIN_1: base-type-size=0, base-type-encoding=NONE
    BT_VIN_{10..17}: base-type-size=0, base-type-encoding=NONE
    BT_VIN_{2..9}: base-type-size=0, base-type-encoding=NONE
    BT_Waermepumpe_Status: base-type-size=0, base-type-encoding=NONE
    BT_WFS_02_BZ: base-type-size=0, base-type-encoding=NONE
    BT_WFS_02_CRC: base-type-size=0, base-type-encoding=NONE
    BT_WFS_Betrieb_Lesespule: base-type-size=0, base-type-encoding=NONE
    BT_WFS_ELV_authorisiert: base-type-size=0, base-type-encoding=NONE
    BT_WFS_Fahrerhinweise: base-type-size=0, base-type-encoding=NONE
    BT_WFS_ID_Geb_autorisiert: base-type-size=0, base-type-encoding=NONE
    BT_WFS_ID_Geb_autorisiert_in_Kl15: base-type-size=0, base-type-encoding=NONE
    BT_WFS_ID_Geb_steckt: base-type-size=0, base-type-encoding=NONE
    BT_WFS_Klemmenfreigabe: base-type-size=0, base-type-encoding=NONE
    BT_WFS_LF_Aktiv: base-type-size=0, base-type-encoding=NONE
    BT_WFS_LZ_02: base-type-size=0, base-type-encoding=NONE
    BT_WFS_Parken_Status: base-type-size=0, base-type-encoding=NONE
    BT_WFS_Safe: base-type-size=0, base-type-encoding=NONE
    BT_WFS_Schluessel_Fahrberecht: base-type-size=0, base-type-encoding=NONE
    BT_WFS_Schluessel_Ist: base-type-size=0, base-type-encoding=NONE
    BT_WFS_Schluessel_Soll: base-type-size=0, base-type-encoding=NONE
    BT_ZM_Fahrzeugabstellzeit: base-type-size=0, base-type-encoding=NONE
    BT_ZM_Fahrzeugabstellzeit_HiRes: base-type-size=0, base-type-encoding=NONE
    BT_ZM_Fahrzeugabstellzeit_Status: base-type-size=0, base-type-encoding=NONE
    BT_ZM_HV_Auszeit: base-type-size=0, base-type-encoding=NONE
    BT_ZM_HV_Auszeit_HiRes: base-type-size=0, base-type-encoding=NONE
    BT_ZM_HV_Auszeit_Status: base-type-size=0, base-type-encoding=NONE
    BT_ZM_Standzeit: base-type-size=0, base-type-encoding=NONE
package /Signal
  11 x system signal:
    ISO_ALL_01_Req_Data  # Funktionaler Request ALL
    SignalVoid_Airbag_10_{0..2}
    SignalVoid_WFS_02_{0..6}
  26 x system signal group:
    SG_BJB_10: system-signal=[BJB_Lebensdauer_Trennelemente, BJB_Sperrung_Unterspannung, BJB_Status_Trennelemente, BJB_Status_HV_Spannungssensorik, BJB_10_CRC, BJB_10_BZ, SignalVoid_BJB_10_0, SignalVoid_BJB_10_1, SignalVoid_BJB_10_2, SignalVoid_BJB_10_3]  # Signal Group
    SG_BJB_11: system-signal=[BJB_Uebertemperaturzaehler_CMC02, BJB_Ueberspannungszaehler_CMC01, BJB_Sperrung_Ueberspannung, BJB_Ueberspannungszaehler_CMC02, BJB_Uebertemperaturzaehler_CMC01, BJB_11_CRC, BJB_11_BZ]  # Signal Group
    SG_BJB_12: system-signal=[BJB_Ueberspannungszaehler_CMC04, BJB_Uebertemperaturzaehler_CMC03, BJB_Ueberspannungszaehler_CMC03, BJB_Sperrung_Uebertemperatur, BJB_Uebertemperaturzaehler_CMC04, BJB_12_CRC, BJB_12_BZ]  # Signal Group
    SG_BJB_13: system-signal=[BJB_Unterspannungszaehler_CMC03, BJB_Unterspannungszaehler_CMC01, BJB_Unterspannungszaehler_CMC02, BJB_Unterspannungszaehler_CMC04, BJB_13_CRC, BJB_13_BZ, SignalVoid_BJB_13_0, SignalVoid_BJB_13_1]  # Signal Group
    SG_BMC_HV_01: system-signal=[BMC_Bankstatus, BMC_Spannung, BMC_Modus, BMC_HVK_Fehler_SD, BMC_HVK_Fehler_HVIL, BMC_HVK_Fehler_Intern, BMC_HVK_EoHVL_Status, BMC_Status_Spgfreiheit, BMC_Spannung_ZwischenKreis, BMC_Strom, BMC_Spannung_ZwischenKreis_2, BMC_HV_01_BZ, BMC_HV_01_CRC, BMC_Strom_Messzeit, BMC_Spannung_Messzeit, BMC_Strom_02, SignalVoid_BMC_HV_01_0]  # Signal Group
    SG_BMC_HV_02: system-signal=[BMC_Bank_seriell_erlaubt, BMC_Bank_parallel_erlaubt, BMC_Bank_Notlauf_erlaubt, BMC_Vorlade_Zielspannung, BMC_IWU_Status, BMC_Max_Entladeleistung, BMC_Energieinhalt, BMC_PerfInd_Laden, BMC_Max_Ladeleistung, BMC_NutzbarerSOC, BMC_PerfInd_Entladen, BMC_Max_Ladestrom, BMC_Status_DCLS, BMC_Spannung_DC_Ladesaeule, BMC_Max_Entladestrom, BMC_IWU_Wert_pos, BMC_IWU_Wert_neg, BMC_AC_Laden, BMC_DC_Laden, BMC_Verbauinfo_ACSchuetz, Hybrid_01_OBD_Lampe_Anf, Anzeige_SOC, BMC_Fehler_Leistungsred, BMC_Verbauinfo_Bank, BMC_Unterboden_Warnung, BMC_MinDyn_Entladespannung, BMC_HV_02_BZ, BMC_MinDyn_Ladespannung, BMC_Leerlaufspannung, BMC_PredLeistung_StuetzungNV, BMC_IstZellspannungMin, BMC_IstZellspannungMax, BMC_HV_02_CRC, BMC_TechnischerSOC, BMC_Fehler_Warnung, BMC_Energie_Sockel_SoC, BMC_MMTR_Status, BMC_ZellTemp_virtuell_min, BMC_ZellTemp_virtuell_max, SignalVoid_BMC_HV_02_0, SignalVoid_BMC_HV_02_1, SignalVoid_BMC_HV_02_2, SignalVoid_BMC_HV_02_3, SignalVoid_BMC_HV_02_4, SignalVoid_BMC_HV_02_5]  # Signal Group
    SG_BMC_HV_04: system-signal=[BMC_Flash_Freigabe, BMC_Dev_Freigabe, BMC_UI1_Spannung1_Schalt_Anf, BMC_Iso_Mode_Anf, BMC_UI1_Spannung2_Schalt_Anf, BMC_UI2_Spannung2_Schalt_Anf, BMC_UI2_Spannung1_Schalt_Anf, BMC_HV_04_CRC, BMC_HV_04_BZ, SignalVoid_BMC_HV_04_0, SignalVoid_BMC_HV_04_1, SignalVoid_BMC_HV_04_2, SignalVoid_BMC_HV_04_3, SignalVoid_BMC_HV_04_4, SignalVoid_BMC_HV_04_5]  # Signal Group
    SG_BMC_HV_10: system-signal=[BMC_Datenuebernahme_Anf, BMC_Lebensdauer_Trennelemente, BMC_Status_Trennelemente, BMC_Sperrung_Unterspannung, BMC_Status_HV_Spannungssensorik, BMC_HV_10_CRC, BMC_HV_10_BZ, SignalVoid_BMC_HV_10_0, SignalVoid_BMC_HV_10_1, SignalVoid_BMC_HV_10_2, SignalVoid_BMC_HV_10_3]  # Signal Group
    SG_BMC_HV_11: system-signal=[BMC_Ueberspannungszaehler_CMC02, BMC_Sperrung_Ueberspannung, BMC_Ueberspannungszaehler_CMC01, BMC_Uebertemperaturzaehler_CMC01, BMC_Uebertemperaturzaehler_CMC02, BMC_HV_11_BZ, BMC_HV_11_CRC]  # Signal Group
    SG_BMC_HV_12: system-signal=[BMC_Sperrung_Uebertemperatur, BMC_Ueberspannungszaehler_CMC04, BMC_Ueberspannungszaehler_CMC03, BMC_Uebertemperaturzaehler_CMC03, BMC_Uebertemperaturzaehler_CMC04, BMC_HV_12_BZ, BMC_HV_12_CRC]  # Signal Group
    SG_BMC_HV_13: system-signal=[BMC_Unterspannungszaehler_CMC01, BMC_Unterspannungszaehler_CMC02, BMC_Unterspannungszaehler_CMC03, BMC_Unterspannungszaehler_CMC04, BMC_HV_13_BZ, BMC_HV_13_CRC, SignalVoid_BMC_HV_13_0, SignalVoid_BMC_HV_13_1]  # Signal Group
    SG_HVK_03: system-signal=[HVK_EKK_Sollmodus, HVK_DCDC_Sollmodus, HVK_HVLM_Sollmodus, HV_Bordnetz_aktiv, HVK_HV_Netz_Warnungen, HV_Bordnetz_Fehler, HVK_Gesamtst_Spgfreiheit, HVK_AktiveEntladung_Anf, HVK_Istmodus_Anf, HVK_Iso_Messung_Start, HVK_Vorladung_aktiv, HVK_ETM_Freigabe, HVK_HV_Netz_Zustand, HVK_HVHL_Sollmodus, HVK_BMC_Sollmodus, HVK_HVHW_Sollmodus, HVK_BMC_Spannung_Anf, HVK_AIAD_Sollmodus, HVK_eKAT_Sollmodus, HVK_03_BZ, HVK_03_CRC, SignalVoid_HVK_03_0, SignalVoid_HVK_03_1]  # Signal Group
    SG_HVLM_14: system-signal=[HVLM_ZustandLadeablauf, HVLM_Ladevorgang_Anf, HVLM_Ladeszenario, HVLM_Laden_ISO_Messung_Anf, HVLM_DC_Aufstartmodus, HVLM_Start_Pulserkennung, HVLM_WakeUpZaehlerResetAnf, HVLM_Aktive_Ladeart, HVLM_Steckerstatus, HVLM_Pulsierstufe, HVLM_Intensitaet_Lk1, HVLM_Intensitaet_Lk2, HVLM_14_BZ, HVLM_14_CRC, HVLM_Ladeniveau_Anf, HVLM_Ladenaktiv_Standzyklus, HVLM_PrkCtl_StPrkLockReq, HVLM_PrkCtl_StAlyReq, HVLM_Grundladen_Anf, SignalVoid_HVLM_14_0, SignalVoid_HVLM_14_1]  # Signal Group
    SG_KS_Hybrid_01_Challenge_K: system-signal=[KS_Hybrid_01_ChK_SID, KS_Hybrid_01_ChK_IKACtr, KS_Hybrid_01_ChK]  # custom ECU specified signal group
    SG_KS_Hybrid_01_Challenge_M: system-signal=[KS_Hybrid_01_ChM_SID, KS_Hybrid_01_ChM_IKACtr, KS_Hybrid_01_ChM]  # custom ECU specified signal group
    SG_KS_Hybrid_01_ReqFrame: system-signal=[KS_Hybrid_01_Req_SID, KS_Hybrid_01_Req_Prio, KS_Hybrid_01_Req_VKMS_Err, KS_Hybrid_01_Req_IKA_Retry, KS_Hybrid_01_Req_ErrCtr, KS_Hybrid_01_Req_SWMaj, KS_Hybrid_01_Req_SWMin, KS_Hybrid_01_Req_SWPat]  # custom ECU specified signal group
    SG_KS_Hybrid_01_Response_K: system-signal=[KS_Hybrid_01_ReK_SID, KS_Hybrid_01_ReK_IKACtr, KS_Hybrid_01_ReK]  # custom ECU specified signal group
    SG_KS_Hybrid_01_Response_M: system-signal=[KS_Hybrid_01_ReM_SID, KS_Hybrid_01_ReM_IKACtr, KS_Hybrid_01_ReM]  # custom ECU specified signal group
    SG_ORU_Control_A_01: system-signal=[OruVehicleLockRequestA, OruReleasePartitionSwitchA, OruIntegrityCheckActiveA, OruHostUpdateA, OruControlReleaseA, ORU_Control_A_01_CRC, ORU_Control_A_01_BZ, OnlineRemoteUpdateControlA, OnlineRemoteUpdateControlOldA, OruControlStateA, SignalVoid_ORU_Control_A_01_0, SignalVoid_ORU_Control_A_01_1]  # Signal Group
    SG_ORU_Control_D_01: system-signal=[OruControlReleaseD, OruVehicleLockRequestD, OruReleasePartitionSwitchD, OruHostUpdateD, OruIntegrityCheckActiveD, OnlineRemoteUpdateControlOldD, OnlineRemoteUpdateControlD, ORU_Control_D_01_BZ, ORU_Control_D_01_CRC, OruControlStateD, SignalVoid_ORU_Control_D_01_0, SignalVoid_ORU_Control_D_01_1]  # Signal Group
    SG_OTAMC_D_01: system-signal=[VehicleProtectedEnvironment_D, OTAMC_D_01_CRC, OTAMC_D_01_BZ, SignalVoid_OTAMC_D_01_0, SignalVoid_OTAMC_D_01_1, SignalVoid_OTAMC_D_01_2]  # Signal Group
    SG_UI1_01: system-signal=[UI1_Strom, UI1_KL30_Spannung, UISensorIso_01_BZ, UISensorIso_01_CRC, SignalVoid_UI1_01_0, SignalVoid_UI1_01_1, SignalVoid_UI1_01_2]  # Signal Group
    SG_UI1_02: system-signal=[UI1_Spannung3, UI1_Spannung2_Schalt_Status, UI1_Spannung1, UI1_Spannung2, UI1_Spannung1_Schalt_Status, UISensorIso_02_BZ, UISensorIso_02_CRC, SignalVoid_UI1_02_0]  # Signal Group
    SG_UI2_01: system-signal=[UI2_Strom, UI2_KL30_Spannung, UISensorPyro_01_BZ, UISensorPyro_01_CRC, SignalVoid_UI2_01_0, SignalVoid_UI2_01_1, SignalVoid_UI2_01_2]  # Signal Group
    SG_UI2_02: system-signal=[UI2_Spannung2_Schalt_Status, UI2_Spannung2, UI2_Spannung3, UI2_Spannung1, UI2_Spannung1_Schalt_Status, UISensorPyro_02_BZ, UISensorPyro_02_CRC, SignalVoid_UI2_02_0]  # Signal Group
    SG_UI2_03: system-signal=[UI2_Spannung6, UI2_Spannung5, UI2_Spannung4, UISensorPyro_03_BZ, UISensorPyro_03_CRC, UI2_HW_Crashleitung_Status, UI2_Pyro_Status, SignalVoid_UI2_03_0]  # Signal Group
package /Unit
  28 x unit:
    Unit_Unit_Amper: display-name=Unit_Amper, factor-si-to-unit=1, physical-dimension=PD_siAmpere
    Unit_Unit_AmperHour: display-name=Unit_AmperHour, factor-si-to-unit=0.000277778, physical-dimension=PD_siAmpereSecond
    Unit_Unit_AmperSecon: display-name=Unit_AmperSecon, factor-si-to-unit=1, physical-dimension=PD_siAmpereSecond
    Unit_Unit_Day: display-name=Unit_Day, factor-si-to-unit=1.157E-05, physical-dimension=PD_siSecond
    Unit_Unit_DegreCelsi: display-name=Unit_DegreCelsi, factor-si-to-unit=1, offset-si-to-unit=-273.2, physical-dimension=PD_siKelvin
    Unit_Unit_Hertz: display-name=Unit_Hertz, factor-si-to-unit=1, physical-dimension=PD_siPerSecond
    Unit_Unit_Hours: display-name=Unit_Hours, factor-si-to-unit=0.0002778, physical-dimension=PD_siSecond
    Unit_Unit_KiloMeter: display-name=Unit_KiloMeter, factor-si-to-unit=0.001, physical-dimension=PD_siMeter
    Unit_Unit_KiloMeterPerHour: display-name=Unit_KiloMeterPerHour, factor-si-to-unit=3.6, physical-dimension=PD_siMeterPerSecond
    Unit_Unit_KiloPascal: display-name=Unit_KiloPascal, factor-si-to-unit=0.001, physical-dimension=PD_siPascal
    Unit_Unit_KiloWatt: display-name=Unit_KiloWatt, factor-si-to-unit=0.001, physical-dimension=PD_siWatt
    Unit_Unit_KiloWattHour: display-name=Unit_KiloWattHour, factor-si-to-unit=2.7777778E-07, physical-dimension=PD_siWattSecond
    Unit_Unit_LiterPerMinut: display-name=Unit_LiterPerMinut, factor-si-to-unit=60000, physical-dimension=PD_siCubicMeterPerSecond
    Unit_Unit_MeterPerSecon: display-name=Unit_MeterPerSecon, factor-si-to-unit=1, physical-dimension=PD_siMeterPerSecond
    Unit_Unit_MilliVolt: display-name=Unit_MilliVolt, factor-si-to-unit=1000, physical-dimension=PD_siVolt
    Unit_Unit_Minut: display-name=Unit_Minut, factor-si-to-unit=60, physical-dimension=PD_siSecond
    Unit_Unit_MinutInver: display-name=Unit_MinutInver, factor-si-to-unit=60, physical-dimension=PD_siPerSecond
    Unit_Unit_Month: display-name=Unit_Month, factor-si-to-unit=3.805E-07, physical-dimension=PD_siSecond
    Unit_Unit_NewtoMeter: display-name=Unit_NewtoMeter, factor-si-to-unit=1, physical-dimension=PD_siNewtonMeter
    Unit_Unit_None: display-name=Unit_None, factor-si-to-unit=1, physical-dimension=PD_siNone
    Unit_Unit_Ohm: display-name=Unit_Ohm, factor-si-to-unit=1, physical-dimension=PD_siOhm
    Unit_Unit_PerCent: display-name=Unit_PerCent, factor-si-to-unit=1, physical-dimension=PD_siNone
    Unit_Unit_Secon: display-name=Unit_Secon, factor-si-to-unit=1, physical-dimension=PD_siSecond
    Unit_Unit_Volt: display-name=Unit_Volt, factor-si-to-unit=1, physical-dimension=PD_siVolt
    Unit_Unit_Watt: display-name=Unit_Watt, factor-si-to-unit=1, physical-dimension=PD_siWatt
    Unit_Unit_WattHour: display-name=Unit_WattHour, factor-si-to-unit=0.00027778, physical-dimension=PD_siWattSecond
    Unit_Unit_WattSecond: display-name=Unit_WattSecond, factor-si-to-unit=1, physical-dimension=PD_siWattSecond
    Unit_Unit_Year: display-name=Unit_Year, factor-si-to-unit=3.16887646E-08, physical-dimension=PD_siSecond
package /PhysicalDimension
  15 x physical dimension:
    PD_siAmpere: current-exp=1
    PD_siAmpereSecond: time-exp=1, current-exp=1
    PD_siCubicMeterPerSecond: length-exp=3, time-exp=-1
    PD_siKelvin: temperature-exp=1
    PD_siMeter: length-exp=1
    PD_siMeterPerSecond: length-exp=1, time-exp=-1
    PD_siNewtonMeter: length-exp=2, mass-exp=1, time-exp=-2
    PD_siNone
    PD_siOhm: length-exp=2, mass-exp=1, time-exp=-3, current-exp=-2
    PD_siPascal: length-exp=-1, mass-exp=1, time-exp=-2
    PD_siPerSecond: time-exp=-1
    PD_siSecond: time-exp=1
    PD_siVolt: length-exp=2, mass-exp=1, time-exp=-1, current-exp=-1
    PD_siWatt: length-exp=2, mass-exp=1, time-exp=-3
    PD_siWattSecond: length-exp=2, mass-exp=1, time-exp=-2
package /TPConfig
  can tp config CanTPConfig_HCP5_CANFD01: communication-cluster=HCP5_CANFD01, can-tp-ecu=BMC_HV
    65 x can tp address:
      TA_0x17FC007B: tp-address=402391163
      TA_0x17FC008F: tp-address=402391183
      TA_0x17FC009C: tp-address=402391196
      TA_0x17FC00AE: tp-address=402391214
      TA_0x17FC00B4: tp-address=402391220
      TA_0x17FC00B9: tp-address=402391225
      TA_0x17FC16D0: tp-address=402396880
      TA_0x17FC17B1: tp-address=402397105
      TA_0x17FC17B2: tp-address=402397106
      TA_0x17FC70D0: tp-address=402419920
      TA_0x17FC71B1: tp-address=402420145
      TA_0x17FC71B2: tp-address=402420146
      TA_0x17FE007B: tp-address=402522235
      TA_0x17FE008F: tp-address=402522255
      TA_0x17FE009C: tp-address=402522268
      TA_0x17FE00AE: tp-address=402522286
      TA_0x17FE00B4: tp-address=402522292
      TA_0x17FE00B9: tp-address=402522297
      TA_0x17FE16D0: tp-address=402527952
      TA_0x17FE17B1: tp-address=402528177
      TA_0x17FE17B2: tp-address=402528178
      TA_0x17FE70D0: tp-address=402550992
      TA_0x17FE71B1: tp-address=402551217
      TA_0x17FE71B2: tp-address=402551218
      TA_0x1804000E: tp-address=402915342
      TA_0x18040015: tp-address=402915349
      TA_0x1804001B: tp-address=402915355
      TA_0x1804001C: tp-address=402915356
      TA_0x1804001D: tp-address=402915357
      TA_0x18040021: tp-address=402915361
      TA_0x1806000E: tp-address=403046414
      TA_0x18060015: tp-address=403046421
      TA_0x1806001B: tp-address=403046427
      TA_0x1806001C: tp-address=403046428
      TA_0x1806001D: tp-address=403046429
      TA_0x18060021: tp-address=403046433
      TA_0x18DA05F1: tp-address=416941553
      TA_0x18DAF105: tp-address=417001733
      TA_0x18DB33F1: tp-address=417018865
      TA_0x1C40007B: tp-address=473956475
      TA_0x1C40027B: tp-address=473956987
      TA_0x1C403F7B: tp-address=473972603
      TA_0x1C410000: tp-address=474021888
      TA_0x1C410200: tp-address=474022400
      TA_0x1C413FDD: tp-address=474038237
      TA_0x1C420044: tp-address=474087492
      TA_0x1C42007B: tp-address=474087547
      TA_0x1C42008F: tp-address=474087567
      TA_0x1C4200B9: tp-address=474087609
      TA_0x1C420244: tp-address=474088004
      TA_0x1C42027B: tp-address=474088059
      TA_0x1C42028F: tp-address=474088079
      TA_0x1C4202B9: tp-address=474088121
      TA_0x1C423F7B: tp-address=474103675
      TA_0x1C46001B: tp-address=474349595
      TA_0x1C46001C: tp-address=474349596
      TA_0x1C46001D: tp-address=474349597
      TA_0x1C46021B: tp-address=474350107
      TA_0x1C46021C: tp-address=474350108
      TA_0x1C46021D: tp-address=474350109
      TA_0x700: tp-address=1792
      TA_0x741: tp-address=1857
      TA_0x744: tp-address=1860
      TA_0x7AB: tp-address=1963
      TA_0x7AE: tp-address=1966
    16 x can tp channel, all with channel-mode=HALF-DUPLEX-MODE:
      TPC_HCP5_CANFD01_XIX_TPCHType_CANFD_DAAP_XIX_0x1C403F7B_XIX_0x1C423F7B_XIX_Physical: channel-id=1453778822
      TPC_HCP5_CANFD01_XIX_TPCHType_CANFD_DAAP_XIX_0x1C413FDD_XIX_Functional: channel-id=1824849867
      TPC_HCP5_CANFD01_XIX_TPCHType_CANFD_ISO_Diagnose_XIX_0x1C40007B_XIX_0x1C42007B_XIX_Physical: channel-id=649008242
      TPC_HCP5_CANFD01_XIX_TPCHType_CANFD_ISO_Diagnose_XIX_0x1C410000_XIX_Functional: channel-id=435765654
      TPC_HCP5_CANFD01_XIX_TPCHType_CANFD_OBDC_Diagnose_XIX_0x1C40027B_XIX_0x1C42027B_XIX_Physical: channel-id=1971298631
      TPC_HCP5_CANFD01_XIX_TPCHType_CANFD_OBDC_Diagnose_XIX_0x1C410200_XIX_Functional: channel-id=166078607
      TPC_HCP5_CANFD01_XIX_TPCHType_CANHS_Flash_DIA_XIX_0x17FC16D0_XIX_0x17FE16D0_XIX_Physical: channel-id=1611926648
      TPC_HCP5_CANFD01_XIX_TPCHType_CANHS_Flash_DIA_XIX_0x17FC17B1_XIX_0x17FE17B1_XIX_Physical: channel-id=1398000392
      TPC_HCP5_CANFD01_XIX_TPCHType_CANHS_Flash_DIA_XIX_0x17FC17B2_XIX_0x17FE17B2_XIX_Physical: channel-id=1210457320
      TPC_HCP5_CANFD01_XIX_TPCHType_CANHS_ISO_Diagnose_XIX_0x17FC007B_XIX_0x17FE007B_XIX_Physical: channel-id=690355579
      TPC_HCP5_CANFD01_XIX_TPCHType_CANHS_ISO_Diagnose_XIX_0x700_XIX_Functional: channel-id=1708026577
      TPC_HCP5_CANFD01_XIX_TPCHType_CANHS_OBDC_SSN_Diagnose_XIX_0x17FC70D0_XIX_0x17FE70D0_XIX_Physical: channel-id=789475177
      TPC_HCP5_CANFD01_XIX_TPCHType_CANHS_OBDC_SSN_Diagnose_XIX_0x17FC71B1_XIX_0x17FE71B1_XIX_Physical: channel-id=2074515433
      TPC_HCP5_CANFD01_XIX_TPCHType_CANHS_OBDC_SSN_Diagnose_XIX_0x17FC71B2_XIX_0x17FE71B2_XIX_Physical: channel-id=2032908791
      TPC_HCP5_CANFD01_XIX_TPCHType_CANHS_OBDx_XIX_0x18DA05F1_XIX_0x18DAF105_XIX_Physical: channel-id=1683031602
      TPC_HCP5_CANFD01_XIX_TPCHType_CANHS_OBDx_XIX_0x18DB33F1_XIX_Functional: channel-id=254423851
    can-tp-connection addressing-format=STANDARD, can-tp-channel=TPC_HCP5_CANFD01_XIX_TPCHType_CANFD_DAAP_XIX_0x1C403F7B_XIX_0x1C423F7B_XIX_Physical, cancellation=true, data-pdu=DAAP_Hybrid_01_Req_FD_XIX_HCP5_CANFD01, flow-control-pdu=DAAP_Hybrid_01_Resp_FD_XIX_HCP5_CANFD01, max-block-size=15, padding-activation=true, receiver=TPN_Hybrid_01_XIX_HCP5_CANFD01_XIX_474103675, ta-type=PHYSICAL, timeout-br=0.1, timeout-bs=1, timeout-cr=1, timeout-cs=0.2, tp-sdu=CDD_HCP5_CANFD01_XIX_TPCHType_CANFD_DAAP_XIX_0x1C403F7B_XIX_0x1C423F7B_XIX_Physical, transmitter=TPN_Gateway_XIX_HCP5_CANFD01_XIX_473972603:
      ident TPCN_HCP5_CANFD01_XIX_TPCHType_CANFD_DAAP_XIX_0x1C403F7B_Gateway_XIX_0x1C423F7B_Hybrid_01_XIX_Physical
    can-tp-connection addressing-format=STANDARD, can-tp-channel=TPC_HCP5_CANFD01_XIX_TPCHType_CANFD_DAAP_XIX_0x1C413FDD_XIX_Functional, cancellation=true, data-pdu=DAAP_Funkt_Req_MC_FD_XIX_HCP5_CANFD01, max-block-size=15, multicast=TA_0x1C413FDD, padding-activation=true, receiver=TPN_Hybrid_01_XIX_HCP5_CANFD01_XIX_474103675, ta-type=FUNCTIONAL, timeout-br=0.1, timeout-bs=1, timeout-cr=1, timeout-cs=0.2, tp-sdu=CDD_HCP5_CANFD01_XIX_TPCHType_CANFD_DAAP_XIX_0x1C413FDD_XIX_Functional, transmitter=TPN_Gateway_XIX_HCP5_CANFD01_XIX_473972603:
      ident TPCN_HCP5_CANFD01_XIX_TPCHType_CANFD_DAAP_XIX_0x1C413FDD_Gateway_XIX_Functional
    can-tp-connection addressing-format=STANDARD, can-tp-channel=TPC_HCP5_CANFD01_XIX_TPCHType_CANFD_DAAP_XIX_0x1C403F7B_XIX_0x1C423F7B_XIX_Physical, cancellation=true, data-pdu=DAAP_Hybrid_01_Resp_FD_XIX_HCP5_CANFD01, flow-control-pdu=DAAP_Hybrid_01_Req_FD_XIX_HCP5_CANFD01, max-block-size=15, padding-activation=true, receiver=TPN_Gateway_XIX_HCP5_CANFD01_XIX_473972603, ta-type=PHYSICAL, timeout-br=0.1, timeout-bs=1, timeout-cr=1, timeout-cs=0.2, tp-sdu=CDD_HCP5_CANFD01_XIX_TPCHType_CANFD_DAAP_XIX_0x1C423F7B_XIX_0x1C403F7B_XIX_Physical, transmitter=TPN_Hybrid_01_XIX_HCP5_CANFD01_XIX_474103675:
      ident TPCN_HCP5_CANFD01_XIX_TPCHType_CANFD_DAAP_XIX_0x1C423F7B_Hybrid_01_XIX_0x1C403F7B_Gateway_XIX_Physical
    can-tp-connection addressing-format=STANDARD, can-tp-channel=TPC_HCP5_CANFD01_XIX_TPCHType_CANFD_ISO_Diagnose_XIX_0x1C40007B_XIX_0x1C42007B_XIX_Physical, cancellation=true, data-pdu=ISOx_Hybrid_01_Req_FD_XIX_HCP5_CANFD01, flow-control-pdu=ISOx_Hybrid_01_Resp_FD_XIX_HCP5_CANFD01, max-block-size=15, padding-activation=true, receiver=TPN_Hybrid_01_XIX_HCP5_CANFD01_XIX_474087547, ta-type=PHYSICAL, timeout-br=0.1, timeout-bs=1, timeout-cr=1, timeout-cs=0.2, tp-sdu=DCM_HCP5_CANFD01_XIX_TPCHType_CANFD_ISO_Diagnose_XIX_0x1C40007B_XIX_0x1C42007B_XIX_Physical, transmitter=TPN_Gateway_XIX_HCP5_CANFD01_XIX_473956475:
      ident TPCN_HCP5_CANFD01_XIX_TPCHType_CANFD_ISO_Diagnose_XIX_0x1C40007B_Gateway_XIX_0x1C42007B_Hybrid_01_XIX_Physical
    can-tp-connection addressing-format=STANDARD, can-tp-channel=TPC_HCP5_CANFD01_XIX_TPCHType_CANFD_ISO_Diagnose_XIX_0x1C410000_XIX_Functional, cancellation=true, data-pdu=ISOx_Funkt_Req_All_FD_XIX_HCP5_CANFD01, max-block-size=15, multicast=TA_0x1C410000, padding-activation=true, receiver=[TPN_AWC_XIX_HCP5_CANFD01_XIX_474087492, TPN_AWC_XIX_HCP5_CANFD01_XIX_474087547, TPN_AWC_XIX_HCP5_CANFD01_XIX_474087567, TPN_AWC_XIX_HCP5_CANFD01_XIX_474087609, TPN_AWC_XIX_HCP5_CANFD01_XIX_474349595, TPN_AWC_XIX_HCP5_CANFD01_XIX_474349596, TPN_AWC_XIX_HCP5_CANFD01_XIX_474349597, TPN_Hybrid_01_XIX_HCP5_CANFD01_XIX_474087492, TPN_Hybrid_01_XIX_HCP5_CANFD01_XIX_474087547, TPN_Hybrid_01_XIX_HCP5_CANFD01_XIX_474087567, TPN_Hybrid_01_XIX_HCP5_CANFD01_XIX_474087609, TPN_Hybrid_01_XIX_HCP5_CANFD01_XIX_474349595, TPN_Hybrid_01_XIX_HCP5_CANFD01_XIX_474349596, TPN_Hybrid_01_XIX_HCP5_CANFD01_XIX_474349597, TPN_DCDC_NV_XIX_HCP5_CANFD01_XIX_474087492, TPN_DCDC_NV_XIX_HCP5_CANFD01_XIX_474087547, TPN_DCDC_NV_XIX_HCP5_CANFD01_XIX_474087567, TPN_DCDC_NV_XIX_HCP5_CANFD01_XIX_474087609, TPN_DCDC_NV_XIX_HCP5_CANFD01_XIX_474349595, TPN_DCDC_NV_XIX_HCP5_CANFD01_XIX_474349596, TPN_DCDC_NV_XIX_HCP5_CANFD01_XIX_474349597, TPN_HVZB_XIX_HCP5_CANFD01_XIX_474087492, TPN_HVZB_XIX_HCP5_CANFD01_XIX_474087547, TPN_HVZB_XIX_HCP5_CANFD01_XIX_474087567, TPN_HVZB_XIX_HCP5_CANFD01_XIX_474087609, TPN_HVZB_XIX_HCP5_CANFD01_XIX_474349595, TPN_HVZB_XIX_HCP5_CANFD01_XIX_474349596, TPN_HVZB_XIX_HCP5_CANFD01_XIX_474349597, TPN_SACID_1_XIX_HCP5_CANFD01_XIX_474087492, TPN_SACID_1_XIX_HCP5_CANFD01_XIX_474087547, TPN_SACID_1_XIX_HCP5_CANFD01_XIX_474087567, TPN_SACID_1_XIX_HCP5_CANFD01_XIX_474087609, TPN_SACID_1_XIX_HCP5_CANFD01_XIX_474349595, TPN_SACID_1_XIX_HCP5_CANFD01_XIX_474349596, TPN_SACID_1_XIX_HCP5_CANFD01_XIX_474349597, TPN_SACID_2_XIX_HCP5_CANFD01_XIX_474087492, TPN_SACID_2_XIX_HCP5_CANFD01_XIX_474087547, TPN_SACID_2_XIX_HCP5_CANFD01_XIX_474087567, TPN_SACID_2_XIX_HCP5_CANFD01_XIX_474087609, TPN_SACID_2_XIX_HCP5_CANFD01_XIX_474349595, TPN_SACID_2_XIX_HCP5_CANFD01_XIX_474349596, TPN_SACID_2_XIX_HCP5_CANFD01_XIX_474349597, TPN_Ladegeraet_XIX_HCP5_CANFD01_XIX_474087492, TPN_Ladegeraet_XIX_HCP5_CANFD01_XIX_474087547, TPN_Ladegeraet_XIX_HCP5_CANFD01_XIX_474087567, TPN_Ladegeraet_XIX_HCP5_CANFD01_XIX_474087609, TPN_Ladegeraet_XIX_HCP5_CANFD01_XIX_474349595, TPN_Ladegeraet_XIX_HCP5_CANFD01_XIX_474349596, TPN_Ladegeraet_XIX_HCP5_CANFD01_XIX_474349597], ta-type=FUNCTIONAL, timeout-br=0.1, timeout-bs=1, timeout-cr=1, timeout-cs=0.2, tp-sdu=DCM_HCP5_CANFD01_XIX_TPCHType_CANFD_ISO_Diagnose_XIX_0x1C410000_XIX_Functional, transmitter=TPN_Gateway_XIX_HCP5_CANFD01_XIX_474021888:
      ident TPCN_HCP5_CANFD01_XIX_TPCHType_CANFD_ISO_Diagnose_XIX_0x1C410000_Gateway_XIX_Functional
    can-tp-connection addressing-format=STANDARD, can-tp-channel=TPC_HCP5_CANFD01_XIX_TPCHType_CANFD_ISO_Diagnose_XIX_0x1C40007B_XIX_0x1C42007B_XIX_Physical, cancellation=true, data-pdu=ISOx_Hybrid_01_Resp_FD_XIX_HCP5_CANFD01, flow-control-pdu=ISOx_Hybrid_01_Req_FD_XIX_HCP5_CANFD01, max-block-size=15, padding-activation=true, receiver=TPN_Gateway_XIX_HCP5_CANFD01_XIX_473956475, ta-type=PHYSICAL, timeout-br=0.1, timeout-bs=1, timeout-cr=1, timeout-cs=0.2, tp-sdu=DCM_HCP5_CANFD01_XIX_TPCHType_CANFD_ISO_Diagnose_XIX_0x1C42007B_XIX_0x1C40007B_XIX_Physical, transmitter=TPN_Hybrid_01_XIX_HCP5_CANFD01_XIX_474087547:
      ident TPCN_HCP5_CANFD01_XIX_TPCHType_CANFD_ISO_Diagnose_XIX_0x1C42007B_Hybrid_01_XIX_0x1C40007B_Gateway_XIX_Physical
    can-tp-connection addressing-format=STANDARD, can-tp-channel=TPC_HCP5_CANFD01_XIX_TPCHType_CANFD_OBDC_Diagnose_XIX_0x1C40027B_XIX_0x1C42027B_XIX_Physical, cancellation=true, data-pdu=OBDC_Hybrid_01_Req_FD_XIX_HCP5_CANFD01, flow-control-pdu=OBDC_Hybrid_01_Resp_FD_XIX_HCP5_CANFD01, max-block-size=15, padding-activation=true, receiver=TPN_Hybrid_01_XIX_HCP5_CANFD01_XIX_474088059, ta-type=PHYSICAL, timeout-br=0.1, timeout-bs=1, timeout-cr=1, timeout-cs=0.2, tp-sdu=DCM_HCP5_CANFD01_XIX_TPCHType_CANFD_OBDC_Diagnose_XIX_0x1C40027B_XIX_0x1C42027B_XIX_Physical, transmitter=TPN_Gateway_XIX_HCP5_CANFD01_XIX_473956987:
      ident TPCN_HCP5_CANFD01_XIX_TPCHType_CANFD_OBDC_Diagnose_XIX_0x1C40027B_Gateway_XIX_0x1C42027B_Hybrid_01_XIX_Physical
    can-tp-connection addressing-format=STANDARD, can-tp-channel=TPC_HCP5_CANFD01_XIX_TPCHType_CANFD_OBDC_Diagnose_XIX_0x1C410200_XIX_Functional, cancellation=true, data-pdu=OBDC_Funktionaler_Req_All_FD_XIX_HCP5_CANFD01, max-block-size=15, multicast=TA_0x1C410200, padding-activation=true, receiver=[TPN_AWC_XIX_HCP5_CANFD01_XIX_474088004, TPN_AWC_XIX_HCP5_CANFD01_XIX_474088059, TPN_AWC_XIX_HCP5_CANFD01_XIX_474088079, TPN_AWC_XIX_HCP5_CANFD01_XIX_474088121, TPN_AWC_XIX_HCP5_CANFD01_XIX_474350107, TPN_AWC_XIX_HCP5_CANFD01_XIX_474350108, TPN_AWC_XIX_HCP5_CANFD01_XIX_474350109, TPN_Hybrid_01_XIX_HCP5_CANFD01_XIX_474088004, TPN_Hybrid_01_XIX_HCP5_CANFD01_XIX_474088059, TPN_Hybrid_01_XIX_HCP5_CANFD01_XIX_474088079, TPN_Hybrid_01_XIX_HCP5_CANFD01_XIX_474088121, TPN_Hybrid_01_XIX_HCP5_CANFD01_XIX_474350107, TPN_Hybrid_01_XIX_HCP5_CANFD01_XIX_474350108, TPN_Hybrid_01_XIX_HCP5_CANFD01_XIX_474350109, TPN_DCDC_NV_XIX_HCP5_CANFD01_XIX_474088004, TPN_DCDC_NV_XIX_HCP5_CANFD01_XIX_474088059, TPN_DCDC_NV_XIX_HCP5_CANFD01_XIX_474088079, TPN_DCDC_NV_XIX_HCP5_CANFD01_XIX_474088121, TPN_DCDC_NV_XIX_HCP5_CANFD01_XIX_474350107, TPN_DCDC_NV_XIX_HCP5_CANFD01_XIX_474350108, TPN_DCDC_NV_XIX_HCP5_CANFD01_XIX_474350109, TPN_HVZB_XIX_HCP5_CANFD01_XIX_474088004, TPN_HVZB_XIX_HCP5_CANFD01_XIX_474088059, TPN_HVZB_XIX_HCP5_CANFD01_XIX_474088079, TPN_HVZB_XIX_HCP5_CANFD01_XIX_474088121, TPN_HVZB_XIX_HCP5_CANFD01_XIX_474350107, TPN_HVZB_XIX_HCP5_CANFD01_XIX_474350108, TPN_HVZB_XIX_HCP5_CANFD01_XIX_474350109, TPN_SACID_1_XIX_HCP5_CANFD01_XIX_474088004, TPN_SACID_1_XIX_HCP5_CANFD01_XIX_474088059, TPN_SACID_1_XIX_HCP5_CANFD01_XIX_474088079, TPN_SACID_1_XIX_HCP5_CANFD01_XIX_474088121, TPN_SACID_1_XIX_HCP5_CANFD01_XIX_474350107, TPN_SACID_1_XIX_HCP5_CANFD01_XIX_474350108, TPN_SACID_1_XIX_HCP5_CANFD01_XIX_474350109, TPN_SACID_2_XIX_HCP5_CANFD01_XIX_474088004, TPN_SACID_2_XIX_HCP5_CANFD01_XIX_474088059, TPN_SACID_2_XIX_HCP5_CANFD01_XIX_474088079, TPN_SACID_2_XIX_HCP5_CANFD01_XIX_474088121, TPN_SACID_2_XIX_HCP5_CANFD01_XIX_474350107, TPN_SACID_2_XIX_HCP5_CANFD01_XIX_474350108, TPN_SACID_2_XIX_HCP5_CANFD01_XIX_474350109, TPN_Ladegeraet_XIX_HCP5_CANFD01_XIX_474088004, TPN_Ladegeraet_XIX_HCP5_CANFD01_XIX_474088059, TPN_Ladegeraet_XIX_HCP5_CANFD01_XIX_474088079, TPN_Ladegeraet_XIX_HCP5_CANFD01_XIX_474088121, TPN_Ladegeraet_XIX_HCP5_CANFD01_XIX_474350107, TPN_Ladegeraet_XIX_HCP5_CANFD01_XIX_474350108, TPN_Ladegeraet_XIX_HCP5_CANFD01_XIX_474350109], ta-type=FUNCTIONAL, timeout-br=0.1, timeout-bs=1, timeout-cr=1, timeout-cs=0.2, tp-sdu=DCM_HCP5_CANFD01_XIX_TPCHType_CANFD_OBDC_Diagnose_XIX_0x1C410200_XIX_Functional, transmitter=TPN_Gateway_XIX_HCP5_CANFD01_XIX_474022400:
      ident TPCN_HCP5_CANFD01_XIX_TPCHType_CANFD_OBDC_Diagnose_XIX_0x1C410200_Gateway_XIX_Functional
    can-tp-connection addressing-format=STANDARD, can-tp-channel=TPC_HCP5_CANFD01_XIX_TPCHType_CANFD_OBDC_Diagnose_XIX_0x1C40027B_XIX_0x1C42027B_XIX_Physical, cancellation=true, data-pdu=OBDC_Hybrid_01_Resp_FD_XIX_HCP5_CANFD01, flow-control-pdu=OBDC_Hybrid_01_Req_FD_XIX_HCP5_CANFD01, max-block-size=15, padding-activation=true, receiver=TPN_Gateway_XIX_HCP5_CANFD01_XIX_473956987, ta-type=PHYSICAL, timeout-br=0.1, timeout-bs=1, timeout-cr=1, timeout-cs=0.2, tp-sdu=DCM_HCP5_CANFD01_XIX_TPCHType_CANFD_OBDC_Diagnose_XIX_0x1C42027B_XIX_0x1C40027B_XIX_Physical, transmitter=TPN_Hybrid_01_XIX_HCP5_CANFD01_XIX_474088059:
      ident TPCN_HCP5_CANFD01_XIX_TPCHType_CANFD_OBDC_Diagnose_XIX_0x1C42027B_Hybrid_01_XIX_0x1C40027B_Gateway_XIX_Physical
    can-tp-connection addressing-format=STANDARD, can-tp-channel=TPC_HCP5_CANFD01_XIX_TPCHType_CANHS_Flash_DIA_XIX_0x17FC16D0_XIX_0x17FE16D0_XIX_Physical, cancellation=true, data-pdu=DIA_BJB_Req_XIX_HCP5_CANFD01, flow-control-pdu=DIA_BJB_Resp_XIX_HCP5_CANFD01, max-block-size=15, padding-activation=true, receiver=TPN_Hybrid_01_XIX_HCP5_CANFD01_XIX_402527952, ta-type=PHYSICAL, timeout-br=0.1, timeout-bs=1, timeout-cr=1, timeout-cs=0.2, tp-sdu=DCM_HCP5_CANFD01_XIX_TPCHType_CANHS_Flash_DIA_XIX_0x17FC16D0_XIX_0x17FE16D0_XIX_Physical, transmitter=TPN_Gateway_XIX_HCP5_CANFD01_XIX_402396880:
      ident TPCN_HCP5_CANFD01_XIX_TPCHType_CANHS_Flash_DIA_XIX_0x17FC16D0_Gateway_XIX_0x17FE16D0_Hybrid_01_XIX_Physical
    can-tp-connection addressing-format=STANDARD, can-tp-channel=TPC_HCP5_CANFD01_XIX_TPCHType_CANHS_Flash_DIA_XIX_0x17FC17B1_XIX_0x17FE17B1_XIX_Physical, cancellation=true, data-pdu=DIA_UI2Sens01_Req_XIX_HCP5_CANFD01, flow-control-pdu=DIA_UI2Sens01_Resp_XIX_HCP5_CANFD01, max-block-size=15, padding-activation=true, receiver=TPN_Hybrid_01_XIX_HCP5_CANFD01_XIX_402528177, ta-type=PHYSICAL, timeout-br=0.1, timeout-bs=1, timeout-cr=1, timeout-cs=0.2, tp-sdu=DCM_HCP5_CANFD01_XIX_TPCHType_CANHS_Flash_DIA_XIX_0x17FC17B1_XIX_0x17FE17B1_XIX_Physical, transmitter=TPN_Gateway_XIX_HCP5_CANFD01_XIX_402397105:
      ident TPCN_HCP5_CANFD01_XIX_TPCHType_CANHS_Flash_DIA_XIX_0x17FC17B1_Gateway_XIX_0x17FE17B1_Hybrid_01_XIX_Physical
    can-tp-connection addressing-format=STANDARD, can-tp-channel=TPC_HCP5_CANFD01_XIX_TPCHType_CANHS_Flash_DIA_XIX_0x17FC17B2_XIX_0x17FE17B2_XIX_Physical, cancellation=true, data-pdu=DIA_UI2Sens02_Req_XIX_HCP5_CANFD01, flow-control-pdu=DIA_UI2Sens02_Resp_XIX_HCP5_CANFD01, max-block-size=15, padding-activation=true, receiver=TPN_Hybrid_01_XIX_HCP5_CANFD01_XIX_402528178, ta-type=PHYSICAL, timeout-br=0.1, timeout-bs=1, timeout-cr=1, timeout-cs=0.2, tp-sdu=DCM_HCP5_CANFD01_XIX_TPCHType_CANHS_Flash_DIA_XIX_0x17FC17B2_XIX_0x17FE17B2_XIX_Physical, transmitter=TPN_Gateway_XIX_HCP5_CANFD01_XIX_402397106:
      ident TPCN_HCP5_CANFD01_XIX_TPCHType_CANHS_Flash_DIA_XIX_0x17FC17B2_Gateway_XIX_0x17FE17B2_Hybrid_01_XIX_Physical
    can-tp-connection addressing-format=STANDARD, can-tp-channel=TPC_HCP5_CANFD01_XIX_TPCHType_CANHS_Flash_DIA_XIX_0x17FC16D0_XIX_0x17FE16D0_XIX_Physical, cancellation=true, data-pdu=DIA_BJB_Resp_XIX_HCP5_CANFD01, flow-control-pdu=DIA_BJB_Req_XIX_HCP5_CANFD01, max-block-size=15, padding-activation=true, receiver=TPN_Gateway_XIX_HCP5_CANFD01_XIX_402396880, ta-type=PHYSICAL, timeout-br=0.1, timeout-bs=1, timeout-cr=1, timeout-cs=0.2, tp-sdu=DCM_HCP5_CANFD01_XIX_TPCHType_CANHS_Flash_DIA_XIX_0x17FE16D0_XIX_0x17FC16D0_XIX_Physical, transmitter=TPN_Hybrid_01_XIX_HCP5_CANFD01_XIX_402527952:
      ident TPCN_HCP5_CANFD01_XIX_TPCHType_CANHS_Flash_DIA_XIX_0x17FE16D0_Hybrid_01_XIX_0x17FC16D0_Gateway_XIX_Physical
    can-tp-connection addressing-format=STANDARD, can-tp-channel=TPC_HCP5_CANFD01_XIX_TPCHType_CANHS_Flash_DIA_XIX_0x17FC17B1_XIX_0x17FE17B1_XIX_Physical, cancellation=true, data-pdu=DIA_UI2Sens01_Resp_XIX_HCP5_CANFD01, flow-control-pdu=DIA_UI2Sens01_Req_XIX_HCP5_CANFD01, max-block-size=15, padding-activation=true, receiver=TPN_Gateway_XIX_HCP5_CANFD01_XIX_402397105, ta-type=PHYSICAL, timeout-br=0.1, timeout-bs=1, timeout-cr=1, timeout-cs=0.2, tp-sdu=DCM_HCP5_CANFD01_XIX_TPCHType_CANHS_Flash_DIA_XIX_0x17FE17B1_XIX_0x17FC17B1_XIX_Physical, transmitter=TPN_Hybrid_01_XIX_HCP5_CANFD01_XIX_402528177:
      ident TPCN_HCP5_CANFD01_XIX_TPCHType_CANHS_Flash_DIA_XIX_0x17FE17B1_Hybrid_01_XIX_0x17FC17B1_Gateway_XIX_Physical
    can-tp-connection addressing-format=STANDARD, can-tp-channel=TPC_HCP5_CANFD01_XIX_TPCHType_CANHS_Flash_DIA_XIX_0x17FC17B2_XIX_0x17FE17B2_XIX_Physical, cancellation=true, data-pdu=DIA_UI2Sens02_Resp_XIX_HCP5_CANFD01, flow-control-pdu=DIA_UI2Sens02_Req_XIX_HCP5_CANFD01, max-block-size=15, padding-activation=true, receiver=TPN_Gateway_XIX_HCP5_CANFD01_XIX_402397106, ta-type=PHYSICAL, timeout-br=0.1, timeout-bs=1, timeout-cr=1, timeout-cs=0.2, tp-sdu=DCM_HCP5_CANFD01_XIX_TPCHType_CANHS_Flash_DIA_XIX_0x17FE17B2_XIX_0x17FC17B2_XIX_Physical, transmitter=TPN_Hybrid_01_XIX_HCP5_CANFD01_XIX_402528178:
      ident TPCN_HCP5_CANFD01_XIX_TPCHType_CANHS_Flash_DIA_XIX_0x17FE17B2_Hybrid_01_XIX_0x17FC17B2_Gateway_XIX_Physical
    can-tp-connection addressing-format=STANDARD, can-tp-channel=TPC_HCP5_CANFD01_XIX_TPCHType_CANHS_ISO_Diagnose_XIX_0x17FC007B_XIX_0x17FE007B_XIX_Physical, cancellation=true, data-pdu=ISOx_Hybrid_01_Req_XIX_HCP5_CANFD01, flow-control-pdu=ISOx_Hybrid_01_Resp_XIX_HCP5_CANFD01, max-block-size=15, padding-activation=true, receiver=TPN_Hybrid_01_XIX_HCP5_CANFD01_XIX_402522235, ta-type=PHYSICAL, timeout-br=0.1, timeout-bs=1, timeout-cr=1, timeout-cs=0.2, tp-sdu=DCM_HCP5_CANFD01_XIX_TPCHType_CANHS_ISO_Diagnose_XIX_0x17FC007B_XIX_0x17FE007B_XIX_Physical, transmitter=TPN_Gateway_XIX_HCP5_CANFD01_XIX_402391163:
      ident TPCN_HCP5_CANFD01_XIX_TPCHType_CANHS_ISO_Diagnose_XIX_0x17FC007B_Gateway_XIX_0x17FE007B_Hybrid_01_XIX_Physical
    can-tp-connection addressing-format=STANDARD, can-tp-channel=TPC_HCP5_CANFD01_XIX_TPCHType_CANHS_ISO_Diagnose_XIX_0x17FC007B_XIX_0x17FE007B_XIX_Physical, cancellation=true, data-pdu=ISOx_Hybrid_01_Resp_XIX_HCP5_CANFD01, flow-control-pdu=ISOx_Hybrid_01_Req_XIX_HCP5_CANFD01, max-block-size=15, padding-activation=true, receiver=TPN_Gateway_XIX_HCP5_CANFD01_XIX_402391163, ta-type=PHYSICAL, timeout-br=0.1, timeout-bs=1, timeout-cr=1, timeout-cs=0.2, tp-sdu=DCM_HCP5_CANFD01_XIX_TPCHType_CANHS_ISO_Diagnose_XIX_0x17FE007B_XIX_0x17FC007B_XIX_Physical, transmitter=TPN_Hybrid_01_XIX_HCP5_CANFD01_XIX_402522235:
      ident TPCN_HCP5_CANFD01_XIX_TPCHType_CANHS_ISO_Diagnose_XIX_0x17FE007B_Hybrid_01_XIX_0x17FC007B_Gateway_XIX_Physical
    can-tp-connection addressing-format=STANDARD, can-tp-channel=TPC_HCP5_CANFD01_XIX_TPCHType_CANHS_ISO_Diagnose_XIX_0x700_XIX_Functional, cancellation=true, data-pdu=ISO_Funktionaler_Req_All_XIX_HCP5_CANFD01, max-block-size=15, multicast=CanTPConfig_HCP5_CANFD01/TA_0x700, padding-activation=true, receiver=[TPN_AWC_XIX_HCP5_CANFD01_XIX_402522255, TPN_Hybrid_01_XIX_HCP5_CANFD01_XIX_1963, TPN_Hybrid_01_XIX_HCP5_CANFD01_XIX_402522235, TPN_Hybrid_01_XIX_HCP5_CANFD01_XIX_402522268, TPN_Hybrid_01_XIX_HCP5_CANFD01_XIX_402522286, TPN_Hybrid_01_XIX_HCP5_CANFD01_XIX_402522292, TPN_Hybrid_01_XIX_HCP5_CANFD01_XIX_403046414, TPN_Hybrid_01_XIX_HCP5_CANFD01_XIX_403046421, TPN_Hybrid_01_XIX_HCP5_CANFD01_XIX_403046433, TPN_DCDC_NV_XIX_HCP5_CANFD01_XIX_402522297, TPN_HVZB_XIX_HCP5_CANFD01_XIX_403046429, TPN_SACID_1_XIX_HCP5_CANFD01_XIX_403046427, TPN_SACID_2_XIX_HCP5_CANFD01_XIX_403046428, TPN_Ladegeraet_XIX_HCP5_CANFD01_XIX_1966], ta-type=FUNCTIONAL, timeout-br=0.1, timeout-bs=1, timeout-cr=1, timeout-cs=0.2, tp-sdu=DCM_HCP5_CANFD01_XIX_TPCHType_CANHS_ISO_Diagnose_XIX_0x700_XIX_Functional, transmitter=TPN_Gateway_XIX_HCP5_CANFD01_XIX_1857:
      ident TPCN_HCP5_CANFD01_XIX_TPCHType_CANHS_ISO_Diagnose_XIX_0x700_Gateway_XIX_Functional
    can-tp-connection addressing-format=STANDARD, can-tp-channel=TPC_HCP5_CANFD01_XIX_TPCHType_CANHS_OBDC_SSN_Diagnose_XIX_0x17FC70D0_XIX_0x17FE70D0_XIX_Physical, cancellation=true, data-pdu=OBDC_SSN_BJB_Req_XIX_HCP5_CANFD01, flow-control-pdu=OBDC_SSN_BJB_Resp_XIX_HCP5_CANFD01, max-block-size=15, padding-activation=true, receiver=TPN_Hybrid_01_XIX_HCP5_CANFD01_XIX_402550992, ta-type=PHYSICAL, timeout-br=0.1, timeout-bs=1, timeout-cr=1, timeout-cs=0.2, tp-sdu=DCM_HCP5_CANFD01_XIX_TPCHType_CANHS_OBDC_SSN_Diagnose_XIX_0x17FC70D0_XIX_0x17FE70D0_XIX_Physical, transmitter=TPN_Gateway_XIX_HCP5_CANFD01_XIX_402419920:
      ident TPCN_HCP5_CANFD01_XIX_TPCHType_CANHS_OBDC_SSN_Diagnose_XIX_0x17FC70D0_Gateway_XIX_0x17FE70D0_Hybrid_01_XIX_Physical
    can-tp-connection addressing-format=STANDARD, can-tp-channel=TPC_HCP5_CANFD01_XIX_TPCHType_CANHS_OBDC_SSN_Diagnose_XIX_0x17FC71B1_XIX_0x17FE71B1_XIX_Physical, cancellation=true, data-pdu=OBDC_SSN_UI2Sens01_Req_XIX_HCP5_CANFD01, flow-control-pdu=OBDC_SSN_UI2Sens01_Resp_XIX_HCP5_CANFD01, max-block-size=15, padding-activation=true, receiver=TPN_Hybrid_01_XIX_HCP5_CANFD01_XIX_402551217, ta-type=PHYSICAL, timeout-br=0.1, timeout-bs=1, timeout-cr=1, timeout-cs=0.2, tp-sdu=DCM_HCP5_CANFD01_XIX_TPCHType_CANHS_OBDC_SSN_Diagnose_XIX_0x17FC71B1_XIX_0x17FE71B1_XIX_Physical, transmitter=TPN_Gateway_XIX_HCP5_CANFD01_XIX_402420145:
      ident TPCN_HCP5_CANFD01_XIX_TPCHType_CANHS_OBDC_SSN_Diagnose_XIX_0x17FC71B1_Gateway_XIX_0x17FE71B1_Hybrid_01_XIX_Physical
    can-tp-connection addressing-format=STANDARD, can-tp-channel=TPC_HCP5_CANFD01_XIX_TPCHType_CANHS_OBDC_SSN_Diagnose_XIX_0x17FC71B2_XIX_0x17FE71B2_XIX_Physical, cancellation=true, data-pdu=OBDC_SSN_UI2Sens02_Req_XIX_HCP5_CANFD01, flow-control-pdu=OBDC_SSN_UI2Sens02_Resp_XIX_HCP5_CANFD01, max-block-size=15, padding-activation=true, receiver=TPN_Hybrid_01_XIX_HCP5_CANFD01_XIX_402551218, ta-type=PHYSICAL, timeout-br=0.1, timeout-bs=1, timeout-cr=1, timeout-cs=0.2, tp-sdu=DCM_HCP5_CANFD01_XIX_TPCHType_CANHS_OBDC_SSN_Diagnose_XIX_0x17FC71B2_XIX_0x17FE71B2_XIX_Physical, transmitter=TPN_Gateway_XIX_HCP5_CANFD01_XIX_402420146:
      ident TPCN_HCP5_CANFD01_XIX_TPCHType_CANHS_OBDC_SSN_Diagnose_XIX_0x17FC71B2_Gateway_XIX_0x17FE71B2_Hybrid_01_XIX_Physical
    can-tp-connection addressing-format=STANDARD, can-tp-channel=TPC_HCP5_CANFD01_XIX_TPCHType_CANHS_OBDC_SSN_Diagnose_XIX_0x17FC70D0_XIX_0x17FE70D0_XIX_Physical, cancellation=true, data-pdu=OBDC_SSN_BJB_Resp_XIX_HCP5_CANFD01, flow-control-pdu=OBDC_SSN_BJB_Req_XIX_HCP5_CANFD01, max-block-size=15, padding-activation=true, receiver=TPN_Gateway_XIX_HCP5_CANFD01_XIX_402419920, ta-type=PHYSICAL, timeout-br=0.1, timeout-bs=1, timeout-cr=1, timeout-cs=0.2, tp-sdu=DCM_HCP5_CANFD01_XIX_TPCHType_CANHS_OBDC_SSN_Diagnose_XIX_0x17FE70D0_XIX_0x17FC70D0_XIX_Physical, transmitter=TPN_Hybrid_01_XIX_HCP5_CANFD01_XIX_402550992:
      ident TPCN_HCP5_CANFD01_XIX_TPCHType_CANHS_OBDC_SSN_Diagnose_XIX_0x17FE70D0_Hybrid_01_XIX_0x17FC70D0_Gateway_XIX_Physical
    can-tp-connection addressing-format=STANDARD, can-tp-channel=TPC_HCP5_CANFD01_XIX_TPCHType_CANHS_OBDC_SSN_Diagnose_XIX_0x17FC71B1_XIX_0x17FE71B1_XIX_Physical, cancellation=true, data-pdu=OBDC_SSN_UI2Sens01_Resp_XIX_HCP5_CANFD01, flow-control-pdu=OBDC_SSN_UI2Sens01_Req_XIX_HCP5_CANFD01, max-block-size=15, padding-activation=true, receiver=TPN_Gateway_XIX_HCP5_CANFD01_XIX_402420145, ta-type=PHYSICAL, timeout-br=0.1, timeout-bs=1, timeout-cr=1, timeout-cs=0.2, tp-sdu=DCM_HCP5_CANFD01_XIX_TPCHType_CANHS_OBDC_SSN_Diagnose_XIX_0x17FE71B1_XIX_0x17FC71B1_XIX_Physical, transmitter=TPN_Hybrid_01_XIX_HCP5_CANFD01_XIX_402551217:
      ident TPCN_HCP5_CANFD01_XIX_TPCHType_CANHS_OBDC_SSN_Diagnose_XIX_0x17FE71B1_Hybrid_01_XIX_0x17FC71B1_Gateway_XIX_Physical
    can-tp-connection addressing-format=STANDARD, can-tp-channel=TPC_HCP5_CANFD01_XIX_TPCHType_CANHS_OBDC_SSN_Diagnose_XIX_0x17FC71B2_XIX_0x17FE71B2_XIX_Physical, cancellation=true, data-pdu=OBDC_SSN_UI2Sens02_Resp_XIX_HCP5_CANFD01, flow-control-pdu=OBDC_SSN_UI2Sens02_Req_XIX_HCP5_CANFD01, max-block-size=15, padding-activation=true, receiver=TPN_Gateway_XIX_HCP5_CANFD01_XIX_402420146, ta-type=PHYSICAL, timeout-br=0.1, timeout-bs=1, timeout-cr=1, timeout-cs=0.2, tp-sdu=DCM_HCP5_CANFD01_XIX_TPCHType_CANHS_OBDC_SSN_Diagnose_XIX_0x17FE71B2_XIX_0x17FC71B2_XIX_Physical, transmitter=TPN_Hybrid_01_XIX_HCP5_CANFD01_XIX_402551218:
      ident TPCN_HCP5_CANFD01_XIX_TPCHType_CANHS_OBDC_SSN_Diagnose_XIX_0x17FE71B2_Hybrid_01_XIX_0x17FC71B2_Gateway_XIX_Physical
    can-tp-connection addressing-format=STANDARD, can-tp-channel=TPC_HCP5_CANFD01_XIX_TPCHType_CANHS_OBDx_XIX_0x18DA05F1_XIX_0x18DAF105_XIX_Physical, cancellation=true, data-pdu=OBDx_Hybrid_01_Req_XIX_HCP5_CANFD01, flow-control-pdu=OBDx_Hybrid_01_Resp_XIX_HCP5_CANFD01, max-block-size=15, padding-activation=true, receiver=TPN_Hybrid_01_XIX_HCP5_CANFD01_XIX_417001733, ta-type=PHYSICAL, timeout-br=0.001, timeout-bs=0.075, timeout-cr=0.15, timeout-cs=0.025, tp-sdu=DCM_HCP5_CANFD01_XIX_TPCHType_CANHS_OBDx_XIX_0x18DA05F1_XIX_0x18DAF105_XIX_Physical, transmitter=TPN_Gateway_XIX_HCP5_CANFD01_XIX_416941553:
      ident TPCN_HCP5_CANFD01_XIX_TPCHType_CANHS_OBDx_XIX_0x18DA05F1_Gateway_XIX_0x18DAF105_Hybrid_01_XIX_Physical
    can-tp-connection addressing-format=STANDARD, can-tp-channel=TPC_HCP5_CANFD01_XIX_TPCHType_CANHS_OBDx_XIX_0x18DA05F1_XIX_0x18DAF105_XIX_Physical, cancellation=true, data-pdu=OBDx_Hybrid_01_Resp_XIX_HCP5_CANFD01, flow-control-pdu=OBDx_Hybrid_01_Req_XIX_HCP5_CANFD01, max-block-size=15, padding-activation=true, receiver=TPN_Gateway_XIX_HCP5_CANFD01_XIX_416941553, ta-type=PHYSICAL, timeout-br=0.001, timeout-bs=0.075, timeout-cr=0.15, timeout-cs=0.025, tp-sdu=DCM_HCP5_CANFD01_XIX_TPCHType_CANHS_OBDx_XIX_0x18DAF105_XIX_0x18DA05F1_XIX_Physical, transmitter=TPN_Hybrid_01_XIX_HCP5_CANFD01_XIX_417001733:
      ident TPCN_HCP5_CANFD01_XIX_TPCHType_CANHS_OBDx_XIX_0x18DAF105_Hybrid_01_XIX_0x18DA05F1_Gateway_XIX_Physical
    can-tp-connection addressing-format=STANDARD, can-tp-channel=TPC_HCP5_CANFD01_XIX_TPCHType_CANHS_OBDx_XIX_0x18DB33F1_XIX_Functional, cancellation=true, data-pdu=OBDx_allOBD_Req_XIX_HCP5_CANFD01, max-block-size=15, multicast=TA_0x18DB33F1, padding-activation=true, receiver=[TPN_AWC_XIX_HCP5_CANFD01_XIX_417018865, TPN_Hybrid_01_XIX_HCP5_CANFD01_XIX_417018865, TPN_HVZB_XIX_HCP5_CANFD01_XIX_417018865, TPN_SACID_1_XIX_HCP5_CANFD01_XIX_417018865, TPN_SACID_2_XIX_HCP5_CANFD01_XIX_417018865, TPN_Ladegeraet_XIX_HCP5_CANFD01_XIX_417018865], ta-type=FUNCTIONAL, timeout-br=0.001, timeout-bs=0.075, timeout-cr=0.15, timeout-cs=0.025, tp-sdu=DCM_HCP5_CANFD01_XIX_TPCHType_CANHS_OBDx_XIX_0x18DB33F1_XIX_Functional, transmitter=TPN_Gateway_XIX_HCP5_CANFD01_XIX_417018865:
      ident TPCN_HCP5_CANFD01_XIX_TPCHType_CANHS_OBDx_XIX_0x18DB33F1_Gateway_XIX_Functional
    153 x can tp node, all with st-min=0.005:
      TPN_AWC_XIX_HCP5_CANFD01_XIX_402522255: max-fc-wait=15, timeout-ar=1, timeout-as=1, tp-address=TA_0x17FE008F
      TPN_AWC_XIX_HCP5_CANFD01_XIX_417018865: max-fc-wait=0, timeout-ar=0.025, timeout-as=0.025, tp-address=TA_0x18DB33F1
      TPN_AWC_XIX_HCP5_CANFD01_XIX_474087492: max-fc-wait=15, timeout-ar=1, timeout-as=1, tp-address=TA_0x1C420044
      TPN_AWC_XIX_HCP5_CANFD01_XIX_474087547: max-fc-wait=15, timeout-ar=1, timeout-as=1, tp-address=TA_0x1C42007B
      TPN_AWC_XIX_HCP5_CANFD01_XIX_474087567: max-fc-wait=15, timeout-ar=1, timeout-as=1, tp-address=TA_0x1C42008F
      TPN_AWC_XIX_HCP5_CANFD01_XIX_474087609: max-fc-wait=15, timeout-ar=1, timeout-as=1, tp-address=TA_0x1C4200B9
      TPN_AWC_XIX_HCP5_CANFD01_XIX_474088004: max-fc-wait=15, timeout-ar=1, timeout-as=1, tp-address=TA_0x1C420244
      TPN_AWC_XIX_HCP5_CANFD01_XIX_474088059: max-fc-wait=15, timeout-ar=1, timeout-as=1, tp-address=TA_0x1C42027B
      TPN_AWC_XIX_HCP5_CANFD01_XIX_474088079: max-fc-wait=15, timeout-ar=1, timeout-as=1, tp-address=TA_0x1C42028F
      TPN_AWC_XIX_HCP5_CANFD01_XIX_474088121: max-fc-wait=15, timeout-ar=1, timeout-as=1, tp-address=TA_0x1C4202B9
      TPN_AWC_XIX_HCP5_CANFD01_XIX_474349595: max-fc-wait=15, timeout-ar=1, timeout-as=1, tp-address=TA_0x1C46001B
      TPN_AWC_XIX_HCP5_CANFD01_XIX_474349596: max-fc-wait=15, timeout-ar=1, timeout-as=1, tp-address=TA_0x1C46001C
      TPN_AWC_XIX_HCP5_CANFD01_XIX_474349597: max-fc-wait=15, timeout-ar=1, timeout-as=1, tp-address=TA_0x1C46001D
      TPN_AWC_XIX_HCP5_CANFD01_XIX_474350107: max-fc-wait=15, timeout-ar=1, timeout-as=1, tp-address=TA_0x1C46021B
      TPN_AWC_XIX_HCP5_CANFD01_XIX_474350108: max-fc-wait=15, timeout-ar=1, timeout-as=1, tp-address=TA_0x1C46021C
      TPN_AWC_XIX_HCP5_CANFD01_XIX_474350109: max-fc-wait=15, timeout-ar=1, timeout-as=1, tp-address=TA_0x1C46021D
      TPN_Hybrid_01_XIX_HCP5_CANFD01_XIX_1963: connector=CN_HCP5_CANFD01, timeout-as=1, tp-address=TA_0x7AB
      TPN_Hybrid_01_XIX_HCP5_CANFD01_XIX_402522235: connector=CN_HCP5_CANFD01, max-fc-wait=15, timeout-ar=1, timeout-as=1, tp-address=TA_0x17FE007B
      TPN_Hybrid_01_XIX_HCP5_CANFD01_XIX_402522268: connector=CN_HCP5_CANFD01, max-fc-wait=15, timeout-ar=1, timeout-as=1, tp-address=TA_0x17FE009C
      TPN_Hybrid_01_XIX_HCP5_CANFD01_XIX_402522286: connector=CN_HCP5_CANFD01, max-fc-wait=15, timeout-ar=1, timeout-as=1, tp-address=TA_0x17FE00AE
      TPN_Hybrid_01_XIX_HCP5_CANFD01_XIX_402522292: connector=CN_HCP5_CANFD01, max-fc-wait=15, timeout-ar=1, timeout-as=1, tp-address=TA_0x17FE00B4
      TPN_Hybrid_01_XIX_HCP5_CANFD01_XIX_402527952: connector=CN_HCP5_CANFD01, max-fc-wait=15, timeout-ar=1, timeout-as=1, tp-address=CanTPConfig_HCP5_CANFD01/TA_0x17FE16D0
      TPN_Hybrid_01_XIX_HCP5_CANFD01_XIX_402528177: connector=CN_HCP5_CANFD01, max-fc-wait=15, timeout-ar=1, timeout-as=1, tp-address=CanTPConfig_HCP5_CANFD01/TA_0x17FE17B1
      TPN_Hybrid_01_XIX_HCP5_CANFD01_XIX_402528178: connector=CN_HCP5_CANFD01, max-fc-wait=15, timeout-ar=1, timeout-as=1, tp-address=CanTPConfig_HCP5_CANFD01/TA_0x17FE17B2
      TPN_Hybrid_01_XIX_HCP5_CANFD01_XIX_402550992: connector=CN_HCP5_CANFD01, max-fc-wait=15, timeout-ar=1, timeout-as=1, tp-address=CanTPConfig_HCP5_CANFD01/TA_0x17FE70D0
      TPN_Hybrid_01_XIX_HCP5_CANFD01_XIX_402551217: connector=CN_HCP5_CANFD01, max-fc-wait=15, timeout-ar=1, timeout-as=1, tp-address=CanTPConfig_HCP5_CANFD01/TA_0x17FE71B1
      TPN_Hybrid_01_XIX_HCP5_CANFD01_XIX_402551218: connector=CN_HCP5_CANFD01, max-fc-wait=15, timeout-ar=1, timeout-as=1, tp-address=CanTPConfig_HCP5_CANFD01/TA_0x17FE71B2
      TPN_Hybrid_01_XIX_HCP5_CANFD01_XIX_403046414: connector=CN_HCP5_CANFD01, max-fc-wait=15, timeout-ar=1, timeout-as=1, tp-address=TA_0x1806000E
      TPN_Hybrid_01_XIX_HCP5_CANFD01_XIX_403046421: connector=CN_HCP5_CANFD01, max-fc-wait=15, timeout-ar=1, timeout-as=1, tp-address=TA_0x18060015
      TPN_Hybrid_01_XIX_HCP5_CANFD01_XIX_403046433: connector=CN_HCP5_CANFD01, max-fc-wait=15, timeout-ar=1, timeout-as=1, tp-address=TA_0x18060021
      TPN_Hybrid_01_XIX_HCP5_CANFD01_XIX_417001733: connector=CN_HCP5_CANFD01, max-fc-wait=0, timeout-ar=0.025, timeout-as=0.025, tp-address=TA_0x18DAF105
      TPN_Hybrid_01_XIX_HCP5_CANFD01_XIX_417018865: connector=CN_HCP5_CANFD01, max-fc-wait=0, timeout-ar=0.025, timeout-as=0.025, tp-address=TA_0x18DB33F1
      TPN_Hybrid_01_XIX_HCP5_CANFD01_XIX_474087492: connector=CN_HCP5_CANFD01, max-fc-wait=15, timeout-ar=1, timeout-as=1, tp-address=TA_0x1C420044
      TPN_Hybrid_01_XIX_HCP5_CANFD01_XIX_474087547: connector=CN_HCP5_CANFD01, max-fc-wait=15, timeout-ar=1, timeout-as=1, tp-address=TA_0x1C42007B
      TPN_Hybrid_01_XIX_HCP5_CANFD01_XIX_474087567: connector=CN_HCP5_CANFD01, max-fc-wait=15, timeout-ar=1, timeout-as=1, tp-address=TA_0x1C42008F
      TPN_Hybrid_01_XIX_HCP5_CANFD01_XIX_474087609: connector=CN_HCP5_CANFD01, max-fc-wait=15, timeout-ar=1, timeout-as=1, tp-address=TA_0x1C4200B9
      TPN_Hybrid_01_XIX_HCP5_CANFD01_XIX_474088004: connector=CN_HCP5_CANFD01, max-fc-wait=15, timeout-ar=1, timeout-as=1, tp-address=TA_0x1C420244
      TPN_Hybrid_01_XIX_HCP5_CANFD01_XIX_474088059: connector=CN_HCP5_CANFD01, max-fc-wait=15, timeout-ar=1, timeout-as=1, tp-address=TA_0x1C42027B
      TPN_Hybrid_01_XIX_HCP5_CANFD01_XIX_474088079: connector=CN_HCP5_CANFD01, max-fc-wait=15, timeout-ar=1, timeout-as=1, tp-address=TA_0x1C42028F
      TPN_Hybrid_01_XIX_HCP5_CANFD01_XIX_474088121: connector=CN_HCP5_CANFD01, max-fc-wait=15, timeout-ar=1, timeout-as=1, tp-address=TA_0x1C4202B9
      TPN_Hybrid_01_XIX_HCP5_CANFD01_XIX_474103675: connector=CN_HCP5_CANFD01, max-fc-wait=15, timeout-ar=1, timeout-as=1, tp-address=TA_0x1C423F7B
      TPN_Hybrid_01_XIX_HCP5_CANFD01_XIX_474349595: connector=CN_HCP5_CANFD01, max-fc-wait=15, timeout-ar=1, timeout-as=1, tp-address=TA_0x1C46001B
      TPN_Hybrid_01_XIX_HCP5_CANFD01_XIX_474349596: connector=CN_HCP5_CANFD01, max-fc-wait=15, timeout-ar=1, timeout-as=1, tp-address=TA_0x1C46001C
      TPN_Hybrid_01_XIX_HCP5_CANFD01_XIX_474349597: connector=CN_HCP5_CANFD01, max-fc-wait=15, timeout-ar=1, timeout-as=1, tp-address=TA_0x1C46001D
      TPN_Hybrid_01_XIX_HCP5_CANFD01_XIX_474350107: connector=CN_HCP5_CANFD01, max-fc-wait=15, timeout-ar=1, timeout-as=1, tp-address=TA_0x1C46021B
      TPN_Hybrid_01_XIX_HCP5_CANFD01_XIX_474350108: connector=CN_HCP5_CANFD01, max-fc-wait=15, timeout-ar=1, timeout-as=1, tp-address=TA_0x1C46021C
      TPN_Hybrid_01_XIX_HCP5_CANFD01_XIX_474350109: connector=CN_HCP5_CANFD01, max-fc-wait=15, timeout-ar=1, timeout-as=1, tp-address=TA_0x1C46021D
      TPN_DCDC_NV_XIX_HCP5_CANFD01_XIX_402522297: max-fc-wait=15, timeout-ar=1, timeout-as=1, tp-address=TA_0x17FE00B9
      TPN_DCDC_NV_XIX_HCP5_CANFD01_XIX_474087492: max-fc-wait=15, timeout-ar=1, timeout-as=1, tp-address=TA_0x1C420044
      TPN_DCDC_NV_XIX_HCP5_CANFD01_XIX_474087547: max-fc-wait=15, timeout-ar=1, timeout-as=1, tp-address=TA_0x1C42007B
      TPN_DCDC_NV_XIX_HCP5_CANFD01_XIX_474087567: max-fc-wait=15, timeout-ar=1, timeout-as=1, tp-address=TA_0x1C42008F
      TPN_DCDC_NV_XIX_HCP5_CANFD01_XIX_474087609: max-fc-wait=15, timeout-ar=1, timeout-as=1, tp-address=TA_0x1C4200B9
      TPN_DCDC_NV_XIX_HCP5_CANFD01_XIX_474088004: max-fc-wait=15, timeout-ar=1, timeout-as=1, tp-address=TA_0x1C420244
      TPN_DCDC_NV_XIX_HCP5_CANFD01_XIX_474088059: max-fc-wait=15, timeout-ar=1, timeout-as=1, tp-address=TA_0x1C42027B
      TPN_DCDC_NV_XIX_HCP5_CANFD01_XIX_474088079: max-fc-wait=15, timeout-ar=1, timeout-as=1, tp-address=TA_0x1C42028F
      TPN_DCDC_NV_XIX_HCP5_CANFD01_XIX_474088121: max-fc-wait=15, timeout-ar=1, timeout-as=1, tp-address=TA_0x1C4202B9
      TPN_DCDC_NV_XIX_HCP5_CANFD01_XIX_474349595: max-fc-wait=15, timeout-ar=1, timeout-as=1, tp-address=TA_0x1C46001B
      TPN_DCDC_NV_XIX_HCP5_CANFD01_XIX_474349596: max-fc-wait=15, timeout-ar=1, timeout-as=1, tp-address=TA_0x1C46001C
      TPN_DCDC_NV_XIX_HCP5_CANFD01_XIX_474349597: max-fc-wait=15, timeout-ar=1, timeout-as=1, tp-address=TA_0x1C46001D
      TPN_DCDC_NV_XIX_HCP5_CANFD01_XIX_474350107: max-fc-wait=15, timeout-ar=1, timeout-as=1, tp-address=TA_0x1C46021B
      TPN_DCDC_NV_XIX_HCP5_CANFD01_XIX_474350108: max-fc-wait=15, timeout-ar=1, timeout-as=1, tp-address=TA_0x1C46021C
      TPN_DCDC_NV_XIX_HCP5_CANFD01_XIX_474350109: max-fc-wait=15, timeout-ar=1, timeout-as=1, tp-address=TA_0x1C46021D
      TPN_Gateway_XIX_HCP5_CANFD01_XIX_1857: max-fc-wait=15, timeout-ar=1, timeout-as=1, tp-address=TA_0x741
      TPN_Gateway_XIX_HCP5_CANFD01_XIX_1860: max-fc-wait=15, timeout-ar=1, timeout-as=1, tp-address=TA_0x744
      TPN_Gateway_XIX_HCP5_CANFD01_XIX_402391163: max-fc-wait=15, timeout-ar=1, timeout-as=1, tp-address=TA_0x17FC007B
      TPN_Gateway_XIX_HCP5_CANFD01_XIX_402391183: max-fc-wait=15, timeout-ar=1, timeout-as=1, tp-address=TA_0x17FC008F
      TPN_Gateway_XIX_HCP5_CANFD01_XIX_402391196: max-fc-wait=15, timeout-ar=1, timeout-as=1, tp-address=TA_0x17FC009C
      TPN_Gateway_XIX_HCP5_CANFD01_XIX_402391214: max-fc-wait=15, timeout-ar=1, timeout-as=1, tp-address=TA_0x17FC00AE
      TPN_Gateway_XIX_HCP5_CANFD01_XIX_402391220: max-fc-wait=15, timeout-ar=1, timeout-as=1, tp-address=TA_0x17FC00B4
      TPN_Gateway_XIX_HCP5_CANFD01_XIX_402391225: max-fc-wait=15, timeout-ar=1, timeout-as=1, tp-address=TA_0x17FC00B9
      TPN_Gateway_XIX_HCP5_CANFD01_XIX_402396880: max-fc-wait=15, timeout-ar=1, timeout-as=1, tp-address=CanTPConfig_HCP5_CANFD01/TA_0x17FC16D0
      TPN_Gateway_XIX_HCP5_CANFD01_XIX_402397105: max-fc-wait=15, timeout-ar=1, timeout-as=1, tp-address=CanTPConfig_HCP5_CANFD01/TA_0x17FC17B1
      TPN_Gateway_XIX_HCP5_CANFD01_XIX_402397106: max-fc-wait=15, timeout-ar=1, timeout-as=1, tp-address=CanTPConfig_HCP5_CANFD01/TA_0x17FC17B2
      TPN_Gateway_XIX_HCP5_CANFD01_XIX_402419920: max-fc-wait=15, timeout-ar=1, timeout-as=1, tp-address=CanTPConfig_HCP5_CANFD01/TA_0x17FC70D0
      TPN_Gateway_XIX_HCP5_CANFD01_XIX_402420145: max-fc-wait=15, timeout-ar=1, timeout-as=1, tp-address=CanTPConfig_HCP5_CANFD01/TA_0x17FC71B1
      TPN_Gateway_XIX_HCP5_CANFD01_XIX_402420146: max-fc-wait=15, timeout-ar=1, timeout-as=1, tp-address=CanTPConfig_HCP5_CANFD01/TA_0x17FC71B2
      TPN_Gateway_XIX_HCP5_CANFD01_XIX_402915342: max-fc-wait=15, timeout-ar=1, timeout-as=1, tp-address=TA_0x1804000E
      TPN_Gateway_XIX_HCP5_CANFD01_XIX_402915349: max-fc-wait=15, timeout-ar=1, timeout-as=1, tp-address=TA_0x18040015
      TPN_Gateway_XIX_HCP5_CANFD01_XIX_402915355: max-fc-wait=15, timeout-ar=1, timeout-as=1, tp-address=TA_0x1804001B
      TPN_Gateway_XIX_HCP5_CANFD01_XIX_402915356: max-fc-wait=15, timeout-ar=1, timeout-as=1, tp-address=TA_0x1804001C
      TPN_Gateway_XIX_HCP5_CANFD01_XIX_402915357: max-fc-wait=15, timeout-ar=1, timeout-as=1, tp-address=TA_0x1804001D
      TPN_Gateway_XIX_HCP5_CANFD01_XIX_402915361: max-fc-wait=15, timeout-ar=1, timeout-as=1, tp-address=TA_0x18040021
      TPN_Gateway_XIX_HCP5_CANFD01_XIX_416941553: max-fc-wait=0, timeout-ar=0.025, timeout-as=0.025, tp-address=TA_0x18DA05F1
      TPN_Gateway_XIX_HCP5_CANFD01_XIX_417018865: max-fc-wait=0, timeout-ar=0.025, timeout-as=0.025, tp-address=TA_0x18DB33F1
      TPN_Gateway_XIX_HCP5_CANFD01_XIX_473956475: max-fc-wait=15, timeout-ar=1, timeout-as=1, tp-address=TA_0x1C40007B
      TPN_Gateway_XIX_HCP5_CANFD01_XIX_473956987: max-fc-wait=15, timeout-ar=1, timeout-as=1, tp-address=TA_0x1C40027B
      TPN_Gateway_XIX_HCP5_CANFD01_XIX_473972603: max-fc-wait=15, timeout-ar=1, timeout-as=1, tp-address=TA_0x1C403F7B
      TPN_Gateway_XIX_HCP5_CANFD01_XIX_474021888: max-fc-wait=15, timeout-ar=1, timeout-as=1, tp-address=TA_0x1C410000
      TPN_Gateway_XIX_HCP5_CANFD01_XIX_474022400: max-fc-wait=15, timeout-ar=1, timeout-as=1, tp-address=TA_0x1C410200
      TPN_HVZB_XIX_HCP5_CANFD01_XIX_403046429: max-fc-wait=15, timeout-ar=1, timeout-as=1, tp-address=TA_0x1806001D
      TPN_HVZB_XIX_HCP5_CANFD01_XIX_417018865: max-fc-wait=0, timeout-ar=0.025, timeout-as=0.025, tp-address=TA_0x18DB33F1
      TPN_HVZB_XIX_HCP5_CANFD01_XIX_474087492: max-fc-wait=15, timeout-ar=1, timeout-as=1, tp-address=TA_0x1C420044
      TPN_HVZB_XIX_HCP5_CANFD01_XIX_474087547: max-fc-wait=15, timeout-ar=1, timeout-as=1, tp-address=TA_0x1C42007B
      TPN_HVZB_XIX_HCP5_CANFD01_XIX_474087567: max-fc-wait=15, timeout-ar=1, timeout-as=1, tp-address=TA_0x1C42008F
      TPN_HVZB_XIX_HCP5_CANFD01_XIX_474087609: max-fc-wait=15, timeout-ar=1, timeout-as=1, tp-address=TA_0x1C4200B9
      TPN_HVZB_XIX_HCP5_CANFD01_XIX_474088004: max-fc-wait=15, timeout-ar=1, timeout-as=1, tp-address=TA_0x1C420244
      TPN_HVZB_XIX_HCP5_CANFD01_XIX_474088059: max-fc-wait=15, timeout-ar=1, timeout-as=1, tp-address=TA_0x1C42027B
      TPN_HVZB_XIX_HCP5_CANFD01_XIX_474088079: max-fc-wait=15, timeout-ar=1, timeout-as=1, tp-address=TA_0x1C42028F
      TPN_HVZB_XIX_HCP5_CANFD01_XIX_474088121: max-fc-wait=15, timeout-ar=1, timeout-as=1, tp-address=TA_0x1C4202B9
      TPN_HVZB_XIX_HCP5_CANFD01_XIX_474349595: max-fc-wait=15, timeout-ar=1, timeout-as=1, tp-address=TA_0x1C46001B
      TPN_HVZB_XIX_HCP5_CANFD01_XIX_474349596: max-fc-wait=15, timeout-ar=1, timeout-as=1, tp-address=TA_0x1C46001C
      TPN_HVZB_XIX_HCP5_CANFD01_XIX_474349597: max-fc-wait=15, timeout-ar=1, timeout-as=1, tp-address=TA_0x1C46001D
      TPN_HVZB_XIX_HCP5_CANFD01_XIX_474350107: max-fc-wait=15, timeout-ar=1, timeout-as=1, tp-address=TA_0x1C46021B
      TPN_HVZB_XIX_HCP5_CANFD01_XIX_474350108: max-fc-wait=15, timeout-ar=1, timeout-as=1, tp-address=TA_0x1C46021C
      TPN_HVZB_XIX_HCP5_CANFD01_XIX_474350109: max-fc-wait=15, timeout-ar=1, timeout-as=1, tp-address=TA_0x1C46021D
      TPN_SACID_1_XIX_HCP5_CANFD01_XIX_403046427: max-fc-wait=15, timeout-ar=1, timeout-as=1, tp-address=TA_0x1806001B
      TPN_SACID_1_XIX_HCP5_CANFD01_XIX_417018865: max-fc-wait=0, timeout-ar=0.025, timeout-as=0.025, tp-address=TA_0x18DB33F1
      TPN_SACID_1_XIX_HCP5_CANFD01_XIX_474087492: max-fc-wait=15, timeout-ar=1, timeout-as=1, tp-address=TA_0x1C420044
      TPN_SACID_1_XIX_HCP5_CANFD01_XIX_474087547: max-fc-wait=15, timeout-ar=1, timeout-as=1, tp-address=TA_0x1C42007B
      TPN_SACID_1_XIX_HCP5_CANFD01_XIX_474087567: max-fc-wait=15, timeout-ar=1, timeout-as=1, tp-address=TA_0x1C42008F
      TPN_SACID_1_XIX_HCP5_CANFD01_XIX_474087609: max-fc-wait=15, timeout-ar=1, timeout-as=1, tp-address=TA_0x1C4200B9
      TPN_SACID_1_XIX_HCP5_CANFD01_XIX_474088004: max-fc-wait=15, timeout-ar=1, timeout-as=1, tp-address=TA_0x1C420244
      TPN_SACID_1_XIX_HCP5_CANFD01_XIX_474088059: max-fc-wait=15, timeout-ar=1, timeout-as=1, tp-address=TA_0x1C42027B
      TPN_SACID_1_XIX_HCP5_CANFD01_XIX_474088079: max-fc-wait=15, timeout-ar=1, timeout-as=1, tp-address=TA_0x1C42028F
      TPN_SACID_1_XIX_HCP5_CANFD01_XIX_474088121: max-fc-wait=15, timeout-ar=1, timeout-as=1, tp-address=TA_0x1C4202B9
      TPN_SACID_1_XIX_HCP5_CANFD01_XIX_474349595: max-fc-wait=15, timeout-ar=1, timeout-as=1, tp-address=TA_0x1C46001B
      TPN_SACID_1_XIX_HCP5_CANFD01_XIX_474349596: max-fc-wait=15, timeout-ar=1, timeout-as=1, tp-address=TA_0x1C46001C
      TPN_SACID_1_XIX_HCP5_CANFD01_XIX_474349597: max-fc-wait=15, timeout-ar=1, timeout-as=1, tp-address=TA_0x1C46001D
      TPN_SACID_1_XIX_HCP5_CANFD01_XIX_474350107: max-fc-wait=15, timeout-ar=1, timeout-as=1, tp-address=TA_0x1C46021B
      TPN_SACID_1_XIX_HCP5_CANFD01_XIX_474350108: max-fc-wait=15, timeout-ar=1, timeout-as=1, tp-address=TA_0x1C46021C
      TPN_SACID_1_XIX_HCP5_CANFD01_XIX_474350109: max-fc-wait=15, timeout-ar=1, timeout-as=1, tp-address=TA_0x1C46021D
      TPN_SACID_2_XIX_HCP5_CANFD01_XIX_403046428: max-fc-wait=15, timeout-ar=1, timeout-as=1, tp-address=TA_0x1806001C
      TPN_SACID_2_XIX_HCP5_CANFD01_XIX_417018865: max-fc-wait=0, timeout-ar=0.025, timeout-as=0.025, tp-address=TA_0x18DB33F1
      TPN_SACID_2_XIX_HCP5_CANFD01_XIX_474087492: max-fc-wait=15, timeout-ar=1, timeout-as=1, tp-address=TA_0x1C420044
      TPN_SACID_2_XIX_HCP5_CANFD01_XIX_474087547: max-fc-wait=15, timeout-ar=1, timeout-as=1, tp-address=TA_0x1C42007B
      TPN_SACID_2_XIX_HCP5_CANFD01_XIX_474087567: max-fc-wait=15, timeout-ar=1, timeout-as=1, tp-address=TA_0x1C42008F
      TPN_SACID_2_XIX_HCP5_CANFD01_XIX_474087609: max-fc-wait=15, timeout-ar=1, timeout-as=1, tp-address=TA_0x1C4200B9
      TPN_SACID_2_XIX_HCP5_CANFD01_XIX_474088004: max-fc-wait=15, timeout-ar=1, timeout-as=1, tp-address=TA_0x1C420244
      TPN_SACID_2_XIX_HCP5_CANFD01_XIX_474088059: max-fc-wait=15, timeout-ar=1, timeout-as=1, tp-address=TA_0x1C42027B
      TPN_SACID_2_XIX_HCP5_CANFD01_XIX_474088079: max-fc-wait=15, timeout-ar=1, timeout-as=1, tp-address=TA_0x1C42028F
      TPN_SACID_2_XIX_HCP5_CANFD01_XIX_474088121: max-fc-wait=15, timeout-ar=1, timeout-as=1, tp-address=TA_0x1C4202B9
      TPN_SACID_2_XIX_HCP5_CANFD01_XIX_474349595: max-fc-wait=15, timeout-ar=1, timeout-as=1, tp-address=TA_0x1C46001B
      TPN_SACID_2_XIX_HCP5_CANFD01_XIX_474349596: max-fc-wait=15, timeout-ar=1, timeout-as=1, tp-address=TA_0x1C46001C
      TPN_SACID_2_XIX_HCP5_CANFD01_XIX_474349597: max-fc-wait=15, timeout-ar=1, timeout-as=1, tp-address=TA_0x1C46001D
      TPN_SACID_2_XIX_HCP5_CANFD01_XIX_474350107: max-fc-wait=15, timeout-ar=1, timeout-as=1, tp-address=TA_0x1C46021B
      TPN_SACID_2_XIX_HCP5_CANFD01_XIX_474350108: max-fc-wait=15, timeout-ar=1, timeout-as=1, tp-address=TA_0x1C46021C
      TPN_SACID_2_XIX_HCP5_CANFD01_XIX_474350109: max-fc-wait=15, timeout-ar=1, timeout-as=1, tp-address=TA_0x1C46021D
      TPN_Ladegeraet_XIX_HCP5_CANFD01_XIX_1966: max-fc-wait=15, timeout-ar=1, timeout-as=1, tp-address=TA_0x7AE
      TPN_Ladegeraet_XIX_HCP5_CANFD01_XIX_417018865: max-fc-wait=0, timeout-ar=0.025, timeout-as=0.025, tp-address=TA_0x18DB33F1
      TPN_Ladegeraet_XIX_HCP5_CANFD01_XIX_474087492: max-fc-wait=15, timeout-ar=1, timeout-as=1, tp-address=TA_0x1C420044
      TPN_Ladegeraet_XIX_HCP5_CANFD01_XIX_474087547: max-fc-wait=15, timeout-ar=1, timeout-as=1, tp-address=TA_0x1C42007B
      TPN_Ladegeraet_XIX_HCP5_CANFD01_XIX_474087567: max-fc-wait=15, timeout-ar=1, timeout-as=1, tp-address=TA_0x1C42008F
      TPN_Ladegeraet_XIX_HCP5_CANFD01_XIX_474087609: max-fc-wait=15, timeout-ar=1, timeout-as=1, tp-address=TA_0x1C4200B9
      TPN_Ladegeraet_XIX_HCP5_CANFD01_XIX_474088004: max-fc-wait=15, timeout-ar=1, timeout-as=1, tp-address=TA_0x1C420244
      TPN_Ladegeraet_XIX_HCP5_CANFD01_XIX_474088059: max-fc-wait=15, timeout-ar=1, timeout-as=1, tp-address=TA_0x1C42027B
      TPN_Ladegeraet_XIX_HCP5_CANFD01_XIX_474088079: max-fc-wait=15, timeout-ar=1, timeout-as=1, tp-address=TA_0x1C42028F
      TPN_Ladegeraet_XIX_HCP5_CANFD01_XIX_474088121: max-fc-wait=15, timeout-ar=1, timeout-as=1, tp-address=TA_0x1C4202B9
      TPN_Ladegeraet_XIX_HCP5_CANFD01_XIX_474349595: max-fc-wait=15, timeout-ar=1, timeout-as=1, tp-address=TA_0x1C46001B
      TPN_Ladegeraet_XIX_HCP5_CANFD01_XIX_474349596: max-fc-wait=15, timeout-ar=1, timeout-as=1, tp-address=TA_0x1C46001C
      TPN_Ladegeraet_XIX_HCP5_CANFD01_XIX_474349597: max-fc-wait=15, timeout-ar=1, timeout-as=1, tp-address=TA_0x1C46001D
      TPN_Ladegeraet_XIX_HCP5_CANFD01_XIX_474350107: max-fc-wait=15, timeout-ar=1, timeout-as=1, tp-address=TA_0x1C46021B
      TPN_Ladegeraet_XIX_HCP5_CANFD01_XIX_474350108: max-fc-wait=15, timeout-ar=1, timeout-as=1, tp-address=TA_0x1C46021C
      TPN_Ladegeraet_XIX_HCP5_CANFD01_XIX_474350109: max-fc-wait=15, timeout-ar=1, timeout-as=1, tp-address=TA_0x1C46021D
  can tp config CanTPConfig_BMC_CAN01: communication-cluster=BMC_CAN01, can-tp-ecu=BMC_HV
    14 x can tp address:
      TA_0x17FC16D0: tp-address=402396880
      TA_0x17FC17B1: tp-address=402397105
      TA_0x17FC17B2: tp-address=402397106
      TA_0x17FC70D0: tp-address=402419920
      TA_0x17FC71B1: tp-address=402420145
      TA_0x17FC71B2: tp-address=402420146
      TA_0x17FD0200: tp-address=402457088
      TA_0x17FE16D0: tp-address=402527952
      TA_0x17FE17B1: tp-address=402528177
      TA_0x17FE17B2: tp-address=402528178
      TA_0x17FE70D0: tp-address=402550992
      TA_0x17FE71B1: tp-address=402551217
      TA_0x17FE71B2: tp-address=402551218
      TA_0x700: tp-address=1792
    8 x can tp channel, all with channel-mode=HALF-DUPLEX-MODE:
      TPC_BMC_CAN01_XIX_TPCHType_CANHS_Flash_DIA_XIX_0x17FC16D0_XIX_0x17FE16D0_XIX_Physical: channel-id=693351486
      TPC_BMC_CAN01_XIX_TPCHType_CANHS_Flash_DIA_XIX_0x17FC17B1_XIX_0x17FE17B1_XIX_Physical: channel-id=591688770
      TPC_BMC_CAN01_XIX_TPCHType_CANHS_Flash_DIA_XIX_0x17FC17B2_XIX_0x17FE17B2_XIX_Physical: channel-id=779231842
      TPC_BMC_CAN01_XIX_TPCHType_CANHS_ISO_Diagnose_XIX_0x700_XIX_Functional: channel-id=1806909241
      TPC_BMC_CAN01_XIX_TPCHType_CANHS_OBDC_Diagnose_XIX_0x17FD0200_XIX_Functional: channel-id=1890032509
      TPC_BMC_CAN01_XIX_TPCHType_CANHS_OBDC_SSN_Diagnose_XIX_0x17FC70D0_XIX_0x17FE70D0_XIX_Physical: channel-id=1086309555
      TPC_BMC_CAN01_XIX_TPCHType_CANHS_OBDC_SSN_Diagnose_XIX_0x17FC71B1_XIX_0x17FE71B1_XIX_Physical: channel-id=1923617485
      TPC_BMC_CAN01_XIX_TPCHType_CANHS_OBDC_SSN_Diagnose_XIX_0x17FC71B2_XIX_0x17FE71B2_XIX_Physical: channel-id=1736074413
    can-tp-connection addressing-format=STANDARD, can-tp-channel=TPC_BMC_CAN01_XIX_TPCHType_CANHS_Flash_DIA_XIX_0x17FC16D0_XIX_0x17FE16D0_XIX_Physical, cancellation=true, data-pdu=DIA_BJB_Req_XIX_BMC_CAN01, flow-control-pdu=DIA_BJB_Resp_XIX_BMC_CAN01, max-block-size=15, padding-activation=true, receiver=TPN_BJB_XIX_BMC_CAN01_XIX_402527952, ta-type=PHYSICAL, timeout-br=0.1, timeout-bs=1, timeout-cr=1, timeout-cs=0.2, tp-sdu=DCM_BMC_CAN01_XIX_TPCHType_CANHS_Flash_DIA_XIX_0x17FC16D0_XIX_0x17FE16D0_XIX_Physical, transmitter=TPN_Hybrid_01_XIX_BMC_CAN01_XIX_402396880:
      ident TPCN_BMC_CAN01_XIX_TPCHType_CANHS_Flash_DIA_XIX_0x17FC16D0_Hybrid_01_XIX_0x17FE16D0_BJB_XIX_Physical
    can-tp-connection addressing-format=STANDARD, can-tp-channel=TPC_BMC_CAN01_XIX_TPCHType_CANHS_Flash_DIA_XIX_0x17FC17B1_XIX_0x17FE17B1_XIX_Physical, cancellation=true, data-pdu=DIA_UI2Sens01_Req_XIX_BMC_CAN01, flow-control-pdu=DIA_UI2Sens01_Resp_XIX_BMC_CAN01, max-block-size=15, padding-activation=true, receiver=TPN_UI2Sens01_XIX_BMC_CAN01_XIX_402528177, ta-type=PHYSICAL, timeout-br=0.1, timeout-bs=1, timeout-cr=1, timeout-cs=0.2, tp-sdu=DCM_BMC_CAN01_XIX_TPCHType_CANHS_Flash_DIA_XIX_0x17FC17B1_XIX_0x17FE17B1_XIX_Physical, transmitter=TPN_Hybrid_01_XIX_BMC_CAN01_XIX_402397105:
      ident TPCN_BMC_CAN01_XIX_TPCHType_CANHS_Flash_DIA_XIX_0x17FC17B1_Hybrid_01_XIX_0x17FE17B1_UI2Sens01_XIX_Physical
    can-tp-connection addressing-format=STANDARD, can-tp-channel=TPC_BMC_CAN01_XIX_TPCHType_CANHS_Flash_DIA_XIX_0x17FC17B2_XIX_0x17FE17B2_XIX_Physical, cancellation=true, data-pdu=DIA_UI2Sens02_Req_XIX_BMC_CAN01, flow-control-pdu=DIA_UI2Sens02_Resp_XIX_BMC_CAN01, max-block-size=15, padding-activation=true, receiver=TPN_UI2Sens02_XIX_BMC_CAN01_XIX_402528178, ta-type=PHYSICAL, timeout-br=0.1, timeout-bs=1, timeout-cr=1, timeout-cs=0.2, tp-sdu=DCM_BMC_CAN01_XIX_TPCHType_CANHS_Flash_DIA_XIX_0x17FC17B2_XIX_0x17FE17B2_XIX_Physical, transmitter=TPN_Hybrid_01_XIX_BMC_CAN01_XIX_402397106:
      ident TPCN_BMC_CAN01_XIX_TPCHType_CANHS_Flash_DIA_XIX_0x17FC17B2_Hybrid_01_XIX_0x17FE17B2_UI2Sens02_XIX_Physical
    can-tp-connection addressing-format=STANDARD, can-tp-channel=TPC_BMC_CAN01_XIX_TPCHType_CANHS_Flash_DIA_XIX_0x17FC16D0_XIX_0x17FE16D0_XIX_Physical, cancellation=true, data-pdu=DIA_BJB_Resp_XIX_BMC_CAN01, flow-control-pdu=DIA_BJB_Req_XIX_BMC_CAN01, max-block-size=15, padding-activation=true, receiver=TPN_Hybrid_01_XIX_BMC_CAN01_XIX_402396880, ta-type=PHYSICAL, timeout-br=0.1, timeout-bs=1, timeout-cr=1, timeout-cs=0.2, tp-sdu=DCM_BMC_CAN01_XIX_TPCHType_CANHS_Flash_DIA_XIX_0x17FE16D0_XIX_0x17FC16D0_XIX_Physical, transmitter=TPN_BJB_XIX_BMC_CAN01_XIX_402527952:
      ident TPCN_BMC_CAN01_XIX_TPCHType_CANHS_Flash_DIA_XIX_0x17FE16D0_BJB_XIX_0x17FC16D0_Hybrid_01_XIX_Physical
    can-tp-connection addressing-format=STANDARD, can-tp-channel=TPC_BMC_CAN01_XIX_TPCHType_CANHS_Flash_DIA_XIX_0x17FC17B1_XIX_0x17FE17B1_XIX_Physical, cancellation=true, data-pdu=DIA_UI2Sens01_Resp_XIX_BMC_CAN01, flow-control-pdu=DIA_UI2Sens01_Req_XIX_BMC_CAN01, max-block-size=15, padding-activation=true, receiver=TPN_Hybrid_01_XIX_BMC_CAN01_XIX_402397105, ta-type=PHYSICAL, timeout-br=0.1, timeout-bs=1, timeout-cr=1, timeout-cs=0.2, tp-sdu=DCM_BMC_CAN01_XIX_TPCHType_CANHS_Flash_DIA_XIX_0x17FE17B1_XIX_0x17FC17B1_XIX_Physical, transmitter=TPN_UI2Sens01_XIX_BMC_CAN01_XIX_402528177:
      ident TPCN_BMC_CAN01_XIX_TPCHType_CANHS_Flash_DIA_XIX_0x17FE17B1_UI2Sens01_XIX_0x17FC17B1_Hybrid_01_XIX_Physical
    can-tp-connection addressing-format=STANDARD, can-tp-channel=TPC_BMC_CAN01_XIX_TPCHType_CANHS_Flash_DIA_XIX_0x17FC17B2_XIX_0x17FE17B2_XIX_Physical, cancellation=true, data-pdu=DIA_UI2Sens02_Resp_XIX_BMC_CAN01, flow-control-pdu=DIA_UI2Sens02_Req_XIX_BMC_CAN01, max-block-size=15, padding-activation=true, receiver=TPN_Hybrid_01_XIX_BMC_CAN01_XIX_402397106, ta-type=PHYSICAL, timeout-br=0.1, timeout-bs=1, timeout-cr=1, timeout-cs=0.2, tp-sdu=DCM_BMC_CAN01_XIX_TPCHType_CANHS_Flash_DIA_XIX_0x17FE17B2_XIX_0x17FC17B2_XIX_Physical, transmitter=TPN_UI2Sens02_XIX_BMC_CAN01_XIX_402528178:
      ident TPCN_BMC_CAN01_XIX_TPCHType_CANHS_Flash_DIA_XIX_0x17FE17B2_UI2Sens02_XIX_0x17FC17B2_Hybrid_01_XIX_Physical
    can-tp-connection addressing-format=STANDARD, can-tp-channel=TPC_BMC_CAN01_XIX_TPCHType_CANHS_ISO_Diagnose_XIX_0x700_XIX_Functional, cancellation=true, data-pdu=ISO_Funktionaler_Req_All_XIX_BMC_CAN01, max-block-size=15, multicast=CanTPConfig_BMC_CAN01/TA_0x700, padding-activation=true, receiver=[TPN_BJB_XIX_BMC_CAN01_XIX_402527952, TPN_BJB_XIX_BMC_CAN01_XIX_402528177, TPN_BJB_XIX_BMC_CAN01_XIX_402528178, TPN_UI2Sens01_XIX_BMC_CAN01_XIX_402527952, TPN_UI2Sens01_XIX_BMC_CAN01_XIX_402528177, TPN_UI2Sens01_XIX_BMC_CAN01_XIX_402528178, TPN_UI2Sens02_XIX_BMC_CAN01_XIX_402527952, TPN_UI2Sens02_XIX_BMC_CAN01_XIX_402528177, TPN_UI2Sens02_XIX_BMC_CAN01_XIX_402528178], ta-type=FUNCTIONAL, timeout-br=0.1, timeout-bs=1, timeout-cr=1, timeout-cs=0.2, tp-sdu=DCM_BMC_CAN01_XIX_TPCHType_CANHS_ISO_Diagnose_XIX_0x700_XIX_Functional, transmitter=TPN_Hybrid_01_XIX_BMC_CAN01_XIX_1792:
      ident TPCN_BMC_CAN01_XIX_TPCHType_CANHS_ISO_Diagnose_XIX_0x700_Hybrid_01_XIX_Functional
    can-tp-connection addressing-format=STANDARD, can-tp-channel=TPC_BMC_CAN01_XIX_TPCHType_CANHS_OBDC_Diagnose_XIX_0x17FD0200_XIX_Functional, cancellation=true, data-pdu=OBDC_Funktionaler_Req_All_XIX_BMC_CAN01, max-block-size=15, multicast=TA_0x17FD0200, padding-activation=true, receiver=[TPN_BJB_XIX_BMC_CAN01_XIX_402550992, TPN_BJB_XIX_BMC_CAN01_XIX_402551217, TPN_BJB_XIX_BMC_CAN01_XIX_402551218, TPN_UI2Sens01_XIX_BMC_CAN01_XIX_402550992, TPN_UI2Sens01_XIX_BMC_CAN01_XIX_402551217, TPN_UI2Sens01_XIX_BMC_CAN01_XIX_402551218, TPN_UI2Sens02_XIX_BMC_CAN01_XIX_402550992, TPN_UI2Sens02_XIX_BMC_CAN01_XIX_402551217, TPN_UI2Sens02_XIX_BMC_CAN01_XIX_402551218], ta-type=FUNCTIONAL, timeout-br=0.1, timeout-bs=1, timeout-cr=1, timeout-cs=0.2, tp-sdu=DCM_BMC_CAN01_XIX_TPCHType_CANHS_OBDC_Diagnose_XIX_0x17FD0200_XIX_Functional, transmitter=TPN_Hybrid_01_XIX_BMC_CAN01_XIX_402457088:
      ident TPCN_BMC_CAN01_XIX_TPCHType_CANHS_OBDC_Diagnose_XIX_0x17FD0200_Hybrid_01_XIX_Functional
    can-tp-connection addressing-format=STANDARD, can-tp-channel=TPC_BMC_CAN01_XIX_TPCHType_CANHS_OBDC_SSN_Diagnose_XIX_0x17FC70D0_XIX_0x17FE70D0_XIX_Physical, cancellation=true, data-pdu=OBDC_SSN_BJB_Req_XIX_BMC_CAN01, flow-control-pdu=OBDC_SSN_BJB_Resp_XIX_BMC_CAN01, max-block-size=15, padding-activation=true, receiver=TPN_BJB_XIX_BMC_CAN01_XIX_402550992, ta-type=PHYSICAL, timeout-br=0.1, timeout-bs=1, timeout-cr=1, timeout-cs=0.2, tp-sdu=DCM_BMC_CAN01_XIX_TPCHType_CANHS_OBDC_SSN_Diagnose_XIX_0x17FC70D0_XIX_0x17FE70D0_XIX_Physical, transmitter=TPN_Hybrid_01_XIX_BMC_CAN01_XIX_402419920:
      ident TPCN_BMC_CAN01_XIX_TPCHType_CANHS_OBDC_SSN_Diagnose_XIX_0x17FC70D0_Hybrid_01_XIX_0x17FE70D0_BJB_XIX_Physical
    can-tp-connection addressing-format=STANDARD, can-tp-channel=TPC_BMC_CAN01_XIX_TPCHType_CANHS_OBDC_SSN_Diagnose_XIX_0x17FC71B1_XIX_0x17FE71B1_XIX_Physical, cancellation=true, data-pdu=OBDC_SSN_UI2Sens01_Req_XIX_BMC_CAN01, flow-control-pdu=OBDC_SSN_UI2Sens01_Resp_XIX_BMC_CAN01, max-block-size=15, padding-activation=true, receiver=TPN_UI2Sens01_XIX_BMC_CAN01_XIX_402551217, ta-type=PHYSICAL, timeout-br=0.1, timeout-bs=1, timeout-cr=1, timeout-cs=0.2, tp-sdu=DCM_BMC_CAN01_XIX_TPCHType_CANHS_OBDC_SSN_Diagnose_XIX_0x17FC71B1_XIX_0x17FE71B1_XIX_Physical, transmitter=TPN_Hybrid_01_XIX_BMC_CAN01_XIX_402420145:
      ident TPCN_BMC_CAN01_XIX_TPCHType_CANHS_OBDC_SSN_Diagnose_XIX_0x17FC71B1_Hybrid_01_XIX_0x17FE71B1_UI2Sens01_XIX_Physical
    can-tp-connection addressing-format=STANDARD, can-tp-channel=TPC_BMC_CAN01_XIX_TPCHType_CANHS_OBDC_SSN_Diagnose_XIX_0x17FC71B2_XIX_0x17FE71B2_XIX_Physical, cancellation=true, data-pdu=OBDC_SSN_UI2Sens02_Req_XIX_BMC_CAN01, flow-control-pdu=OBDC_SSN_UI2Sens02_Resp_XIX_BMC_CAN01, max-block-size=15, padding-activation=true, receiver=TPN_UI2Sens02_XIX_BMC_CAN01_XIX_402551218, ta-type=PHYSICAL, timeout-br=0.1, timeout-bs=1, timeout-cr=1, timeout-cs=0.2, tp-sdu=DCM_BMC_CAN01_XIX_TPCHType_CANHS_OBDC_SSN_Diagnose_XIX_0x17FC71B2_XIX_0x17FE71B2_XIX_Physical, transmitter=TPN_Hybrid_01_XIX_BMC_CAN01_XIX_402420146:
      ident TPCN_BMC_CAN01_XIX_TPCHType_CANHS_OBDC_SSN_Diagnose_XIX_0x17FC71B2_Hybrid_01_XIX_0x17FE71B2_UI2Sens02_XIX_Physical
    can-tp-connection addressing-format=STANDARD, can-tp-channel=TPC_BMC_CAN01_XIX_TPCHType_CANHS_OBDC_SSN_Diagnose_XIX_0x17FC70D0_XIX_0x17FE70D0_XIX_Physical, cancellation=true, data-pdu=OBDC_SSN_BJB_Resp_XIX_BMC_CAN01, flow-control-pdu=OBDC_SSN_BJB_Req_XIX_BMC_CAN01, max-block-size=15, padding-activation=true, receiver=TPN_Hybrid_01_XIX_BMC_CAN01_XIX_402419920, ta-type=PHYSICAL, timeout-br=0.1, timeout-bs=1, timeout-cr=1, timeout-cs=0.2, tp-sdu=DCM_BMC_CAN01_XIX_TPCHType_CANHS_OBDC_SSN_Diagnose_XIX_0x17FE70D0_XIX_0x17FC70D0_XIX_Physical, transmitter=TPN_BJB_XIX_BMC_CAN01_XIX_402550992:
      ident TPCN_BMC_CAN01_XIX_TPCHType_CANHS_OBDC_SSN_Diagnose_XIX_0x17FE70D0_BJB_XIX_0x17FC70D0_Hybrid_01_XIX_Physical
    can-tp-connection addressing-format=STANDARD, can-tp-channel=TPC_BMC_CAN01_XIX_TPCHType_CANHS_OBDC_SSN_Diagnose_XIX_0x17FC71B1_XIX_0x17FE71B1_XIX_Physical, cancellation=true, data-pdu=OBDC_SSN_UI2Sens01_Resp_XIX_BMC_CAN01, flow-control-pdu=OBDC_SSN_UI2Sens01_Req_XIX_BMC_CAN01, max-block-size=15, padding-activation=true, receiver=TPN_Hybrid_01_XIX_BMC_CAN01_XIX_402420145, ta-type=PHYSICAL, timeout-br=0.1, timeout-bs=1, timeout-cr=1, timeout-cs=0.2, tp-sdu=DCM_BMC_CAN01_XIX_TPCHType_CANHS_OBDC_SSN_Diagnose_XIX_0x17FE71B1_XIX_0x17FC71B1_XIX_Physical, transmitter=TPN_UI2Sens01_XIX_BMC_CAN01_XIX_402551217:
      ident TPCN_BMC_CAN01_XIX_TPCHType_CANHS_OBDC_SSN_Diagnose_XIX_0x17FE71B1_UI2Sens01_XIX_0x17FC71B1_Hybrid_01_XIX_Physical
    can-tp-connection addressing-format=STANDARD, can-tp-channel=TPC_BMC_CAN01_XIX_TPCHType_CANHS_OBDC_SSN_Diagnose_XIX_0x17FC71B2_XIX_0x17FE71B2_XIX_Physical, cancellation=true, data-pdu=OBDC_SSN_UI2Sens02_Resp_XIX_BMC_CAN01, flow-control-pdu=OBDC_SSN_UI2Sens02_Req_XIX_BMC_CAN01, max-block-size=15, padding-activation=true, receiver=TPN_Hybrid_01_XIX_BMC_CAN01_XIX_402420146, ta-type=PHYSICAL, timeout-br=0.1, timeout-bs=1, timeout-cr=1, timeout-cs=0.2, tp-sdu=DCM_BMC_CAN01_XIX_TPCHType_CANHS_OBDC_SSN_Diagnose_XIX_0x17FE71B2_XIX_0x17FC71B2_XIX_Physical, transmitter=TPN_UI2Sens02_XIX_BMC_CAN01_XIX_402551218:
      ident TPCN_BMC_CAN01_XIX_TPCHType_CANHS_OBDC_SSN_Diagnose_XIX_0x17FE71B2_UI2Sens02_XIX_0x17FC71B2_Hybrid_01_XIX_Physical
    26 x can tp node, all with max-fc-wait=15, st-min=0.005, timeout-ar=1, timeout-as=1:
      TPN_BJB_XIX_BMC_CAN01_XIX_402527952: tp-address=CanTPConfig_BMC_CAN01/TA_0x17FE16D0
      TPN_BJB_XIX_BMC_CAN01_XIX_402528177: tp-address=CanTPConfig_BMC_CAN01/TA_0x17FE17B1
      TPN_BJB_XIX_BMC_CAN01_XIX_402528178: tp-address=CanTPConfig_BMC_CAN01/TA_0x17FE17B2
      TPN_BJB_XIX_BMC_CAN01_XIX_402550992: tp-address=CanTPConfig_BMC_CAN01/TA_0x17FE70D0
      TPN_BJB_XIX_BMC_CAN01_XIX_402551217: tp-address=CanTPConfig_BMC_CAN01/TA_0x17FE71B1
      TPN_BJB_XIX_BMC_CAN01_XIX_402551218: tp-address=CanTPConfig_BMC_CAN01/TA_0x17FE71B2
      TPN_Hybrid_01_XIX_BMC_CAN01_XIX_1792: connector=CN_BMC_CAN01, tp-address=CanTPConfig_BMC_CAN01/TA_0x700
      TPN_Hybrid_01_XIX_BMC_CAN01_XIX_402396880: connector=CN_BMC_CAN01, tp-address=CanTPConfig_BMC_CAN01/TA_0x17FC16D0
      TPN_Hybrid_01_XIX_BMC_CAN01_XIX_402397105: connector=CN_BMC_CAN01, tp-address=CanTPConfig_BMC_CAN01/TA_0x17FC17B1
      TPN_Hybrid_01_XIX_BMC_CAN01_XIX_402397106: connector=CN_BMC_CAN01, tp-address=CanTPConfig_BMC_CAN01/TA_0x17FC17B2
      TPN_Hybrid_01_XIX_BMC_CAN01_XIX_402419920: connector=CN_BMC_CAN01, tp-address=CanTPConfig_BMC_CAN01/TA_0x17FC70D0
      TPN_Hybrid_01_XIX_BMC_CAN01_XIX_402420145: connector=CN_BMC_CAN01, tp-address=CanTPConfig_BMC_CAN01/TA_0x17FC71B1
      TPN_Hybrid_01_XIX_BMC_CAN01_XIX_402420146: connector=CN_BMC_CAN01, tp-address=CanTPConfig_BMC_CAN01/TA_0x17FC71B2
      TPN_Hybrid_01_XIX_BMC_CAN01_XIX_402457088: connector=CN_BMC_CAN01, tp-address=TA_0x17FD0200
      TPN_UI2Sens01_XIX_BMC_CAN01_XIX_402527952: tp-address=CanTPConfig_BMC_CAN01/TA_0x17FE16D0
      TPN_UI2Sens01_XIX_BMC_CAN01_XIX_402528177: tp-address=CanTPConfig_BMC_CAN01/TA_0x17FE17B1
      TPN_UI2Sens01_XIX_BMC_CAN01_XIX_402528178: tp-address=CanTPConfig_BMC_CAN01/TA_0x17FE17B2
      TPN_UI2Sens01_XIX_BMC_CAN01_XIX_402550992: tp-address=CanTPConfig_BMC_CAN01/TA_0x17FE70D0
      TPN_UI2Sens01_XIX_BMC_CAN01_XIX_402551217: tp-address=CanTPConfig_BMC_CAN01/TA_0x17FE71B1
      TPN_UI2Sens01_XIX_BMC_CAN01_XIX_402551218: tp-address=CanTPConfig_BMC_CAN01/TA_0x17FE71B2
      TPN_UI2Sens02_XIX_BMC_CAN01_XIX_402527952: tp-address=CanTPConfig_BMC_CAN01/TA_0x17FE16D0
      TPN_UI2Sens02_XIX_BMC_CAN01_XIX_402528177: tp-address=CanTPConfig_BMC_CAN01/TA_0x17FE17B1
      TPN_UI2Sens02_XIX_BMC_CAN01_XIX_402528178: tp-address=CanTPConfig_BMC_CAN01/TA_0x17FE17B2
      TPN_UI2Sens02_XIX_BMC_CAN01_XIX_402550992: tp-address=CanTPConfig_BMC_CAN01/TA_0x17FE70D0
      TPN_UI2Sens02_XIX_BMC_CAN01_XIX_402551217: tp-address=CanTPConfig_BMC_CAN01/TA_0x17FE71B1
      TPN_UI2Sens02_XIX_BMC_CAN01_XIX_402551218: tp-address=CanTPConfig_BMC_CAN01/TA_0x17FE71B2
package /SecureCommunication
  secure communication props set SecureCommunicationPropsSet
    secure communication authentication props SecureCommunicationAuthenticationProps_XIX_32: category=VW_PROFILE, auth-algorithm=SipHash24, auth-info-tx-length=32
    secure communication authentication props SecureCommunicationAuthenticationProps_Aes128_XIX_32: category=VW_PROFILE, auth-algorithm=AES128, auth-info-tx-length=32
    secure communication authentication props SecureCommunicationAuthenticationProps_XIX_64: category=VW_PROFILE, auth-algorithm=SipHash24, auth-info-tx-length=64
    secure communication freshness props SecureCommunicationFreshnessProps: category=VW_PROFILE, freshness-value-length=64, freshness-value-tx-length=0
package /DiagnosticServices
  5 x diagnostic connection:
    DC_BMC_HV_XIX_TPCHType_CANFD_ISO_Diagnose: functional-request=TPCN_HCP5_CANFD01_XIX_TPCHType_CANFD_ISO_Diagnose_XIX_0x1C410000_Gateway_XIX_Functional, physical-request=TPCN_HCP5_CANFD01_XIX_TPCHType_CANFD_ISO_Diagnose_XIX_0x1C40007B_Gateway_XIX_0x1C42007B_Hybrid_01_XIX_Physical, response=TPCN_HCP5_CANFD01_XIX_TPCHType_CANFD_ISO_Diagnose_XIX_0x1C42007B_Hybrid_01_XIX_0x1C40007B_Gateway_XIX_Physical
    DC_BMC_HV_XIX_TPCHType_CANFD_OBDC_Diagnose: functional-request=TPCN_HCP5_CANFD01_XIX_TPCHType_CANFD_OBDC_Diagnose_XIX_0x1C410200_Gateway_XIX_Functional, physical-request=TPCN_HCP5_CANFD01_XIX_TPCHType_CANFD_OBDC_Diagnose_XIX_0x1C40027B_Gateway_XIX_0x1C42027B_Hybrid_01_XIX_Physical, response=TPCN_HCP5_CANFD01_XIX_TPCHType_CANFD_OBDC_Diagnose_XIX_0x1C42027B_Hybrid_01_XIX_0x1C40027B_Gateway_XIX_Physical
    DC_BMC_HV_XIX_TPCHType_CANHS_ISO_Diagnose:
      functional-request=[TPCN_BMC_CAN01_XIX_TPCHType_CANHS_ISO_Diagnose_XIX_0x700_Hybrid_01_XIX_Functional, TPCN_HCP5_CANFD01_XIX_TPCHType_CANHS_ISO_Diagnose_XIX_0x700_Gateway_XIX_Functional]
      physical-request=TPCN_HCP5_CANFD01_XIX_TPCHType_CANHS_ISO_Diagnose_XIX_0x17FC007B_Gateway_XIX_0x17FE007B_Hybrid_01_XIX_Physical
      response=TPCN_HCP5_CANFD01_XIX_TPCHType_CANHS_ISO_Diagnose_XIX_0x17FE007B_Hybrid_01_XIX_0x17FC007B_Gateway_XIX_Physical
    DC_BMC_HV_XIX_TPCHType_CANHS_OBDC_Diagnose: functional-request=TPCN_BMC_CAN01_XIX_TPCHType_CANHS_OBDC_Diagnose_XIX_0x17FD0200_Hybrid_01_XIX_Functional
    DC_BMC_HV_XIX_TPCHType_CANHS_OBDx: functional-request=TPCN_HCP5_CANFD01_XIX_TPCHType_CANHS_OBDx_XIX_0x18DB33F1_Gateway_XIX_Functional, physical-request=TPCN_HCP5_CANFD01_XIX_TPCHType_CANHS_OBDx_XIX_0x18DA05F1_Gateway_XIX_0x18DAF105_Hybrid_01_XIX_Physical, response=TPCN_HCP5_CANFD01_XIX_TPCHType_CANHS_OBDx_XIX_0x18DAF105_Hybrid_01_XIX_0x18DA05F1_Gateway_XIX_Physical
  diagnostic service table DST_BMC_HV: ecu-instance=BMC_HV
    diagnostic-connections:
      DC_BMC_HV_XIX_TPCHType_CANFD_ISO_Diagnose
      DC_BMC_HV_XIX_TPCHType_CANFD_OBDC_Diagnose
      DC_BMC_HV_XIX_TPCHType_CANHS_ISO_Diagnose
      DC_BMC_HV_XIX_TPCHType_CANHS_OBDC_Diagnose
      DC_BMC_HV_XIX_TPCHType_CANHS_OBDx
