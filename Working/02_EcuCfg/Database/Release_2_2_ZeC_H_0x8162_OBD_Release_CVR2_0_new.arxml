[part 13 of 19: packages /ZeC/DTC/DTC/Power_Path_111_Short_to_BAT_Failure to /ZeC/DTC/DTC/LIN_12_Slave_8_Defect]
AUTOSAR XML (schema 00047)
package /ZeC/DTC/DTC/Power_Path_111_Short_to_BAT_Failure
  diagnostic trouble code uds Power_Path_111_Short_to_BAT_Failure: dtc-props=Dtc_Props_ab1a9d1d, uds-dtc-value=0x00516f
  diagnostic event EventPowerPath111ShortToBATFailure: aging-allowed=true, event-kind=SWC, prestorage-freeze-frame=false  # Event_Power_Path_111_Short_to_BAT_Failure
  diagnostic event to trouble code uds mapping EventDtcMapPowerPath111ShortToBATFailure: diagnostic-event=EventPowerPath111ShortToBATFailure, trouble-code-uds=Power_Path_111_Short_to_BAT_Failure  # Event_Dtc_Map_Power_Path_111_Short_to_BAT_Failure
  diagnostic event to operation cycle mapping EventOperCycleMapPowerPath111ShortToBATFailure: diagnostic-event=EventPowerPath111ShortToBATFailure, operation-cycle=DefaultOperationCycle  # Event_Oper_Cycle_Map_Power_Path_111_Short_to_BAT_Failure
  diagnostic event to debounce algorithm mapping EventDebounceMapPowerPath111ShortToBATFailure: debounce-algorithm=time_based, diagnostic-event=EventPowerPath111ShortToBATFailure  # EventDebounceMap_Power_Path_111_Short_to_BAT_Failure
package /ZeC/DTC/DTC/LIN_20_Slave_6_NoCommunication
  diagnostic trouble code uds LIN_20_Slave_6_NoCommunication: dtc-props=Dtc_Props_358996c7, uds-dtc-value=0x031410  # LIN 20 Slave 6_NoCommunication
  diagnostic event EventLIN20Slave6NoCommunication: aging-allowed=true, event-kind=SWC, prestorage-freeze-frame=false  # Event_LIN 20 Slave 6_NoCommunication
  diagnostic event to trouble code uds mapping EventDtcMapLIN20Slave6NoCommunication: diagnostic-event=EventLIN20Slave6NoCommunication, trouble-code-uds=LIN_20_Slave_6_NoCommunication  # Event_Dtc_Map_LIN 20 Slave 6_NoCommunication
  diagnostic event to operation cycle mapping EventOperCycleMapLIN20Slave6NoCommunication: diagnostic-event=EventLIN20Slave6NoCommunication, operation-cycle=DefaultOperationCycle  # Event_Oper_Cycle_Map_LIN 20 Slave 6_NoCommunication
  diagnostic event to debounce algorithm mapping EventDebounceMapLIN20Slave6NoCommunication: debounce-algorithm=counter_based, diagnostic-event=EventLIN20Slave6NoCommunication  # EventDebounceMap_LIN 20 Slave 6_NoCommunication
package /ZeC/DTC/DTC/Power_Path_108_Short_to_BAT_Failure
  diagnostic trouble code uds Power_Path_108_Short_to_BAT_Failure: dtc-props=Dtc_Props_2e16b98e, uds-dtc-value=0x00516c
  diagnostic event EventPowerPath108ShortToBATFailure: aging-allowed=true, event-kind=SWC, prestorage-freeze-frame=false  # Event_Power_Path_108_Short_to_BAT_Failure
  diagnostic event to trouble code uds mapping EventDtcMapPowerPath108ShortToBATFailure: diagnostic-event=EventPowerPath108ShortToBATFailure, trouble-code-uds=Power_Path_108_Short_to_BAT_Failure  # Event_Dtc_Map_Power_Path_108_Short_to_BAT_Failure
  diagnostic event to operation cycle mapping EventOperCycleMapPowerPath108ShortToBATFailure: diagnostic-event=EventPowerPath108ShortToBATFailure, operation-cycle=DefaultOperationCycle  # Event_Oper_Cycle_Map_Power_Path_108_Short_to_BAT_Failure
  diagnostic event to debounce algorithm mapping EventDebounceMapPowerPath108ShortToBATFailure: debounce-algorithm=time_based, diagnostic-event=EventPowerPath108ShortToBATFailure  # EventDebounceMap_Power_Path_108_Short_to_BAT_Failure
package /ZeC/DTC/DTC/Power_Path_107_Short_to_BAT_Failure
  diagnostic trouble code uds Power_Path_107_Short_to_BAT_Failure: dtc-props=Dtc_Props_680fb3b4, uds-dtc-value=0x00516b
  diagnostic event EventPowerPath107ShortToBATFailure: aging-allowed=true, event-kind=SWC, prestorage-freeze-frame=false  # Event_Power_Path_107_Short_to_BAT_Failure
  diagnostic event to trouble code uds mapping EventDtcMapPowerPath107ShortToBATFailure: diagnostic-event=EventPowerPath107ShortToBATFailure, trouble-code-uds=Power_Path_107_Short_to_BAT_Failure  # Event_Dtc_Map_Power_Path_107_Short_to_BAT_Failure
  diagnostic event to operation cycle mapping EventOperCycleMapPowerPath107ShortToBATFailure: diagnostic-event=EventPowerPath107ShortToBATFailure, operation-cycle=DefaultOperationCycle  # Event_Oper_Cycle_Map_Power_Path_107_Short_to_BAT_Failure
  diagnostic event to debounce algorithm mapping EventDebounceMapPowerPath107ShortToBATFailure: debounce-algorithm=time_based, diagnostic-event=EventPowerPath107ShortToBATFailure  # EventDebounceMap_Power_Path_107_Short_to_BAT_Failure
package /ZeC/DTC/DTC/Power_Path_110_Short_to_BAT_Failure
  diagnostic trouble code uds Power_Path_110_Short_to_BAT_Failure: dtc-props=Dtc_Props_61318353, uds-dtc-value=0x00516e
  diagnostic event EventPowerPath110ShortToBATFailure: aging-allowed=true, event-kind=SWC, prestorage-freeze-frame=false  # Event_Power_Path_110_Short_to_BAT_Failure
  diagnostic event to trouble code uds mapping EventDtcMapPowerPath110ShortToBATFailure: diagnostic-event=EventPowerPath110ShortToBATFailure, trouble-code-uds=Power_Path_110_Short_to_BAT_Failure  # Event_Dtc_Map_Power_Path_110_Short_to_BAT_Failure
  diagnostic event to operation cycle mapping EventOperCycleMapPowerPath110ShortToBATFailure: diagnostic-event=EventPowerPath110ShortToBATFailure, operation-cycle=DefaultOperationCycle  # Event_Oper_Cycle_Map_Power_Path_110_Short_to_BAT_Failure
  diagnostic event to debounce algorithm mapping EventDebounceMapPowerPath110ShortToBATFailure: debounce-algorithm=time_based, diagnostic-event=EventPowerPath110ShortToBATFailure  # EventDebounceMap_Power_Path_110_Short_to_BAT_Failure
package /ZeC/DTC/DTC/Power_Path_109_Short_to_BAT_Failure
  diagnostic trouble code uds Power_Path_109_Short_to_BAT_Failure: dtc-props=Dtc_Props_27288969, uds-dtc-value=0x00516d
  diagnostic event EventPowerPath109ShortToBATFailure: aging-allowed=true, event-kind=SWC, prestorage-freeze-frame=false  # Event_Power_Path_109_Short_to_BAT_Failure
  diagnostic event to trouble code uds mapping EventDtcMapPowerPath109ShortToBATFailure: diagnostic-event=EventPowerPath109ShortToBATFailure, trouble-code-uds=Power_Path_109_Short_to_BAT_Failure  # Event_Dtc_Map_Power_Path_109_Short_to_BAT_Failure
  diagnostic event to operation cycle mapping EventOperCycleMapPowerPath109ShortToBATFailure: diagnostic-event=EventPowerPath109ShortToBATFailure, operation-cycle=DefaultOperationCycle  # Event_Oper_Cycle_Map_Power_Path_109_Short_to_BAT_Failure
  diagnostic event to debounce algorithm mapping EventDebounceMapPowerPath109ShortToBATFailure: debounce-algorithm=time_based, diagnostic-event=EventPowerPath109ShortToBATFailure  # EventDebounceMap_Power_Path_109_Short_to_BAT_Failure
package /ZeC/DTC/DTC/LIN_11_Slave_11_Defect
  diagnostic trouble code uds LIN_11_Slave_11_Defect: dtc-props=Dtc_Props_358996c7, uds-dtc-value=0x030b09  # LIN 11 Slave 11_Defect
  diagnostic event EventLIN11Slave11Defect: aging-allowed=true, event-kind=SWC, prestorage-freeze-frame=false  # Event_LIN 11 Slave 11_Defect
  diagnostic event to trouble code uds mapping EventDtcMapLIN11Slave11Defect: diagnostic-event=EventLIN11Slave11Defect, trouble-code-uds=LIN_11_Slave_11_Defect  # Event_Dtc_Map_LIN 11 Slave 11_Defect
  diagnostic event to operation cycle mapping EventOperCycleMapLIN11Slave11Defect: diagnostic-event=EventLIN11Slave11Defect, operation-cycle=DefaultOperationCycle  # Event_Oper_Cycle_Map_LIN 11 Slave 11_Defect
  diagnostic event to debounce algorithm mapping EventDebounceMapLIN11Slave11Defect: debounce-algorithm=counter_based, diagnostic-event=EventLIN11Slave11Defect  # EventDebounceMap_LIN 11 Slave 11_Defect
package /ZeC/DTC/DTC/Power_Path_112_Short_to_BAT_Failure
  diagnostic trouble code uds Power_Path_112_Short_to_BAT_Failure: dtc-props=Dtc_Props_1f880305, uds-dtc-value=0x005170
  diagnostic event EventPowerPath112ShortToBATFailure: aging-allowed=true, event-kind=SWC, prestorage-freeze-frame=false  # Event_Power_Path_112_Short_to_BAT_Failure
  diagnostic event to trouble code uds mapping EventDtcMapPowerPath112ShortToBATFailure: diagnostic-event=EventPowerPath112ShortToBATFailure, trouble-code-uds=Power_Path_112_Short_to_BAT_Failure  # Event_Dtc_Map_Power_Path_112_Short_to_BAT_Failure
  diagnostic event to operation cycle mapping EventOperCycleMapPowerPath112ShortToBATFailure: diagnostic-event=EventPowerPath112ShortToBATFailure, operation-cycle=DefaultOperationCycle  # Event_Oper_Cycle_Map_Power_Path_112_Short_to_BAT_Failure
  diagnostic event to debounce algorithm mapping EventDebounceMapPowerPath112ShortToBATFailure: debounce-algorithm=time_based, diagnostic-event=EventPowerPath112ShortToBATFailure  # EventDebounceMap_Power_Path_112_Short_to_BAT_Failure
package /ZeC/DTC/DTC/LIN_11_Slave_10_Defect
  diagnostic trouble code uds LIN_11_Slave_10_Defect: dtc-props=Dtc_Props_358996c7, uds-dtc-value=0x030b07  # LIN 11 Slave 10_Defect
  diagnostic event EventLIN11Slave10Defect: aging-allowed=true, event-kind=SWC, prestorage-freeze-frame=false  # Event_LIN 11 Slave 10_Defect
  diagnostic event to trouble code uds mapping EventDtcMapLIN11Slave10Defect: diagnostic-event=EventLIN11Slave10Defect, trouble-code-uds=LIN_11_Slave_10_Defect  # Event_Dtc_Map_LIN 11 Slave 10_Defect
  diagnostic event to operation cycle mapping EventOperCycleMapLIN11Slave10Defect: diagnostic-event=EventLIN11Slave10Defect, operation-cycle=DefaultOperationCycle  # Event_Oper_Cycle_Map_LIN 11 Slave 10_Defect
  diagnostic event to debounce algorithm mapping EventDebounceMapLIN11Slave10Defect: debounce-algorithm=counter_based, diagnostic-event=EventLIN11Slave10Defect  # EventDebounceMap_LIN 11 Slave 10_Defect
package /ZeC/DTC/DTC/Power_Path_114_Short_to_BAT_Failure
  diagnostic trouble code uds Power_Path_114_Short_to_BAT_Failure: dtc-props=Dtc_Props_93ba1771, uds-dtc-value=0x005172
  diagnostic event EventPowerPath114ShortToBATFailure: aging-allowed=true, event-kind=SWC, prestorage-freeze-frame=false  # Event_Power_Path_114_Short_to_BAT_Failure
  diagnostic event to trouble code uds mapping EventDtcMapPowerPath114ShortToBATFailure: diagnostic-event=EventPowerPath114ShortToBATFailure, trouble-code-uds=Power_Path_114_Short_to_BAT_Failure  # Event_Dtc_Map_Power_Path_114_Short_to_BAT_Failure
  diagnostic event to operation cycle mapping EventOperCycleMapPowerPath114ShortToBATFailure: diagnostic-event=EventPowerPath114ShortToBATFailure, operation-cycle=DefaultOperationCycle  # Event_Oper_Cycle_Map_Power_Path_114_Short_to_BAT_Failure
  diagnostic event to debounce algorithm mapping EventDebounceMapPowerPath114ShortToBATFailure: debounce-algorithm=time_based, diagnostic-event=EventPowerPath114ShortToBATFailure  # EventDebounceMap_Power_Path_114_Short_to_BAT_Failure
package /ZeC/DTC/DTC/LIN_11_Slave_10_NoCommunication
  diagnostic trouble code uds LIN_11_Slave_10_NoCommunication: dtc-props=Dtc_Props_358996c7, uds-dtc-value=0x030b08  # LIN 11 Slave 10_NoCommunication
  diagnostic event EventLIN11Slave10NoCommunication: aging-allowed=true, event-kind=SWC, prestorage-freeze-frame=false  # Event_LIN 11 Slave 10_NoCommunication
  diagnostic event to trouble code uds mapping EventDtcMapLIN11Slave10NoCommunication: diagnostic-event=EventLIN11Slave10NoCommunication, trouble-code-uds=LIN_11_Slave_10_NoCommunication  # Event_Dtc_Map_LIN 11 Slave 10_NoCommunication
  diagnostic event to operation cycle mapping EventOperCycleMapLIN11Slave10NoCommunication: diagnostic-event=EventLIN11Slave10NoCommunication, operation-cycle=DefaultOperationCycle  # Event_Oper_Cycle_Map_LIN 11 Slave 10_NoCommunication
  diagnostic event to debounce algorithm mapping EventDebounceMapLIN11Slave10NoCommunication: debounce-algorithm=counter_based, diagnostic-event=EventLIN11Slave10NoCommunication  # EventDebounceMap_LIN 11 Slave 10_NoCommunication
package /ZeC/DTC/DTC/Power_Path_113_Short_to_BAT_Failure
  diagnostic trouble code uds Power_Path_113_Short_to_BAT_Failure: dtc-props=Dtc_Props_5991093f, uds-dtc-value=0x005171
  diagnostic event EventPowerPath113ShortToBATFailure: aging-allowed=true, event-kind=SWC, prestorage-freeze-frame=false  # Event_Power_Path_113_Short_to_BAT_Failure
  diagnostic event to trouble code uds mapping EventDtcMapPowerPath113ShortToBATFailure: diagnostic-event=EventPowerPath113ShortToBATFailure, trouble-code-uds=Power_Path_113_Short_to_BAT_Failure  # Event_Dtc_Map_Power_Path_113_Short_to_BAT_Failure
  diagnostic event to operation cycle mapping EventOperCycleMapPowerPath113ShortToBATFailure: diagnostic-event=EventPowerPath113ShortToBATFailure, operation-cycle=DefaultOperationCycle  # Event_Oper_Cycle_Map_Power_Path_113_Short_to_BAT_Failure
  diagnostic event to debounce algorithm mapping EventDebounceMapPowerPath113ShortToBATFailure: debounce-algorithm=time_based, diagnostic-event=EventPowerPath113ShortToBATFailure  # EventDebounceMap_Power_Path_113_Short_to_BAT_Failure
package /ZeC/DTC/DTC/LIN_20_Slave_12_NoCommunication
  diagnostic trouble code uds LIN_20_Slave_12_NoCommunication: dtc-props=Dtc_Props_358996c7, uds-dtc-value=0x03141e  # LIN 20 Slave 12_NoCommunication
  diagnostic event EventLIN20Slave12NoCommunication: aging-allowed=true, event-kind=SWC, prestorage-freeze-frame=false  # Event_LIN 20 Slave 12_NoCommunication
  diagnostic event to trouble code uds mapping EventDtcMapLIN20Slave12NoCommunication: diagnostic-event=EventLIN20Slave12NoCommunication, trouble-code-uds=LIN_20_Slave_12_NoCommunication  # Event_Dtc_Map_LIN 20 Slave 12_NoCommunication
  diagnostic event to operation cycle mapping EventOperCycleMapLIN20Slave12NoCommunication: diagnostic-event=EventLIN20Slave12NoCommunication, operation-cycle=DefaultOperationCycle  # Event_Oper_Cycle_Map_LIN 20 Slave 12_NoCommunication
  diagnostic event to debounce algorithm mapping EventDebounceMapLIN20Slave12NoCommunication: debounce-algorithm=counter_based, diagnostic-event=EventLIN20Slave12NoCommunication  # EventDebounceMap_LIN 20 Slave 12_NoCommunication
package /ZeC/DTC/DTC/LIN_11_Slave_1_Defect
  diagnostic trouble code uds LIN_11_Slave_1_Defect: dtc-props=Dtc_Props_358996c7, uds-dtc-value=0x030b05  # LIN 11 Slave 1_Defect
  diagnostic event EventLIN11Slave1Defect: aging-allowed=true, event-kind=SWC, prestorage-freeze-frame=false  # Event_LIN 11 Slave 1_Defect
  diagnostic event to trouble code uds mapping EventDtcMapLIN11Slave1Defect: diagnostic-event=EventLIN11Slave1Defect, trouble-code-uds=LIN_11_Slave_1_Defect  # Event_Dtc_Map_LIN 11 Slave 1_Defect
  diagnostic event to operation cycle mapping EventOperCycleMapLIN11Slave1Defect: diagnostic-event=EventLIN11Slave1Defect, operation-cycle=DefaultOperationCycle  # Event_Oper_Cycle_Map_LIN 11 Slave 1_Defect
  diagnostic event to debounce algorithm mapping EventDebounceMapLIN11Slave1Defect: debounce-algorithm=counter_based, diagnostic-event=EventLIN11Slave1Defect  # EventDebounceMap_LIN 11 Slave 1_Defect
package /ZeC/DTC/DTC/LIN_11_Slave_1_NoCommunication
  diagnostic trouble code uds LIN_11_Slave_1_NoCommunication: dtc-props=Dtc_Props_358996c7, uds-dtc-value=0x030b06  # LIN 11 Slave 1_NoCommunication
  diagnostic event EventLIN11Slave1NoCommunication: aging-allowed=true, event-kind=SWC, prestorage-freeze-frame=false  # Event_LIN 11 Slave 1_NoCommunication
  diagnostic event to trouble code uds mapping EventDtcMapLIN11Slave1NoCommunication: diagnostic-event=EventLIN11Slave1NoCommunication, trouble-code-uds=LIN_11_Slave_1_NoCommunication  # Event_Dtc_Map_LIN 11 Slave 1_NoCommunication
  diagnostic event to operation cycle mapping EventOperCycleMapLIN11Slave1NoCommunication: diagnostic-event=EventLIN11Slave1NoCommunication, operation-cycle=DefaultOperationCycle  # Event_Oper_Cycle_Map_LIN 11 Slave 1_NoCommunication
  diagnostic event to debounce algorithm mapping EventDebounceMapLIN11Slave1NoCommunication: debounce-algorithm=counter_based, diagnostic-event=EventLIN11Slave1NoCommunication  # EventDebounceMap_LIN 11 Slave 1_NoCommunication
package /ZeC/DTC/DTC/LIN_20_Slave_11_NoCommunication
  diagnostic trouble code uds LIN_20_Slave_11_NoCommunication: dtc-props=Dtc_Props_358996c7, uds-dtc-value=0x03141c  # LIN 20 Slave 11_NoCommunication
  diagnostic event EventLIN20Slave11NoCommunication: aging-allowed=true, event-kind=SWC, prestorage-freeze-frame=false  # Event_LIN 20 Slave 11_NoCommunication
  diagnostic event to trouble code uds mapping EventDtcMapLIN20Slave11NoCommunication: diagnostic-event=EventLIN20Slave11NoCommunication, trouble-code-uds=LIN_20_Slave_11_NoCommunication  # Event_Dtc_Map_LIN 20 Slave 11_NoCommunication
  diagnostic event to operation cycle mapping EventOperCycleMapLIN20Slave11NoCommunication: diagnostic-event=EventLIN20Slave11NoCommunication, operation-cycle=DefaultOperationCycle  # Event_Oper_Cycle_Map_LIN 20 Slave 11_NoCommunication
  diagnostic event to debounce algorithm mapping EventDebounceMapLIN20Slave11NoCommunication: debounce-algorithm=counter_based, diagnostic-event=EventLIN20Slave11NoCommunication  # EventDebounceMap_LIN 20 Slave 11_NoCommunication
package /ZeC/DTC/DTC/LIN_11_Slave_9_Defect
  diagnostic trouble code uds LIN_11_Slave_9_Defect: dtc-props=Dtc_Props_358996c7, uds-dtc-value=0x030b03  # LIN 11 Slave 9_Defect
  diagnostic event EventLIN11Slave9Defect: aging-allowed=true, event-kind=SWC, prestorage-freeze-frame=false  # Event_LIN 11 Slave 9_Defect
  diagnostic event to trouble code uds mapping EventDtcMapLIN11Slave9Defect: diagnostic-event=EventLIN11Slave9Defect, trouble-code-uds=LIN_11_Slave_9_Defect  # Event_Dtc_Map_LIN 11 Slave 9_Defect
  diagnostic event to operation cycle mapping EventOperCycleMapLIN11Slave9Defect: diagnostic-event=EventLIN11Slave9Defect, operation-cycle=DefaultOperationCycle  # Event_Oper_Cycle_Map_LIN 11 Slave 9_Defect
  diagnostic event to debounce algorithm mapping EventDebounceMapLIN11Slave9Defect: debounce-algorithm=counter_based, diagnostic-event=EventLIN11Slave9Defect  # EventDebounceMap_LIN 11 Slave 9_Defect
package /ZeC/DTC/DTC/LIN_20_Slave_12_Defect
  diagnostic trouble code uds LIN_20_Slave_12_Defect: dtc-props=Dtc_Props_358996c7, uds-dtc-value=0x03141d  # LIN 20 Slave 12_Defect
  diagnostic event EventLIN20Slave12Defect: aging-allowed=true, event-kind=SWC, prestorage-freeze-frame=false  # Event_LIN 20 Slave 12_Defect
  diagnostic event to trouble code uds mapping EventDtcMapLIN20Slave12Defect: diagnostic-event=EventLIN20Slave12Defect, trouble-code-uds=LIN_20_Slave_12_Defect  # Event_Dtc_Map_LIN 20 Slave 12_Defect
  diagnostic event to operation cycle mapping EventOperCycleMapLIN20Slave12Defect: diagnostic-event=EventLIN20Slave12Defect, operation-cycle=DefaultOperationCycle  # Event_Oper_Cycle_Map_LIN 20 Slave 12_Defect
  diagnostic event to debounce algorithm mapping EventDebounceMapLIN20Slave12Defect: debounce-algorithm=counter_based, diagnostic-event=EventLIN20Slave12Defect  # EventDebounceMap_LIN 20 Slave 12_Defect
package /ZeC/DTC/DTC/LIN_11_Slave_9_NoCommunication
  diagnostic trouble code uds LIN_11_Slave_9_NoCommunication: dtc-props=Dtc_Props_358996c7, uds-dtc-value=0x030b04  # LIN 11 Slave 9_NoCommunication
  diagnostic event EventLIN11Slave9NoCommunication: aging-allowed=true, event-kind=SWC, prestorage-freeze-frame=false  # Event_LIN 11 Slave 9_NoCommunication
  diagnostic event to trouble code uds mapping EventDtcMapLIN11Slave9NoCommunication: diagnostic-event=EventLIN11Slave9NoCommunication, trouble-code-uds=LIN_11_Slave_9_NoCommunication  # Event_Dtc_Map_LIN 11 Slave 9_NoCommunication
  diagnostic event to operation cycle mapping EventOperCycleMapLIN11Slave9NoCommunication: diagnostic-event=EventLIN11Slave9NoCommunication, operation-cycle=DefaultOperationCycle  # Event_Oper_Cycle_Map_LIN 11 Slave 9_NoCommunication
  diagnostic event to debounce algorithm mapping EventDebounceMapLIN11Slave9NoCommunication: debounce-algorithm=counter_based, diagnostic-event=EventLIN11Slave9NoCommunication  # EventDebounceMap_LIN 11 Slave 9_NoCommunication
package /ZeC/DTC/DTC/LIN_20_Slave_10_NoCommunication
  diagnostic trouble code uds LIN_20_Slave_10_NoCommunication: dtc-props=Dtc_Props_358996c7, uds-dtc-value=0x03141a  # LIN 20 Slave 10_NoCommunication
  diagnostic event EventLIN20Slave10NoCommunication: aging-allowed=true, event-kind=SWC, prestorage-freeze-frame=false  # Event_LIN 20 Slave 10_NoCommunication
  diagnostic event to trouble code uds mapping EventDtcMapLIN20Slave10NoCommunication: diagnostic-event=EventLIN20Slave10NoCommunication, trouble-code-uds=LIN_20_Slave_10_NoCommunication  # Event_Dtc_Map_LIN 20 Slave 10_NoCommunication
  diagnostic event to operation cycle mapping EventOperCycleMapLIN20Slave10NoCommunication: diagnostic-event=EventLIN20Slave10NoCommunication, operation-cycle=DefaultOperationCycle  # Event_Oper_Cycle_Map_LIN 20 Slave 10_NoCommunication
  diagnostic event to debounce algorithm mapping EventDebounceMapLIN20Slave10NoCommunication: debounce-algorithm=counter_based, diagnostic-event=EventLIN20Slave10NoCommunication  # EventDebounceMap_LIN 20 Slave 10_NoCommunication
package /ZeC/DTC/DTC/LIN_11_Slave_8_Defect
  diagnostic trouble code uds LIN_11_Slave_8_Defect: dtc-props=Dtc_Props_358996c7, uds-dtc-value=0x030b01  # LIN 11 Slave 8_Defect
  diagnostic event EventLIN11Slave8Defect: aging-allowed=true, event-kind=SWC, prestorage-freeze-frame=false  # Event_LIN 11 Slave 8_Defect
  diagnostic event to trouble code uds mapping EventDtcMapLIN11Slave8Defect: diagnostic-event=EventLIN11Slave8Defect, trouble-code-uds=LIN_11_Slave_8_Defect  # Event_Dtc_Map_LIN 11 Slave 8_Defect
  diagnostic event to operation cycle mapping EventOperCycleMapLIN11Slave8Defect: diagnostic-event=EventLIN11Slave8Defect, operation-cycle=DefaultOperationCycle  # Event_Oper_Cycle_Map_LIN 11 Slave 8_Defect
  diagnostic event to debounce algorithm mapping EventDebounceMapLIN11Slave8Defect: debounce-algorithm=counter_based, diagnostic-event=EventLIN11Slave8Defect  # EventDebounceMap_LIN 11 Slave 8_Defect
package /ZeC/DTC/DTC/Power_Path_120_Short_to_BAT_Failure
  diagnostic trouble code uds Power_Path_120_Short_to_BAT_Failure: dtc-props=Dtc_Props_42d35816, uds-dtc-value=0x005178
  diagnostic event EventPowerPath120ShortToBATFailure: aging-allowed=true, event-kind=SWC, prestorage-freeze-frame=false  # Event_Power_Path_120_Short_to_BAT_Failure
  diagnostic event to trouble code uds mapping EventDtcMapPowerPath120ShortToBATFailure: diagnostic-event=EventPowerPath120ShortToBATFailure, trouble-code-uds=Power_Path_120_Short_to_BAT_Failure  # Event_Dtc_Map_Power_Path_120_Short_to_BAT_Failure
  diagnostic event to operation cycle mapping EventOperCycleMapPowerPath120ShortToBATFailure: diagnostic-event=EventPowerPath120ShortToBATFailure, operation-cycle=DefaultOperationCycle  # Event_Oper_Cycle_Map_Power_Path_120_Short_to_BAT_Failure
  diagnostic event to debounce algorithm mapping EventDebounceMapPowerPath120ShortToBATFailure: debounce-algorithm=time_based, diagnostic-event=EventPowerPath120ShortToBATFailure  # EventDebounceMap_Power_Path_120_Short_to_BAT_Failure
package /ZeC/DTC/DTC/LIN_20_Slave_11_Defect
  diagnostic trouble code uds LIN_20_Slave_11_Defect: dtc-props=Dtc_Props_358996c7, uds-dtc-value=0x03141b  # LIN 20 Slave 11_Defect
  diagnostic event EventLIN20Slave11Defect: aging-allowed=true, event-kind=SWC, prestorage-freeze-frame=false  # Event_LIN 20 Slave 11_Defect
  diagnostic event to trouble code uds mapping EventDtcMapLIN20Slave11Defect: diagnostic-event=EventLIN20Slave11Defect, trouble-code-uds=LIN_20_Slave_11_Defect  # Event_Dtc_Map_LIN 20 Slave 11_Defect
  diagnostic event to operation cycle mapping EventOperCycleMapLIN20Slave11Defect: diagnostic-event=EventLIN20Slave11Defect, operation-cycle=DefaultOperationCycle  # Event_Oper_Cycle_Map_LIN 20 Slave 11_Defect
  diagnostic event to debounce algorithm mapping EventDebounceMapLIN20Slave11Defect: debounce-algorithm=counter_based, diagnostic-event=EventLIN20Slave11Defect  # EventDebounceMap_LIN 20 Slave 11_Defect
package /ZeC/DTC/DTC/LIN_11_Slave_8_NoCommunication
  diagnostic trouble code uds LIN_11_Slave_8_NoCommunication: dtc-props=Dtc_Props_358996c7, uds-dtc-value=0x030b02  # LIN 11 Slave 8_NoCommunication
  diagnostic event EventLIN11Slave8NoCommunication: aging-allowed=true, event-kind=SWC, prestorage-freeze-frame=false  # Event_LIN 11 Slave 8_NoCommunication
  diagnostic event to trouble code uds mapping EventDtcMapLIN11Slave8NoCommunication: diagnostic-event=EventLIN11Slave8NoCommunication, trouble-code-uds=LIN_11_Slave_8_NoCommunication  # Event_Dtc_Map_LIN 11 Slave 8_NoCommunication
  diagnostic event to operation cycle mapping EventOperCycleMapLIN11Slave8NoCommunication: diagnostic-event=EventLIN11Slave8NoCommunication, operation-cycle=DefaultOperationCycle  # Event_Oper_Cycle_Map_LIN 11 Slave 8_NoCommunication
  diagnostic event to debounce algorithm mapping EventDebounceMapLIN11Slave8NoCommunication: debounce-algorithm=counter_based, diagnostic-event=EventLIN11Slave8NoCommunication  # EventDebounceMap_LIN 11 Slave 8_NoCommunication
package /ZeC/DTC/DTC/Power_Path_119_Short_to_BAT_Failure
  diagnostic trouble code uds Power_Path_119_Short_to_BAT_Failure: dtc-props=Dtc_Props_16b633e2, uds-dtc-value=0x005177
  diagnostic event EventPowerPath119ShortToBATFailure: aging-allowed=true, event-kind=SWC, prestorage-freeze-frame=false  # Event_Power_Path_119_Short_to_BAT_Failure
  diagnostic event to trouble code uds mapping EventDtcMapPowerPath119ShortToBATFailure: diagnostic-event=EventPowerPath119ShortToBATFailure, trouble-code-uds=Power_Path_119_Short_to_BAT_Failure  # Event_Dtc_Map_Power_Path_119_Short_to_BAT_Failure
  diagnostic event to operation cycle mapping EventOperCycleMapPowerPath119ShortToBATFailure: diagnostic-event=EventPowerPath119ShortToBATFailure, operation-cycle=DefaultOperationCycle  # Event_Oper_Cycle_Map_Power_Path_119_Short_to_BAT_Failure
  diagnostic event to debounce algorithm mapping EventDebounceMapPowerPath119ShortToBATFailure: debounce-algorithm=time_based, diagnostic-event=EventPowerPath119ShortToBATFailure  # EventDebounceMap_Power_Path_119_Short_to_BAT_Failure
package /ZeC/DTC/DTC/Power_Path_121_Short_to_BAT_Failure
  diagnostic trouble code uds Power_Path_121_Short_to_BAT_Failure: dtc-props=Dtc_Props_4ca522c, uds-dtc-value=0x005179
  diagnostic event EventPowerPath121ShortToBATFailure: aging-allowed=true, event-kind=SWC, prestorage-freeze-frame=false  # Event_Power_Path_121_Short_to_BAT_Failure
  diagnostic event to trouble code uds mapping EventDtcMapPowerPath121ShortToBATFailure: diagnostic-event=EventPowerPath121ShortToBATFailure, trouble-code-uds=Power_Path_121_Short_to_BAT_Failure  # Event_Dtc_Map_Power_Path_121_Short_to_BAT_Failure
  diagnostic event to operation cycle mapping EventOperCycleMapPowerPath121ShortToBATFailure: diagnostic-event=EventPowerPath121ShortToBATFailure, operation-cycle=DefaultOperationCycle  # Event_Oper_Cycle_Map_Power_Path_121_Short_to_BAT_Failure
  diagnostic event to debounce algorithm mapping EventDebounceMapPowerPath121ShortToBATFailure: debounce-algorithm=time_based, diagnostic-event=EventPowerPath121ShortToBATFailure  # EventDebounceMap_Power_Path_121_Short_to_BAT_Failure
package /ZeC/DTC/DTC/Power_Path_116_Short_to_BAT_Failure
  diagnostic trouble code uds Power_Path_116_Short_to_BAT_Failure: dtc-props=Dtc_Props_dc9d2dac, uds-dtc-value=0x005174
  diagnostic event EventPowerPath116ShortToBATFailure: aging-allowed=true, event-kind=SWC, prestorage-freeze-frame=false  # Event_Power_Path_116_Short_to_BAT_Failure
  diagnostic event to trouble code uds mapping EventDtcMapPowerPath116ShortToBATFailure: diagnostic-event=EventPowerPath116ShortToBATFailure, trouble-code-uds=Power_Path_116_Short_to_BAT_Failure  # Event_Dtc_Map_Power_Path_116_Short_to_BAT_Failure
  diagnostic event to operation cycle mapping EventOperCycleMapPowerPath116ShortToBATFailure: diagnostic-event=EventPowerPath116ShortToBATFailure, operation-cycle=DefaultOperationCycle  # Event_Oper_Cycle_Map_Power_Path_116_Short_to_BAT_Failure
  diagnostic event to debounce algorithm mapping EventDebounceMapPowerPath116ShortToBATFailure: debounce-algorithm=time_based, diagnostic-event=EventPowerPath116ShortToBATFailure  # EventDebounceMap_Power_Path_116_Short_to_BAT_Failure
package /ZeC/DTC/DTC/Power_Path_115_Short_to_BAT_Failure
  diagnostic trouble code uds Power_Path_115_Short_to_BAT_Failure: dtc-props=Dtc_Props_d5a31d4b, uds-dtc-value=0x005173
  diagnostic event EventPowerPath115ShortToBATFailure: aging-allowed=true, event-kind=SWC, prestorage-freeze-frame=false  # Event_Power_Path_115_Short_to_BAT_Failure
  diagnostic event to trouble code uds mapping EventDtcMapPowerPath115ShortToBATFailure: diagnostic-event=EventPowerPath115ShortToBATFailure, trouble-code-uds=Power_Path_115_Short_to_BAT_Failure  # Event_Dtc_Map_Power_Path_115_Short_to_BAT_Failure
  diagnostic event to operation cycle mapping EventOperCycleMapPowerPath115ShortToBATFailure: diagnostic-event=EventPowerPath115ShortToBATFailure, operation-cycle=DefaultOperationCycle  # Event_Oper_Cycle_Map_Power_Path_115_Short_to_BAT_Failure
  diagnostic event to debounce algorithm mapping EventDebounceMapPowerPath115ShortToBATFailure: debounce-algorithm=time_based, diagnostic-event=EventPowerPath115ShortToBATFailure  # EventDebounceMap_Power_Path_115_Short_to_BAT_Failure
package /ZeC/DTC/DTC/Power_Path_118_Short_to_BAT_Failure
  diagnostic trouble code uds Power_Path_118_Short_to_BAT_Failure: dtc-props=Dtc_Props_50af39d8, uds-dtc-value=0x005176
  diagnostic event EventPowerPath118ShortToBATFailure: aging-allowed=true, event-kind=SWC, prestorage-freeze-frame=false  # Event_Power_Path_118_Short_to_BAT_Failure
  diagnostic event to trouble code uds mapping EventDtcMapPowerPath118ShortToBATFailure: diagnostic-event=EventPowerPath118ShortToBATFailure, trouble-code-uds=Power_Path_118_Short_to_BAT_Failure  # Event_Dtc_Map_Power_Path_118_Short_to_BAT_Failure
  diagnostic event to operation cycle mapping EventOperCycleMapPowerPath118ShortToBATFailure: diagnostic-event=EventPowerPath118ShortToBATFailure, operation-cycle=DefaultOperationCycle  # Event_Oper_Cycle_Map_Power_Path_118_Short_to_BAT_Failure
  diagnostic event to debounce algorithm mapping EventDebounceMapPowerPath118ShortToBATFailure: debounce-algorithm=time_based, diagnostic-event=EventPowerPath118ShortToBATFailure  # EventDebounceMap_Power_Path_118_Short_to_BAT_Failure
package /ZeC/DTC/DTC/Power_Path_117_Short_to_BAT_Failure
  diagnostic trouble code uds Power_Path_117_Short_to_BAT_Failure: dtc-props=Dtc_Props_9a842796, uds-dtc-value=0x005175
  diagnostic event EventPowerPath117ShortToBATFailure: aging-allowed=true, event-kind=SWC, prestorage-freeze-frame=false  # Event_Power_Path_117_Short_to_BAT_Failure
  diagnostic event to trouble code uds mapping EventDtcMapPowerPath117ShortToBATFailure: diagnostic-event=EventPowerPath117ShortToBATFailure, trouble-code-uds=Power_Path_117_Short_to_BAT_Failure  # Event_Dtc_Map_Power_Path_117_Short_to_BAT_Failure
  diagnostic event to operation cycle mapping EventOperCycleMapPowerPath117ShortToBATFailure: diagnostic-event=EventPowerPath117ShortToBATFailure, operation-cycle=DefaultOperationCycle  # Event_Oper_Cycle_Map_Power_Path_117_Short_to_BAT_Failure
  diagnostic event to debounce algorithm mapping EventDebounceMapPowerPath117ShortToBATFailure: debounce-algorithm=time_based, diagnostic-event=EventPowerPath117ShortToBATFailure  # EventDebounceMap_Power_Path_117_Short_to_BAT_Failure
package /ZeC/DTC/DTC/LIN_11_Slave_13_NoCommunication
  diagnostic trouble code uds LIN_11_Slave_13_NoCommunication: dtc-props=Dtc_Props_358996c7, uds-dtc-value=0x030b0e  # LIN 11 Slave 13_NoCommunication
  diagnostic event EventLIN11Slave13NoCommunication: aging-allowed=true, event-kind=SWC, prestorage-freeze-frame=false  # Event_LIN 11 Slave 13_NoCommunication
  diagnostic event to trouble code uds mapping EventDtcMapLIN11Slave13NoCommunication: diagnostic-event=EventLIN11Slave13NoCommunication, trouble-code-uds=LIN_11_Slave_13_NoCommunication  # Event_Dtc_Map_LIN 11 Slave 13_NoCommunication
  diagnostic event to operation cycle mapping EventOperCycleMapLIN11Slave13NoCommunication: diagnostic-event=EventLIN11Slave13NoCommunication, operation-cycle=DefaultOperationCycle  # Event_Oper_Cycle_Map_LIN 11 Slave 13_NoCommunication
  diagnostic event to debounce algorithm mapping EventDebounceMapLIN11Slave13NoCommunication: debounce-algorithm=counter_based, diagnostic-event=EventLIN11Slave13NoCommunication  # EventDebounceMap_LIN 11 Slave 13_NoCommunication
package /ZeC/DTC/DTC/LIN_11_Slave_14_Defect
  diagnostic trouble code uds LIN_11_Slave_14_Defect: dtc-props=Dtc_Props_358996c7, uds-dtc-value=0x030b0f  # LIN 11 Slave 14_Defect
  diagnostic event EventLIN11Slave14Defect: aging-allowed=true, event-kind=SWC, prestorage-freeze-frame=false  # Event_LIN 11 Slave 14_Defect
  diagnostic event to trouble code uds mapping EventDtcMapLIN11Slave14Defect: diagnostic-event=EventLIN11Slave14Defect, trouble-code-uds=LIN_11_Slave_14_Defect  # Event_Dtc_Map_LIN 11 Slave 14_Defect
  diagnostic event to operation cycle mapping EventOperCycleMapLIN11Slave14Defect: diagnostic-event=EventLIN11Slave14Defect, operation-cycle=DefaultOperationCycle  # Event_Oper_Cycle_Map_LIN 11 Slave 14_Defect
  diagnostic event to debounce algorithm mapping EventDebounceMapLIN11Slave14Defect: debounce-algorithm=counter_based, diagnostic-event=EventLIN11Slave14Defect  # EventDebounceMap_LIN 11 Slave 14_Defect
package /ZeC/DTC/DTC/Power_Path_089_Short_to_BAT_Failure
  diagnostic trouble code uds Power_Path_089_Short_to_BAT_Failure: dtc-props=Dtc_Props_532ed51d, uds-dtc-value=0x005159
  diagnostic event EventPowerPath089ShortToBATFailure: aging-allowed=true, event-kind=SWC, prestorage-freeze-frame=false  # Event_Power_Path_089_Short_to_BAT_Failure
  diagnostic event to trouble code uds mapping EventDtcMapPowerPath089ShortToBATFailure: diagnostic-event=EventPowerPath089ShortToBATFailure, trouble-code-uds=Power_Path_089_Short_to_BAT_Failure  # Event_Dtc_Map_Power_Path_089_Short_to_BAT_Failure
  diagnostic event to operation cycle mapping EventOperCycleMapPowerPath089ShortToBATFailure: diagnostic-event=EventPowerPath089ShortToBATFailure, operation-cycle=DefaultOperationCycle  # Event_Oper_Cycle_Map_Power_Path_089_Short_to_BAT_Failure
  diagnostic event to debounce algorithm mapping EventDebounceMapPowerPath089ShortToBATFailure: debounce-algorithm=time_based, diagnostic-event=EventPowerPath089ShortToBATFailure  # EventDebounceMap_Power_Path_089_Short_to_BAT_Failure
package /ZeC/DTC/DTC/LIN_11_Slave_12_NoCommunication
  diagnostic trouble code uds LIN_11_Slave_12_NoCommunication: dtc-props=Dtc_Props_358996c7, uds-dtc-value=0x030b0c  # LIN 11 Slave 12_NoCommunication
  diagnostic event EventLIN11Slave12NoCommunication: aging-allowed=true, event-kind=SWC, prestorage-freeze-frame=false  # Event_LIN 11 Slave 12_NoCommunication
  diagnostic event to trouble code uds mapping EventDtcMapLIN11Slave12NoCommunication: diagnostic-event=EventLIN11Slave12NoCommunication, trouble-code-uds=LIN_11_Slave_12_NoCommunication  # Event_Dtc_Map_LIN 11 Slave 12_NoCommunication
  diagnostic event to operation cycle mapping EventOperCycleMapLIN11Slave12NoCommunication: diagnostic-event=EventLIN11Slave12NoCommunication, operation-cycle=DefaultOperationCycle  # Event_Oper_Cycle_Map_LIN 11 Slave 12_NoCommunication
  diagnostic event to debounce algorithm mapping EventDebounceMapLIN11Slave12NoCommunication: debounce-algorithm=counter_based, diagnostic-event=EventLIN11Slave12NoCommunication  # EventDebounceMap_LIN 11 Slave 12_NoCommunication
package /ZeC/DTC/DTC/LIN_11_Slave_13_Defect
  diagnostic trouble code uds LIN_11_Slave_13_Defect: dtc-props=Dtc_Props_358996c7, uds-dtc-value=0x030b0d  # LIN 11 Slave 13_Defect
  diagnostic event EventLIN11Slave13Defect: aging-allowed=true, event-kind=SWC, prestorage-freeze-frame=false  # Event_LIN 11 Slave 13_Defect
  diagnostic event to trouble code uds mapping EventDtcMapLIN11Slave13Defect: diagnostic-event=EventLIN11Slave13Defect, trouble-code-uds=LIN_11_Slave_13_Defect  # Event_Dtc_Map_LIN 11 Slave 13_Defect
  diagnostic event to operation cycle mapping EventOperCycleMapLIN11Slave13Defect: diagnostic-event=EventLIN11Slave13Defect, operation-cycle=DefaultOperationCycle  # Event_Oper_Cycle_Map_LIN 11 Slave 13_Defect
  diagnostic event to debounce algorithm mapping EventDebounceMapLIN11Slave13Defect: debounce-algorithm=counter_based, diagnostic-event=EventLIN11Slave13Defect  # EventDebounceMap_LIN 11 Slave 13_Defect
package /ZeC/DTC/DTC/LIN_11_Slave_11_NoCommunication
  diagnostic trouble code uds LIN_11_Slave_11_NoCommunication: dtc-props=Dtc_Props_358996c7, uds-dtc-value=0x030b0a  # LIN 11 Slave 11_NoCommunication
  diagnostic event EventLIN11Slave11NoCommunication: aging-allowed=true, event-kind=SWC, prestorage-freeze-frame=false  # Event_LIN 11 Slave 11_NoCommunication
  diagnostic event to trouble code uds mapping EventDtcMapLIN11Slave11NoCommunication: diagnostic-event=EventLIN11Slave11NoCommunication, trouble-code-uds=LIN_11_Slave_11_NoCommunication  # Event_Dtc_Map_LIN 11 Slave 11_NoCommunication
  diagnostic event to operation cycle mapping EventOperCycleMapLIN11Slave11NoCommunication: diagnostic-event=EventLIN11Slave11NoCommunication, operation-cycle=DefaultOperationCycle  # Event_Oper_Cycle_Map_LIN 11 Slave 11_NoCommunication
  diagnostic event to debounce algorithm mapping EventDebounceMapLIN11Slave11NoCommunication: debounce-algorithm=counter_based, diagnostic-event=EventLIN11Slave11NoCommunication  # EventDebounceMap_LIN 11 Slave 11_NoCommunication
package /ZeC/DTC/DTC/Power_Path_095_Short_to_BAT_Failure
  diagnostic trouble code uds Power_Path_095_Short_to_BAT_Failure: dtc-props=Dtc_Props_3ab4da94, uds-dtc-value=0x00515f
  diagnostic event EventPowerPath095ShortToBATFailure: aging-allowed=true, event-kind=SWC, prestorage-freeze-frame=false  # Event_Power_Path_095_Short_to_BAT_Failure
  diagnostic event to trouble code uds mapping EventDtcMapPowerPath095ShortToBATFailure: diagnostic-event=EventPowerPath095ShortToBATFailure, trouble-code-uds=Power_Path_095_Short_to_BAT_Failure  # Event_Dtc_Map_Power_Path_095_Short_to_BAT_Failure
  diagnostic event to operation cycle mapping EventOperCycleMapPowerPath095ShortToBATFailure: diagnostic-event=EventPowerPath095ShortToBATFailure, operation-cycle=DefaultOperationCycle  # Event_Oper_Cycle_Map_Power_Path_095_Short_to_BAT_Failure
  diagnostic event to debounce algorithm mapping EventDebounceMapPowerPath095ShortToBATFailure: debounce-algorithm=time_based, diagnostic-event=EventPowerPath095ShortToBATFailure  # EventDebounceMap_Power_Path_095_Short_to_BAT_Failure
package /ZeC/DTC/DTC/LIN_11_Slave_12_Defect
  diagnostic trouble code uds LIN_11_Slave_12_Defect: dtc-props=Dtc_Props_358996c7, uds-dtc-value=0x030b0b  # LIN 11 Slave 12_Defect
  diagnostic event EventLIN11Slave12Defect: aging-allowed=true, event-kind=SWC, prestorage-freeze-frame=false  # Event_LIN 11 Slave 12_Defect
  diagnostic event to trouble code uds mapping EventDtcMapLIN11Slave12Defect: diagnostic-event=EventLIN11Slave12Defect, trouble-code-uds=LIN_11_Slave_12_Defect  # Event_Dtc_Map_LIN 11 Slave 12_Defect
  diagnostic event to operation cycle mapping EventOperCycleMapLIN11Slave12Defect: diagnostic-event=EventLIN11Slave12Defect, operation-cycle=DefaultOperationCycle  # Event_Oper_Cycle_Map_LIN 11 Slave 12_Defect
  diagnostic event to debounce algorithm mapping EventDebounceMapLIN11Slave12Defect: debounce-algorithm=counter_based, diagnostic-event=EventLIN11Slave12Defect  # EventDebounceMap_LIN 11 Slave 12_Defect
package /ZeC/DTC/DTC/Power_Path_094_Short_to_BAT_Failure
  diagnostic trouble code uds Power_Path_094_Short_to_BAT_Failure: dtc-props=Dtc_Props_f09fc4da, uds-dtc-value=0x00515e
  diagnostic event EventPowerPath094ShortToBATFailure: aging-allowed=true, event-kind=SWC, prestorage-freeze-frame=false  # Event_Power_Path_094_Short_to_BAT_Failure
  diagnostic event to trouble code uds mapping EventDtcMapPowerPath094ShortToBATFailure: diagnostic-event=EventPowerPath094ShortToBATFailure, trouble-code-uds=Power_Path_094_Short_to_BAT_Failure  # Event_Dtc_Map_Power_Path_094_Short_to_BAT_Failure
  diagnostic event to operation cycle mapping EventOperCycleMapPowerPath094ShortToBATFailure: diagnostic-event=EventPowerPath094ShortToBATFailure, operation-cycle=DefaultOperationCycle  # Event_Oper_Cycle_Map_Power_Path_094_Short_to_BAT_Failure
  diagnostic event to debounce algorithm mapping EventDebounceMapPowerPath094ShortToBATFailure: debounce-algorithm=time_based, diagnostic-event=EventPowerPath094ShortToBATFailure  # EventDebounceMap_Power_Path_094_Short_to_BAT_Failure
package /ZeC/DTC/DTC/LIN_20_Databus_No_Comm
  diagnostic trouble code uds LIN_20_Databus_No_Comm: dtc-props=Dtc_Props_358996c7, uds-dtc-value=0x031420  # LIN 20 Databus_No_Comm
  diagnostic event EventLIN20DatabusNoComm: aging-allowed=true, event-kind=SWC, prestorage-freeze-frame=false  # Event_LIN 20 Databus_No_Comm
  diagnostic event to trouble code uds mapping EventDtcMapLIN20DatabusNoComm: diagnostic-event=EventLIN20DatabusNoComm, trouble-code-uds=LIN_20_Databus_No_Comm  # Event_Dtc_Map_LIN 20 Databus_No_Comm
  diagnostic event to operation cycle mapping EventOperCycleMapLIN20DatabusNoComm: diagnostic-event=EventLIN20DatabusNoComm, operation-cycle=DefaultOperationCycle  # Event_Oper_Cycle_Map_LIN 20 Databus_No_Comm
  diagnostic event to debounce algorithm mapping EventDebounceMapLIN20DatabusNoComm: debounce-algorithm=counter_based, diagnostic-event=EventLIN20DatabusNoComm  # EventDebounceMap_LIN 20 Databus_No_Comm
package /ZeC/DTC/DTC/LIN_20_Local_Databus_Electrical_Failure
  diagnostic trouble code uds LIN_20_Local_Databus_Electrical_Failure: dtc-props=Dtc_Props_358996c7, uds-dtc-value=0x031421  # LIN 20 Local_Databus_Electrical_Failure
  diagnostic event EventLIN20LocalDatabusElectricalFailure: aging-allowed=true, event-kind=SWC, prestorage-freeze-frame=false  # Event_LIN 20 Local_Databus_Electrical_Failure
  diagnostic event to trouble code uds mapping EventDtcMapLIN20LocalDatabusElectricalFailure: diagnostic-event=EventLIN20LocalDatabusElectricalFailure, trouble-code-uds=LIN_20_Local_Databus_Electrical_Failure  # Event_Dtc_Map_LIN 20 Local_Databus_Electrical_Failure
  diagnostic event to operation cycle mapping EventOperCycleMapLIN20LocalDatabusElectricalFailure: diagnostic-event=EventLIN20LocalDatabusElectricalFailure, operation-cycle=DefaultOperationCycle  # Event_Oper_Cycle_Map_LIN 20 Local_Databus_Electrical_Failure
  diagnostic event to debounce algorithm mapping EventDebounceMapLIN20LocalDatabusElectricalFailure: debounce-algorithm=counter_based, diagnostic-event=EventLIN20LocalDatabusElectricalFailure  # EventDebounceMap_LIN 20 Local_Databus_Electrical_Failure
package /ZeC/DTC/DTC/Power_Path_091_Short_to_BAT_Failure
  diagnostic trouble code uds Power_Path_091_Short_to_BAT_Failure: dtc-props=Dtc_Props_f9a1f43d, uds-dtc-value=0x00515b
  diagnostic event EventPowerPath091ShortToBATFailure: aging-allowed=true, event-kind=SWC, prestorage-freeze-frame=false  # Event_Power_Path_091_Short_to_BAT_Failure
  diagnostic event to trouble code uds mapping EventDtcMapPowerPath091ShortToBATFailure: diagnostic-event=EventPowerPath091ShortToBATFailure, trouble-code-uds=Power_Path_091_Short_to_BAT_Failure  # Event_Dtc_Map_Power_Path_091_Short_to_BAT_Failure
  diagnostic event to operation cycle mapping EventOperCycleMapPowerPath091ShortToBATFailure: diagnostic-event=EventPowerPath091ShortToBATFailure, operation-cycle=DefaultOperationCycle  # Event_Oper_Cycle_Map_Power_Path_091_Short_to_BAT_Failure
  diagnostic event to debounce algorithm mapping EventDebounceMapPowerPath091ShortToBATFailure: debounce-algorithm=time_based, diagnostic-event=EventPowerPath091ShortToBATFailure  # EventDebounceMap_Power_Path_091_Short_to_BAT_Failure
package /ZeC/DTC/DTC/Power_Path_090_Short_to_BAT_Failure
  diagnostic trouble code uds Power_Path_090_Short_to_BAT_Failure: dtc-props=Dtc_Props_338aea73, uds-dtc-value=0x00515a
  diagnostic event EventPowerPath090ShortToBATFailure: aging-allowed=true, event-kind=SWC, prestorage-freeze-frame=false  # Event_Power_Path_090_Short_to_BAT_Failure
  diagnostic event to trouble code uds mapping EventDtcMapPowerPath090ShortToBATFailure: diagnostic-event=EventPowerPath090ShortToBATFailure, trouble-code-uds=Power_Path_090_Short_to_BAT_Failure  # Event_Dtc_Map_Power_Path_090_Short_to_BAT_Failure
  diagnostic event to operation cycle mapping EventOperCycleMapPowerPath090ShortToBATFailure: diagnostic-event=EventPowerPath090ShortToBATFailure, operation-cycle=DefaultOperationCycle  # Event_Oper_Cycle_Map_Power_Path_090_Short_to_BAT_Failure
  diagnostic event to debounce algorithm mapping EventDebounceMapPowerPath090ShortToBATFailure: debounce-algorithm=time_based, diagnostic-event=EventPowerPath090ShortToBATFailure  # EventDebounceMap_Power_Path_090_Short_to_BAT_Failure
package /ZeC/DTC/DTC/Power_Path_093_Short_to_BAT_Failure
  diagnostic trouble code uds Power_Path_093_Short_to_BAT_Failure: dtc-props=Dtc_Props_b686cee0, uds-dtc-value=0x00515d
  diagnostic event EventPowerPath093ShortToBATFailure: aging-allowed=true, event-kind=SWC, prestorage-freeze-frame=false  # Event_Power_Path_093_Short_to_BAT_Failure
  diagnostic event to trouble code uds mapping EventDtcMapPowerPath093ShortToBATFailure: diagnostic-event=EventPowerPath093ShortToBATFailure, trouble-code-uds=Power_Path_093_Short_to_BAT_Failure  # Event_Dtc_Map_Power_Path_093_Short_to_BAT_Failure
  diagnostic event to operation cycle mapping EventOperCycleMapPowerPath093ShortToBATFailure: diagnostic-event=EventPowerPath093ShortToBATFailure, operation-cycle=DefaultOperationCycle  # Event_Oper_Cycle_Map_Power_Path_093_Short_to_BAT_Failure
  diagnostic event to debounce algorithm mapping EventDebounceMapPowerPath093ShortToBATFailure: debounce-algorithm=time_based, diagnostic-event=EventPowerPath093ShortToBATFailure  # EventDebounceMap_Power_Path_093_Short_to_BAT_Failure
package /ZeC/DTC/DTC/Power_Path_092_Short_to_BAT_Failure
  diagnostic trouble code uds Power_Path_092_Short_to_BAT_Failure: dtc-props=Dtc_Props_bfb8fe07, uds-dtc-value=0x00515c
  diagnostic event EventPowerPath092ShortToBATFailure: aging-allowed=true, event-kind=SWC, prestorage-freeze-frame=false  # Event_Power_Path_092_Short_to_BAT_Failure
  diagnostic event to trouble code uds mapping EventDtcMapPowerPath092ShortToBATFailure: diagnostic-event=EventPowerPath092ShortToBATFailure, trouble-code-uds=Power_Path_092_Short_to_BAT_Failure  # Event_Dtc_Map_Power_Path_092_Short_to_BAT_Failure
  diagnostic event to operation cycle mapping EventOperCycleMapPowerPath092ShortToBATFailure: diagnostic-event=EventPowerPath092ShortToBATFailure, operation-cycle=DefaultOperationCycle  # Event_Oper_Cycle_Map_Power_Path_092_Short_to_BAT_Failure
  diagnostic event to debounce algorithm mapping EventDebounceMapPowerPath092ShortToBATFailure: debounce-algorithm=time_based, diagnostic-event=EventPowerPath092ShortToBATFailure  # EventDebounceMap_Power_Path_092_Short_to_BAT_Failure
package /ZeC/DTC/DTC/LIN_11_Slave_4_NoCommunication
  diagnostic trouble code uds LIN_11_Slave_4_NoCommunication: dtc-props=Dtc_Props_358996c7, uds-dtc-value=0x030b18  # LIN 11 Slave 4_NoCommunication
  diagnostic event EventLIN11Slave4NoCommunication: aging-allowed=true, event-kind=SWC, prestorage-freeze-frame=false  # Event_LIN 11 Slave 4_NoCommunication
  diagnostic event to trouble code uds mapping EventDtcMapLIN11Slave4NoCommunication: diagnostic-event=EventLIN11Slave4NoCommunication, trouble-code-uds=LIN_11_Slave_4_NoCommunication  # Event_Dtc_Map_LIN 11 Slave 4_NoCommunication
  diagnostic event to operation cycle mapping EventOperCycleMapLIN11Slave4NoCommunication: diagnostic-event=EventLIN11Slave4NoCommunication, operation-cycle=DefaultOperationCycle  # Event_Oper_Cycle_Map_LIN 11 Slave 4_NoCommunication
  diagnostic event to debounce algorithm mapping EventDebounceMapLIN11Slave4NoCommunication: debounce-algorithm=counter_based, diagnostic-event=EventLIN11Slave4NoCommunication  # EventDebounceMap_LIN 11 Slave 4_NoCommunication
package /ZeC/DTC/DTC/Power_Path_097_Short_to_BAT_Failure
  diagnostic trouble code uds Power_Path_097_Short_to_BAT_Failure: dtc-props=Dtc_Props_9fdbc987, uds-dtc-value=0x005161
  diagnostic event EventPowerPath097ShortToBATFailure: aging-allowed=true, event-kind=SWC, prestorage-freeze-frame=false  # Event_Power_Path_097_Short_to_BAT_Failure
  diagnostic event to trouble code uds mapping EventDtcMapPowerPath097ShortToBATFailure: diagnostic-event=EventPowerPath097ShortToBATFailure, trouble-code-uds=Power_Path_097_Short_to_BAT_Failure  # Event_Dtc_Map_Power_Path_097_Short_to_BAT_Failure
  diagnostic event to operation cycle mapping EventOperCycleMapPowerPath097ShortToBATFailure: diagnostic-event=EventPowerPath097ShortToBATFailure, operation-cycle=DefaultOperationCycle  # Event_Oper_Cycle_Map_Power_Path_097_Short_to_BAT_Failure
  diagnostic event to debounce algorithm mapping EventDebounceMapPowerPath097ShortToBATFailure: debounce-algorithm=time_based, diagnostic-event=EventPowerPath097ShortToBATFailure  # EventDebounceMap_Power_Path_097_Short_to_BAT_Failure
package /ZeC/DTC/DTC/LIN_11_Slave_5_Defect
  diagnostic trouble code uds LIN_11_Slave_5_Defect: dtc-props=Dtc_Props_358996c7, uds-dtc-value=0x030b19  # LIN 11 Slave 5_Defect
  diagnostic event EventLIN11Slave5Defect: aging-allowed=true, event-kind=SWC, prestorage-freeze-frame=false  # Event_LIN 11 Slave 5_Defect
  diagnostic event to trouble code uds mapping EventDtcMapLIN11Slave5Defect: diagnostic-event=EventLIN11Slave5Defect, trouble-code-uds=LIN_11_Slave_5_Defect  # Event_Dtc_Map_LIN 11 Slave 5_Defect
  diagnostic event to operation cycle mapping EventOperCycleMapLIN11Slave5Defect: diagnostic-event=EventLIN11Slave5Defect, operation-cycle=DefaultOperationCycle  # Event_Oper_Cycle_Map_LIN 11 Slave 5_Defect
  diagnostic event to debounce algorithm mapping EventDebounceMapLIN11Slave5Defect: debounce-algorithm=counter_based, diagnostic-event=EventLIN11Slave5Defect  # EventDebounceMap_LIN 11 Slave 5_Defect
package /ZeC/DTC/DTC/Power_Path_096_Short_to_BAT_Failure
  diagnostic trouble code uds Power_Path_096_Short_to_BAT_Failure: dtc-props=Dtc_Props_d9c2c3bd, uds-dtc-value=0x005160
  diagnostic event EventPowerPath096ShortToBATFailure: aging-allowed=true, event-kind=SWC, prestorage-freeze-frame=false  # Event_Power_Path_096_Short_to_BAT_Failure
  diagnostic event to trouble code uds mapping EventDtcMapPowerPath096ShortToBATFailure: diagnostic-event=EventPowerPath096ShortToBATFailure, trouble-code-uds=Power_Path_096_Short_to_BAT_Failure  # Event_Dtc_Map_Power_Path_096_Short_to_BAT_Failure
  diagnostic event to operation cycle mapping EventOperCycleMapPowerPath096ShortToBATFailure: diagnostic-event=EventPowerPath096ShortToBATFailure, operation-cycle=DefaultOperationCycle  # Event_Oper_Cycle_Map_Power_Path_096_Short_to_BAT_Failure
  diagnostic event to debounce algorithm mapping EventDebounceMapPowerPath096ShortToBATFailure: debounce-algorithm=time_based, diagnostic-event=EventPowerPath096ShortToBATFailure  # EventDebounceMap_Power_Path_096_Short_to_BAT_Failure
package /ZeC/DTC/DTC/LIN_11_Slave_3_NoCommunication
  diagnostic trouble code uds LIN_11_Slave_3_NoCommunication: dtc-props=Dtc_Props_358996c7, uds-dtc-value=0x030b16  # LIN 11 Slave 3_NoCommunication
  diagnostic event EventLIN11Slave3NoCommunication: aging-allowed=true, event-kind=SWC, prestorage-freeze-frame=false  # Event_LIN 11 Slave 3_NoCommunication
  diagnostic event to trouble code uds mapping EventDtcMapLIN11Slave3NoCommunication: diagnostic-event=EventLIN11Slave3NoCommunication, trouble-code-uds=LIN_11_Slave_3_NoCommunication  # Event_Dtc_Map_LIN 11 Slave 3_NoCommunication
  diagnostic event to operation cycle mapping EventOperCycleMapLIN11Slave3NoCommunication: diagnostic-event=EventLIN11Slave3NoCommunication, operation-cycle=DefaultOperationCycle  # Event_Oper_Cycle_Map_LIN 11 Slave 3_NoCommunication
  diagnostic event to debounce algorithm mapping EventDebounceMapLIN11Slave3NoCommunication: debounce-algorithm=counter_based, diagnostic-event=EventLIN11Slave3NoCommunication  # EventDebounceMap_LIN 11 Slave 3_NoCommunication
package /ZeC/DTC/DTC/LIN_11_Slave_4_Defect
  diagnostic trouble code uds LIN_11_Slave_4_Defect: dtc-props=Dtc_Props_358996c7, uds-dtc-value=0x030b17  # LIN 11 Slave 4_Defect
  diagnostic event EventLIN11Slave4Defect: aging-allowed=true, event-kind=SWC, prestorage-freeze-frame=false  # Event_LIN 11 Slave 4_Defect
  diagnostic event to trouble code uds mapping EventDtcMapLIN11Slave4Defect: diagnostic-event=EventLIN11Slave4Defect, trouble-code-uds=LIN_11_Slave_4_Defect  # Event_Dtc_Map_LIN 11 Slave 4_Defect
  diagnostic event to operation cycle mapping EventOperCycleMapLIN11Slave4Defect: diagnostic-event=EventLIN11Slave4Defect, operation-cycle=DefaultOperationCycle  # Event_Oper_Cycle_Map_LIN 11 Slave 4_Defect
  diagnostic event to debounce algorithm mapping EventDebounceMapLIN11Slave4Defect: debounce-algorithm=counter_based, diagnostic-event=EventLIN11Slave4Defect  # EventDebounceMap_LIN 11 Slave 4_Defect
package /ZeC/DTC/DTC/LIN_11_Slave_2_NoCommunication
  diagnostic trouble code uds LIN_11_Slave_2_NoCommunication: dtc-props=Dtc_Props_358996c7, uds-dtc-value=0x030b14  # LIN 11 Slave 2_NoCommunication
  diagnostic event EventLIN11Slave2NoCommunication: aging-allowed=true, event-kind=SWC, prestorage-freeze-frame=false  # Event_LIN 11 Slave 2_NoCommunication
  diagnostic event to trouble code uds mapping EventDtcMapLIN11Slave2NoCommunication: diagnostic-event=EventLIN11Slave2NoCommunication, trouble-code-uds=LIN_11_Slave_2_NoCommunication  # Event_Dtc_Map_LIN 11 Slave 2_NoCommunication
  diagnostic event to operation cycle mapping EventOperCycleMapLIN11Slave2NoCommunication: diagnostic-event=EventLIN11Slave2NoCommunication, operation-cycle=DefaultOperationCycle  # Event_Oper_Cycle_Map_LIN 11 Slave 2_NoCommunication
  diagnostic event to debounce algorithm mapping EventDebounceMapLIN11Slave2NoCommunication: debounce-algorithm=counter_based, diagnostic-event=EventLIN11Slave2NoCommunication  # EventDebounceMap_LIN 11 Slave 2_NoCommunication
package /ZeC/DTC/DTC/LIN_11_Slave_3_Defect
  diagnostic trouble code uds LIN_11_Slave_3_Defect: dtc-props=Dtc_Props_358996c7, uds-dtc-value=0x030b15  # LIN 11 Slave 3_Defect
  diagnostic event EventLIN11Slave3Defect: aging-allowed=true, event-kind=SWC, prestorage-freeze-frame=false  # Event_LIN 11 Slave 3_Defect
  diagnostic event to trouble code uds mapping EventDtcMapLIN11Slave3Defect: diagnostic-event=EventLIN11Slave3Defect, trouble-code-uds=LIN_11_Slave_3_Defect  # Event_Dtc_Map_LIN 11 Slave 3_Defect
  diagnostic event to operation cycle mapping EventOperCycleMapLIN11Slave3Defect: diagnostic-event=EventLIN11Slave3Defect, operation-cycle=DefaultOperationCycle  # Event_Oper_Cycle_Map_LIN 11 Slave 3_Defect
  diagnostic event to debounce algorithm mapping EventDebounceMapLIN11Slave3Defect: debounce-algorithm=counter_based, diagnostic-event=EventLIN11Slave3Defect  # EventDebounceMap_LIN 11 Slave 3_Defect
package /ZeC/DTC/DTC/LIN_11_Slave_15_NoCommunication
  diagnostic trouble code uds LIN_11_Slave_15_NoCommunication: dtc-props=Dtc_Props_358996c7, uds-dtc-value=0x030b12  # LIN 11 Slave 15_NoCommunication
  diagnostic event EventLIN11Slave15NoCommunication: aging-allowed=true, event-kind=SWC, prestorage-freeze-frame=false  # Event_LIN 11 Slave 15_NoCommunication
  diagnostic event to trouble code uds mapping EventDtcMapLIN11Slave15NoCommunication: diagnostic-event=EventLIN11Slave15NoCommunication, trouble-code-uds=LIN_11_Slave_15_NoCommunication  # Event_Dtc_Map_LIN 11 Slave 15_NoCommunication
  diagnostic event to operation cycle mapping EventOperCycleMapLIN11Slave15NoCommunication: diagnostic-event=EventLIN11Slave15NoCommunication, operation-cycle=DefaultOperationCycle  # Event_Oper_Cycle_Map_LIN 11 Slave 15_NoCommunication
  diagnostic event to debounce algorithm mapping EventDebounceMapLIN11Slave15NoCommunication: debounce-algorithm=counter_based, diagnostic-event=EventLIN11Slave15NoCommunication  # EventDebounceMap_LIN 11 Slave 15_NoCommunication
package /ZeC/DTC/DTC/Power_Path_103_Short_to_BAT_Failure
  diagnostic trouble code uds Power_Path_103_Short_to_BAT_Failure: dtc-props=Dtc_Props_d0fcf35a, uds-dtc-value=0x005167
  diagnostic event EventPowerPath103ShortToBATFailure: aging-allowed=true, event-kind=SWC, prestorage-freeze-frame=false  # Event_Power_Path_103_Short_to_BAT_Failure
  diagnostic event to trouble code uds mapping EventDtcMapPowerPath103ShortToBATFailure: diagnostic-event=EventPowerPath103ShortToBATFailure, trouble-code-uds=Power_Path_103_Short_to_BAT_Failure  # Event_Dtc_Map_Power_Path_103_Short_to_BAT_Failure
  diagnostic event to operation cycle mapping EventOperCycleMapPowerPath103ShortToBATFailure: diagnostic-event=EventPowerPath103ShortToBATFailure, operation-cycle=DefaultOperationCycle  # Event_Oper_Cycle_Map_Power_Path_103_Short_to_BAT_Failure
  diagnostic event to debounce algorithm mapping EventDebounceMapPowerPath103ShortToBATFailure: debounce-algorithm=time_based, diagnostic-event=EventPowerPath103ShortToBATFailure  # EventDebounceMap_Power_Path_103_Short_to_BAT_Failure
package /ZeC/DTC/DTC/LIN_11_Slave_2_Defect
  diagnostic trouble code uds LIN_11_Slave_2_Defect: dtc-props=Dtc_Props_358996c7, uds-dtc-value=0x030b13  # LIN 11 Slave 2_Defect
  diagnostic event EventLIN11Slave2Defect: aging-allowed=true, event-kind=SWC, prestorage-freeze-frame=false  # Event_LIN 11 Slave 2_Defect
  diagnostic event to trouble code uds mapping EventDtcMapLIN11Slave2Defect: diagnostic-event=EventLIN11Slave2Defect, trouble-code-uds=LIN_11_Slave_2_Defect  # Event_Dtc_Map_LIN 11 Slave 2_Defect
  diagnostic event to operation cycle mapping EventOperCycleMapLIN11Slave2Defect: diagnostic-event=EventLIN11Slave2Defect, operation-cycle=DefaultOperationCycle  # Event_Oper_Cycle_Map_LIN 11 Slave 2_Defect
  diagnostic event to debounce algorithm mapping EventDebounceMapLIN11Slave2Defect: debounce-algorithm=counter_based, diagnostic-event=EventLIN11Slave2Defect  # EventDebounceMap_LIN 11 Slave 2_Defect
package /ZeC/DTC/DTC/Power_Path_102_Short_to_BAT_Failure
  diagnostic trouble code uds Power_Path_102_Short_to_BAT_Failure: dtc-props=Dtc_Props_96e5f960, uds-dtc-value=0x005166
  diagnostic event EventPowerPath102ShortToBATFailure: aging-allowed=true, event-kind=SWC, prestorage-freeze-frame=false  # Event_Power_Path_102_Short_to_BAT_Failure
  diagnostic event to trouble code uds mapping EventDtcMapPowerPath102ShortToBATFailure: diagnostic-event=EventPowerPath102ShortToBATFailure, trouble-code-uds=Power_Path_102_Short_to_BAT_Failure  # Event_Dtc_Map_Power_Path_102_Short_to_BAT_Failure
  diagnostic event to operation cycle mapping EventOperCycleMapPowerPath102ShortToBATFailure: diagnostic-event=EventPowerPath102ShortToBATFailure, operation-cycle=DefaultOperationCycle  # Event_Oper_Cycle_Map_Power_Path_102_Short_to_BAT_Failure
  diagnostic event to debounce algorithm mapping EventDebounceMapPowerPath102ShortToBATFailure: debounce-algorithm=time_based, diagnostic-event=EventPowerPath102ShortToBATFailure  # EventDebounceMap_Power_Path_102_Short_to_BAT_Failure
package /ZeC/DTC/DTC/LIN_11_Slave_14_NoCommunication
  diagnostic trouble code uds LIN_11_Slave_14_NoCommunication: dtc-props=Dtc_Props_358996c7, uds-dtc-value=0x030b10  # LIN 11 Slave 14_NoCommunication
  diagnostic event EventLIN11Slave14NoCommunication: aging-allowed=true, event-kind=SWC, prestorage-freeze-frame=false  # Event_LIN 11 Slave 14_NoCommunication
  diagnostic event to trouble code uds mapping EventDtcMapLIN11Slave14NoCommunication: diagnostic-event=EventLIN11Slave14NoCommunication, trouble-code-uds=LIN_11_Slave_14_NoCommunication  # Event_Dtc_Map_LIN 11 Slave 14_NoCommunication
  diagnostic event to operation cycle mapping EventOperCycleMapLIN11Slave14NoCommunication: diagnostic-event=EventLIN11Slave14NoCommunication, operation-cycle=DefaultOperationCycle  # Event_Oper_Cycle_Map_LIN 11 Slave 14_NoCommunication
  diagnostic event to debounce algorithm mapping EventDebounceMapLIN11Slave14NoCommunication: debounce-algorithm=counter_based, diagnostic-event=EventLIN11Slave14NoCommunication  # EventDebounceMap_LIN 11 Slave 14_NoCommunication
package /ZeC/DTC/DTC/Power_Path_105_Short_to_BAT_Failure
  diagnostic trouble code uds Power_Path_105_Short_to_BAT_Failure: dtc-props=Dtc_Props_c2809294, uds-dtc-value=0x005169
  diagnostic event EventPowerPath105ShortToBATFailure: aging-allowed=true, event-kind=SWC, prestorage-freeze-frame=false  # Event_Power_Path_105_Short_to_BAT_Failure
  diagnostic event to trouble code uds mapping EventDtcMapPowerPath105ShortToBATFailure: diagnostic-event=EventPowerPath105ShortToBATFailure, trouble-code-uds=Power_Path_105_Short_to_BAT_Failure  # Event_Dtc_Map_Power_Path_105_Short_to_BAT_Failure
  diagnostic event to operation cycle mapping EventOperCycleMapPowerPath105ShortToBATFailure: diagnostic-event=EventPowerPath105ShortToBATFailure, operation-cycle=DefaultOperationCycle  # Event_Oper_Cycle_Map_Power_Path_105_Short_to_BAT_Failure
  diagnostic event to debounce algorithm mapping EventDebounceMapPowerPath105ShortToBATFailure: debounce-algorithm=time_based, diagnostic-event=EventPowerPath105ShortToBATFailure  # EventDebounceMap_Power_Path_105_Short_to_BAT_Failure
package /ZeC/DTC/DTC/LIN_11_Slave_15_Defect
  diagnostic trouble code uds LIN_11_Slave_15_Defect: dtc-props=Dtc_Props_358996c7, uds-dtc-value=0x030b11  # LIN 11 Slave 15_Defect
  diagnostic event EventLIN11Slave15Defect: aging-allowed=true, event-kind=SWC, prestorage-freeze-frame=false  # Event_LIN 11 Slave 15_Defect
  diagnostic event to trouble code uds mapping EventDtcMapLIN11Slave15Defect: diagnostic-event=EventLIN11Slave15Defect, trouble-code-uds=LIN_11_Slave_15_Defect  # Event_Dtc_Map_LIN 11 Slave 15_Defect
  diagnostic event to operation cycle mapping EventOperCycleMapLIN11Slave15Defect: diagnostic-event=EventLIN11Slave15Defect, operation-cycle=DefaultOperationCycle  # Event_Oper_Cycle_Map_LIN 11 Slave 15_Defect
  diagnostic event to debounce algorithm mapping EventDebounceMapLIN11Slave15Defect: debounce-algorithm=counter_based, diagnostic-event=EventLIN11Slave15Defect  # EventDebounceMap_LIN 11 Slave 15_Defect
package /ZeC/DTC/DTC/Power_Path_104_Short_to_BAT_Failure
  diagnostic trouble code uds Power_Path_104_Short_to_BAT_Failure: dtc-props=Dtc_Props_849998ae, uds-dtc-value=0x005168
  diagnostic event EventPowerPath104ShortToBATFailure: aging-allowed=true, event-kind=SWC, prestorage-freeze-frame=false  # Event_Power_Path_104_Short_to_BAT_Failure
  diagnostic event to trouble code uds mapping EventDtcMapPowerPath104ShortToBATFailure: diagnostic-event=EventPowerPath104ShortToBATFailure, trouble-code-uds=Power_Path_104_Short_to_BAT_Failure  # Event_Dtc_Map_Power_Path_104_Short_to_BAT_Failure
  diagnostic event to operation cycle mapping EventOperCycleMapPowerPath104ShortToBATFailure: diagnostic-event=EventPowerPath104ShortToBATFailure, operation-cycle=DefaultOperationCycle  # Event_Oper_Cycle_Map_Power_Path_104_Short_to_BAT_Failure
  diagnostic event to debounce algorithm mapping EventDebounceMapPowerPath104ShortToBATFailure: debounce-algorithm=time_based, diagnostic-event=EventPowerPath104ShortToBATFailure  # EventDebounceMap_Power_Path_104_Short_to_BAT_Failure
package /ZeC/DTC/DTC/Power_Path_099_Short_to_BAT_Failure
  diagnostic trouble code uds Power_Path_099_Short_to_BAT_Failure: dtc-props=Dtc_Props_13e9ddf3, uds-dtc-value=0x005163
  diagnostic event EventPowerPath099ShortToBATFailure: aging-allowed=true, event-kind=SWC, prestorage-freeze-frame=false  # Event_Power_Path_099_Short_to_BAT_Failure
  diagnostic event to trouble code uds mapping EventDtcMapPowerPath099ShortToBATFailure: diagnostic-event=EventPowerPath099ShortToBATFailure, trouble-code-uds=Power_Path_099_Short_to_BAT_Failure  # Event_Dtc_Map_Power_Path_099_Short_to_BAT_Failure
  diagnostic event to operation cycle mapping EventOperCycleMapPowerPath099ShortToBATFailure: diagnostic-event=EventPowerPath099ShortToBATFailure, operation-cycle=DefaultOperationCycle  # Event_Oper_Cycle_Map_Power_Path_099_Short_to_BAT_Failure
  diagnostic event to debounce algorithm mapping EventDebounceMapPowerPath099ShortToBATFailure: debounce-algorithm=time_based, diagnostic-event=EventPowerPath099ShortToBATFailure  # EventDebounceMap_Power_Path_099_Short_to_BAT_Failure
package /ZeC/DTC/DTC/Power_Path_098_Short_to_BAT_Failure
  diagnostic trouble code uds Power_Path_098_Short_to_BAT_Failure: dtc-props=Dtc_Props_55f0d7c9, uds-dtc-value=0x005162
  diagnostic event EventPowerPath098ShortToBATFailure: aging-allowed=true, event-kind=SWC, prestorage-freeze-frame=false  # Event_Power_Path_098_Short_to_BAT_Failure
  diagnostic event to trouble code uds mapping EventDtcMapPowerPath098ShortToBATFailure: diagnostic-event=EventPowerPath098ShortToBATFailure, trouble-code-uds=Power_Path_098_Short_to_BAT_Failure  # Event_Dtc_Map_Power_Path_098_Short_to_BAT_Failure
  diagnostic event to operation cycle mapping EventOperCycleMapPowerPath098ShortToBATFailure: diagnostic-event=EventPowerPath098ShortToBATFailure, operation-cycle=DefaultOperationCycle  # Event_Oper_Cycle_Map_Power_Path_098_Short_to_BAT_Failure
  diagnostic event to debounce algorithm mapping EventDebounceMapPowerPath098ShortToBATFailure: debounce-algorithm=time_based, diagnostic-event=EventPowerPath098ShortToBATFailure  # EventDebounceMap_Power_Path_098_Short_to_BAT_Failure
package /ZeC/DTC/DTC/Power_Path_101_Short_to_BAT_Failure
  diagnostic trouble code uds Power_Path_101_Short_to_BAT_Failure: dtc-props=Dtc_Props_5ccee72e, uds-dtc-value=0x005165
  diagnostic event EventPowerPath101ShortToBATFailure: aging-allowed=true, event-kind=SWC, prestorage-freeze-frame=false  # Event_Power_Path_101_Short_to_BAT_Failure
  diagnostic event to trouble code uds mapping EventDtcMapPowerPath101ShortToBATFailure: diagnostic-event=EventPowerPath101ShortToBATFailure, trouble-code-uds=Power_Path_101_Short_to_BAT_Failure  # Event_Dtc_Map_Power_Path_101_Short_to_BAT_Failure
  diagnostic event to operation cycle mapping EventOperCycleMapPowerPath101ShortToBATFailure: diagnostic-event=EventPowerPath101ShortToBATFailure, operation-cycle=DefaultOperationCycle  # Event_Oper_Cycle_Map_Power_Path_101_Short_to_BAT_Failure
  diagnostic event to debounce algorithm mapping EventDebounceMapPowerPath101ShortToBATFailure: debounce-algorithm=time_based, diagnostic-event=EventPowerPath101ShortToBATFailure  # EventDebounceMap_Power_Path_101_Short_to_BAT_Failure
package /ZeC/DTC/DTC/Power_Path_100_Short_to_BAT_Failure
  diagnostic trouble code uds Power_Path_100_Short_to_BAT_Failure: dtc-props=Dtc_Props_1ad7ed14, uds-dtc-value=0x005164
  diagnostic event EventPowerPath100ShortToBATFailure: aging-allowed=true, event-kind=SWC, prestorage-freeze-frame=false  # Event_Power_Path_100_Short_to_BAT_Failure
  diagnostic event to trouble code uds mapping EventDtcMapPowerPath100ShortToBATFailure: diagnostic-event=EventPowerPath100ShortToBATFailure, trouble-code-uds=Power_Path_100_Short_to_BAT_Failure  # Event_Dtc_Map_Power_Path_100_Short_to_BAT_Failure
  diagnostic event to operation cycle mapping EventOperCycleMapPowerPath100ShortToBATFailure: diagnostic-event=EventPowerPath100ShortToBATFailure, operation-cycle=DefaultOperationCycle  # Event_Oper_Cycle_Map_Power_Path_100_Short_to_BAT_Failure
  diagnostic event to debounce algorithm mapping EventDebounceMapPowerPath100ShortToBATFailure: debounce-algorithm=time_based, diagnostic-event=EventPowerPath100ShortToBATFailure  # EventDebounceMap_Power_Path_100_Short_to_BAT_Failure
package /ZeC/DTC/DTC/Power_Path_160_Short_to_BAT_Failure
  diagnostic trouble code uds Power_Path_160_Short_to_BAT_Failure: dtc-props=Dtc_Props_c92c78b3, uds-dtc-value=0x0051a0
  diagnostic event EventPowerPath160ShortToBATFailure: aging-allowed=true, event-kind=SWC, prestorage-freeze-frame=false  # Event_Power_Path_160_Short_to_BAT_Failure
  diagnostic event to trouble code uds mapping EventDtcMapPowerPath160ShortToBATFailure: diagnostic-event=EventPowerPath160ShortToBATFailure, trouble-code-uds=Power_Path_160_Short_to_BAT_Failure  # Event_Dtc_Map_Power_Path_160_Short_to_BAT_Failure
  diagnostic event to operation cycle mapping EventOperCycleMapPowerPath160ShortToBATFailure: diagnostic-event=EventPowerPath160ShortToBATFailure, operation-cycle=DefaultOperationCycle  # Event_Oper_Cycle_Map_Power_Path_160_Short_to_BAT_Failure
  diagnostic event to debounce algorithm mapping EventDebounceMapPowerPath160ShortToBATFailure: debounce-algorithm=time_based, diagnostic-event=EventPowerPath160ShortToBATFailure  # EventDebounceMap_Power_Path_160_Short_to_BAT_Failure
package /ZeC/DTC/DTC/Databus_missing_message
  diagnostic trouble code uds Databus_missing_message: dtc-props=Dtc_Props_b618fb9, uds-dtc-value=0x033210  # Databus missing message
  diagnostic event EventDatabusMissingMessage: aging-allowed=true, event-kind=SWC, prestorage-freeze-frame=false  # Event_Databus missing message
  diagnostic event to trouble code uds mapping EventDtcMapDatabusMissingMessage: diagnostic-event=EventDatabusMissingMessage, trouble-code-uds=Databus_missing_message  # Event_Dtc_Map_Databus missing message
  diagnostic event to operation cycle mapping EventOperCycleMapDatabusMissingMessage: diagnostic-event=EventDatabusMissingMessage, operation-cycle=DefaultOperationCycle  # Event_Oper_Cycle_Map_Databus missing message
  diagnostic event to debounce algorithm mapping EventDebounceMapDatabusMissingMessage: debounce-algorithm=counter_based, diagnostic-event=EventDatabusMissingMessage  # EventDebounceMap_Databus missing message
package /ZeC/DTC/DTC/LIN_16_Slave_14_NoCommunication
  diagnostic trouble code uds LIN_16_Slave_14_NoCommunication: dtc-props=Dtc_Props_358996c7, uds-dtc-value=0x031019  # LIN 16 Slave 14_NoCommunication
  diagnostic event EventLIN16Slave14NoCommunication: aging-allowed=true, event-kind=SWC, prestorage-freeze-frame=false  # Event_LIN 16 Slave 14_NoCommunication
  diagnostic event to trouble code uds mapping EventDtcMapLIN16Slave14NoCommunication: diagnostic-event=EventLIN16Slave14NoCommunication, trouble-code-uds=LIN_16_Slave_14_NoCommunication  # Event_Dtc_Map_LIN 16 Slave 14_NoCommunication
  diagnostic event to operation cycle mapping EventOperCycleMapLIN16Slave14NoCommunication: diagnostic-event=EventLIN16Slave14NoCommunication, operation-cycle=DefaultOperationCycle  # Event_Oper_Cycle_Map_LIN 16 Slave 14_NoCommunication
  diagnostic event to debounce algorithm mapping EventDebounceMapLIN16Slave14NoCommunication: debounce-algorithm=counter_based, diagnostic-event=EventLIN16Slave14NoCommunication  # EventDebounceMap_LIN 16 Slave 14_NoCommunication
package /ZeC/DTC/DTC/LIN_16_Slave_13_NoCommunication
  diagnostic trouble code uds LIN_16_Slave_13_NoCommunication: dtc-props=Dtc_Props_358996c7, uds-dtc-value=0x031017  # LIN 16 Slave 13_NoCommunication
  diagnostic event EventLIN16Slave13NoCommunication: aging-allowed=true, event-kind=SWC, prestorage-freeze-frame=false  # Event_LIN 16 Slave 13_NoCommunication
  diagnostic event to trouble code uds mapping EventDtcMapLIN16Slave13NoCommunication: diagnostic-event=EventLIN16Slave13NoCommunication, trouble-code-uds=LIN_16_Slave_13_NoCommunication  # Event_Dtc_Map_LIN 16 Slave 13_NoCommunication
  diagnostic event to operation cycle mapping EventOperCycleMapLIN16Slave13NoCommunication: diagnostic-event=EventLIN16Slave13NoCommunication, operation-cycle=DefaultOperationCycle  # Event_Oper_Cycle_Map_LIN 16 Slave 13_NoCommunication
  diagnostic event to debounce algorithm mapping EventDebounceMapLIN16Slave13NoCommunication: debounce-algorithm=counter_based, diagnostic-event=EventLIN16Slave13NoCommunication  # EventDebounceMap_LIN 16 Slave 13_NoCommunication
package /ZeC/DTC/DTC/LIN_16_Slave_14_Defect
  diagnostic trouble code uds LIN_16_Slave_14_Defect: dtc-props=Dtc_Props_358996c7, uds-dtc-value=0x031018  # LIN 16 Slave 14_Defect
  diagnostic event EventLIN16Slave14Defect: aging-allowed=true, event-kind=SWC, prestorage-freeze-frame=false  # Event_LIN 16 Slave 14_Defect
  diagnostic event to trouble code uds mapping EventDtcMapLIN16Slave14Defect: diagnostic-event=EventLIN16Slave14Defect, trouble-code-uds=LIN_16_Slave_14_Defect  # Event_Dtc_Map_LIN 16 Slave 14_Defect
  diagnostic event to operation cycle mapping EventOperCycleMapLIN16Slave14Defect: diagnostic-event=EventLIN16Slave14Defect, operation-cycle=DefaultOperationCycle  # Event_Oper_Cycle_Map_LIN 16 Slave 14_Defect
  diagnostic event to debounce algorithm mapping EventDebounceMapLIN16Slave14Defect: debounce-algorithm=counter_based, diagnostic-event=EventLIN16Slave14Defect  # EventDebounceMap_LIN 16 Slave 14_Defect
package /ZeC/DTC/DTC/LIN_16_Slave_12_NoCommunication
  diagnostic trouble code uds LIN_16_Slave_12_NoCommunication: dtc-props=Dtc_Props_358996c7, uds-dtc-value=0x031015  # LIN 16 Slave 12_NoCommunication
  diagnostic event EventLIN16Slave12NoCommunication: aging-allowed=true, event-kind=SWC, prestorage-freeze-frame=false  # Event_LIN 16 Slave 12_NoCommunication
  diagnostic event to trouble code uds mapping EventDtcMapLIN16Slave12NoCommunication: diagnostic-event=EventLIN16Slave12NoCommunication, trouble-code-uds=LIN_16_Slave_12_NoCommunication  # Event_Dtc_Map_LIN 16 Slave 12_NoCommunication
  diagnostic event to operation cycle mapping EventOperCycleMapLIN16Slave12NoCommunication: diagnostic-event=EventLIN16Slave12NoCommunication, operation-cycle=DefaultOperationCycle  # Event_Oper_Cycle_Map_LIN 16 Slave 12_NoCommunication
  diagnostic event to debounce algorithm mapping EventDebounceMapLIN16Slave12NoCommunication: debounce-algorithm=counter_based, diagnostic-event=EventLIN16Slave12NoCommunication  # EventDebounceMap_LIN 16 Slave 12_NoCommunication
package /ZeC/DTC/DTC/LIN_16_Slave_13_Defect
  diagnostic trouble code uds LIN_16_Slave_13_Defect: dtc-props=Dtc_Props_358996c7, uds-dtc-value=0x031016  # LIN 16 Slave 13_Defect
  diagnostic event EventLIN16Slave13Defect: aging-allowed=true, event-kind=SWC, prestorage-freeze-frame=false  # Event_LIN 16 Slave 13_Defect
  diagnostic event to trouble code uds mapping EventDtcMapLIN16Slave13Defect: diagnostic-event=EventLIN16Slave13Defect, trouble-code-uds=LIN_16_Slave_13_Defect  # Event_Dtc_Map_LIN 16 Slave 13_Defect
  diagnostic event to operation cycle mapping EventOperCycleMapLIN16Slave13Defect: diagnostic-event=EventLIN16Slave13Defect, operation-cycle=DefaultOperationCycle  # Event_Oper_Cycle_Map_LIN 16 Slave 13_Defect
  diagnostic event to debounce algorithm mapping EventDebounceMapLIN16Slave13Defect: debounce-algorithm=counter_based, diagnostic-event=EventLIN16Slave13Defect  # EventDebounceMap_LIN 16 Slave 13_Defect
package /ZeC/DTC/DTC/LIN_16_Slave_11_NoCommunication
  diagnostic trouble code uds LIN_16_Slave_11_NoCommunication: dtc-props=Dtc_Props_358996c7, uds-dtc-value=0x031013  # LIN 16 Slave 11_NoCommunication
  diagnostic event EventLIN16Slave11NoCommunication: aging-allowed=true, event-kind=SWC, prestorage-freeze-frame=false  # Event_LIN 16 Slave 11_NoCommunication
  diagnostic event to trouble code uds mapping EventDtcMapLIN16Slave11NoCommunication: diagnostic-event=EventLIN16Slave11NoCommunication, trouble-code-uds=LIN_16_Slave_11_NoCommunication  # Event_Dtc_Map_LIN 16 Slave 11_NoCommunication
  diagnostic event to operation cycle mapping EventOperCycleMapLIN16Slave11NoCommunication: diagnostic-event=EventLIN16Slave11NoCommunication, operation-cycle=DefaultOperationCycle  # Event_Oper_Cycle_Map_LIN 16 Slave 11_NoCommunication
  diagnostic event to debounce algorithm mapping EventDebounceMapLIN16Slave11NoCommunication: debounce-algorithm=counter_based, diagnostic-event=EventLIN16Slave11NoCommunication  # EventDebounceMap_LIN 16 Slave 11_NoCommunication
package /ZeC/DTC/DTC/LIN_16_Slave_12_Defect
  diagnostic trouble code uds LIN_16_Slave_12_Defect: dtc-props=Dtc_Props_358996c7, uds-dtc-value=0x031014  # LIN 16 Slave 12_Defect
  diagnostic event EventLIN16Slave12Defect: aging-allowed=true, event-kind=SWC, prestorage-freeze-frame=false  # Event_LIN 16 Slave 12_Defect
  diagnostic event to trouble code uds mapping EventDtcMapLIN16Slave12Defect: diagnostic-event=EventLIN16Slave12Defect, trouble-code-uds=LIN_16_Slave_12_Defect  # Event_Dtc_Map_LIN 16 Slave 12_Defect
  diagnostic event to operation cycle mapping EventOperCycleMapLIN16Slave12Defect: diagnostic-event=EventLIN16Slave12Defect, operation-cycle=DefaultOperationCycle  # Event_Oper_Cycle_Map_LIN 16 Slave 12_Defect
  diagnostic event to debounce algorithm mapping EventDebounceMapLIN16Slave12Defect: debounce-algorithm=counter_based, diagnostic-event=EventLIN16Slave12Defect  # EventDebounceMap_LIN 16 Slave 12_Defect
package /ZeC/DTC/DTC/LIN_16_Slave_10_NoCommunication
  diagnostic trouble code uds LIN_16_Slave_10_NoCommunication: dtc-props=Dtc_Props_358996c7, uds-dtc-value=0x031011  # LIN 16 Slave 10_NoCommunication
  diagnostic event EventLIN16Slave10NoCommunication: aging-allowed=true, event-kind=SWC, prestorage-freeze-frame=false  # Event_LIN 16 Slave 10_NoCommunication
  diagnostic event to trouble code uds mapping EventDtcMapLIN16Slave10NoCommunication: diagnostic-event=EventLIN16Slave10NoCommunication, trouble-code-uds=LIN_16_Slave_10_NoCommunication  # Event_Dtc_Map_LIN 16 Slave 10_NoCommunication
  diagnostic event to operation cycle mapping EventOperCycleMapLIN16Slave10NoCommunication: diagnostic-event=EventLIN16Slave10NoCommunication, operation-cycle=DefaultOperationCycle  # Event_Oper_Cycle_Map_LIN 16 Slave 10_NoCommunication
  diagnostic event to debounce algorithm mapping EventDebounceMapLIN16Slave10NoCommunication: debounce-algorithm=counter_based, diagnostic-event=EventLIN16Slave10NoCommunication  # EventDebounceMap_LIN 16 Slave 10_NoCommunication
package /ZeC/DTC/DTC/LIN_16_Slave_11_Defect
  diagnostic trouble code uds LIN_16_Slave_11_Defect: dtc-props=Dtc_Props_358996c7, uds-dtc-value=0x031012  # LIN 16 Slave 11_Defect
  diagnostic event EventLIN16Slave11Defect: aging-allowed=true, event-kind=SWC, prestorage-freeze-frame=false  # Event_LIN 16 Slave 11_Defect
  diagnostic event to trouble code uds mapping EventDtcMapLIN16Slave11Defect: diagnostic-event=EventLIN16Slave11Defect, trouble-code-uds=LIN_16_Slave_11_Defect  # Event_Dtc_Map_LIN 16 Slave 11_Defect
  diagnostic event to operation cycle mapping EventOperCycleMapLIN16Slave11Defect: diagnostic-event=EventLIN16Slave11Defect, operation-cycle=DefaultOperationCycle  # Event_Oper_Cycle_Map_LIN 16 Slave 11_Defect
  diagnostic event to debounce algorithm mapping EventDebounceMapLIN16Slave11Defect: debounce-algorithm=counter_based, diagnostic-event=EventLIN16Slave11Defect  # EventDebounceMap_LIN 16 Slave 11_Defect
package /ZeC/DTC/DTC/LIN_16_Slave_10_Defect
  diagnostic trouble code uds LIN_16_Slave_10_Defect: dtc-props=Dtc_Props_358996c7, uds-dtc-value=0x031010  # LIN 16 Slave 10_Defect
  diagnostic event EventLIN16Slave10Defect: aging-allowed=true, event-kind=SWC, prestorage-freeze-frame=false  # Event_LIN 16 Slave 10_Defect
  diagnostic event to trouble code uds mapping EventDtcMapLIN16Slave10Defect: diagnostic-event=EventLIN16Slave10Defect, trouble-code-uds=LIN_16_Slave_10_Defect  # Event_Dtc_Map_LIN 16 Slave 10_Defect
  diagnostic event to operation cycle mapping EventOperCycleMapLIN16Slave10Defect: diagnostic-event=EventLIN16Slave10Defect, operation-cycle=DefaultOperationCycle  # Event_Oper_Cycle_Map_LIN 16 Slave 10_Defect
  diagnostic event to debounce algorithm mapping EventDebounceMapLIN16Slave10Defect: debounce-algorithm=counter_based, diagnostic-event=EventLIN16Slave10Defect  # EventDebounceMap_LIN 16 Slave 10_Defect
package /ZeC/DTC/DTC/LIN_16_Slave_3_Defect
  diagnostic trouble code uds LIN_16_Slave_3_Defect: dtc-props=Dtc_Props_358996c7, uds-dtc-value=0x03101e  # LIN 16 Slave 3_Defect
  diagnostic event EventLIN16Slave3Defect: aging-allowed=true, event-kind=SWC, prestorage-freeze-frame=false  # Event_LIN 16 Slave 3_Defect
  diagnostic event to trouble code uds mapping EventDtcMapLIN16Slave3Defect: diagnostic-event=EventLIN16Slave3Defect, trouble-code-uds=LIN_16_Slave_3_Defect  # Event_Dtc_Map_LIN 16 Slave 3_Defect
  diagnostic event to operation cycle mapping EventOperCycleMapLIN16Slave3Defect: diagnostic-event=EventLIN16Slave3Defect, operation-cycle=DefaultOperationCycle  # Event_Oper_Cycle_Map_LIN 16 Slave 3_Defect
  diagnostic event to debounce algorithm mapping EventDebounceMapLIN16Slave3Defect: debounce-algorithm=counter_based, diagnostic-event=EventLIN16Slave3Defect  # EventDebounceMap_LIN 16 Slave 3_Defect
package /ZeC/DTC/DTC/LIN_16_Slave_2_Defect
  diagnostic trouble code uds LIN_16_Slave_2_Defect: dtc-props=Dtc_Props_358996c7, uds-dtc-value=0x03101c  # LIN 16 Slave 2_Defect
  diagnostic event EventLIN16Slave2Defect: aging-allowed=true, event-kind=SWC, prestorage-freeze-frame=false  # Event_LIN 16 Slave 2_Defect
  diagnostic event to trouble code uds mapping EventDtcMapLIN16Slave2Defect: diagnostic-event=EventLIN16Slave2Defect, trouble-code-uds=LIN_16_Slave_2_Defect  # Event_Dtc_Map_LIN 16 Slave 2_Defect
  diagnostic event to operation cycle mapping EventOperCycleMapLIN16Slave2Defect: diagnostic-event=EventLIN16Slave2Defect, operation-cycle=DefaultOperationCycle  # Event_Oper_Cycle_Map_LIN 16 Slave 2_Defect
  diagnostic event to debounce algorithm mapping EventDebounceMapLIN16Slave2Defect: debounce-algorithm=counter_based, diagnostic-event=EventLIN16Slave2Defect  # EventDebounceMap_LIN 16 Slave 2_Defect
package /ZeC/DTC/DTC/LIN_16_Slave_2_NoCommunication
  diagnostic trouble code uds LIN_16_Slave_2_NoCommunication: dtc-props=Dtc_Props_358996c7, uds-dtc-value=0x03101d  # LIN 16 Slave 2_NoCommunication
  diagnostic event EventLIN16Slave2NoCommunication: aging-allowed=true, event-kind=SWC, prestorage-freeze-frame=false  # Event_LIN 16 Slave 2_NoCommunication
  diagnostic event to trouble code uds mapping EventDtcMapLIN16Slave2NoCommunication: diagnostic-event=EventLIN16Slave2NoCommunication, trouble-code-uds=LIN_16_Slave_2_NoCommunication  # Event_Dtc_Map_LIN 16 Slave 2_NoCommunication
  diagnostic event to operation cycle mapping EventOperCycleMapLIN16Slave2NoCommunication: diagnostic-event=EventLIN16Slave2NoCommunication, operation-cycle=DefaultOperationCycle  # Event_Oper_Cycle_Map_LIN 16 Slave 2_NoCommunication
  diagnostic event to debounce algorithm mapping EventDebounceMapLIN16Slave2NoCommunication: debounce-algorithm=counter_based, diagnostic-event=EventLIN16Slave2NoCommunication  # EventDebounceMap_LIN 16 Slave 2_NoCommunication
package /ZeC/DTC/DTC/LIN_16_Slave_15_Defect
  diagnostic trouble code uds LIN_16_Slave_15_Defect: dtc-props=Dtc_Props_358996c7, uds-dtc-value=0x03101a  # LIN 16 Slave 15_Defect
  diagnostic event EventLIN16Slave15Defect: aging-allowed=true, event-kind=SWC, prestorage-freeze-frame=false  # Event_LIN 16 Slave 15_Defect
  diagnostic event to trouble code uds mapping EventDtcMapLIN16Slave15Defect: diagnostic-event=EventLIN16Slave15Defect, trouble-code-uds=LIN_16_Slave_15_Defect  # Event_Dtc_Map_LIN 16 Slave 15_Defect
  diagnostic event to operation cycle mapping EventOperCycleMapLIN16Slave15Defect: diagnostic-event=EventLIN16Slave15Defect, operation-cycle=DefaultOperationCycle  # Event_Oper_Cycle_Map_LIN 16 Slave 15_Defect
  diagnostic event to debounce algorithm mapping EventDebounceMapLIN16Slave15Defect: debounce-algorithm=counter_based, diagnostic-event=EventLIN16Slave15Defect  # EventDebounceMap_LIN 16 Slave 15_Defect
package /ZeC/DTC/DTC/LIN_16_Slave_15_NoCommunication
  diagnostic trouble code uds LIN_16_Slave_15_NoCommunication: dtc-props=Dtc_Props_358996c7, uds-dtc-value=0x03101b  # LIN 16 Slave 15_NoCommunication
  diagnostic event EventLIN16Slave15NoCommunication: aging-allowed=true, event-kind=SWC, prestorage-freeze-frame=false  # Event_LIN 16 Slave 15_NoCommunication
  diagnostic event to trouble code uds mapping EventDtcMapLIN16Slave15NoCommunication: diagnostic-event=EventLIN16Slave15NoCommunication, trouble-code-uds=LIN_16_Slave_15_NoCommunication  # Event_Dtc_Map_LIN 16 Slave 15_NoCommunication
  diagnostic event to operation cycle mapping EventOperCycleMapLIN16Slave15NoCommunication: diagnostic-event=EventLIN16Slave15NoCommunication, operation-cycle=DefaultOperationCycle  # Event_Oper_Cycle_Map_LIN 16 Slave 15_NoCommunication
  diagnostic event to debounce algorithm mapping EventDebounceMapLIN16Slave15NoCommunication: debounce-algorithm=counter_based, diagnostic-event=EventLIN16Slave15NoCommunication  # EventDebounceMap_LIN 16 Slave 15_NoCommunication
package /ZeC/DTC/DTC/ECU_5_no_communication
  diagnostic trouble code uds ECU_5_no_communication: dtc-props=Dtc_Props_14158306, uds-dtc-value=0x033205  # ECU 5 no communication
  diagnostic event EventECU5NoCommunication: aging-allowed=true, event-kind=SWC, prestorage-freeze-frame=false  # Event_ECU 5 no communication
  diagnostic event to trouble code uds mapping EventDtcMapECU5NoCommunication: diagnostic-event=EventECU5NoCommunication, trouble-code-uds=ECU_5_no_communication  # Event_Dtc_Map_ECU 5 no communication
  diagnostic event to operation cycle mapping EventOperCycleMapECU5NoCommunication: diagnostic-event=EventECU5NoCommunication, operation-cycle=DefaultOperationCycle  # Event_Oper_Cycle_Map_ECU 5 no communication
  diagnostic event to debounce algorithm mapping EventDebounceMapECU5NoCommunication: debounce-algorithm=time_based, diagnostic-event=EventECU5NoCommunication  # EventDebounceMap_ECU 5 no communication
package /ZeC/DTC/DTC/ECU_4_no_communication
  diagnostic trouble code uds ECU_4_no_communication: dtc-props=Dtc_Props_14158306, uds-dtc-value=0x033204  # ECU 4 no communication
  diagnostic event EventECU4NoCommunication: aging-allowed=true, event-kind=SWC, prestorage-freeze-frame=false  # Event_ECU 4 no communication
  diagnostic event to trouble code uds mapping EventDtcMapECU4NoCommunication: diagnostic-event=EventECU4NoCommunication, trouble-code-uds=ECU_4_no_communication  # Event_Dtc_Map_ECU 4 no communication
  diagnostic event to operation cycle mapping EventOperCycleMapECU4NoCommunication: diagnostic-event=EventECU4NoCommunication, operation-cycle=DefaultOperationCycle  # Event_Oper_Cycle_Map_ECU 4 no communication
  diagnostic event to debounce algorithm mapping EventDebounceMapECU4NoCommunication: debounce-algorithm=time_based, diagnostic-event=EventECU4NoCommunication  # EventDebounceMap_ECU 4 no communication
package /ZeC/DTC/DTC/ECU_3_no_communication
  diagnostic trouble code uds ECU_3_no_communication: dtc-props=Dtc_Props_14158306, uds-dtc-value=0x033203  # ECU 3 no communication
  diagnostic event EventECU3NoCommunication: aging-allowed=true, event-kind=SWC, prestorage-freeze-frame=false  # Event_ECU 3 no communication
  diagnostic event to trouble code uds mapping EventDtcMapECU3NoCommunication: diagnostic-event=EventECU3NoCommunication, trouble-code-uds=ECU_3_no_communication  # Event_Dtc_Map_ECU 3 no communication
  diagnostic event to operation cycle mapping EventOperCycleMapECU3NoCommunication: diagnostic-event=EventECU3NoCommunication, operation-cycle=DefaultOperationCycle  # Event_Oper_Cycle_Map_ECU 3 no communication
  diagnostic event to debounce algorithm mapping EventDebounceMapECU3NoCommunication: debounce-algorithm=time_based, diagnostic-event=EventECU3NoCommunication  # EventDebounceMap_ECU 3 no communication
package /ZeC/DTC/DTC/ECU_2_no_communication
  diagnostic trouble code uds ECU_2_no_communication: dtc-props=Dtc_Props_14158306, uds-dtc-value=0x033202  # ECU 2 no communication
  diagnostic event EventECU2NoCommunication: aging-allowed=true, event-kind=SWC, prestorage-freeze-frame=false  # Event_ECU 2 no communication
  diagnostic event to trouble code uds mapping EventDtcMapECU2NoCommunication: diagnostic-event=EventECU2NoCommunication, trouble-code-uds=ECU_2_no_communication  # Event_Dtc_Map_ECU 2 no communication
  diagnostic event to operation cycle mapping EventOperCycleMapECU2NoCommunication: diagnostic-event=EventECU2NoCommunication, operation-cycle=DefaultOperationCycle  # Event_Oper_Cycle_Map_ECU 2 no communication
  diagnostic event to debounce algorithm mapping EventDebounceMapECU2NoCommunication: debounce-algorithm=time_based, diagnostic-event=EventECU2NoCommunication  # EventDebounceMap_ECU 2 no communication
package /ZeC/DTC/DTC/ECU_1_no_communication
  diagnostic trouble code uds ECU_1_no_communication: dtc-props=Dtc_Props_14158306, uds-dtc-value=0x033201  # ECU 1 no communication
  diagnostic event EventECU1NoCommunication: aging-allowed=true, event-kind=SWC, prestorage-freeze-frame=false  # Event_ECU 1 no communication
  diagnostic event to trouble code uds mapping EventDtcMapECU1NoCommunication: diagnostic-event=EventECU1NoCommunication, trouble-code-uds=ECU_1_no_communication  # Event_Dtc_Map_ECU 1 no communication
  diagnostic event to operation cycle mapping EventOperCycleMapECU1NoCommunication: diagnostic-event=EventECU1NoCommunication, operation-cycle=DefaultOperationCycle  # Event_Oper_Cycle_Map_ECU 1 no communication
  diagnostic event to debounce algorithm mapping EventDebounceMapECU1NoCommunication: debounce-algorithm=time_based, diagnostic-event=EventECU1NoCommunication  # EventDebounceMap_ECU 1 no communication
package /ZeC/DTC/DTC/LIN_16_Databus_No_Comm
  diagnostic trouble code uds LIN_16_Databus_No_Comm: dtc-props=Dtc_Props_358996c7, uds-dtc-value=0x031020  # LIN 16 Databus_No_Comm
  diagnostic event EventLIN16DatabusNoComm: aging-allowed=true, event-kind=SWC, prestorage-freeze-frame=false  # Event_LIN 16 Databus_No_Comm
  diagnostic event to trouble code uds mapping EventDtcMapLIN16DatabusNoComm: diagnostic-event=EventLIN16DatabusNoComm, trouble-code-uds=LIN_16_Databus_No_Comm  # Event_Dtc_Map_LIN 16 Databus_No_Comm
  diagnostic event to operation cycle mapping EventOperCycleMapLIN16DatabusNoComm: diagnostic-event=EventLIN16DatabusNoComm, operation-cycle=DefaultOperationCycle  # Event_Oper_Cycle_Map_LIN 16 Databus_No_Comm
  diagnostic event to debounce algorithm mapping EventDebounceMapLIN16DatabusNoComm: debounce-algorithm=counter_based, diagnostic-event=EventLIN16DatabusNoComm  # EventDebounceMap_LIN 16 Databus_No_Comm
package /ZeC/DTC/DTC/LIN_16_Local_Databus_Electrical_Failure
  diagnostic trouble code uds LIN_16_Local_Databus_Electrical_Failure: dtc-props=Dtc_Props_358996c7, uds-dtc-value=0x031021  # LIN 16 Local_Databus_Electrical_Failure
  diagnostic event EventLIN16LocalDatabusElectricalFailure: aging-allowed=true, event-kind=SWC, prestorage-freeze-frame=false  # Event_LIN 16 Local_Databus_Electrical_Failure
  diagnostic event to trouble code uds mapping EventDtcMapLIN16LocalDatabusElectricalFailure: diagnostic-event=EventLIN16LocalDatabusElectricalFailure, trouble-code-uds=LIN_16_Local_Databus_Electrical_Failure  # Event_Dtc_Map_LIN 16 Local_Databus_Electrical_Failure
  diagnostic event to operation cycle mapping EventOperCycleMapLIN16LocalDatabusElectricalFailure: diagnostic-event=EventLIN16LocalDatabusElectricalFailure, operation-cycle=DefaultOperationCycle  # Event_Oper_Cycle_Map_LIN 16 Local_Databus_Electrical_Failure
  diagnostic event to debounce algorithm mapping EventDebounceMapLIN16LocalDatabusElectricalFailure: debounce-algorithm=counter_based, diagnostic-event=EventLIN16LocalDatabusElectricalFailure  # EventDebounceMap_LIN 16 Local_Databus_Electrical_Failure
package /ZeC/DTC/DTC/Power_Path_038_Not_Found_Failure
  diagnostic trouble code uds Power_Path_038_Not_Found_Failure: dtc-props=Dtc_Props_392cf702, uds-dtc-value=0x005626
  diagnostic event EventPowerPath038NotFoundFailure: aging-allowed=true, event-kind=SWC, prestorage-freeze-frame=false  # Event_Power_Path_038_Not_Found_Failure
  diagnostic event to trouble code uds mapping EventDtcMapPowerPath038NotFoundFailure: diagnostic-event=EventPowerPath038NotFoundFailure, trouble-code-uds=Power_Path_038_Not_Found_Failure  # Event_Dtc_Map_Power_Path_038_Not_Found_Failure
  diagnostic event to operation cycle mapping EventOperCycleMapPowerPath038NotFoundFailure: diagnostic-event=EventPowerPath038NotFoundFailure, operation-cycle=DefaultOperationCycle  # Event_Oper_Cycle_Map_Power_Path_038_Not_Found_Failure
  diagnostic event to debounce algorithm mapping EventDebounceMapPowerPath038NotFoundFailure: debounce-algorithm=time_based, diagnostic-event=EventPowerPath038NotFoundFailure  # EventDebounceMap_Power_Path_038_Not_Found_Failure
package /ZeC/DTC/DTC/Power_Path_037_Not_Found_Failure
  diagnostic trouble code uds Power_Path_037_Not_Found_Failure: dtc-props=Dtc_Props_f307e94c, uds-dtc-value=0x005625
  diagnostic event EventPowerPath037NotFoundFailure: aging-allowed=true, event-kind=SWC, prestorage-freeze-frame=false  # Event_Power_Path_037_Not_Found_Failure
  diagnostic event to trouble code uds mapping EventDtcMapPowerPath037NotFoundFailure: diagnostic-event=EventPowerPath037NotFoundFailure, trouble-code-uds=Power_Path_037_Not_Found_Failure  # Event_Dtc_Map_Power_Path_037_Not_Found_Failure
  diagnostic event to operation cycle mapping EventOperCycleMapPowerPath037NotFoundFailure: diagnostic-event=EventPowerPath037NotFoundFailure, operation-cycle=DefaultOperationCycle  # Event_Oper_Cycle_Map_Power_Path_037_Not_Found_Failure
  diagnostic event to debounce algorithm mapping EventDebounceMapPowerPath037NotFoundFailure: debounce-algorithm=time_based, diagnostic-event=EventPowerPath037NotFoundFailure  # EventDebounceMap_Power_Path_037_Not_Found_Failure
package /ZeC/DTC/DTC/Power_Path_040_Not_Found_Failure
  diagnostic trouble code uds Power_Path_040_Not_Found_Failure: dtc-props=Dtc_Props_2b5096cc, uds-dtc-value=0x005628
  diagnostic event EventPowerPath040NotFoundFailure: aging-allowed=true, event-kind=SWC, prestorage-freeze-frame=false  # Event_Power_Path_040_Not_Found_Failure
  diagnostic event to trouble code uds mapping EventDtcMapPowerPath040NotFoundFailure: diagnostic-event=EventPowerPath040NotFoundFailure, trouble-code-uds=Power_Path_040_Not_Found_Failure  # Event_Dtc_Map_Power_Path_040_Not_Found_Failure
  diagnostic event to operation cycle mapping EventOperCycleMapPowerPath040NotFoundFailure: diagnostic-event=EventPowerPath040NotFoundFailure, operation-cycle=DefaultOperationCycle  # Event_Oper_Cycle_Map_Power_Path_040_Not_Found_Failure
  diagnostic event to debounce algorithm mapping EventDebounceMapPowerPath040NotFoundFailure: debounce-algorithm=time_based, diagnostic-event=EventPowerPath040NotFoundFailure  # EventDebounceMap_Power_Path_040_Not_Found_Failure
package /ZeC/DTC/DTC/Power_Path_039_Not_Found_Failure
  diagnostic trouble code uds Power_Path_039_Not_Found_Failure: dtc-props=Dtc_Props_7f35fd38, uds-dtc-value=0x005627
  diagnostic event EventPowerPath039NotFoundFailure: aging-allowed=true, event-kind=SWC, prestorage-freeze-frame=false  # Event_Power_Path_039_Not_Found_Failure
  diagnostic event to trouble code uds mapping EventDtcMapPowerPath039NotFoundFailure: diagnostic-event=EventPowerPath039NotFoundFailure, trouble-code-uds=Power_Path_039_Not_Found_Failure  # Event_Dtc_Map_Power_Path_039_Not_Found_Failure
  diagnostic event to operation cycle mapping EventOperCycleMapPowerPath039NotFoundFailure: diagnostic-event=EventPowerPath039NotFoundFailure, operation-cycle=DefaultOperationCycle  # Event_Oper_Cycle_Map_Power_Path_039_Not_Found_Failure
  diagnostic event to debounce algorithm mapping EventDebounceMapPowerPath039NotFoundFailure: debounce-algorithm=time_based, diagnostic-event=EventPowerPath039NotFoundFailure  # EventDebounceMap_Power_Path_039_Not_Found_Failure
package /ZeC/DTC/DTC/Power_Path_034_Not_Found_Failure
  diagnostic trouble code uds Power_Path_034_Not_Found_Failure: dtc-props=Dtc_Props_fa39d9ab, uds-dtc-value=0x005622
  diagnostic event EventPowerPath034NotFoundFailure: aging-allowed=true, event-kind=SWC, prestorage-freeze-frame=false  # Event_Power_Path_034_Not_Found_Failure
  diagnostic event to trouble code uds mapping EventDtcMapPowerPath034NotFoundFailure: diagnostic-event=EventPowerPath034NotFoundFailure, trouble-code-uds=Power_Path_034_Not_Found_Failure  # Event_Dtc_Map_Power_Path_034_Not_Found_Failure
  diagnostic event to operation cycle mapping EventOperCycleMapPowerPath034NotFoundFailure: diagnostic-event=EventPowerPath034NotFoundFailure, operation-cycle=DefaultOperationCycle  # Event_Oper_Cycle_Map_Power_Path_034_Not_Found_Failure
  diagnostic event to debounce algorithm mapping EventDebounceMapPowerPath034NotFoundFailure: debounce-algorithm=time_based, diagnostic-event=EventPowerPath034NotFoundFailure  # EventDebounceMap_Power_Path_034_Not_Found_Failure
package /ZeC/DTC/DTC/Power_Path_033_Not_Found_Failure
  diagnostic trouble code uds Power_Path_033_Not_Found_Failure: dtc-props=Dtc_Props_3012c7e5, uds-dtc-value=0x005621
  diagnostic event EventPowerPath033NotFoundFailure: aging-allowed=true, event-kind=SWC, prestorage-freeze-frame=false  # Event_Power_Path_033_Not_Found_Failure
  diagnostic event to trouble code uds mapping EventDtcMapPowerPath033NotFoundFailure: diagnostic-event=EventPowerPath033NotFoundFailure, trouble-code-uds=Power_Path_033_Not_Found_Failure  # Event_Dtc_Map_Power_Path_033_Not_Found_Failure
  diagnostic event to operation cycle mapping EventOperCycleMapPowerPath033NotFoundFailure: diagnostic-event=EventPowerPath033NotFoundFailure, operation-cycle=DefaultOperationCycle  # Event_Oper_Cycle_Map_Power_Path_033_Not_Found_Failure
  diagnostic event to debounce algorithm mapping EventDebounceMapPowerPath033NotFoundFailure: debounce-algorithm=time_based, diagnostic-event=EventPowerPath033NotFoundFailure  # EventDebounceMap_Power_Path_033_Not_Found_Failure
package /ZeC/DTC/DTC/Power_Path_036_Not_Found_Failure
  diagnostic trouble code uds Power_Path_036_Not_Found_Failure: dtc-props=Dtc_Props_b51ee376, uds-dtc-value=0x005624
  diagnostic event EventPowerPath036NotFoundFailure: aging-allowed=true, event-kind=SWC, prestorage-freeze-frame=false  # Event_Power_Path_036_Not_Found_Failure
  diagnostic event to trouble code uds mapping EventDtcMapPowerPath036NotFoundFailure: diagnostic-event=EventPowerPath036NotFoundFailure, trouble-code-uds=Power_Path_036_Not_Found_Failure  # Event_Dtc_Map_Power_Path_036_Not_Found_Failure
  diagnostic event to operation cycle mapping EventOperCycleMapPowerPath036NotFoundFailure: diagnostic-event=EventPowerPath036NotFoundFailure, operation-cycle=DefaultOperationCycle  # Event_Oper_Cycle_Map_Power_Path_036_Not_Found_Failure
  diagnostic event to debounce algorithm mapping EventDebounceMapPowerPath036NotFoundFailure: debounce-algorithm=time_based, diagnostic-event=EventPowerPath036NotFoundFailure  # EventDebounceMap_Power_Path_036_Not_Found_Failure
package /ZeC/DTC/DTC/Power_Path_035_Not_Found_Failure
  diagnostic trouble code uds Power_Path_035_Not_Found_Failure: dtc-props=Dtc_Props_bc20d391, uds-dtc-value=0x005623
  diagnostic event EventPowerPath035NotFoundFailure: aging-allowed=true, event-kind=SWC, prestorage-freeze-frame=false  # Event_Power_Path_035_Not_Found_Failure
  diagnostic event to trouble code uds mapping EventDtcMapPowerPath035NotFoundFailure: diagnostic-event=EventPowerPath035NotFoundFailure, trouble-code-uds=Power_Path_035_Not_Found_Failure  # Event_Dtc_Map_Power_Path_035_Not_Found_Failure
  diagnostic event to operation cycle mapping EventOperCycleMapPowerPath035NotFoundFailure: diagnostic-event=EventPowerPath035NotFoundFailure, operation-cycle=DefaultOperationCycle  # Event_Oper_Cycle_Map_Power_Path_035_Not_Found_Failure
  diagnostic event to debounce algorithm mapping EventDebounceMapPowerPath035NotFoundFailure: debounce-algorithm=time_based, diagnostic-event=EventPowerPath035NotFoundFailure  # EventDebounceMap_Power_Path_035_Not_Found_Failure
package /ZeC/DTC/DTC/Power_Path_041_Not_Found_Failure
  diagnostic trouble code uds Power_Path_041_Not_Found_Failure: dtc-props=Dtc_Props_6d499cf6, uds-dtc-value=0x005629
  diagnostic event EventPowerPath041NotFoundFailure: aging-allowed=true, event-kind=SWC, prestorage-freeze-frame=false  # Event_Power_Path_041_Not_Found_Failure
  diagnostic event to trouble code uds mapping EventDtcMapPowerPath041NotFoundFailure: diagnostic-event=EventPowerPath041NotFoundFailure, trouble-code-uds=Power_Path_041_Not_Found_Failure  # Event_Dtc_Map_Power_Path_041_Not_Found_Failure
  diagnostic event to operation cycle mapping EventOperCycleMapPowerPath041NotFoundFailure: diagnostic-event=EventPowerPath041NotFoundFailure, operation-cycle=DefaultOperationCycle  # Event_Oper_Cycle_Map_Power_Path_041_Not_Found_Failure
  diagnostic event to debounce algorithm mapping EventDebounceMapPowerPath041NotFoundFailure: debounce-algorithm=time_based, diagnostic-event=EventPowerPath041NotFoundFailure  # EventDebounceMap_Power_Path_041_Not_Found_Failure
package /ZeC/DTC/DTC/Power_Path_047_Not_Found_Failure
  diagnostic trouble code uds Power_Path_047_Not_Found_Failure: dtc-props=Dtc_Props_4d3937f, uds-dtc-value=0x00562f
  diagnostic event EventPowerPath047NotFoundFailure: aging-allowed=true, event-kind=SWC, prestorage-freeze-frame=false  # Event_Power_Path_047_Not_Found_Failure
  diagnostic event to trouble code uds mapping EventDtcMapPowerPath047NotFoundFailure: diagnostic-event=EventPowerPath047NotFoundFailure, trouble-code-uds=Power_Path_047_Not_Found_Failure  # Event_Dtc_Map_Power_Path_047_Not_Found_Failure
  diagnostic event to operation cycle mapping EventOperCycleMapPowerPath047NotFoundFailure: diagnostic-event=EventPowerPath047NotFoundFailure, operation-cycle=DefaultOperationCycle  # Event_Oper_Cycle_Map_Power_Path_047_Not_Found_Failure
  diagnostic event to debounce algorithm mapping EventDebounceMapPowerPath047NotFoundFailure: debounce-algorithm=time_based, diagnostic-event=EventPowerPath047NotFoundFailure  # EventDebounceMap_Power_Path_047_Not_Found_Failure
package /ZeC/DTC/DTC/Power_Path_046_Not_Found_Failure
  diagnostic trouble code uds Power_Path_046_Not_Found_Failure: dtc-props=Dtc_Props_cef88d31, uds-dtc-value=0x00562e
  diagnostic event EventPowerPath046NotFoundFailure: aging-allowed=true, event-kind=SWC, prestorage-freeze-frame=false  # Event_Power_Path_046_Not_Found_Failure
  diagnostic event to trouble code uds mapping EventDtcMapPowerPath046NotFoundFailure: diagnostic-event=EventPowerPath046NotFoundFailure, trouble-code-uds=Power_Path_046_Not_Found_Failure  # Event_Dtc_Map_Power_Path_046_Not_Found_Failure
  diagnostic event to operation cycle mapping EventOperCycleMapPowerPath046NotFoundFailure: diagnostic-event=EventPowerPath046NotFoundFailure, operation-cycle=DefaultOperationCycle  # Event_Oper_Cycle_Map_Power_Path_046_Not_Found_Failure
  diagnostic event to debounce algorithm mapping EventDebounceMapPowerPath046NotFoundFailure: debounce-algorithm=time_based, diagnostic-event=EventPowerPath046NotFoundFailure  # EventDebounceMap_Power_Path_046_Not_Found_Failure
package /ZeC/DTC/DTC/Power_Path_043_Not_Found_Failure
  diagnostic trouble code uds Power_Path_043_Not_Found_Failure: dtc-props=Dtc_Props_c7c6bdd6, uds-dtc-value=0x00562b
  diagnostic event EventPowerPath043NotFoundFailure: aging-allowed=true, event-kind=SWC, prestorage-freeze-frame=false  # Event_Power_Path_043_Not_Found_Failure
  diagnostic event to trouble code uds mapping EventDtcMapPowerPath043NotFoundFailure: diagnostic-event=EventPowerPath043NotFoundFailure, trouble-code-uds=Power_Path_043_Not_Found_Failure  # Event_Dtc_Map_Power_Path_043_Not_Found_Failure
  diagnostic event to operation cycle mapping EventOperCycleMapPowerPath043NotFoundFailure: diagnostic-event=EventPowerPath043NotFoundFailure, operation-cycle=DefaultOperationCycle  # Event_Oper_Cycle_Map_Power_Path_043_Not_Found_Failure
  diagnostic event to debounce algorithm mapping EventDebounceMapPowerPath043NotFoundFailure: debounce-algorithm=time_based, diagnostic-event=EventPowerPath043NotFoundFailure  # EventDebounceMap_Power_Path_043_Not_Found_Failure
package /ZeC/DTC/DTC/Power_Path_042_Not_Found_Failure
  diagnostic trouble code uds Power_Path_042_Not_Found_Failure: dtc-props=Dtc_Props_deda398, uds-dtc-value=0x00562a
  diagnostic event EventPowerPath042NotFoundFailure: aging-allowed=true, event-kind=SWC, prestorage-freeze-frame=false  # Event_Power_Path_042_Not_Found_Failure
  diagnostic event to trouble code uds mapping EventDtcMapPowerPath042NotFoundFailure: diagnostic-event=EventPowerPath042NotFoundFailure, trouble-code-uds=Power_Path_042_Not_Found_Failure  # Event_Dtc_Map_Power_Path_042_Not_Found_Failure
  diagnostic event to operation cycle mapping EventOperCycleMapPowerPath042NotFoundFailure: diagnostic-event=EventPowerPath042NotFoundFailure, operation-cycle=DefaultOperationCycle  # Event_Oper_Cycle_Map_Power_Path_042_Not_Found_Failure
  diagnostic event to debounce algorithm mapping EventDebounceMapPowerPath042NotFoundFailure: debounce-algorithm=time_based, diagnostic-event=EventPowerPath042NotFoundFailure  # EventDebounceMap_Power_Path_042_Not_Found_Failure
package /ZeC/DTC/DTC/Power_Path_045_Not_Found_Failure
  diagnostic trouble code uds Power_Path_045_Not_Found_Failure: dtc-props=Dtc_Props_88e1870b, uds-dtc-value=0x00562d
  diagnostic event EventPowerPath045NotFoundFailure: aging-allowed=true, event-kind=SWC, prestorage-freeze-frame=false  # Event_Power_Path_045_Not_Found_Failure
  diagnostic event to trouble code uds mapping EventDtcMapPowerPath045NotFoundFailure: diagnostic-event=EventPowerPath045NotFoundFailure, trouble-code-uds=Power_Path_045_Not_Found_Failure  # Event_Dtc_Map_Power_Path_045_Not_Found_Failure
  diagnostic event to operation cycle mapping EventOperCycleMapPowerPath045NotFoundFailure: diagnostic-event=EventPowerPath045NotFoundFailure, operation-cycle=DefaultOperationCycle  # Event_Oper_Cycle_Map_Power_Path_045_Not_Found_Failure
  diagnostic event to debounce algorithm mapping EventDebounceMapPowerPath045NotFoundFailure: debounce-algorithm=time_based, diagnostic-event=EventPowerPath045NotFoundFailure  # EventDebounceMap_Power_Path_045_Not_Found_Failure
package /ZeC/DTC/DTC/Power_Path_044_Not_Found_Failure
  diagnostic trouble code uds Power_Path_044_Not_Found_Failure: dtc-props=Dtc_Props_81dfb7ec, uds-dtc-value=0x00562c
  diagnostic event EventPowerPath044NotFoundFailure: aging-allowed=true, event-kind=SWC, prestorage-freeze-frame=false  # Event_Power_Path_044_Not_Found_Failure
  diagnostic event to trouble code uds mapping EventDtcMapPowerPath044NotFoundFailure: diagnostic-event=EventPowerPath044NotFoundFailure, trouble-code-uds=Power_Path_044_Not_Found_Failure  # Event_Dtc_Map_Power_Path_044_Not_Found_Failure
  diagnostic event to operation cycle mapping EventOperCycleMapPowerPath044NotFoundFailure: diagnostic-event=EventPowerPath044NotFoundFailure, operation-cycle=DefaultOperationCycle  # Event_Oper_Cycle_Map_Power_Path_044_Not_Found_Failure
  diagnostic event to debounce algorithm mapping EventDebounceMapPowerPath044NotFoundFailure: debounce-algorithm=time_based, diagnostic-event=EventPowerPath044NotFoundFailure  # EventDebounceMap_Power_Path_044_Not_Found_Failure
package /ZeC/DTC/DTC/Power_Path_049_Not_Found_Failure
  diagnostic trouble code uds Power_Path_049_Not_Found_Failure: dtc-props=Dtc_Props_f658075d, uds-dtc-value=0x005631
  diagnostic event EventPowerPath049NotFoundFailure: aging-allowed=true, event-kind=SWC, prestorage-freeze-frame=false  # Event_Power_Path_049_Not_Found_Failure
  diagnostic event to trouble code uds mapping EventDtcMapPowerPath049NotFoundFailure: diagnostic-event=EventPowerPath049NotFoundFailure, trouble-code-uds=Power_Path_049_Not_Found_Failure  # Event_Dtc_Map_Power_Path_049_Not_Found_Failure
  diagnostic event to operation cycle mapping EventOperCycleMapPowerPath049NotFoundFailure: diagnostic-event=EventPowerPath049NotFoundFailure, operation-cycle=DefaultOperationCycle  # Event_Oper_Cycle_Map_Power_Path_049_Not_Found_Failure
  diagnostic event to debounce algorithm mapping EventDebounceMapPowerPath049NotFoundFailure: debounce-algorithm=time_based, diagnostic-event=EventPowerPath049NotFoundFailure  # EventDebounceMap_Power_Path_049_Not_Found_Failure
package /ZeC/DTC/DTC/Power_Path_048_Not_Found_Failure
  diagnostic trouble code uds Power_Path_048_Not_Found_Failure: dtc-props=Dtc_Props_b0410d67, uds-dtc-value=0x005630
  diagnostic event EventPowerPath048NotFoundFailure: aging-allowed=true, event-kind=SWC, prestorage-freeze-frame=false  # Event_Power_Path_048_Not_Found_Failure
  diagnostic event to trouble code uds mapping EventDtcMapPowerPath048NotFoundFailure: diagnostic-event=EventPowerPath048NotFoundFailure, trouble-code-uds=Power_Path_048_Not_Found_Failure  # Event_Dtc_Map_Power_Path_048_Not_Found_Failure
  diagnostic event to operation cycle mapping EventOperCycleMapPowerPath048NotFoundFailure: diagnostic-event=EventPowerPath048NotFoundFailure, operation-cycle=DefaultOperationCycle  # Event_Oper_Cycle_Map_Power_Path_048_Not_Found_Failure
  diagnostic event to debounce algorithm mapping EventDebounceMapPowerPath048NotFoundFailure: debounce-algorithm=time_based, diagnostic-event=EventPowerPath048NotFoundFailure  # EventDebounceMap_Power_Path_048_Not_Found_Failure
package /ZeC/DTC/DTC/Power_Path_021_Not_Found_Failure
  diagnostic trouble code uds Power_Path_021_Not_Found_Failure: dtc-props=Dtc_Props_62a9aec5, uds-dtc-value=0x005615
  diagnostic event EventPowerPath021NotFoundFailure: aging-allowed=true, event-kind=SWC, prestorage-freeze-frame=false  # Event_Power_Path_021_Not_Found_Failure
  diagnostic event to trouble code uds mapping EventDtcMapPowerPath021NotFoundFailure: diagnostic-event=EventPowerPath021NotFoundFailure, trouble-code-uds=Power_Path_021_Not_Found_Failure  # Event_Dtc_Map_Power_Path_021_Not_Found_Failure
  diagnostic event to operation cycle mapping EventOperCycleMapPowerPath021NotFoundFailure: diagnostic-event=EventPowerPath021NotFoundFailure, operation-cycle=DefaultOperationCycle  # Event_Oper_Cycle_Map_Power_Path_021_Not_Found_Failure
  diagnostic event to debounce algorithm mapping EventDebounceMapPowerPath021NotFoundFailure: debounce-algorithm=time_based, diagnostic-event=EventPowerPath021NotFoundFailure  # EventDebounceMap_Power_Path_021_Not_Found_Failure
package /ZeC/DTC/DTC/Power_Path_020_Not_Found_Failure
  diagnostic trouble code uds Power_Path_020_Not_Found_Failure: dtc-props=Dtc_Props_24b0a4ff, uds-dtc-value=0x005614
  diagnostic event EventPowerPath020NotFoundFailure: aging-allowed=true, event-kind=SWC, prestorage-freeze-frame=false  # Event_Power_Path_020_Not_Found_Failure
  diagnostic event to trouble code uds mapping EventDtcMapPowerPath020NotFoundFailure: diagnostic-event=EventPowerPath020NotFoundFailure, trouble-code-uds=Power_Path_020_Not_Found_Failure  # Event_Dtc_Map_Power_Path_020_Not_Found_Failure
  diagnostic event to operation cycle mapping EventOperCycleMapPowerPath020NotFoundFailure: diagnostic-event=EventPowerPath020NotFoundFailure, operation-cycle=DefaultOperationCycle  # Event_Oper_Cycle_Map_Power_Path_020_Not_Found_Failure
  diagnostic event to debounce algorithm mapping EventDebounceMapPowerPath020NotFoundFailure: debounce-algorithm=time_based, diagnostic-event=EventPowerPath020NotFoundFailure  # EventDebounceMap_Power_Path_020_Not_Found_Failure
package /ZeC/DTC/DTC/Power_Path_023_Not_Found_Failure
  diagnostic trouble code uds Power_Path_023_Not_Found_Failure: dtc-props=Dtc_Props_ee9bbab1, uds-dtc-value=0x005617
  diagnostic event EventPowerPath023NotFoundFailure: aging-allowed=true, event-kind=SWC, prestorage-freeze-frame=false  # Event_Power_Path_023_Not_Found_Failure
  diagnostic event to trouble code uds mapping EventDtcMapPowerPath023NotFoundFailure: diagnostic-event=EventPowerPath023NotFoundFailure, trouble-code-uds=Power_Path_023_Not_Found_Failure  # Event_Dtc_Map_Power_Path_023_Not_Found_Failure
  diagnostic event to operation cycle mapping EventOperCycleMapPowerPath023NotFoundFailure: diagnostic-event=EventPowerPath023NotFoundFailure, operation-cycle=DefaultOperationCycle  # Event_Oper_Cycle_Map_Power_Path_023_Not_Found_Failure
  diagnostic event to debounce algorithm mapping EventDebounceMapPowerPath023NotFoundFailure: debounce-algorithm=time_based, diagnostic-event=EventPowerPath023NotFoundFailure  # EventDebounceMap_Power_Path_023_Not_Found_Failure
package /ZeC/DTC/DTC/Power_Path_022_Not_Found_Failure
  diagnostic trouble code uds Power_Path_022_Not_Found_Failure: dtc-props=Dtc_Props_a882b08b, uds-dtc-value=0x005616
  diagnostic event EventPowerPath022NotFoundFailure: aging-allowed=true, event-kind=SWC, prestorage-freeze-frame=false  # Event_Power_Path_022_Not_Found_Failure
  diagnostic event to trouble code uds mapping EventDtcMapPowerPath022NotFoundFailure: diagnostic-event=EventPowerPath022NotFoundFailure, trouble-code-uds=Power_Path_022_Not_Found_Failure  # Event_Dtc_Map_Power_Path_022_Not_Found_Failure
  diagnostic event to operation cycle mapping EventOperCycleMapPowerPath022NotFoundFailure: diagnostic-event=EventPowerPath022NotFoundFailure, operation-cycle=DefaultOperationCycle  # Event_Oper_Cycle_Map_Power_Path_022_Not_Found_Failure
  diagnostic event to debounce algorithm mapping EventDebounceMapPowerPath022NotFoundFailure: debounce-algorithm=time_based, diagnostic-event=EventPowerPath022NotFoundFailure  # EventDebounceMap_Power_Path_022_Not_Found_Failure
package /ZeC/DTC/DTC/Power_Path_017_Not_Found_Failure
  diagnostic trouble code uds Power_Path_017_Not_Found_Failure: dtc-props=Dtc_Props_a1bc806c, uds-dtc-value=0x005611
  diagnostic event EventPowerPath017NotFoundFailure: aging-allowed=true, event-kind=SWC, prestorage-freeze-frame=false  # Event_Power_Path_017_Not_Found_Failure
  diagnostic event to trouble code uds mapping EventDtcMapPowerPath017NotFoundFailure: diagnostic-event=EventPowerPath017NotFoundFailure, trouble-code-uds=Power_Path_017_Not_Found_Failure  # Event_Dtc_Map_Power_Path_017_Not_Found_Failure
  diagnostic event to operation cycle mapping EventOperCycleMapPowerPath017NotFoundFailure: diagnostic-event=EventPowerPath017NotFoundFailure, operation-cycle=DefaultOperationCycle  # Event_Oper_Cycle_Map_Power_Path_017_Not_Found_Failure
  diagnostic event to debounce algorithm mapping EventDebounceMapPowerPath017NotFoundFailure: debounce-algorithm=time_based, diagnostic-event=EventPowerPath017NotFoundFailure  # EventDebounceMap_Power_Path_017_Not_Found_Failure
package /ZeC/DTC/DTC/Power_Path_016_Not_Found_Failure
  diagnostic trouble code uds Power_Path_016_Not_Found_Failure: dtc-props=Dtc_Props_e7a58a56, uds-dtc-value=0x005610
  diagnostic event EventPowerPath016NotFoundFailure: aging-allowed=true, event-kind=SWC, prestorage-freeze-frame=false  # Event_Power_Path_016_Not_Found_Failure
  diagnostic event to trouble code uds mapping EventDtcMapPowerPath016NotFoundFailure: diagnostic-event=EventPowerPath016NotFoundFailure, trouble-code-uds=Power_Path_016_Not_Found_Failure  # Event_Dtc_Map_Power_Path_016_Not_Found_Failure
  diagnostic event to operation cycle mapping EventOperCycleMapPowerPath016NotFoundFailure: diagnostic-event=EventPowerPath016NotFoundFailure, operation-cycle=DefaultOperationCycle  # Event_Oper_Cycle_Map_Power_Path_016_Not_Found_Failure
  diagnostic event to debounce algorithm mapping EventDebounceMapPowerPath016NotFoundFailure: debounce-algorithm=time_based, diagnostic-event=EventPowerPath016NotFoundFailure  # EventDebounceMap_Power_Path_016_Not_Found_Failure
package /ZeC/DTC/DTC/Power_Path_019_Not_Found_Failure
  diagnostic trouble code uds Power_Path_019_Not_Found_Failure: dtc-props=Dtc_Props_2d8e9418, uds-dtc-value=0x005613
  diagnostic event EventPowerPath019NotFoundFailure: aging-allowed=true, event-kind=SWC, prestorage-freeze-frame=false  # Event_Power_Path_019_Not_Found_Failure
  diagnostic event to trouble code uds mapping EventDtcMapPowerPath019NotFoundFailure: diagnostic-event=EventPowerPath019NotFoundFailure, trouble-code-uds=Power_Path_019_Not_Found_Failure  # Event_Dtc_Map_Power_Path_019_Not_Found_Failure
  diagnostic event to operation cycle mapping EventOperCycleMapPowerPath019NotFoundFailure: diagnostic-event=EventPowerPath019NotFoundFailure, operation-cycle=DefaultOperationCycle  # Event_Oper_Cycle_Map_Power_Path_019_Not_Found_Failure
  diagnostic event to debounce algorithm mapping EventDebounceMapPowerPath019NotFoundFailure: debounce-algorithm=time_based, diagnostic-event=EventPowerPath019NotFoundFailure  # EventDebounceMap_Power_Path_019_Not_Found_Failure
package /ZeC/DTC/DTC/Power_Path_018_Not_Found_Failure
  diagnostic trouble code uds Power_Path_018_Not_Found_Failure: dtc-props=Dtc_Props_6b979e22, uds-dtc-value=0x005612
  diagnostic event EventPowerPath018NotFoundFailure: aging-allowed=true, event-kind=SWC, prestorage-freeze-frame=false  # Event_Power_Path_018_Not_Found_Failure
  diagnostic event to trouble code uds mapping EventDtcMapPowerPath018NotFoundFailure: diagnostic-event=EventPowerPath018NotFoundFailure, trouble-code-uds=Power_Path_018_Not_Found_Failure  # Event_Dtc_Map_Power_Path_018_Not_Found_Failure
  diagnostic event to operation cycle mapping EventOperCycleMapPowerPath018NotFoundFailure: diagnostic-event=EventPowerPath018NotFoundFailure, operation-cycle=DefaultOperationCycle  # Event_Oper_Cycle_Map_Power_Path_018_Not_Found_Failure
  diagnostic event to debounce algorithm mapping EventDebounceMapPowerPath018NotFoundFailure: debounce-algorithm=time_based, diagnostic-event=EventPowerPath018NotFoundFailure  # EventDebounceMap_Power_Path_018_Not_Found_Failure
package /ZeC/DTC/DTC/Power_Path_025_Not_Found_Failure
  diagnostic trouble code uds Power_Path_025_Not_Found_Failure: dtc-props=Dtc_Props_fce7db7f, uds-dtc-value=0x005619
  diagnostic event EventPowerPath025NotFoundFailure: aging-allowed=true, event-kind=SWC, prestorage-freeze-frame=false  # Event_Power_Path_025_Not_Found_Failure
  diagnostic event to trouble code uds mapping EventDtcMapPowerPath025NotFoundFailure: diagnostic-event=EventPowerPath025NotFoundFailure, trouble-code-uds=Power_Path_025_Not_Found_Failure  # Event_Dtc_Map_Power_Path_025_Not_Found_Failure
  diagnostic event to operation cycle mapping EventOperCycleMapPowerPath025NotFoundFailure: diagnostic-event=EventPowerPath025NotFoundFailure, operation-cycle=DefaultOperationCycle  # Event_Oper_Cycle_Map_Power_Path_025_Not_Found_Failure
  diagnostic event to debounce algorithm mapping EventDebounceMapPowerPath025NotFoundFailure: debounce-algorithm=time_based, diagnostic-event=EventPowerPath025NotFoundFailure  # EventDebounceMap_Power_Path_025_Not_Found_Failure
package /ZeC/DTC/DTC/Power_Path_024_Not_Found_Failure
  diagnostic trouble code uds Power_Path_024_Not_Found_Failure: dtc-props=Dtc_Props_bafed145, uds-dtc-value=0x005618
  diagnostic event EventPowerPath024NotFoundFailure: aging-allowed=true, event-kind=SWC, prestorage-freeze-frame=false  # Event_Power_Path_024_Not_Found_Failure
  diagnostic event to trouble code uds mapping EventDtcMapPowerPath024NotFoundFailure: diagnostic-event=EventPowerPath024NotFoundFailure, trouble-code-uds=Power_Path_024_Not_Found_Failure  # Event_Dtc_Map_Power_Path_024_Not_Found_Failure
  diagnostic event to operation cycle mapping EventOperCycleMapPowerPath024NotFoundFailure: diagnostic-event=EventPowerPath024NotFoundFailure, operation-cycle=DefaultOperationCycle  # Event_Oper_Cycle_Map_Power_Path_024_Not_Found_Failure
  diagnostic event to debounce algorithm mapping EventDebounceMapPowerPath024NotFoundFailure: debounce-algorithm=time_based, diagnostic-event=EventPowerPath024NotFoundFailure  # EventDebounceMap_Power_Path_024_Not_Found_Failure
package /ZeC/DTC/DTC/Power_Path_030_Not_Found_Failure
  diagnostic trouble code uds Power_Path_030_Not_Found_Failure: dtc-props=Dtc_Props_5f56cab8, uds-dtc-value=0x00561e
  diagnostic event EventPowerPath030NotFoundFailure: aging-allowed=true, event-kind=SWC, prestorage-freeze-frame=false  # Event_Power_Path_030_Not_Found_Failure
  diagnostic event to trouble code uds mapping EventDtcMapPowerPath030NotFoundFailure: diagnostic-event=EventPowerPath030NotFoundFailure, trouble-code-uds=Power_Path_030_Not_Found_Failure  # Event_Dtc_Map_Power_Path_030_Not_Found_Failure
  diagnostic event to operation cycle mapping EventOperCycleMapPowerPath030NotFoundFailure: diagnostic-event=EventPowerPath030NotFoundFailure, operation-cycle=DefaultOperationCycle  # Event_Oper_Cycle_Map_Power_Path_030_Not_Found_Failure
  diagnostic event to debounce algorithm mapping EventDebounceMapPowerPath030NotFoundFailure: debounce-algorithm=time_based, diagnostic-event=EventPowerPath030NotFoundFailure  # EventDebounceMap_Power_Path_030_Not_Found_Failure
package /ZeC/DTC/DTC/Power_Path_029_Not_Found_Failure
  diagnostic trouble code uds Power_Path_029_Not_Found_Failure: dtc-props=Dtc_Props_194fc082, uds-dtc-value=0x00561d
  diagnostic event EventPowerPath029NotFoundFailure: aging-allowed=true, event-kind=SWC, prestorage-freeze-frame=false  # Event_Power_Path_029_Not_Found_Failure
  diagnostic event to trouble code uds mapping EventDtcMapPowerPath029NotFoundFailure: diagnostic-event=EventPowerPath029NotFoundFailure, trouble-code-uds=Power_Path_029_Not_Found_Failure  # Event_Dtc_Map_Power_Path_029_Not_Found_Failure
  diagnostic event to operation cycle mapping EventOperCycleMapPowerPath029NotFoundFailure: diagnostic-event=EventPowerPath029NotFoundFailure, operation-cycle=DefaultOperationCycle  # Event_Oper_Cycle_Map_Power_Path_029_Not_Found_Failure
  diagnostic event to debounce algorithm mapping EventDebounceMapPowerPath029NotFoundFailure: debounce-algorithm=time_based, diagnostic-event=EventPowerPath029NotFoundFailure  # EventDebounceMap_Power_Path_029_Not_Found_Failure
package /ZeC/DTC/DTC/Power_Path_031_Not_Found_Failure
  diagnostic trouble code uds Power_Path_031_Not_Found_Failure: dtc-props=Dtc_Props_957dd4f6, uds-dtc-value=0x00561f
  diagnostic event EventPowerPath031NotFoundFailure: aging-allowed=true, event-kind=SWC, prestorage-freeze-frame=false  # Event_Power_Path_031_Not_Found_Failure
  diagnostic event to trouble code uds mapping EventDtcMapPowerPath031NotFoundFailure: diagnostic-event=EventPowerPath031NotFoundFailure, trouble-code-uds=Power_Path_031_Not_Found_Failure  # Event_Dtc_Map_Power_Path_031_Not_Found_Failure
  diagnostic event to operation cycle mapping EventOperCycleMapPowerPath031NotFoundFailure: diagnostic-event=EventPowerPath031NotFoundFailure, operation-cycle=DefaultOperationCycle  # Event_Oper_Cycle_Map_Power_Path_031_Not_Found_Failure
  diagnostic event to debounce algorithm mapping EventDebounceMapPowerPath031NotFoundFailure: debounce-algorithm=time_based, diagnostic-event=EventPowerPath031NotFoundFailure  # EventDebounceMap_Power_Path_031_Not_Found_Failure
package /ZeC/DTC/DTC/Power_Path_026_Not_Found_Failure
  diagnostic trouble code uds Power_Path_026_Not_Found_Failure: dtc-props=Dtc_Props_9c43e411, uds-dtc-value=0x00561a
  diagnostic event EventPowerPath026NotFoundFailure: aging-allowed=true, event-kind=SWC, prestorage-freeze-frame=false  # Event_Power_Path_026_Not_Found_Failure
  diagnostic event to trouble code uds mapping EventDtcMapPowerPath026NotFoundFailure: diagnostic-event=EventPowerPath026NotFoundFailure, trouble-code-uds=Power_Path_026_Not_Found_Failure  # Event_Dtc_Map_Power_Path_026_Not_Found_Failure
  diagnostic event to operation cycle mapping EventOperCycleMapPowerPath026NotFoundFailure: diagnostic-event=EventPowerPath026NotFoundFailure, operation-cycle=DefaultOperationCycle  # Event_Oper_Cycle_Map_Power_Path_026_Not_Found_Failure
  diagnostic event to debounce algorithm mapping EventDebounceMapPowerPath026NotFoundFailure: debounce-algorithm=time_based, diagnostic-event=EventPowerPath026NotFoundFailure  # EventDebounceMap_Power_Path_026_Not_Found_Failure
package /ZeC/DTC/DTC/Power_Path_028_Not_Found_Failure
  diagnostic trouble code uds Power_Path_028_Not_Found_Failure: dtc-props=Dtc_Props_1071f065, uds-dtc-value=0x00561c
  diagnostic event EventPowerPath028NotFoundFailure: aging-allowed=true, event-kind=SWC, prestorage-freeze-frame=false  # Event_Power_Path_028_Not_Found_Failure
  diagnostic event to trouble code uds mapping EventDtcMapPowerPath028NotFoundFailure: diagnostic-event=EventPowerPath028NotFoundFailure, trouble-code-uds=Power_Path_028_Not_Found_Failure  # Event_Dtc_Map_Power_Path_028_Not_Found_Failure
  diagnostic event to operation cycle mapping EventOperCycleMapPowerPath028NotFoundFailure: diagnostic-event=EventPowerPath028NotFoundFailure, operation-cycle=DefaultOperationCycle  # Event_Oper_Cycle_Map_Power_Path_028_Not_Found_Failure
  diagnostic event to debounce algorithm mapping EventDebounceMapPowerPath028NotFoundFailure: debounce-algorithm=time_based, diagnostic-event=EventPowerPath028NotFoundFailure  # EventDebounceMap_Power_Path_028_Not_Found_Failure
package /ZeC/DTC/DTC/Power_Path_027_Not_Found_Failure
  diagnostic trouble code uds Power_Path_027_Not_Found_Failure: dtc-props=Dtc_Props_5668fa5f, uds-dtc-value=0x00561b
  diagnostic event EventPowerPath027NotFoundFailure: aging-allowed=true, event-kind=SWC, prestorage-freeze-frame=false  # Event_Power_Path_027_Not_Found_Failure
  diagnostic event to trouble code uds mapping EventDtcMapPowerPath027NotFoundFailure: diagnostic-event=EventPowerPath027NotFoundFailure, trouble-code-uds=Power_Path_027_Not_Found_Failure  # Event_Dtc_Map_Power_Path_027_Not_Found_Failure
  diagnostic event to operation cycle mapping EventOperCycleMapPowerPath027NotFoundFailure: diagnostic-event=EventPowerPath027NotFoundFailure, operation-cycle=DefaultOperationCycle  # Event_Oper_Cycle_Map_Power_Path_027_Not_Found_Failure
  diagnostic event to debounce algorithm mapping EventDebounceMapPowerPath027NotFoundFailure: debounce-algorithm=time_based, diagnostic-event=EventPowerPath027NotFoundFailure  # EventDebounceMap_Power_Path_027_Not_Found_Failure
package /ZeC/DTC/DTC/Power_Path_032_Not_Found_Failure
  diagnostic trouble code uds Power_Path_032_Not_Found_Failure: dtc-props=Dtc_Props_760bcddf, uds-dtc-value=0x005620
  diagnostic event EventPowerPath032NotFoundFailure: aging-allowed=true, event-kind=SWC, prestorage-freeze-frame=false  # Event_Power_Path_032_Not_Found_Failure
  diagnostic event to trouble code uds mapping EventDtcMapPowerPath032NotFoundFailure: diagnostic-event=EventPowerPath032NotFoundFailure, trouble-code-uds=Power_Path_032_Not_Found_Failure  # Event_Dtc_Map_Power_Path_032_Not_Found_Failure
  diagnostic event to operation cycle mapping EventOperCycleMapPowerPath032NotFoundFailure: diagnostic-event=EventPowerPath032NotFoundFailure, operation-cycle=DefaultOperationCycle  # Event_Oper_Cycle_Map_Power_Path_032_Not_Found_Failure
  diagnostic event to debounce algorithm mapping EventDebounceMapPowerPath032NotFoundFailure: debounce-algorithm=time_based, diagnostic-event=EventPowerPath032NotFoundFailure  # EventDebounceMap_Power_Path_032_Not_Found_Failure
package /ZeC/DTC/DTC/Power_Path_072_Not_Found_Failure
  diagnostic trouble code uds Power_Path_072_Not_Found_Failure: dtc-props=Dtc_Props_d37d1f9f, uds-dtc-value=0x005648
  diagnostic event EventPowerPath072NotFoundFailure: aging-allowed=true, event-kind=SWC, prestorage-freeze-frame=false  # Event_Power_Path_072_Not_Found_Failure
  diagnostic event to trouble code uds mapping EventDtcMapPowerPath072NotFoundFailure: diagnostic-event=EventPowerPath072NotFoundFailure, trouble-code-uds=Power_Path_072_Not_Found_Failure  # Event_Dtc_Map_Power_Path_072_Not_Found_Failure
  diagnostic event to operation cycle mapping EventOperCycleMapPowerPath072NotFoundFailure: diagnostic-event=EventPowerPath072NotFoundFailure, operation-cycle=DefaultOperationCycle  # Event_Oper_Cycle_Map_Power_Path_072_Not_Found_Failure
  diagnostic event to debounce algorithm mapping EventDebounceMapPowerPath072NotFoundFailure: debounce-algorithm=time_based, diagnostic-event=EventPowerPath072NotFoundFailure  # EventDebounceMap_Power_Path_072_Not_Found_Failure
package /ZeC/DTC/DTC/Power_Path_071_Not_Found_Failure
  diagnostic trouble code uds Power_Path_071_Not_Found_Failure: dtc-props=Dtc_Props_8718746b, uds-dtc-value=0x005647
  diagnostic event EventPowerPath071NotFoundFailure: aging-allowed=true, event-kind=SWC, prestorage-freeze-frame=false  # Event_Power_Path_071_Not_Found_Failure
  diagnostic event to trouble code uds mapping EventDtcMapPowerPath071NotFoundFailure: diagnostic-event=EventPowerPath071NotFoundFailure, trouble-code-uds=Power_Path_071_Not_Found_Failure  # Event_Dtc_Map_Power_Path_071_Not_Found_Failure
  diagnostic event to operation cycle mapping EventOperCycleMapPowerPath071NotFoundFailure: diagnostic-event=EventPowerPath071NotFoundFailure, operation-cycle=DefaultOperationCycle  # Event_Oper_Cycle_Map_Power_Path_071_Not_Found_Failure
  diagnostic event to debounce algorithm mapping EventDebounceMapPowerPath071NotFoundFailure: debounce-algorithm=time_based, diagnostic-event=EventPowerPath071NotFoundFailure  # EventDebounceMap_Power_Path_071_Not_Found_Failure
package /ZeC/DTC/DTC/Power_Path_073_Not_Found_Failure
  diagnostic trouble code uds Power_Path_073_Not_Found_Failure: dtc-props=Dtc_Props_956415a5, uds-dtc-value=0x005649
  diagnostic event EventPowerPath073NotFoundFailure: aging-allowed=true, event-kind=SWC, prestorage-freeze-frame=false  # Event_Power_Path_073_Not_Found_Failure
  diagnostic event to trouble code uds mapping EventDtcMapPowerPath073NotFoundFailure: diagnostic-event=EventPowerPath073NotFoundFailure, trouble-code-uds=Power_Path_073_Not_Found_Failure  # Event_Dtc_Map_Power_Path_073_Not_Found_Failure
  diagnostic event to operation cycle mapping EventOperCycleMapPowerPath073NotFoundFailure: diagnostic-event=EventPowerPath073NotFoundFailure, operation-cycle=DefaultOperationCycle  # Event_Oper_Cycle_Map_Power_Path_073_Not_Found_Failure
  diagnostic event to debounce algorithm mapping EventDebounceMapPowerPath073NotFoundFailure: debounce-algorithm=time_based, diagnostic-event=EventPowerPath073NotFoundFailure  # EventDebounceMap_Power_Path_073_Not_Found_Failure
package /ZeC/DTC/DTC/Power_Path_068_Not_Found_Failure
  diagnostic trouble code uds Power_Path_068_Not_Found_Failure: dtc-props=Dtc_Props_4d336a25, uds-dtc-value=0x005644
  diagnostic event EventPowerPath068NotFoundFailure: aging-allowed=true, event-kind=SWC, prestorage-freeze-frame=false  # Event_Power_Path_068_Not_Found_Failure
  diagnostic event to trouble code uds mapping EventDtcMapPowerPath068NotFoundFailure: diagnostic-event=EventPowerPath068NotFoundFailure, trouble-code-uds=Power_Path_068_Not_Found_Failure  # Event_Dtc_Map_Power_Path_068_Not_Found_Failure
  diagnostic event to operation cycle mapping EventOperCycleMapPowerPath068NotFoundFailure: diagnostic-event=EventPowerPath068NotFoundFailure, operation-cycle=DefaultOperationCycle  # Event_Oper_Cycle_Map_Power_Path_068_Not_Found_Failure
  diagnostic event to debounce algorithm mapping EventDebounceMapPowerPath068NotFoundFailure: debounce-algorithm=time_based, diagnostic-event=EventPowerPath068NotFoundFailure  # EventDebounceMap_Power_Path_068_Not_Found_Failure
package /ZeC/DTC/DTC/Power_Path_067_Not_Found_Failure
  diagnostic trouble code uds Power_Path_067_Not_Found_Failure: dtc-props=Dtc_Props_440d5ac2, uds-dtc-value=0x005643
  diagnostic event EventPowerPath067NotFoundFailure: aging-allowed=true, event-kind=SWC, prestorage-freeze-frame=false  # Event_Power_Path_067_Not_Found_Failure
  diagnostic event to trouble code uds mapping EventDtcMapPowerPath067NotFoundFailure: diagnostic-event=EventPowerPath067NotFoundFailure, trouble-code-uds=Power_Path_067_Not_Found_Failure  # Event_Dtc_Map_Power_Path_067_Not_Found_Failure
  diagnostic event to operation cycle mapping EventOperCycleMapPowerPath067NotFoundFailure: diagnostic-event=EventPowerPath067NotFoundFailure, operation-cycle=DefaultOperationCycle  # Event_Oper_Cycle_Map_Power_Path_067_Not_Found_Failure
  diagnostic event to debounce algorithm mapping EventDebounceMapPowerPath067NotFoundFailure: debounce-algorithm=time_based, diagnostic-event=EventPowerPath067NotFoundFailure  # EventDebounceMap_Power_Path_067_Not_Found_Failure
package /ZeC/DTC/DTC/Power_Path_070_Not_Found_Failure
  diagnostic trouble code uds Power_Path_070_Not_Found_Failure: dtc-props=Dtc_Props_c1017e51, uds-dtc-value=0x005646
  diagnostic event EventPowerPath070NotFoundFailure: aging-allowed=true, event-kind=SWC, prestorage-freeze-frame=false  # Event_Power_Path_070_Not_Found_Failure
  diagnostic event to trouble code uds mapping EventDtcMapPowerPath070NotFoundFailure: diagnostic-event=EventPowerPath070NotFoundFailure, trouble-code-uds=Power_Path_070_Not_Found_Failure  # Event_Dtc_Map_Power_Path_070_Not_Found_Failure
  diagnostic event to operation cycle mapping EventOperCycleMapPowerPath070NotFoundFailure: diagnostic-event=EventPowerPath070NotFoundFailure, operation-cycle=DefaultOperationCycle  # Event_Oper_Cycle_Map_Power_Path_070_Not_Found_Failure
  diagnostic event to debounce algorithm mapping EventDebounceMapPowerPath070NotFoundFailure: debounce-algorithm=time_based, diagnostic-event=EventPowerPath070NotFoundFailure  # EventDebounceMap_Power_Path_070_Not_Found_Failure
package /ZeC/DTC/DTC/Power_Path_069_Not_Found_Failure
  diagnostic trouble code uds Power_Path_069_Not_Found_Failure: dtc-props=Dtc_Props_b2a601f, uds-dtc-value=0x005645
  diagnostic event EventPowerPath069NotFoundFailure: aging-allowed=true, event-kind=SWC, prestorage-freeze-frame=false  # Event_Power_Path_069_Not_Found_Failure
  diagnostic event to trouble code uds mapping EventDtcMapPowerPath069NotFoundFailure: diagnostic-event=EventPowerPath069NotFoundFailure, trouble-code-uds=Power_Path_069_Not_Found_Failure  # Event_Dtc_Map_Power_Path_069_Not_Found_Failure
  diagnostic event to operation cycle mapping EventOperCycleMapPowerPath069NotFoundFailure: diagnostic-event=EventPowerPath069NotFoundFailure, operation-cycle=DefaultOperationCycle  # Event_Oper_Cycle_Map_Power_Path_069_Not_Found_Failure
  diagnostic event to debounce algorithm mapping EventDebounceMapPowerPath069NotFoundFailure: debounce-algorithm=time_based, diagnostic-event=EventPowerPath069NotFoundFailure  # EventDebounceMap_Power_Path_069_Not_Found_Failure
package /ZeC/DTC/DTC/Power_Path_075_Not_Found_Failure
  diagnostic trouble code uds Power_Path_075_Not_Found_Failure: dtc-props=Dtc_Props_3feb3485, uds-dtc-value=0x00564b
  diagnostic event EventPowerPath075NotFoundFailure: aging-allowed=true, event-kind=SWC, prestorage-freeze-frame=false  # Event_Power_Path_075_Not_Found_Failure
  diagnostic event to trouble code uds mapping EventDtcMapPowerPath075NotFoundFailure: diagnostic-event=EventPowerPath075NotFoundFailure, trouble-code-uds=Power_Path_075_Not_Found_Failure  # Event_Dtc_Map_Power_Path_075_Not_Found_Failure
  diagnostic event to operation cycle mapping EventOperCycleMapPowerPath075NotFoundFailure: diagnostic-event=EventPowerPath075NotFoundFailure, operation-cycle=DefaultOperationCycle  # Event_Oper_Cycle_Map_Power_Path_075_Not_Found_Failure
  diagnostic event to debounce algorithm mapping EventDebounceMapPowerPath075NotFoundFailure: debounce-algorithm=time_based, diagnostic-event=EventPowerPath075NotFoundFailure  # EventDebounceMap_Power_Path_075_Not_Found_Failure
package /ZeC/DTC/DTC/Power_Path_074_Not_Found_Failure
  diagnostic trouble code uds Power_Path_074_Not_Found_Failure: dtc-props=Dtc_Props_f5c02acb, uds-dtc-value=0x00564a
  diagnostic event EventPowerPath074NotFoundFailure: aging-allowed=true, event-kind=SWC, prestorage-freeze-frame=false  # Event_Power_Path_074_Not_Found_Failure
  diagnostic event to trouble code uds mapping EventDtcMapPowerPath074NotFoundFailure: diagnostic-event=EventPowerPath074NotFoundFailure, trouble-code-uds=Power_Path_074_Not_Found_Failure  # Event_Dtc_Map_Power_Path_074_Not_Found_Failure
  diagnostic event to operation cycle mapping EventOperCycleMapPowerPath074NotFoundFailure: diagnostic-event=EventPowerPath074NotFoundFailure, operation-cycle=DefaultOperationCycle  # Event_Oper_Cycle_Map_Power_Path_074_Not_Found_Failure
  diagnostic event to debounce algorithm mapping EventDebounceMapPowerPath074NotFoundFailure: debounce-algorithm=time_based, diagnostic-event=EventPowerPath074NotFoundFailure  # EventDebounceMap_Power_Path_074_Not_Found_Failure
package /ZeC/DTC/DTC/Power_Path_077_Not_Found_Failure
  diagnostic trouble code uds Power_Path_077_Not_Found_Failure: dtc-props=Dtc_Props_70cc0e58, uds-dtc-value=0x00564d
  diagnostic event EventPowerPath077NotFoundFailure: aging-allowed=true, event-kind=SWC, prestorage-freeze-frame=false  # Event_Power_Path_077_Not_Found_Failure
  diagnostic event to trouble code uds mapping EventDtcMapPowerPath077NotFoundFailure: diagnostic-event=EventPowerPath077NotFoundFailure, trouble-code-uds=Power_Path_077_Not_Found_Failure  # Event_Dtc_Map_Power_Path_077_Not_Found_Failure
  diagnostic event to operation cycle mapping EventOperCycleMapPowerPath077NotFoundFailure: diagnostic-event=EventPowerPath077NotFoundFailure, operation-cycle=DefaultOperationCycle  # Event_Oper_Cycle_Map_Power_Path_077_Not_Found_Failure
  diagnostic event to debounce algorithm mapping EventDebounceMapPowerPath077NotFoundFailure: debounce-algorithm=time_based, diagnostic-event=EventPowerPath077NotFoundFailure  # EventDebounceMap_Power_Path_077_Not_Found_Failure
package /ZeC/DTC/DTC/Power_Path_076_Not_Found_Failure
  diagnostic trouble code uds Power_Path_076_Not_Found_Failure: dtc-props=Dtc_Props_79f23ebf, uds-dtc-value=0x00564c
  diagnostic event EventPowerPath076NotFoundFailure: aging-allowed=true, event-kind=SWC, prestorage-freeze-frame=false  # Event_Power_Path_076_Not_Found_Failure
  diagnostic event to trouble code uds mapping EventDtcMapPowerPath076NotFoundFailure: diagnostic-event=EventPowerPath076NotFoundFailure, trouble-code-uds=Power_Path_076_Not_Found_Failure  # Event_Dtc_Map_Power_Path_076_Not_Found_Failure
  diagnostic event to operation cycle mapping EventOperCycleMapPowerPath076NotFoundFailure: diagnostic-event=EventPowerPath076NotFoundFailure, operation-cycle=DefaultOperationCycle  # Event_Oper_Cycle_Map_Power_Path_076_Not_Found_Failure
  diagnostic event to debounce algorithm mapping EventDebounceMapPowerPath076NotFoundFailure: debounce-algorithm=time_based, diagnostic-event=EventPowerPath076NotFoundFailure  # EventDebounceMap_Power_Path_076_Not_Found_Failure
package /ZeC/DTC/DTC/Power_Path_079_Not_Found_Failure
  diagnostic trouble code uds Power_Path_079_Not_Found_Failure: dtc-props=Dtc_Props_fcfe1a2c, uds-dtc-value=0x00564f
  diagnostic event EventPowerPath079NotFoundFailure: aging-allowed=true, event-kind=SWC, prestorage-freeze-frame=false  # Event_Power_Path_079_Not_Found_Failure
  diagnostic event to trouble code uds mapping EventDtcMapPowerPath079NotFoundFailure: diagnostic-event=EventPowerPath079NotFoundFailure, trouble-code-uds=Power_Path_079_Not_Found_Failure  # Event_Dtc_Map_Power_Path_079_Not_Found_Failure
  diagnostic event to operation cycle mapping EventOperCycleMapPowerPath079NotFoundFailure: diagnostic-event=EventPowerPath079NotFoundFailure, operation-cycle=DefaultOperationCycle  # Event_Oper_Cycle_Map_Power_Path_079_Not_Found_Failure
  diagnostic event to debounce algorithm mapping EventDebounceMapPowerPath079NotFoundFailure: debounce-algorithm=time_based, diagnostic-event=EventPowerPath079NotFoundFailure  # EventDebounceMap_Power_Path_079_Not_Found_Failure
package /ZeC/DTC/DTC/Power_Path_078_Not_Found_Failure
  diagnostic trouble code uds Power_Path_078_Not_Found_Failure: dtc-props=Dtc_Props_36d50462, uds-dtc-value=0x00564e
  diagnostic event EventPowerPath078NotFoundFailure: aging-allowed=true, event-kind=SWC, prestorage-freeze-frame=false  # Event_Power_Path_078_Not_Found_Failure
  diagnostic event to trouble code uds mapping EventDtcMapPowerPath078NotFoundFailure: diagnostic-event=EventPowerPath078NotFoundFailure, trouble-code-uds=Power_Path_078_Not_Found_Failure  # Event_Dtc_Map_Power_Path_078_Not_Found_Failure
  diagnostic event to operation cycle mapping EventOperCycleMapPowerPath078NotFoundFailure: diagnostic-event=EventPowerPath078NotFoundFailure, operation-cycle=DefaultOperationCycle  # Event_Oper_Cycle_Map_Power_Path_078_Not_Found_Failure
  diagnostic event to debounce algorithm mapping EventDebounceMapPowerPath078NotFoundFailure: debounce-algorithm=time_based, diagnostic-event=EventPowerPath078NotFoundFailure  # EventDebounceMap_Power_Path_078_Not_Found_Failure
package /ZeC/DTC/DTC/Power_Path_081_Not_Found_Failure
  diagnostic trouble code uds Power_Path_081_Not_Found_Failure: dtc-props=Dtc_Props_e758e0e, uds-dtc-value=0x005651
  diagnostic event EventPowerPath081NotFoundFailure: aging-allowed=true, event-kind=SWC, prestorage-freeze-frame=false  # Event_Power_Path_081_Not_Found_Failure
  diagnostic event to trouble code uds mapping EventDtcMapPowerPath081NotFoundFailure: diagnostic-event=EventPowerPath081NotFoundFailure, trouble-code-uds=Power_Path_081_Not_Found_Failure  # Event_Dtc_Map_Power_Path_081_Not_Found_Failure
  diagnostic event to operation cycle mapping EventOperCycleMapPowerPath081NotFoundFailure: diagnostic-event=EventPowerPath081NotFoundFailure, operation-cycle=DefaultOperationCycle  # Event_Oper_Cycle_Map_Power_Path_081_Not_Found_Failure
  diagnostic event to debounce algorithm mapping EventDebounceMapPowerPath081NotFoundFailure: debounce-algorithm=time_based, diagnostic-event=EventPowerPath081NotFoundFailure  # EventDebounceMap_Power_Path_081_Not_Found_Failure
package /ZeC/DTC/DTC/Power_Path_080_Not_Found_Failure
  diagnostic trouble code uds Power_Path_080_Not_Found_Failure: dtc-props=Dtc_Props_486c8434, uds-dtc-value=0x005650
  diagnostic event EventPowerPath080NotFoundFailure: aging-allowed=true, event-kind=SWC, prestorage-freeze-frame=false  # Event_Power_Path_080_Not_Found_Failure
  diagnostic event to trouble code uds mapping EventDtcMapPowerPath080NotFoundFailure: diagnostic-event=EventPowerPath080NotFoundFailure, trouble-code-uds=Power_Path_080_Not_Found_Failure  # Event_Dtc_Map_Power_Path_080_Not_Found_Failure
  diagnostic event to operation cycle mapping EventOperCycleMapPowerPath080NotFoundFailure: diagnostic-event=EventPowerPath080NotFoundFailure, operation-cycle=DefaultOperationCycle  # Event_Oper_Cycle_Map_Power_Path_080_Not_Found_Failure
  diagnostic event to debounce algorithm mapping EventDebounceMapPowerPath080NotFoundFailure: debounce-algorithm=time_based, diagnostic-event=EventPowerPath080NotFoundFailure  # EventDebounceMap_Power_Path_080_Not_Found_Failure
package /ZeC/DTC/DTC/Power_Path_083_Not_Found_Failure
  diagnostic trouble code uds Power_Path_083_Not_Found_Failure: dtc-props=Dtc_Props_82479a7a, uds-dtc-value=0x005653
  diagnostic event EventPowerPath083NotFoundFailure: aging-allowed=true, event-kind=SWC, prestorage-freeze-frame=false  # Event_Power_Path_083_Not_Found_Failure
  diagnostic event to trouble code uds mapping EventDtcMapPowerPath083NotFoundFailure: diagnostic-event=EventPowerPath083NotFoundFailure, trouble-code-uds=Power_Path_083_Not_Found_Failure  # Event_Dtc_Map_Power_Path_083_Not_Found_Failure
  diagnostic event to operation cycle mapping EventOperCycleMapPowerPath083NotFoundFailure: diagnostic-event=EventPowerPath083NotFoundFailure, operation-cycle=DefaultOperationCycle  # Event_Oper_Cycle_Map_Power_Path_083_Not_Found_Failure
  diagnostic event to debounce algorithm mapping EventDebounceMapPowerPath083NotFoundFailure: debounce-algorithm=time_based, diagnostic-event=EventPowerPath083NotFoundFailure  # EventDebounceMap_Power_Path_083_Not_Found_Failure
package /ZeC/DTC/DTC/Power_Path_082_Not_Found_Failure
  diagnostic trouble code uds Power_Path_082_Not_Found_Failure: dtc-props=Dtc_Props_c45e9040, uds-dtc-value=0x005652
  diagnostic event EventPowerPath082NotFoundFailure: aging-allowed=true, event-kind=SWC, prestorage-freeze-frame=false  # Event_Power_Path_082_Not_Found_Failure
  diagnostic event to trouble code uds mapping EventDtcMapPowerPath082NotFoundFailure: diagnostic-event=EventPowerPath082NotFoundFailure, trouble-code-uds=Power_Path_082_Not_Found_Failure  # Event_Dtc_Map_Power_Path_082_Not_Found_Failure
  diagnostic event to operation cycle mapping EventOperCycleMapPowerPath082NotFoundFailure: diagnostic-event=EventPowerPath082NotFoundFailure, operation-cycle=DefaultOperationCycle  # Event_Oper_Cycle_Map_Power_Path_082_Not_Found_Failure
  diagnostic event to debounce algorithm mapping EventDebounceMapPowerPath082NotFoundFailure: debounce-algorithm=time_based, diagnostic-event=EventPowerPath082NotFoundFailure  # EventDebounceMap_Power_Path_082_Not_Found_Failure
package /ZeC/DTC/DTC/Power_Path_055_Not_Found_Failure
  diagnostic trouble code uds Power_Path_055_Not_Found_Failure: dtc-props=Dtc_Props_b97f3d80, uds-dtc-value=0x005637
  diagnostic event EventPowerPath055NotFoundFailure: aging-allowed=true, event-kind=SWC, prestorage-freeze-frame=false  # Event_Power_Path_055_Not_Found_Failure
  diagnostic event to trouble code uds mapping EventDtcMapPowerPath055NotFoundFailure: diagnostic-event=EventPowerPath055NotFoundFailure, trouble-code-uds=Power_Path_055_Not_Found_Failure  # Event_Dtc_Map_Power_Path_055_Not_Found_Failure
  diagnostic event to operation cycle mapping EventOperCycleMapPowerPath055NotFoundFailure: diagnostic-event=EventPowerPath055NotFoundFailure, operation-cycle=DefaultOperationCycle  # Event_Oper_Cycle_Map_Power_Path_055_Not_Found_Failure
  diagnostic event to debounce algorithm mapping EventDebounceMapPowerPath055NotFoundFailure: debounce-algorithm=time_based, diagnostic-event=EventPowerPath055NotFoundFailure  # EventDebounceMap_Power_Path_055_Not_Found_Failure
package /ZeC/DTC/DTC/Power_Path_054_Not_Found_Failure
  diagnostic trouble code uds Power_Path_054_Not_Found_Failure: dtc-props=Dtc_Props_ff6637ba, uds-dtc-value=0x005636
  diagnostic event EventPowerPath054NotFoundFailure: aging-allowed=true, event-kind=SWC, prestorage-freeze-frame=false  # Event_Power_Path_054_Not_Found_Failure
  diagnostic event to trouble code uds mapping EventDtcMapPowerPath054NotFoundFailure: diagnostic-event=EventPowerPath054NotFoundFailure, trouble-code-uds=Power_Path_054_Not_Found_Failure  # Event_Dtc_Map_Power_Path_054_Not_Found_Failure
  diagnostic event to operation cycle mapping EventOperCycleMapPowerPath054NotFoundFailure: diagnostic-event=EventPowerPath054NotFoundFailure, operation-cycle=DefaultOperationCycle  # Event_Oper_Cycle_Map_Power_Path_054_Not_Found_Failure
  diagnostic event to debounce algorithm mapping EventDebounceMapPowerPath054NotFoundFailure: debounce-algorithm=time_based, diagnostic-event=EventPowerPath054NotFoundFailure  # EventDebounceMap_Power_Path_054_Not_Found_Failure
package /ZeC/DTC/DTC/Power_Path_057_Not_Found_Failure
  diagnostic trouble code uds Power_Path_057_Not_Found_Failure: dtc-props=Dtc_Props_ab035c4e, uds-dtc-value=0x005639
  diagnostic event EventPowerPath057NotFoundFailure: aging-allowed=true, event-kind=SWC, prestorage-freeze-frame=false  # Event_Power_Path_057_Not_Found_Failure
  diagnostic event to trouble code uds mapping EventDtcMapPowerPath057NotFoundFailure: diagnostic-event=EventPowerPath057NotFoundFailure, trouble-code-uds=Power_Path_057_Not_Found_Failure  # Event_Dtc_Map_Power_Path_057_Not_Found_Failure
  diagnostic event to operation cycle mapping EventOperCycleMapPowerPath057NotFoundFailure: diagnostic-event=EventPowerPath057NotFoundFailure, operation-cycle=DefaultOperationCycle  # Event_Oper_Cycle_Map_Power_Path_057_Not_Found_Failure
  diagnostic event to debounce algorithm mapping EventDebounceMapPowerPath057NotFoundFailure: debounce-algorithm=time_based, diagnostic-event=EventPowerPath057NotFoundFailure  # EventDebounceMap_Power_Path_057_Not_Found_Failure
package /ZeC/DTC/DTC/Power_Path_056_Not_Found_Failure
  diagnostic trouble code uds Power_Path_056_Not_Found_Failure: dtc-props=Dtc_Props_ed1a5674, uds-dtc-value=0x005638
  diagnostic event EventPowerPath056NotFoundFailure: aging-allowed=true, event-kind=SWC, prestorage-freeze-frame=false  # Event_Power_Path_056_Not_Found_Failure
  diagnostic event to trouble code uds mapping EventDtcMapPowerPath056NotFoundFailure: diagnostic-event=EventPowerPath056NotFoundFailure, trouble-code-uds=Power_Path_056_Not_Found_Failure  # Event_Dtc_Map_Power_Path_056_Not_Found_Failure
  diagnostic event to operation cycle mapping EventOperCycleMapPowerPath056NotFoundFailure: diagnostic-event=EventPowerPath056NotFoundFailure, operation-cycle=DefaultOperationCycle  # Event_Oper_Cycle_Map_Power_Path_056_Not_Found_Failure
  diagnostic event to debounce algorithm mapping EventDebounceMapPowerPath056NotFoundFailure: debounce-algorithm=time_based, diagnostic-event=EventPowerPath056NotFoundFailure  # EventDebounceMap_Power_Path_056_Not_Found_Failure
package /ZeC/DTC/DTC/Power_Path_051_Not_Found_Failure
  diagnostic trouble code uds Power_Path_051_Not_Found_Failure: dtc-props=Dtc_Props_7a6a1329, uds-dtc-value=0x005633
  diagnostic event EventPowerPath051NotFoundFailure: aging-allowed=true, event-kind=SWC, prestorage-freeze-frame=false  # Event_Power_Path_051_Not_Found_Failure
  diagnostic event to trouble code uds mapping EventDtcMapPowerPath051NotFoundFailure: diagnostic-event=EventPowerPath051NotFoundFailure, trouble-code-uds=Power_Path_051_Not_Found_Failure  # Event_Dtc_Map_Power_Path_051_Not_Found_Failure
  diagnostic event to operation cycle mapping EventOperCycleMapPowerPath051NotFoundFailure: diagnostic-event=EventPowerPath051NotFoundFailure, operation-cycle=DefaultOperationCycle  # Event_Oper_Cycle_Map_Power_Path_051_Not_Found_Failure
  diagnostic event to debounce algorithm mapping EventDebounceMapPowerPath051NotFoundFailure: debounce-algorithm=time_based, diagnostic-event=EventPowerPath051NotFoundFailure  # EventDebounceMap_Power_Path_051_Not_Found_Failure
package /ZeC/DTC/DTC/Power_Path_050_Not_Found_Failure
  diagnostic trouble code uds Power_Path_050_Not_Found_Failure: dtc-props=Dtc_Props_3c731913, uds-dtc-value=0x005632
  diagnostic event EventPowerPath050NotFoundFailure: aging-allowed=true, event-kind=SWC, prestorage-freeze-frame=false  # Event_Power_Path_050_Not_Found_Failure
  diagnostic event to trouble code uds mapping EventDtcMapPowerPath050NotFoundFailure: diagnostic-event=EventPowerPath050NotFoundFailure, trouble-code-uds=Power_Path_050_Not_Found_Failure  # Event_Dtc_Map_Power_Path_050_Not_Found_Failure
  diagnostic event to operation cycle mapping EventOperCycleMapPowerPath050NotFoundFailure: diagnostic-event=EventPowerPath050NotFoundFailure, operation-cycle=DefaultOperationCycle  # Event_Oper_Cycle_Map_Power_Path_050_Not_Found_Failure
  diagnostic event to debounce algorithm mapping EventDebounceMapPowerPath050NotFoundFailure: debounce-algorithm=time_based, diagnostic-event=EventPowerPath050NotFoundFailure  # EventDebounceMap_Power_Path_050_Not_Found_Failure
package /ZeC/DTC/DTC/Power_Path_053_Not_Found_Failure
  diagnostic trouble code uds Power_Path_053_Not_Found_Failure: dtc-props=Dtc_Props_354d29f4, uds-dtc-value=0x005635
  diagnostic event EventPowerPath053NotFoundFailure: aging-allowed=true, event-kind=SWC, prestorage-freeze-frame=false  # Event_Power_Path_053_Not_Found_Failure
  diagnostic event to trouble code uds mapping EventDtcMapPowerPath053NotFoundFailure: diagnostic-event=EventPowerPath053NotFoundFailure, trouble-code-uds=Power_Path_053_Not_Found_Failure  # Event_Dtc_Map_Power_Path_053_Not_Found_Failure
  diagnostic event to operation cycle mapping EventOperCycleMapPowerPath053NotFoundFailure: diagnostic-event=EventPowerPath053NotFoundFailure, operation-cycle=DefaultOperationCycle  # Event_Oper_Cycle_Map_Power_Path_053_Not_Found_Failure
  diagnostic event to debounce algorithm mapping EventDebounceMapPowerPath053NotFoundFailure: debounce-algorithm=time_based, diagnostic-event=EventPowerPath053NotFoundFailure  # EventDebounceMap_Power_Path_053_Not_Found_Failure
package /ZeC/DTC/DTC/Power_Path_052_Not_Found_Failure
  diagnostic trouble code uds Power_Path_052_Not_Found_Failure: dtc-props=Dtc_Props_735423ce, uds-dtc-value=0x005634
  diagnostic event EventPowerPath052NotFoundFailure: aging-allowed=true, event-kind=SWC, prestorage-freeze-frame=false  # Event_Power_Path_052_Not_Found_Failure
  diagnostic event to trouble code uds mapping EventDtcMapPowerPath052NotFoundFailure: diagnostic-event=EventPowerPath052NotFoundFailure, trouble-code-uds=Power_Path_052_Not_Found_Failure  # Event_Dtc_Map_Power_Path_052_Not_Found_Failure
  diagnostic event to operation cycle mapping EventOperCycleMapPowerPath052NotFoundFailure: diagnostic-event=EventPowerPath052NotFoundFailure, operation-cycle=DefaultOperationCycle  # Event_Oper_Cycle_Map_Power_Path_052_Not_Found_Failure
  diagnostic event to debounce algorithm mapping EventDebounceMapPowerPath052NotFoundFailure: debounce-algorithm=time_based, diagnostic-event=EventPowerPath052NotFoundFailure  # EventDebounceMap_Power_Path_052_Not_Found_Failure
package /ZeC/DTC/DTC/Power_Path_058_Not_Found_Failure
  diagnostic trouble code uds Power_Path_058_Not_Found_Failure: dtc-props=Dtc_Props_cba76320, uds-dtc-value=0x00563a
  diagnostic event EventPowerPath058NotFoundFailure: aging-allowed=true, event-kind=SWC, prestorage-freeze-frame=false  # Event_Power_Path_058_Not_Found_Failure
  diagnostic event to trouble code uds mapping EventDtcMapPowerPath058NotFoundFailure: diagnostic-event=EventPowerPath058NotFoundFailure, trouble-code-uds=Power_Path_058_Not_Found_Failure  # Event_Dtc_Map_Power_Path_058_Not_Found_Failure
  diagnostic event to operation cycle mapping EventOperCycleMapPowerPath058NotFoundFailure: diagnostic-event=EventPowerPath058NotFoundFailure, operation-cycle=DefaultOperationCycle  # Event_Oper_Cycle_Map_Power_Path_058_Not_Found_Failure
  diagnostic event to debounce algorithm mapping EventDebounceMapPowerPath058NotFoundFailure: debounce-algorithm=time_based, diagnostic-event=EventPowerPath058NotFoundFailure  # EventDebounceMap_Power_Path_058_Not_Found_Failure
package /ZeC/DTC/DTC/Power_Path_063_Not_Found_Failure
  diagnostic trouble code uds Power_Path_063_Not_Found_Failure: dtc-props=Dtc_Props_c29953c7, uds-dtc-value=0x00563f
  diagnostic event EventPowerPath063NotFoundFailure: aging-allowed=true, event-kind=SWC, prestorage-freeze-frame=false  # Event_Power_Path_063_Not_Found_Failure
  diagnostic event to trouble code uds mapping EventDtcMapPowerPath063NotFoundFailure: diagnostic-event=EventPowerPath063NotFoundFailure, trouble-code-uds=Power_Path_063_Not_Found_Failure  # Event_Dtc_Map_Power_Path_063_Not_Found_Failure
  diagnostic event to operation cycle mapping EventOperCycleMapPowerPath063NotFoundFailure: diagnostic-event=EventPowerPath063NotFoundFailure, operation-cycle=DefaultOperationCycle  # Event_Oper_Cycle_Map_Power_Path_063_Not_Found_Failure
  diagnostic event to debounce algorithm mapping EventDebounceMapPowerPath063NotFoundFailure: debounce-algorithm=time_based, diagnostic-event=EventPowerPath063NotFoundFailure  # EventDebounceMap_Power_Path_063_Not_Found_Failure
package /ZeC/DTC/DTC/Power_Path_060_Not_Found_Failure
  diagnostic trouble code uds Power_Path_060_Not_Found_Failure: dtc-props=Dtc_Props_47957754, uds-dtc-value=0x00563c
  diagnostic event EventPowerPath060NotFoundFailure: aging-allowed=true, event-kind=SWC, prestorage-freeze-frame=false  # Event_Power_Path_060_Not_Found_Failure
  diagnostic event to trouble code uds mapping EventDtcMapPowerPath060NotFoundFailure: diagnostic-event=EventPowerPath060NotFoundFailure, trouble-code-uds=Power_Path_060_Not_Found_Failure  # Event_Dtc_Map_Power_Path_060_Not_Found_Failure
  diagnostic event to operation cycle mapping EventOperCycleMapPowerPath060NotFoundFailure: diagnostic-event=EventPowerPath060NotFoundFailure, operation-cycle=DefaultOperationCycle  # Event_Oper_Cycle_Map_Power_Path_060_Not_Found_Failure
  diagnostic event to debounce algorithm mapping EventDebounceMapPowerPath060NotFoundFailure: debounce-algorithm=time_based, diagnostic-event=EventPowerPath060NotFoundFailure  # EventDebounceMap_Power_Path_060_Not_Found_Failure
package /ZeC/DTC/DTC/Power_Path_059_Not_Found_Failure
  diagnostic trouble code uds Power_Path_059_Not_Found_Failure: dtc-props=Dtc_Props_18c7d6e, uds-dtc-value=0x00563b
  diagnostic event EventPowerPath059NotFoundFailure: aging-allowed=true, event-kind=SWC, prestorage-freeze-frame=false  # Event_Power_Path_059_Not_Found_Failure
  diagnostic event to trouble code uds mapping EventDtcMapPowerPath059NotFoundFailure: diagnostic-event=EventPowerPath059NotFoundFailure, trouble-code-uds=Power_Path_059_Not_Found_Failure  # Event_Dtc_Map_Power_Path_059_Not_Found_Failure
  diagnostic event to operation cycle mapping EventOperCycleMapPowerPath059NotFoundFailure: diagnostic-event=EventPowerPath059NotFoundFailure, operation-cycle=DefaultOperationCycle  # Event_Oper_Cycle_Map_Power_Path_059_Not_Found_Failure
  diagnostic event to debounce algorithm mapping EventDebounceMapPowerPath059NotFoundFailure: debounce-algorithm=time_based, diagnostic-event=EventPowerPath059NotFoundFailure  # EventDebounceMap_Power_Path_059_Not_Found_Failure
package /ZeC/DTC/DTC/Power_Path_062_Not_Found_Failure
  diagnostic trouble code uds Power_Path_062_Not_Found_Failure: dtc-props=Dtc_Props_8b24d89, uds-dtc-value=0x00563e
  diagnostic event EventPowerPath062NotFoundFailure: aging-allowed=true, event-kind=SWC, prestorage-freeze-frame=false  # Event_Power_Path_062_Not_Found_Failure
  diagnostic event to trouble code uds mapping EventDtcMapPowerPath062NotFoundFailure: diagnostic-event=EventPowerPath062NotFoundFailure, trouble-code-uds=Power_Path_062_Not_Found_Failure  # Event_Dtc_Map_Power_Path_062_Not_Found_Failure
  diagnostic event to operation cycle mapping EventOperCycleMapPowerPath062NotFoundFailure: diagnostic-event=EventPowerPath062NotFoundFailure, operation-cycle=DefaultOperationCycle  # Event_Oper_Cycle_Map_Power_Path_062_Not_Found_Failure
  diagnostic event to debounce algorithm mapping EventDebounceMapPowerPath062NotFoundFailure: debounce-algorithm=time_based, diagnostic-event=EventPowerPath062NotFoundFailure  # EventDebounceMap_Power_Path_062_Not_Found_Failure
package /ZeC/DTC/DTC/Power_Path_061_Not_Found_Failure
  diagnostic trouble code uds Power_Path_061_Not_Found_Failure: dtc-props=Dtc_Props_4eab47b3, uds-dtc-value=0x00563d
  diagnostic event EventPowerPath061NotFoundFailure: aging-allowed=true, event-kind=SWC, prestorage-freeze-frame=false  # Event_Power_Path_061_Not_Found_Failure
  diagnostic event to trouble code uds mapping EventDtcMapPowerPath061NotFoundFailure: diagnostic-event=EventPowerPath061NotFoundFailure, trouble-code-uds=Power_Path_061_Not_Found_Failure  # Event_Dtc_Map_Power_Path_061_Not_Found_Failure
  diagnostic event to operation cycle mapping EventOperCycleMapPowerPath061NotFoundFailure: diagnostic-event=EventPowerPath061NotFoundFailure, operation-cycle=DefaultOperationCycle  # Event_Oper_Cycle_Map_Power_Path_061_Not_Found_Failure
  diagnostic event to debounce algorithm mapping EventDebounceMapPowerPath061NotFoundFailure: debounce-algorithm=time_based, diagnostic-event=EventPowerPath061NotFoundFailure  # EventDebounceMap_Power_Path_061_Not_Found_Failure
package /ZeC/DTC/DTC/Power_Path_064_Not_Found_Failure
  diagnostic trouble code uds Power_Path_064_Not_Found_Failure: dtc-props=Dtc_Props_8e26448c, uds-dtc-value=0x005640
  diagnostic event EventPowerPath064NotFoundFailure: aging-allowed=true, event-kind=SWC, prestorage-freeze-frame=false  # Event_Power_Path_064_Not_Found_Failure
  diagnostic event to trouble code uds mapping EventDtcMapPowerPath064NotFoundFailure: diagnostic-event=EventPowerPath064NotFoundFailure, trouble-code-uds=Power_Path_064_Not_Found_Failure  # Event_Dtc_Map_Power_Path_064_Not_Found_Failure
  diagnostic event to operation cycle mapping EventOperCycleMapPowerPath064NotFoundFailure: diagnostic-event=EventPowerPath064NotFoundFailure, operation-cycle=DefaultOperationCycle  # Event_Oper_Cycle_Map_Power_Path_064_Not_Found_Failure
  diagnostic event to debounce algorithm mapping EventDebounceMapPowerPath064NotFoundFailure: debounce-algorithm=time_based, diagnostic-event=EventPowerPath064NotFoundFailure  # EventDebounceMap_Power_Path_064_Not_Found_Failure
package /ZeC/DTC/DTC/Power_Path_066_Not_Found_Failure
  diagnostic trouble code uds Power_Path_066_Not_Found_Failure: dtc-props=Dtc_Props_21450f8, uds-dtc-value=0x005642
  diagnostic event EventPowerPath066NotFoundFailure: aging-allowed=true, event-kind=SWC, prestorage-freeze-frame=false  # Event_Power_Path_066_Not_Found_Failure
  diagnostic event to trouble code uds mapping EventDtcMapPowerPath066NotFoundFailure: diagnostic-event=EventPowerPath066NotFoundFailure, trouble-code-uds=Power_Path_066_Not_Found_Failure  # Event_Dtc_Map_Power_Path_066_Not_Found_Failure
  diagnostic event to operation cycle mapping EventOperCycleMapPowerPath066NotFoundFailure: diagnostic-event=EventPowerPath066NotFoundFailure, operation-cycle=DefaultOperationCycle  # Event_Oper_Cycle_Map_Power_Path_066_Not_Found_Failure
  diagnostic event to debounce algorithm mapping EventDebounceMapPowerPath066NotFoundFailure: debounce-algorithm=time_based, diagnostic-event=EventPowerPath066NotFoundFailure  # EventDebounceMap_Power_Path_066_Not_Found_Failure
package /ZeC/DTC/DTC/Power_Path_065_Not_Found_Failure
  diagnostic trouble code uds Power_Path_065_Not_Found_Failure: dtc-props=Dtc_Props_c83f4eb6, uds-dtc-value=0x005641
  diagnostic event EventPowerPath065NotFoundFailure: aging-allowed=true, event-kind=SWC, prestorage-freeze-frame=false  # Event_Power_Path_065_Not_Found_Failure
  diagnostic event to trouble code uds mapping EventDtcMapPowerPath065NotFoundFailure: diagnostic-event=EventPowerPath065NotFoundFailure, trouble-code-uds=Power_Path_065_Not_Found_Failure  # Event_Dtc_Map_Power_Path_065_Not_Found_Failure
  diagnostic event to operation cycle mapping EventOperCycleMapPowerPath065NotFoundFailure: diagnostic-event=EventPowerPath065NotFoundFailure, operation-cycle=DefaultOperationCycle  # Event_Oper_Cycle_Map_Power_Path_065_Not_Found_Failure
  diagnostic event to debounce algorithm mapping EventDebounceMapPowerPath065NotFoundFailure: debounce-algorithm=time_based, diagnostic-event=EventPowerPath065NotFoundFailure  # EventDebounceMap_Power_Path_065_Not_Found_Failure
package /ZeC/DTC/DTC/Power_Path_004_Not_Found_Failure
  diagnostic trouble code uds Power_Path_004_Not_Found_Failure: dtc-props=Dtc_Props_e2fa6447, uds-dtc-value=0x005604
  diagnostic event EventPowerPath004NotFoundFailure: aging-allowed=true, event-kind=SWC, prestorage-freeze-frame=false  # Event_Power_Path_004_Not_Found_Failure
  diagnostic event to trouble code uds mapping EventDtcMapPowerPath004NotFoundFailure: diagnostic-event=EventPowerPath004NotFoundFailure, trouble-code-uds=Power_Path_004_Not_Found_Failure  # Event_Dtc_Map_Power_Path_004_Not_Found_Failure
  diagnostic event to operation cycle mapping EventOperCycleMapPowerPath004NotFoundFailure: diagnostic-event=EventPowerPath004NotFoundFailure, operation-cycle=DefaultOperationCycle  # Event_Oper_Cycle_Map_Power_Path_004_Not_Found_Failure
  diagnostic event to debounce algorithm mapping EventDebounceMapPowerPath004NotFoundFailure: debounce-algorithm=time_based, diagnostic-event=EventPowerPath004NotFoundFailure  # EventDebounceMap_Power_Path_004_Not_Found_Failure
package /ZeC/DTC/DTC/Power_Path_003_Not_Found_Failure
  diagnostic trouble code uds Power_Path_003_Not_Found_Failure: dtc-props=Dtc_Props_ebc454a0, uds-dtc-value=0x005603
  diagnostic event EventPowerPath003NotFoundFailure: aging-allowed=true, event-kind=SWC, prestorage-freeze-frame=false  # Event_Power_Path_003_Not_Found_Failure
  diagnostic event to trouble code uds mapping EventDtcMapPowerPath003NotFoundFailure: diagnostic-event=EventPowerPath003NotFoundFailure, trouble-code-uds=Power_Path_003_Not_Found_Failure  # Event_Dtc_Map_Power_Path_003_Not_Found_Failure
  diagnostic event to operation cycle mapping EventOperCycleMapPowerPath003NotFoundFailure: diagnostic-event=EventPowerPath003NotFoundFailure, operation-cycle=DefaultOperationCycle  # Event_Oper_Cycle_Map_Power_Path_003_Not_Found_Failure
  diagnostic event to debounce algorithm mapping EventDebounceMapPowerPath003NotFoundFailure: debounce-algorithm=time_based, diagnostic-event=EventPowerPath003NotFoundFailure  # EventDebounceMap_Power_Path_003_Not_Found_Failure
package /ZeC/DTC/DTC/Power_Path_006_Not_Found_Failure
  diagnostic trouble code uds Power_Path_006_Not_Found_Failure: dtc-props=Dtc_Props_6ec87033, uds-dtc-value=0x005606
  diagnostic event EventPowerPath006NotFoundFailure: aging-allowed=true, event-kind=SWC, prestorage-freeze-frame=false  # Event_Power_Path_006_Not_Found_Failure
  diagnostic event to trouble code uds mapping EventDtcMapPowerPath006NotFoundFailure: diagnostic-event=EventPowerPath006NotFoundFailure, trouble-code-uds=Power_Path_006_Not_Found_Failure  # Event_Dtc_Map_Power_Path_006_Not_Found_Failure
  diagnostic event to operation cycle mapping EventOperCycleMapPowerPath006NotFoundFailure: diagnostic-event=EventPowerPath006NotFoundFailure, operation-cycle=DefaultOperationCycle  # Event_Oper_Cycle_Map_Power_Path_006_Not_Found_Failure
  diagnostic event to debounce algorithm mapping EventDebounceMapPowerPath006NotFoundFailure: debounce-algorithm=time_based, diagnostic-event=EventPowerPath006NotFoundFailure  # EventDebounceMap_Power_Path_006_Not_Found_Failure
package /ZeC/DTC/DTC/Power_Path_005_Not_Found_Failure
  diagnostic trouble code uds Power_Path_005_Not_Found_Failure: dtc-props=Dtc_Props_a4e36e7d, uds-dtc-value=0x005605
  diagnostic event EventPowerPath005NotFoundFailure: aging-allowed=true, event-kind=SWC, prestorage-freeze-frame=false  # Event_Power_Path_005_Not_Found_Failure
  diagnostic event to trouble code uds mapping EventDtcMapPowerPath005NotFoundFailure: diagnostic-event=EventPowerPath005NotFoundFailure, trouble-code-uds=Power_Path_005_Not_Found_Failure  # Event_Dtc_Map_Power_Path_005_Not_Found_Failure
  diagnostic event to operation cycle mapping EventOperCycleMapPowerPath005NotFoundFailure: diagnostic-event=EventPowerPath005NotFoundFailure, operation-cycle=DefaultOperationCycle  # Event_Oper_Cycle_Map_Power_Path_005_Not_Found_Failure
  diagnostic event to debounce algorithm mapping EventDebounceMapPowerPath005NotFoundFailure: debounce-algorithm=time_based, diagnostic-event=EventPowerPath005NotFoundFailure  # EventDebounceMap_Power_Path_005_Not_Found_Failure
package /ZeC/DTC/DTC/Power_Path_002_Not_Found_Failure
  diagnostic trouble code uds Power_Path_002_Not_Found_Failure: dtc-props=Dtc_Props_addd5e9a, uds-dtc-value=0x005602
  diagnostic event EventPowerPath002NotFoundFailure: aging-allowed=true, event-kind=SWC, prestorage-freeze-frame=false  # Event_Power_Path_002_Not_Found_Failure
  diagnostic event to trouble code uds mapping EventDtcMapPowerPath002NotFoundFailure: diagnostic-event=EventPowerPath002NotFoundFailure, trouble-code-uds=Power_Path_002_Not_Found_Failure  # Event_Dtc_Map_Power_Path_002_Not_Found_Failure
  diagnostic event to operation cycle mapping EventOperCycleMapPowerPath002NotFoundFailure: diagnostic-event=EventPowerPath002NotFoundFailure, operation-cycle=DefaultOperationCycle  # Event_Oper_Cycle_Map_Power_Path_002_Not_Found_Failure
  diagnostic event to debounce algorithm mapping EventDebounceMapPowerPath002NotFoundFailure: debounce-algorithm=time_based, diagnostic-event=EventPowerPath002NotFoundFailure  # EventDebounceMap_Power_Path_002_Not_Found_Failure
package /ZeC/DTC/DTC/Power_Path_001_Not_Found_Failure
  diagnostic trouble code uds Power_Path_001_Not_Found_Failure: dtc-props=Dtc_Props_67f640d4, uds-dtc-value=0x005601
  diagnostic event EventPowerPath001NotFoundFailure: aging-allowed=true, event-kind=SWC, prestorage-freeze-frame=false  # Event_Power_Path_001_Not_Found_Failure
  diagnostic event to trouble code uds mapping EventDtcMapPowerPath001NotFoundFailure: diagnostic-event=EventPowerPath001NotFoundFailure, trouble-code-uds=Power_Path_001_Not_Found_Failure  # Event_Dtc_Map_Power_Path_001_Not_Found_Failure
  diagnostic event to operation cycle mapping EventOperCycleMapPowerPath001NotFoundFailure: diagnostic-event=EventPowerPath001NotFoundFailure, operation-cycle=DefaultOperationCycle  # Event_Oper_Cycle_Map_Power_Path_001_Not_Found_Failure
  diagnostic event to debounce algorithm mapping EventDebounceMapPowerPath001NotFoundFailure: debounce-algorithm=time_based, diagnostic-event=EventPowerPath001NotFoundFailure  # EventDebounceMap_Power_Path_001_Not_Found_Failure
package /ZeC/DTC/DTC/Power_Path_008_Not_Found_Failure
  diagnostic trouble code uds Power_Path_008_Not_Found_Failure: dtc-props=Dtc_Props_7cb411fd, uds-dtc-value=0x005608
  diagnostic event EventPowerPath008NotFoundFailure: aging-allowed=true, event-kind=SWC, prestorage-freeze-frame=false  # Event_Power_Path_008_Not_Found_Failure
  diagnostic event to trouble code uds mapping EventDtcMapPowerPath008NotFoundFailure: diagnostic-event=EventPowerPath008NotFoundFailure, trouble-code-uds=Power_Path_008_Not_Found_Failure  # Event_Dtc_Map_Power_Path_008_Not_Found_Failure
  diagnostic event to operation cycle mapping EventOperCycleMapPowerPath008NotFoundFailure: diagnostic-event=EventPowerPath008NotFoundFailure, operation-cycle=DefaultOperationCycle  # Event_Oper_Cycle_Map_Power_Path_008_Not_Found_Failure
  diagnostic event to debounce algorithm mapping EventDebounceMapPowerPath008NotFoundFailure: debounce-algorithm=time_based, diagnostic-event=EventPowerPath008NotFoundFailure  # EventDebounceMap_Power_Path_008_Not_Found_Failure
package /ZeC/DTC/DTC/Power_Path_007_Not_Found_Failure
  diagnostic trouble code uds Power_Path_007_Not_Found_Failure: dtc-props=Dtc_Props_28d17a09, uds-dtc-value=0x005607
  diagnostic event EventPowerPath007NotFoundFailure: aging-allowed=true, event-kind=SWC, prestorage-freeze-frame=false  # Event_Power_Path_007_Not_Found_Failure
  diagnostic event to trouble code uds mapping EventDtcMapPowerPath007NotFoundFailure: diagnostic-event=EventPowerPath007NotFoundFailure, trouble-code-uds=Power_Path_007_Not_Found_Failure  # Event_Dtc_Map_Power_Path_007_Not_Found_Failure
  diagnostic event to operation cycle mapping EventOperCycleMapPowerPath007NotFoundFailure: diagnostic-event=EventPowerPath007NotFoundFailure, operation-cycle=DefaultOperationCycle  # Event_Oper_Cycle_Map_Power_Path_007_Not_Found_Failure
  diagnostic event to debounce algorithm mapping EventDebounceMapPowerPath007NotFoundFailure: debounce-algorithm=time_based, diagnostic-event=EventPowerPath007NotFoundFailure  # EventDebounceMap_Power_Path_007_Not_Found_Failure
package /ZeC/DTC/DTC/Power_Path_009_Not_Found_Failure
  diagnostic trouble code uds Power_Path_009_Not_Found_Failure: dtc-props=Dtc_Props_3aad1bc7, uds-dtc-value=0x005609
  diagnostic event EventPowerPath009NotFoundFailure: aging-allowed=true, event-kind=SWC, prestorage-freeze-frame=false  # Event_Power_Path_009_Not_Found_Failure
  diagnostic event to trouble code uds mapping EventDtcMapPowerPath009NotFoundFailure: diagnostic-event=EventPowerPath009NotFoundFailure, trouble-code-uds=Power_Path_009_Not_Found_Failure  # Event_Dtc_Map_Power_Path_009_Not_Found_Failure
  diagnostic event to operation cycle mapping EventOperCycleMapPowerPath009NotFoundFailure: diagnostic-event=EventPowerPath009NotFoundFailure, operation-cycle=DefaultOperationCycle  # Event_Oper_Cycle_Map_Power_Path_009_Not_Found_Failure
  diagnostic event to debounce algorithm mapping EventDebounceMapPowerPath009NotFoundFailure: debounce-algorithm=time_based, diagnostic-event=EventPowerPath009NotFoundFailure  # EventDebounceMap_Power_Path_009_Not_Found_Failure
package /ZeC/DTC/DTC/Power_Path_013_Not_Found_Failure
  diagnostic trouble code uds Power_Path_013_Not_Found_Failure: dtc-props=Dtc_Props_df05003a, uds-dtc-value=0x00560d
  diagnostic event EventPowerPath013NotFoundFailure: aging-allowed=true, event-kind=SWC, prestorage-freeze-frame=false  # Event_Power_Path_013_Not_Found_Failure
  diagnostic event to trouble code uds mapping EventDtcMapPowerPath013NotFoundFailure: diagnostic-event=EventPowerPath013NotFoundFailure, trouble-code-uds=Power_Path_013_Not_Found_Failure  # Event_Dtc_Map_Power_Path_013_Not_Found_Failure
  diagnostic event to operation cycle mapping EventOperCycleMapPowerPath013NotFoundFailure: diagnostic-event=EventPowerPath013NotFoundFailure, operation-cycle=DefaultOperationCycle  # Event_Oper_Cycle_Map_Power_Path_013_Not_Found_Failure
  diagnostic event to debounce algorithm mapping EventDebounceMapPowerPath013NotFoundFailure: debounce-algorithm=time_based, diagnostic-event=EventPowerPath013NotFoundFailure  # EventDebounceMap_Power_Path_013_Not_Found_Failure
package /ZeC/DTC/DTC/Power_Path_012_Not_Found_Failure
  diagnostic trouble code uds Power_Path_012_Not_Found_Failure: dtc-props=Dtc_Props_d63b30dd, uds-dtc-value=0x00560c
  diagnostic event EventPowerPath012NotFoundFailure: aging-allowed=true, event-kind=SWC, prestorage-freeze-frame=false  # Event_Power_Path_012_Not_Found_Failure
  diagnostic event to trouble code uds mapping EventDtcMapPowerPath012NotFoundFailure: diagnostic-event=EventPowerPath012NotFoundFailure, trouble-code-uds=Power_Path_012_Not_Found_Failure  # Event_Dtc_Map_Power_Path_012_Not_Found_Failure
  diagnostic event to operation cycle mapping EventOperCycleMapPowerPath012NotFoundFailure: diagnostic-event=EventPowerPath012NotFoundFailure, operation-cycle=DefaultOperationCycle  # Event_Oper_Cycle_Map_Power_Path_012_Not_Found_Failure
  diagnostic event to debounce algorithm mapping EventDebounceMapPowerPath012NotFoundFailure: debounce-algorithm=time_based, diagnostic-event=EventPowerPath012NotFoundFailure  # EventDebounceMap_Power_Path_012_Not_Found_Failure
package /ZeC/DTC/DTC/Power_Path_015_Not_Found_Failure
  diagnostic trouble code uds Power_Path_015_Not_Found_Failure: dtc-props=Dtc_Props_5337144e, uds-dtc-value=0x00560f
  diagnostic event EventPowerPath015NotFoundFailure: aging-allowed=true, event-kind=SWC, prestorage-freeze-frame=false  # Event_Power_Path_015_Not_Found_Failure
  diagnostic event to trouble code uds mapping EventDtcMapPowerPath015NotFoundFailure: diagnostic-event=EventPowerPath015NotFoundFailure, trouble-code-uds=Power_Path_015_Not_Found_Failure  # Event_Dtc_Map_Power_Path_015_Not_Found_Failure
  diagnostic event to operation cycle mapping EventOperCycleMapPowerPath015NotFoundFailure: diagnostic-event=EventPowerPath015NotFoundFailure, operation-cycle=DefaultOperationCycle  # Event_Oper_Cycle_Map_Power_Path_015_Not_Found_Failure
  diagnostic event to debounce algorithm mapping EventDebounceMapPowerPath015NotFoundFailure: debounce-algorithm=time_based, diagnostic-event=EventPowerPath015NotFoundFailure  # EventDebounceMap_Power_Path_015_Not_Found_Failure
package /ZeC/DTC/DTC/Power_Path_014_Not_Found_Failure
  diagnostic trouble code uds Power_Path_014_Not_Found_Failure: dtc-props=Dtc_Props_991c0a00, uds-dtc-value=0x00560e
  diagnostic event EventPowerPath014NotFoundFailure: aging-allowed=true, event-kind=SWC, prestorage-freeze-frame=false  # Event_Power_Path_014_Not_Found_Failure
  diagnostic event to trouble code uds mapping EventDtcMapPowerPath014NotFoundFailure: diagnostic-event=EventPowerPath014NotFoundFailure, trouble-code-uds=Power_Path_014_Not_Found_Failure  # Event_Dtc_Map_Power_Path_014_Not_Found_Failure
  diagnostic event to operation cycle mapping EventOperCycleMapPowerPath014NotFoundFailure: diagnostic-event=EventPowerPath014NotFoundFailure, operation-cycle=DefaultOperationCycle  # Event_Oper_Cycle_Map_Power_Path_014_Not_Found_Failure
  diagnostic event to debounce algorithm mapping EventDebounceMapPowerPath014NotFoundFailure: debounce-algorithm=time_based, diagnostic-event=EventPowerPath014NotFoundFailure  # EventDebounceMap_Power_Path_014_Not_Found_Failure
package /ZeC/DTC/DTC/Power_Path_011_Not_Found_Failure
  diagnostic trouble code uds Power_Path_011_Not_Found_Failure: dtc-props=Dtc_Props_90223ae7, uds-dtc-value=0x00560b
  diagnostic event EventPowerPath011NotFoundFailure: aging-allowed=true, event-kind=SWC, prestorage-freeze-frame=false  # Event_Power_Path_011_Not_Found_Failure
  diagnostic event to trouble code uds mapping EventDtcMapPowerPath011NotFoundFailure: diagnostic-event=EventPowerPath011NotFoundFailure, trouble-code-uds=Power_Path_011_Not_Found_Failure  # Event_Dtc_Map_Power_Path_011_Not_Found_Failure
  diagnostic event to operation cycle mapping EventOperCycleMapPowerPath011NotFoundFailure: diagnostic-event=EventPowerPath011NotFoundFailure, operation-cycle=DefaultOperationCycle  # Event_Oper_Cycle_Map_Power_Path_011_Not_Found_Failure
  diagnostic event to debounce algorithm mapping EventDebounceMapPowerPath011NotFoundFailure: debounce-algorithm=time_based, diagnostic-event=EventPowerPath011NotFoundFailure  # EventDebounceMap_Power_Path_011_Not_Found_Failure
package /ZeC/DTC/DTC/Power_Path_010_Not_Found_Failure
  diagnostic trouble code uds Power_Path_010_Not_Found_Failure: dtc-props=Dtc_Props_5a0924a9, uds-dtc-value=0x00560a
  diagnostic event EventPowerPath010NotFoundFailure: aging-allowed=true, event-kind=SWC, prestorage-freeze-frame=false  # Event_Power_Path_010_Not_Found_Failure
  diagnostic event to trouble code uds mapping EventDtcMapPowerPath010NotFoundFailure: diagnostic-event=EventPowerPath010NotFoundFailure, trouble-code-uds=Power_Path_010_Not_Found_Failure  # Event_Dtc_Map_Power_Path_010_Not_Found_Failure
  diagnostic event to operation cycle mapping EventOperCycleMapPowerPath010NotFoundFailure: diagnostic-event=EventPowerPath010NotFoundFailure, operation-cycle=DefaultOperationCycle  # Event_Oper_Cycle_Map_Power_Path_010_Not_Found_Failure
  diagnostic event to debounce algorithm mapping EventDebounceMapPowerPath010NotFoundFailure: debounce-algorithm=time_based, diagnostic-event=EventPowerPath010NotFoundFailure  # EventDebounceMap_Power_Path_010_Not_Found_Failure
package /ZeC/DTC/DTC/Power_Path_041_Short_to_GND_Failure
  diagnostic trouble code uds Power_Path_041_Short_to_GND_Failure: dtc-props=Dtc_Props_6d499cf6, uds-dtc-value=0x005229
  diagnostic event EventPowerPath041ShortToGNDFailure: aging-allowed=true, event-kind=SWC, prestorage-freeze-frame=false  # Event_Power_Path_041_Short_to_GND_Failure
  diagnostic event to trouble code uds mapping EventDtcMapPowerPath041ShortToGNDFailure: diagnostic-event=EventPowerPath041ShortToGNDFailure, trouble-code-uds=Power_Path_041_Short_to_GND_Failure  # Event_Dtc_Map_Power_Path_041_Short_to_GND_Failure
  diagnostic event to operation cycle mapping EventOperCycleMapPowerPath041ShortToGNDFailure: diagnostic-event=EventPowerPath041ShortToGNDFailure, operation-cycle=DefaultOperationCycle  # Event_Oper_Cycle_Map_Power_Path_041_Short_to_GND_Failure
  diagnostic event to debounce algorithm mapping EventDebounceMapPowerPath041ShortToGNDFailure: debounce-algorithm=time_based, diagnostic-event=EventPowerPath041ShortToGNDFailure  # EventDebounceMap_Power_Path_041_Short_to_GND_Failure
package /ZeC/DTC/DTC/Power_Path_038_Short_to_GND_Failure
  diagnostic trouble code uds Power_Path_038_Short_to_GND_Failure: dtc-props=Dtc_Props_392cf702, uds-dtc-value=0x005226
  diagnostic event EventPowerPath038ShortToGNDFailure: aging-allowed=true, event-kind=SWC, prestorage-freeze-frame=false  # Event_Power_Path_038_Short_to_GND_Failure
  diagnostic event to trouble code uds mapping EventDtcMapPowerPath038ShortToGNDFailure: diagnostic-event=EventPowerPath038ShortToGNDFailure, trouble-code-uds=Power_Path_038_Short_to_GND_Failure  # Event_Dtc_Map_Power_Path_038_Short_to_GND_Failure
  diagnostic event to operation cycle mapping EventOperCycleMapPowerPath038ShortToGNDFailure: diagnostic-event=EventPowerPath038ShortToGNDFailure, operation-cycle=DefaultOperationCycle  # Event_Oper_Cycle_Map_Power_Path_038_Short_to_GND_Failure
  diagnostic event to debounce algorithm mapping EventDebounceMapPowerPath038ShortToGNDFailure: debounce-algorithm=time_based, diagnostic-event=EventPowerPath038ShortToGNDFailure  # EventDebounceMap_Power_Path_038_Short_to_GND_Failure
package /ZeC/DTC/DTC/Power_Path_037_Short_to_GND_Failure
  diagnostic trouble code uds Power_Path_037_Short_to_GND_Failure: dtc-props=Dtc_Props_f307e94c, uds-dtc-value=0x005225
  diagnostic event EventPowerPath037ShortToGNDFailure: aging-allowed=true, event-kind=SWC, prestorage-freeze-frame=false  # Event_Power_Path_037_Short_to_GND_Failure
  diagnostic event to trouble code uds mapping EventDtcMapPowerPath037ShortToGNDFailure: diagnostic-event=EventPowerPath037ShortToGNDFailure, trouble-code-uds=Power_Path_037_Short_to_GND_Failure  # Event_Dtc_Map_Power_Path_037_Short_to_GND_Failure
  diagnostic event to operation cycle mapping EventOperCycleMapPowerPath037ShortToGNDFailure: diagnostic-event=EventPowerPath037ShortToGNDFailure, operation-cycle=DefaultOperationCycle  # Event_Oper_Cycle_Map_Power_Path_037_Short_to_GND_Failure
  diagnostic event to debounce algorithm mapping EventDebounceMapPowerPath037ShortToGNDFailure: debounce-algorithm=time_based, diagnostic-event=EventPowerPath037ShortToGNDFailure  # EventDebounceMap_Power_Path_037_Short_to_GND_Failure
package /ZeC/DTC/DTC/Power_Path_040_Short_to_GND_Failure
  diagnostic trouble code uds Power_Path_040_Short_to_GND_Failure: dtc-props=Dtc_Props_2b5096cc, uds-dtc-value=0x005228
  diagnostic event EventPowerPath040ShortToGNDFailure: aging-allowed=true, event-kind=SWC, prestorage-freeze-frame=false  # Event_Power_Path_040_Short_to_GND_Failure
  diagnostic event to trouble code uds mapping EventDtcMapPowerPath040ShortToGNDFailure: diagnostic-event=EventPowerPath040ShortToGNDFailure, trouble-code-uds=Power_Path_040_Short_to_GND_Failure  # Event_Dtc_Map_Power_Path_040_Short_to_GND_Failure
  diagnostic event to operation cycle mapping EventOperCycleMapPowerPath040ShortToGNDFailure: diagnostic-event=EventPowerPath040ShortToGNDFailure, operation-cycle=DefaultOperationCycle  # Event_Oper_Cycle_Map_Power_Path_040_Short_to_GND_Failure
  diagnostic event to debounce algorithm mapping EventDebounceMapPowerPath040ShortToGNDFailure: debounce-algorithm=time_based, diagnostic-event=EventPowerPath040ShortToGNDFailure  # EventDebounceMap_Power_Path_040_Short_to_GND_Failure
package /ZeC/DTC/DTC/Power_Path_039_Short_to_GND_Failure
  diagnostic trouble code uds Power_Path_039_Short_to_GND_Failure: dtc-props=Dtc_Props_7f35fd38, uds-dtc-value=0x005227
  diagnostic event EventPowerPath039ShortToGNDFailure: aging-allowed=true, event-kind=SWC, prestorage-freeze-frame=false  # Event_Power_Path_039_Short_to_GND_Failure
  diagnostic event to trouble code uds mapping EventDtcMapPowerPath039ShortToGNDFailure: diagnostic-event=EventPowerPath039ShortToGNDFailure, trouble-code-uds=Power_Path_039_Short_to_GND_Failure  # Event_Dtc_Map_Power_Path_039_Short_to_GND_Failure
  diagnostic event to operation cycle mapping EventOperCycleMapPowerPath039ShortToGNDFailure: diagnostic-event=EventPowerPath039ShortToGNDFailure, operation-cycle=DefaultOperationCycle  # Event_Oper_Cycle_Map_Power_Path_039_Short_to_GND_Failure
  diagnostic event to debounce algorithm mapping EventDebounceMapPowerPath039ShortToGNDFailure: debounce-algorithm=time_based, diagnostic-event=EventPowerPath039ShortToGNDFailure  # EventDebounceMap_Power_Path_039_Short_to_GND_Failure
package /ZeC/DTC/DTC/Power_Path_043_Short_to_GND_Failure
  diagnostic trouble code uds Power_Path_043_Short_to_GND_Failure: dtc-props=Dtc_Props_c7c6bdd6, uds-dtc-value=0x00522b
  diagnostic event EventPowerPath043ShortToGNDFailure: aging-allowed=true, event-kind=SWC, prestorage-freeze-frame=false  # Event_Power_Path_043_Short_to_GND_Failure
  diagnostic event to trouble code uds mapping EventDtcMapPowerPath043ShortToGNDFailure: diagnostic-event=EventPowerPath043ShortToGNDFailure, trouble-code-uds=Power_Path_043_Short_to_GND_Failure  # Event_Dtc_Map_Power_Path_043_Short_to_GND_Failure
  diagnostic event to operation cycle mapping EventOperCycleMapPowerPath043ShortToGNDFailure: diagnostic-event=EventPowerPath043ShortToGNDFailure, operation-cycle=DefaultOperationCycle  # Event_Oper_Cycle_Map_Power_Path_043_Short_to_GND_Failure
  diagnostic event to debounce algorithm mapping EventDebounceMapPowerPath043ShortToGNDFailure: debounce-algorithm=time_based, diagnostic-event=EventPowerPath043ShortToGNDFailure  # EventDebounceMap_Power_Path_043_Short_to_GND_Failure
package /ZeC/DTC/DTC/Power_Path_042_Short_to_GND_Failure
  diagnostic trouble code uds Power_Path_042_Short_to_GND_Failure: dtc-props=Dtc_Props_deda398, uds-dtc-value=0x00522a
  diagnostic event EventPowerPath042ShortToGNDFailure: aging-allowed=true, event-kind=SWC, prestorage-freeze-frame=false  # Event_Power_Path_042_Short_to_GND_Failure
  diagnostic event to trouble code uds mapping EventDtcMapPowerPath042ShortToGNDFailure: diagnostic-event=EventPowerPath042ShortToGNDFailure, trouble-code-uds=Power_Path_042_Short_to_GND_Failure  # Event_Dtc_Map_Power_Path_042_Short_to_GND_Failure
  diagnostic event to operation cycle mapping EventOperCycleMapPowerPath042ShortToGNDFailure: diagnostic-event=EventPowerPath042ShortToGNDFailure, operation-cycle=DefaultOperationCycle  # Event_Oper_Cycle_Map_Power_Path_042_Short_to_GND_Failure
  diagnostic event to debounce algorithm mapping EventDebounceMapPowerPath042ShortToGNDFailure: debounce-algorithm=time_based, diagnostic-event=EventPowerPath042ShortToGNDFailure  # EventDebounceMap_Power_Path_042_Short_to_GND_Failure
package /ZeC/DTC/DTC/Power_Path_045_Short_to_GND_Failure
  diagnostic trouble code uds Power_Path_045_Short_to_GND_Failure: dtc-props=Dtc_Props_88e1870b, uds-dtc-value=0x00522d
  diagnostic event EventPowerPath045ShortToGNDFailure: aging-allowed=true, event-kind=SWC, prestorage-freeze-frame=false  # Event_Power_Path_045_Short_to_GND_Failure
  diagnostic event to trouble code uds mapping EventDtcMapPowerPath045ShortToGNDFailure: diagnostic-event=EventPowerPath045ShortToGNDFailure, trouble-code-uds=Power_Path_045_Short_to_GND_Failure  # Event_Dtc_Map_Power_Path_045_Short_to_GND_Failure
  diagnostic event to operation cycle mapping EventOperCycleMapPowerPath045ShortToGNDFailure: diagnostic-event=EventPowerPath045ShortToGNDFailure, operation-cycle=DefaultOperationCycle  # Event_Oper_Cycle_Map_Power_Path_045_Short_to_GND_Failure
  diagnostic event to debounce algorithm mapping EventDebounceMapPowerPath045ShortToGNDFailure: debounce-algorithm=time_based, diagnostic-event=EventPowerPath045ShortToGNDFailure  # EventDebounceMap_Power_Path_045_Short_to_GND_Failure
package /ZeC/DTC/DTC/Power_Path_044_Short_to_GND_Failure
  diagnostic trouble code uds Power_Path_044_Short_to_GND_Failure: dtc-props=Dtc_Props_81dfb7ec, uds-dtc-value=0x00522c
  diagnostic event EventPowerPath044ShortToGNDFailure: aging-allowed=true, event-kind=SWC, prestorage-freeze-frame=false  # Event_Power_Path_044_Short_to_GND_Failure
  diagnostic event to trouble code uds mapping EventDtcMapPowerPath044ShortToGNDFailure: diagnostic-event=EventPowerPath044ShortToGNDFailure, trouble-code-uds=Power_Path_044_Short_to_GND_Failure  # Event_Dtc_Map_Power_Path_044_Short_to_GND_Failure
  diagnostic event to operation cycle mapping EventOperCycleMapPowerPath044ShortToGNDFailure: diagnostic-event=EventPowerPath044ShortToGNDFailure, operation-cycle=DefaultOperationCycle  # Event_Oper_Cycle_Map_Power_Path_044_Short_to_GND_Failure
  diagnostic event to debounce algorithm mapping EventDebounceMapPowerPath044ShortToGNDFailure: debounce-algorithm=time_based, diagnostic-event=EventPowerPath044ShortToGNDFailure  # EventDebounceMap_Power_Path_044_Short_to_GND_Failure
package /ZeC/DTC/DTC/LIN_12_Slave_1_NoCommunication
  diagnostic trouble code uds LIN_12_Slave_1_NoCommunication: dtc-props=Dtc_Props_358996c7, uds-dtc-value=0x030c08  # LIN 12 Slave 1_NoCommunication
  diagnostic event EventLIN12Slave1NoCommunication: aging-allowed=true, event-kind=SWC, prestorage-freeze-frame=false  # Event_LIN 12 Slave 1_NoCommunication
  diagnostic event to trouble code uds mapping EventDtcMapLIN12Slave1NoCommunication: diagnostic-event=EventLIN12Slave1NoCommunication, trouble-code-uds=LIN_12_Slave_1_NoCommunication  # Event_Dtc_Map_LIN 12 Slave 1_NoCommunication
  diagnostic event to operation cycle mapping EventOperCycleMapLIN12Slave1NoCommunication: diagnostic-event=EventLIN12Slave1NoCommunication, operation-cycle=DefaultOperationCycle  # Event_Oper_Cycle_Map_LIN 12 Slave 1_NoCommunication
  diagnostic event to debounce algorithm mapping EventDebounceMapLIN12Slave1NoCommunication: debounce-algorithm=counter_based, diagnostic-event=EventLIN12Slave1NoCommunication  # EventDebounceMap_LIN 12 Slave 1_NoCommunication
package /ZeC/DTC/DTC/LIN_12_Slave_10_Defect
  diagnostic trouble code uds LIN_12_Slave_10_Defect: dtc-props=Dtc_Props_358996c7, uds-dtc-value=0x030c09  # LIN 12 Slave 10_Defect
  diagnostic event EventLIN12Slave10Defect: aging-allowed=true, event-kind=SWC, prestorage-freeze-frame=false  # Event_LIN 12 Slave 10_Defect
  diagnostic event to trouble code uds mapping EventDtcMapLIN12Slave10Defect: diagnostic-event=EventLIN12Slave10Defect, trouble-code-uds=LIN_12_Slave_10_Defect  # Event_Dtc_Map_LIN 12 Slave 10_Defect
  diagnostic event to operation cycle mapping EventOperCycleMapLIN12Slave10Defect: diagnostic-event=EventLIN12Slave10Defect, operation-cycle=DefaultOperationCycle  # Event_Oper_Cycle_Map_LIN 12 Slave 10_Defect
  diagnostic event to debounce algorithm mapping EventDebounceMapLIN12Slave10Defect: debounce-algorithm=counter_based, diagnostic-event=EventLIN12Slave10Defect  # EventDebounceMap_LIN 12 Slave 10_Defect
package /ZeC/DTC/DTC/LIN_12_Slave_9_NoCommunication
  diagnostic trouble code uds LIN_12_Slave_9_NoCommunication: dtc-props=Dtc_Props_358996c7, uds-dtc-value=0x030c06  # LIN 12 Slave 9_NoCommunication
  diagnostic event EventLIN12Slave9NoCommunication: aging-allowed=true, event-kind=SWC, prestorage-freeze-frame=false  # Event_LIN 12 Slave 9_NoCommunication
  diagnostic event to trouble code uds mapping EventDtcMapLIN12Slave9NoCommunication: diagnostic-event=EventLIN12Slave9NoCommunication, trouble-code-uds=LIN_12_Slave_9_NoCommunication  # Event_Dtc_Map_LIN 12 Slave 9_NoCommunication
  diagnostic event to operation cycle mapping EventOperCycleMapLIN12Slave9NoCommunication: diagnostic-event=EventLIN12Slave9NoCommunication, operation-cycle=DefaultOperationCycle  # Event_Oper_Cycle_Map_LIN 12 Slave 9_NoCommunication
  diagnostic event to debounce algorithm mapping EventDebounceMapLIN12Slave9NoCommunication: debounce-algorithm=counter_based, diagnostic-event=EventLIN12Slave9NoCommunication  # EventDebounceMap_LIN 12 Slave 9_NoCommunication
package /ZeC/DTC/DTC/LIN_12_Slave_1_Defect
  diagnostic trouble code uds LIN_12_Slave_1_Defect: dtc-props=Dtc_Props_358996c7, uds-dtc-value=0x030c07  # LIN 12 Slave 1_Defect
  diagnostic event EventLIN12Slave1Defect: aging-allowed=true, event-kind=SWC, prestorage-freeze-frame=false  # Event_LIN 12 Slave 1_Defect
  diagnostic event to trouble code uds mapping EventDtcMapLIN12Slave1Defect: diagnostic-event=EventLIN12Slave1Defect, trouble-code-uds=LIN_12_Slave_1_Defect  # Event_Dtc_Map_LIN 12 Slave 1_Defect
  diagnostic event to operation cycle mapping EventOperCycleMapLIN12Slave1Defect: diagnostic-event=EventLIN12Slave1Defect, operation-cycle=DefaultOperationCycle  # Event_Oper_Cycle_Map_LIN 12 Slave 1_Defect
  diagnostic event to debounce algorithm mapping EventDebounceMapLIN12Slave1Defect: debounce-algorithm=counter_based, diagnostic-event=EventLIN12Slave1Defect  # EventDebounceMap_LIN 12 Slave 1_Defect
package /ZeC/DTC/DTC/LIN_12_Slave_8_NoCommunication
  diagnostic trouble code uds LIN_12_Slave_8_NoCommunication: dtc-props=Dtc_Props_358996c7, uds-dtc-value=0x030c04  # LIN 12 Slave 8_NoCommunication
  diagnostic event EventLIN12Slave8NoCommunication: aging-allowed=true, event-kind=SWC, prestorage-freeze-frame=false  # Event_LIN 12 Slave 8_NoCommunication
  diagnostic event to trouble code uds mapping EventDtcMapLIN12Slave8NoCommunication: diagnostic-event=EventLIN12Slave8NoCommunication, trouble-code-uds=LIN_12_Slave_8_NoCommunication  # Event_Dtc_Map_LIN 12 Slave 8_NoCommunication
  diagnostic event to operation cycle mapping EventOperCycleMapLIN12Slave8NoCommunication: diagnostic-event=EventLIN12Slave8NoCommunication, operation-cycle=DefaultOperationCycle  # Event_Oper_Cycle_Map_LIN 12 Slave 8_NoCommunication
  diagnostic event to debounce algorithm mapping EventDebounceMapLIN12Slave8NoCommunication: debounce-algorithm=counter_based, diagnostic-event=EventLIN12Slave8NoCommunication  # EventDebounceMap_LIN 12 Slave 8_NoCommunication
package /ZeC/DTC/DTC/Power_Path_047_Short_to_GND_Failure
  diagnostic trouble code uds Power_Path_047_Short_to_GND_Failure: dtc-props=Dtc_Props_4d3937f, uds-dtc-value=0x00522f
  diagnostic event EventPowerPath047ShortToGNDFailure: aging-allowed=true, event-kind=SWC, prestorage-freeze-frame=false  # Event_Power_Path_047_Short_to_GND_Failure
  diagnostic event to trouble code uds mapping EventDtcMapPowerPath047ShortToGNDFailure: diagnostic-event=EventPowerPath047ShortToGNDFailure, trouble-code-uds=Power_Path_047_Short_to_GND_Failure  # Event_Dtc_Map_Power_Path_047_Short_to_GND_Failure
  diagnostic event to operation cycle mapping EventOperCycleMapPowerPath047ShortToGNDFailure: diagnostic-event=EventPowerPath047ShortToGNDFailure, operation-cycle=DefaultOperationCycle  # Event_Oper_Cycle_Map_Power_Path_047_Short_to_GND_Failure
  diagnostic event to debounce algorithm mapping EventDebounceMapPowerPath047ShortToGNDFailure: debounce-algorithm=time_based, diagnostic-event=EventPowerPath047ShortToGNDFailure  # EventDebounceMap_Power_Path_047_Short_to_GND_Failure
package /ZeC/DTC/DTC/LIN_12_Slave_9_Defect
  diagnostic trouble code uds LIN_12_Slave_9_Defect: dtc-props=Dtc_Props_358996c7, uds-dtc-value=0x030c05  # LIN 12 Slave 9_Defect
  diagnostic event EventLIN12Slave9Defect: aging-allowed=true, event-kind=SWC, prestorage-freeze-frame=false  # Event_LIN 12 Slave 9_Defect
  diagnostic event to trouble code uds mapping EventDtcMapLIN12Slave9Defect: diagnostic-event=EventLIN12Slave9Defect, trouble-code-uds=LIN_12_Slave_9_Defect  # Event_Dtc_Map_LIN 12 Slave 9_Defect
  diagnostic event to operation cycle mapping EventOperCycleMapLIN12Slave9Defect: diagnostic-event=EventLIN12Slave9Defect, operation-cycle=DefaultOperationCycle  # Event_Oper_Cycle_Map_LIN 12 Slave 9_Defect
  diagnostic event to debounce algorithm mapping EventDebounceMapLIN12Slave9Defect: debounce-algorithm=counter_based, diagnostic-event=EventLIN12Slave9Defect  # EventDebounceMap_LIN 12 Slave 9_Defect
package /ZeC/DTC/DTC/Power_Path_046_Short_to_GND_Failure
  diagnostic trouble code uds Power_Path_046_Short_to_GND_Failure: dtc-props=Dtc_Props_cef88d31, uds-dtc-value=0x00522e
  diagnostic event EventPowerPath046ShortToGNDFailure: aging-allowed=true, event-kind=SWC, prestorage-freeze-frame=false  # Event_Power_Path_046_Short_to_GND_Failure
  diagnostic event to trouble code uds mapping EventDtcMapPowerPath046ShortToGNDFailure: diagnostic-event=EventPowerPath046ShortToGNDFailure, trouble-code-uds=Power_Path_046_Short_to_GND_Failure  # Event_Dtc_Map_Power_Path_046_Short_to_GND_Failure
  diagnostic event to operation cycle mapping EventOperCycleMapPowerPath046ShortToGNDFailure: diagnostic-event=EventPowerPath046ShortToGNDFailure, operation-cycle=DefaultOperationCycle  # Event_Oper_Cycle_Map_Power_Path_046_Short_to_GND_Failure
  diagnostic event to debounce algorithm mapping EventDebounceMapPowerPath046ShortToGNDFailure: debounce-algorithm=time_based, diagnostic-event=EventPowerPath046ShortToGNDFailure  # EventDebounceMap_Power_Path_046_Short_to_GND_Failure
package /ZeC/DTC/DTC/LIN_12_Slave_7_NoCommunication
  diagnostic trouble code uds LIN_12_Slave_7_NoCommunication: dtc-props=Dtc_Props_358996c7, uds-dtc-value=0x030c02  # LIN 12 Slave 7_NoCommunication
  diagnostic event EventLIN12Slave7NoCommunication: aging-allowed=true, event-kind=SWC, prestorage-freeze-frame=false  # Event_LIN 12 Slave 7_NoCommunication
  diagnostic event to trouble code uds mapping EventDtcMapLIN12Slave7NoCommunication: diagnostic-event=EventLIN12Slave7NoCommunication, trouble-code-uds=LIN_12_Slave_7_NoCommunication  # Event_Dtc_Map_LIN 12 Slave 7_NoCommunication
  diagnostic event to operation cycle mapping EventOperCycleMapLIN12Slave7NoCommunication: diagnostic-event=EventLIN12Slave7NoCommunication, operation-cycle=DefaultOperationCycle  # Event_Oper_Cycle_Map_LIN 12 Slave 7_NoCommunication
  diagnostic event to debounce algorithm mapping EventDebounceMapLIN12Slave7NoCommunication: debounce-algorithm=counter_based, diagnostic-event=EventLIN12Slave7NoCommunication  # EventDebounceMap_LIN 12 Slave 7_NoCommunication
package /ZeC/DTC/DTC/LIN_12_Slave_8_Defect
  diagnostic trouble code uds LIN_12_Slave_8_Defect: dtc-props=Dtc_Props_358996c7, uds-dtc-value=0x030c03  # LIN 12 Slave 8_Defect
  diagnostic event EventLIN12Slave8Defect: aging-allowed=true, event-kind=SWC, prestorage-freeze-frame=false  # Event_LIN 12 Slave 8_Defect
  diagnostic event to trouble code uds mapping EventDtcMapLIN12Slave8Defect: diagnostic-event=EventLIN12Slave8Defect, trouble-code-uds=LIN_12_Slave_8_Defect  # Event_Dtc_Map_LIN 12 Slave 8_Defect
  diagnostic event to operation cycle mapping EventOperCycleMapLIN12Slave8Defect: diagnostic-event=EventLIN12Slave8Defect, operation-cycle=DefaultOperationCycle  # Event_Oper_Cycle_Map_LIN 12 Slave 8_Defect
  diagnostic event to debounce algorithm mapping EventDebounceMapLIN12Slave8Defect: debounce-algorithm=counter_based, diagnostic-event=EventLIN12Slave8Defect  # EventDebounceMap_LIN 12 Slave 8_Defect
