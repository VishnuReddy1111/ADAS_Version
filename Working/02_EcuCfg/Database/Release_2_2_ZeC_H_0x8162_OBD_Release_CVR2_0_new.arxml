[part 1 of 19]
AUTOSAR XML (schema 00047)
standard types defined: boolean, uint8, uint16, uint32
package /ZeC/EnvironmentCondition
  7 x diagnostic environmental condition:
    EptiSFDRole: formula={nrc-value=0x33, op=LOGICAL-OR, parts=[{compare-type=IS-EQUAL, compare-value=1, data-element=MeasurementValue_0x0174_Unlock_status_of_ECU_of_protection_of_vehicle_diagnosis_Role_for_protection_of_vehicle_diagnosis}, {compare-type=IS-EQUAL, compare-value=2, data-element=MeasurementValue_0x0174_Unlock_status_of_ECU_of_protection_of_vehicle_diagnosis_Role_for_protection_of_vehicle_diagnosis}, {compare-type=IS-EQUAL, compare-value=3, data-element=MeasurementValue_0x0174_Unlock_status_of_ECU_of_protection_of_vehicle_diagnosis_Role_for_protection_of_vehicle_diagnosis}, {compare-type=IS-EQUAL, compare-value=4, data-element=MeasurementValue_0x0174_Unlock_status_of_ECU_of_protection_of_vehicle_diagnosis_Role_for_protection_of_vehicle_diagnosis}, {compare-type=IS-EQUAL, compare-value=5, data-element=MeasurementValue_0x0174_Unlock_status_of_ECU_of_protection_of_vehicle_diagnosis_Role_for_protection_of_vehicle_diagnosis}]}
    BasicSFDRole: formula={nrc-value=0x33, op=LOGICAL-OR, parts=[{compare-type=IS-EQUAL, compare-value=2, data-element=MeasurementValue_0x0174_Unlock_status_of_ECU_of_protection_of_vehicle_diagnosis_Role_for_protection_of_vehicle_diagnosis}, {compare-type=IS-EQUAL, compare-value=3, data-element=MeasurementValue_0x0174_Unlock_status_of_ECU_of_protection_of_vehicle_diagnosis_Role_for_protection_of_vehicle_diagnosis}, {compare-type=IS-EQUAL, compare-value=4, data-element=MeasurementValue_0x0174_Unlock_status_of_ECU_of_protection_of_vehicle_diagnosis_Role_for_protection_of_vehicle_diagnosis}, {compare-type=IS-EQUAL, compare-value=5, data-element=MeasurementValue_0x0174_Unlock_status_of_ECU_of_protection_of_vehicle_diagnosis_Role_for_protection_of_vehicle_diagnosis}]}
    ProductionSFDRole: formula={nrc-value=0x33, op=LOGICAL-OR, parts=[{compare-type=IS-EQUAL, compare-value=3, data-element=MeasurementValue_0x0174_Unlock_status_of_ECU_of_protection_of_vehicle_diagnosis_Role_for_protection_of_vehicle_diagnosis}, {compare-type=IS-EQUAL, compare-value=4, data-element=MeasurementValue_0x0174_Unlock_status_of_ECU_of_protection_of_vehicle_diagnosis_Role_for_protection_of_vehicle_diagnosis}, {compare-type=IS-EQUAL, compare-value=5, data-element=MeasurementValue_0x0174_Unlock_status_of_ECU_of_protection_of_vehicle_diagnosis_Role_for_protection_of_vehicle_diagnosis}]}
    ExtendedSFDRole: formula={nrc-value=0x33, op=LOGICAL-OR, parts=[{compare-type=IS-EQUAL, compare-value=3, data-element=MeasurementValue_0x0174_Unlock_status_of_ECU_of_protection_of_vehicle_diagnosis_Role_for_protection_of_vehicle_diagnosis}, {compare-type=IS-EQUAL, compare-value=4, data-element=MeasurementValue_0x0174_Unlock_status_of_ECU_of_protection_of_vehicle_diagnosis_Role_for_protection_of_vehicle_diagnosis}]}
    SuperUserSFDRole: formula={nrc-value=0x33, op=LOGICAL-AND, parts=diagnostic-env-data-condition={compare-type=IS-EQUAL, compare-value=4, data-element=MeasurementValue_0x0174_Unlock_status_of_ECU_of_protection_of_vehicle_diagnosis_Role_for_protection_of_vehicle_diagnosis}}
    OtaSFDRole: formula={nrc-value=0x33, op=LOGICAL-OR, parts=[{compare-type=IS-EQUAL, compare-value=2, data-element=MeasurementValue_0x0174_Unlock_status_of_ECU_of_protection_of_vehicle_diagnosis_Role_for_protection_of_vehicle_diagnosis}, {compare-type=IS-EQUAL, compare-value=3, data-element=MeasurementValue_0x0174_Unlock_status_of_ECU_of_protection_of_vehicle_diagnosis_Role_for_protection_of_vehicle_diagnosis}, {compare-type=IS-EQUAL, compare-value=4, data-element=MeasurementValue_0x0174_Unlock_status_of_ECU_of_protection_of_vehicle_diagnosis_Role_for_protection_of_vehicle_diagnosis}, {compare-type=IS-EQUAL, compare-value=5, data-element=MeasurementValue_0x0174_Unlock_status_of_ECU_of_protection_of_vehicle_diagnosis_Role_for_protection_of_vehicle_diagnosis}, {compare-type=IS-EQUAL, compare-value=6, data-element=MeasurementValue_0x0174_Unlock_status_of_ECU_of_protection_of_vehicle_diagnosis_Role_for_protection_of_vehicle_diagnosis}]}
    E2eSFDMode: formula={nrc-value=0x33, op=LOGICAL-OR, parts=[{compare-type=IS-EQUAL, compare-value=2, data-element=MeasurementValue_0x3c0e_Mode_of_protection_of_vehicle_diagnosis_Mode_of_protection_of_vehicle_diagnosis}, {compare-type=IS-EQUAL, compare-value=3, data-element=MeasurementValue_0x3c0e_Mode_of_protection_of_vehicle_diagnosis_Mode_of_protection_of_vehicle_diagnosis}]}
package /ZeC/Session
  diagnostic session control class Diagnostic_Session_Control_Class: access-permission-validity=ACCESS-PERMISSION-SERVICE-INSTANCE  # Diagnostic Session Control Class
  5 x diagnostic session, all with p-2-server-max=0.05, p-2-star-server-max=5.0:
    EndOfLineSession: id=0x40, jump-to-boot-loader=NO-BOOT  # End of Line Session
    ExtendedSession: id=0x03, jump-to-boot-loader=NO-BOOT  # Extended Session
    ECUProgrammingSession: id=0x02, jump-to-boot-loader=OEM-BOOT  # ECU Programming Session
    DevelopmentSession: id=0x4f, jump-to-boot-loader=NO-BOOT  # Development Session
    DefaultSession: id=0x01, jump-to-boot-loader=NO-BOOT  # Default Session
  5 x diagnostic session control, all with session-control-class=Diagnostic_Session_Control_Class:
    SessionControlVWEndOfLineSession: access-permission=READWRITE0x01DefaultSession0x02ECUProgrammingSession0x03ExtendedSession0x40EndOfLineSession0x4FDevelopmentSession, diagnostic-session=EndOfLineSession  # Session Control VW End Of Line Session
    SessionControlExtendedDiagnosticSession: access-permission=READWRITE0x01DefaultSession0x02ECUProgrammingSession0x03ExtendedSession0x40EndOfLineSession0x4FDevelopmentSession, diagnostic-session=ExtendedSession  # Session Control Extended Diagnostic Session
    SessionControlECUProgrammingSession: access-permission=READWRITE0x02ECUProgrammingSession0x03ExtendedSession0x40EndOfLineSession0x4FDevelopmentSession, diagnostic-session=ECUProgrammingSession  # Session Control ECU Programming Session
    SessionControlDevelopmentSession: access-permission=READWRITE0x02ECUProgrammingSession0x03ExtendedSession0x40EndOfLineSession0x4FDevelopmentSession, diagnostic-session=DevelopmentSession  # Session Control Development Session
    SessionControlDefaultSession: access-permission=READWRITE0x01DefaultSession0x02ECUProgrammingSession0x03ExtendedSession0x40EndOfLineSession0x4FDevelopmentSession, diagnostic-session=DefaultSession  # Session Control Default Session
package /ZeC/AccessPermissions
  34 x diagnostic access permission:
    READWRITE0x01DefaultSession0x02ECUProgrammingSession0x03ExtendedSession0x40EndOfLineSession0x4FDevelopmentSession: diagnostic-session=[DefaultSession, ECUProgrammingSession, ExtendedSession, EndOfLineSession, DevelopmentSession]  # READ_WRITE_0x01_Default Session_0x02_ECU Programming Session_0x03_Extended Session_0x40_End of Line Session_0x4F_Development Session
    READWRITE0x02ECUProgrammingSession0x03ExtendedSession0x40EndOfLineSession0x4FDevelopmentSession: diagnostic-session=[ECUProgrammingSession, ExtendedSession, EndOfLineSession, DevelopmentSession]  # READ_WRITE_0x02_ECU Programming Session_0x03_Extended Session_0x40_End of Line Session_0x4F_Development Session
    READ0x01DefaultSession0x02ProgrammingSession0x03ExtendedSession: diagnostic-session=[DefaultSession, ExtendedSession]  # READ_0x01_DefaultSession_0x02_ProgrammingSession_0x03_ExtendedSession
    READ0x01DefaultSession0x03ExtendedSession: diagnostic-session=[ExtendedSession, DefaultSession]  # READ_0x01_DefaultSession_0x03_ExtendedSession
    READBasicSFDRole0x03ExtendedSession: diagnostic-session=ExtendedSession, environmental-condition=BasicSFDRole  # READ_BasicSFDRole_0x03_ExtendedSession
    READ0x03ExtendedSession: diagnostic-session=ExtendedSession  # READ_0x03_ExtendedSession
    WRITEExtendedSFDRole0x03ExtendedSession: diagnostic-session=ExtendedSession, environmental-condition=ExtendedSFDRole  # WRITE_ExtendedSFDRole_0x03_ExtendedSession
    WRITEProductionSFDRole0x03ExtendedSession: diagnostic-session=ExtendedSession, environmental-condition=ProductionSFDRole  # WRITE_ProductionSFDRole_0x03_ExtendedSession
    WRITEE2eSFDMode0x03ExtendedSession: diagnostic-session=ExtendedSession, environmental-condition=E2eSFDMode  # WRITE_E2eSFDMode_0x03_ExtendedSession
    WRITEBasicSFDRole0x03ExtendedSession: diagnostic-session=ExtendedSession, environmental-condition=BasicSFDRole  # WRITE_BasicSFDRole_0x03_ExtendedSession
    WRITE0x03ExtendedSession: diagnostic-session=ExtendedSession  # WRITE_0x03_ExtendedSession
    READ0x01DefaultSession: diagnostic-session=DefaultSession  # READ_0x01_DefaultSession
    WRITE0x01DefaultSession: diagnostic-session=DefaultSession  # WRITE_0x01_DefaultSession
    READ0x01DefaultSession0x03ExtendedSession0x40EndOfLineSession0x4FDevelopmentSession: diagnostic-session=[DefaultSession, ExtendedSession, EndOfLineSession, DevelopmentSession]  # READ_0x01_Default Session_0x03_Extended Session_0x40_End of Line Session_0x4F_Development Session
    WRITE0x03ExtendedSession0x40EndOfLineSession0x4FDevelopmentSession: diagnostic-session=[ExtendedSession, EndOfLineSession, DevelopmentSession]  # WRITE_0x03_Extended Session_0x40_End of Line Session_0x4F_Development Session
    READWRITE0x02ECUProgrammingSession: diagnostic-session=ECUProgrammingSession  # READ_WRITE_0x02_ECU Programming Session
    WRITE0x02ProgrammingSession0x03ExtendedSession: diagnostic-session=ExtendedSession  # WRITE_0x02_ProgrammingSession_0x03_ExtendedSession
    READSA11120x02ProgrammingSession: security-level=SA1112  # READ_SA_11_12_0x02_ProgrammingSession
    WRITESA11120x02ProgrammingSession: security-level=SA1112  # WRITE_SA_11_12_0x02_ProgrammingSession
    READWRITE0x03ExtendedSession: diagnostic-session=ExtendedSession  # READ_WRITE_0x03_ExtendedSession
    READWRITEBasicSFDRole0x01DefaultSession0x03ExtendedSession: diagnostic-session=[ExtendedSession, DefaultSession], environmental-condition=BasicSFDRole  # READ_WRITE_BasicSFDRole_0x01_DefaultSession_0x03_ExtendedSession
    READWRITE0x01DefaultSession0x03ExtendedSession: diagnostic-session=[DefaultSession, ExtendedSession]  # READ_WRITE_0x01_DefaultSession_0x03_ExtendedSession
    READWRITE0x03ExtendedSession0x40EOLSession0x4FDevelopmentSession: diagnostic-session=[DevelopmentSession, ExtendedSession]  # READ_WRITE_0x03_ExtendedSession_0x40_EOLSession_0x4F_DevelopmentSession
    READWRITESuperUserSFDRole0x03ExtendedSession: diagnostic-session=ExtendedSession, environmental-condition=SuperUserSFDRole  # READ_WRITE_SuperUserSFDRole_0x03_ExtendedSession
    READWRITEBasicSFDRole0x03ExtendedSession: diagnostic-session=ExtendedSession, environmental-condition=BasicSFDRole  # READ_WRITE_BasicSFDRole_0x03_ExtendedSession
    READWRITESA11120x02ProgrammingSession: security-level=SA1112  # READ_WRITE_SA_11_12_0x02_ProgrammingSession
    READWRITEExtendedSFDRole0x01DefaultSession0x03ExtendedSession: diagnostic-session=[ExtendedSession, DefaultSession], environmental-condition=ExtendedSFDRole  # READ_WRITE_ExtendedSFDRole_0x01_DefaultSession_0x03_ExtendedSession
    READWRITEExtendedSFDRole0x03ExtendedSession: diagnostic-session=ExtendedSession, environmental-condition=ExtendedSFDRole  # READ_WRITE_ExtendedSFDRole_0x03_ExtendedSession
    READWRITE0x01DefaultSession0x02ProgrammingSession0x03ExtendedSession: diagnostic-session=[DefaultSession, ExtendedSession]  # READ_WRITE_0x01_DefaultSession_0x02_ProgrammingSession_0x03_ExtendedSession
    READWRITEProductionSFDRole0x03ExtendedSession: diagnostic-session=ExtendedSession, environmental-condition=ProductionSFDRole  # READ_WRITE_ProductionSFDRole_0x03_ExtendedSession
    READWRITE0x03ExtendedSession0x4FDevelopmentSession: diagnostic-session=[DevelopmentSession, ExtendedSession]  # READ_WRITE_0x03_ExtendedSession_0x4F_DevelopmentSession
    READ0x01DefaultSession0x02ECUProgrammingSession0x03ExtendedSession: diagnostic-session=[DefaultSession, ECUProgrammingSession, ExtendedSession]  # READ_0x01_Default Session_0x02_ECU Programming Session_0x03_Extended Session
    READ0x02ECUProgrammingSession: diagnostic-session=ECUProgrammingSession  # READ_0x02_ECU Programming Session
    READ0x4fDevelopmentSession: diagnostic-session=DevelopmentSession  # READ_0x4f_Development Session
package /ZeC/DataIdentifiers
  diagnostic read data by identifier class DiagnosticReadDataByIdentifierClass: access-permission-validity=ACCESS-PERMISSION-SERVICE-INSTANCE, max-did-to-read=8  # Diagnostic Read Data By Identifier Class
  diagnostic write data by identifier class DiagnosticWriteDataByIdentifierClass: access-permission-validity=ACCESS-PERMISSION-SERVICE-INSTANCE  # Diagnostic Write Data By Identifier Class
package /ZeC/DataIdentifiers/MeasurementValue/Service_identification_extended
  diagnostic data identifier ServiceIdentificationExtended: id=0x01d8, represents-vin=false  # Service_identification_extended
    diagnostic-parameter bit-offset=0:
      diagnostic data element MeasurementValue_0x01d8_Service_identification_extended_amount_unauthorized_service_offers: base-type=uint8  # Parameters: amount_unauthorized_service_offers
    diagnostic-parameter bit-offset=8:
      diagnostic data element MeasurementValue_0x01d8_Service_identification_extended_service_id_application_protocol_ip_v6_address_port: array-size-semantics=VARIABLE-SIZE, max-number-of-elements=160, base-type=uint8  # Parameters: service_id / application_protocol / ip_v6_address / port
  diagnostic read data by identifier ReadServiceIdentificationExtended: access-permission=READ0x01DefaultSession0x02ProgrammingSession0x03ExtendedSession, data-identifier=ServiceIdentificationExtended, read-class=DiagnosticReadDataByIdentifierClass  # Read_Service_identification_extended
package /ZeC/DataIdentifiers/MeasurementValue/Ip_ipv6_addresses_list
  diagnostic data identifier IpIpv6AddressesList: id=0x013d, represents-vin=false  # Ip_ipv6_addresses_list
    diagnostic-parameter bit-offset=0:
      diagnostic data element MeasurementValue_0x013d_Ip_ipv6_addresses_list_Ip_ipv6_address: array-size-semantics=VARIABLE-SIZE, max-number-of-elements=16, base-type=uint8  # Parameters: Ip_ipv6_address
  diagnostic read data by identifier ReadIpIpv6AddressesList: access-permission=READ0x01DefaultSession0x03ExtendedSession, data-identifier=IpIpv6AddressesList, read-class=DiagnosticReadDataByIdentifierClass  # Read_Ip_ipv6_addresses_list
package /ZeC/DataIdentifiers/MeasurementValue/Ip_ipv6_multicast_addresses_list
  diagnostic data identifier IpIpv6MulticastAddressesList: id=0x013e, represents-vin=false  # Ip_ipv6_multicast_addresses_list
    diagnostic-parameter bit-offset=0:
      diagnostic data element MeasurementValue_0x013e_Ip_ipv6_multicast_addresses_list_Ip_ipv6_multicast_address: array-size-semantics=VARIABLE-SIZE, max-number-of-elements=16, base-type=uint8  # Parameters: Ip_ipv6_multicast_address
  diagnostic read data by identifier ReadIpIpv6MulticastAddressesList: access-permission=READ0x01DefaultSession0x03ExtendedSession, data-identifier=IpIpv6MulticastAddressesList, read-class=DiagnosticReadDataByIdentifierClass  # Read_Ip_ipv6_multicast_addresses_list
package /ZeC/DataIdentifiers/MeasurementValue/Ip_ndp_cache_list
  diagnostic data identifier IpNdpCacheList: id=0x0142, represents-vin=false  # Ip_ndp_cache_list
    diagnostic-parameter bit-offset=0:
      diagnostic data element MeasurementValue_0x0142_Ip_ndp_cache_list_Ip_Mac_address_Ip_ipv6_address_Ip_VLAN: array-size-semantics=VARIABLE-SIZE, max-number-of-elements=24, base-type=uint8  # Parameters: Ip_Mac_address / Ip_ipv6_address / Ip_VLAN
  diagnostic read data by identifier ReadIpNdpCacheList: access-permission=READ0x01DefaultSession0x03ExtendedSession, data-identifier=IpNdpCacheList, read-class=DiagnosticReadDataByIdentifierClass  # Read_Ip_ndp_cache_list
package /ZeC/DataIdentifiers/MeasurementValue/OBD_Driving_Cycle_set_once
  diagnostic data identifier OBDDrivingCycleSetOnce: id=0x0261, represents-vin=false  # OBD_Driving_Cycle_set_once
    diagnostic-parameter bit-offset=0:
      diagnostic data element MeasurementValue_0x0261_OBD_Driving_Cycle_set_once_OBD_Driving_Cycle_set_once: base-type=uint8, compu {0=OBD_Driving_Cycle_set_once: not active (TTR202414), 1=OBD_Driving_Cycle_set_once: active (TTR202313)}  # Parameters: OBD_Driving_Cycle_set_once
  diagnostic read data by identifier ReadOBDDrivingCycleSetOnce: access-permission=READ0x01DefaultSession0x03ExtendedSession, data-identifier=OBDDrivingCycleSetOnce, read-class=DiagnosticReadDataByIdentifierClass  # Read_OBD_Driving_Cycle_set_once
package /ZeC/DataIdentifiers/MeasurementValue/Ip_counter_wrong_tcp_ports
  diagnostic data identifier IpCounterWrongTcpPorts: id=0x0a2e, represents-vin=false  # Ip_counter_wrong_tcp_ports
    diagnostic-parameter bit-offset=0:
      diagnostic data element MeasurementValue_0x0a2e_Ip_counter_wrong_tcp_ports_Ip_counter_wrong_tcp_ports: base-type=uint16  # Parameters: Ip_counter_wrong_tcp_ports
  diagnostic read data by identifier ReadIpCounterWrongTcpPorts: access-permission=READ0x01DefaultSession0x03ExtendedSession, data-identifier=IpCounterWrongTcpPorts, read-class=DiagnosticReadDataByIdentifierClass  # Read_Ip_counter_wrong_tcp_ports
package /ZeC/DataIdentifiers/MeasurementValue/Ip_counter_wrong_udp_ports
  diagnostic data identifier IpCounterWrongUdpPorts: id=0x0a2f, represents-vin=false  # Ip_counter_wrong_udp_ports
    diagnostic-parameter bit-offset=0:
      diagnostic data element MeasurementValue_0x0a2f_Ip_counter_wrong_udp_ports_Ip_counter_wrong_udp_ports: base-type=uint16  # Parameters: Ip_counter_wrong_udp_ports
  diagnostic read data by identifier ReadIpCounterWrongUdpPorts: access-permission=READ0x01DefaultSession0x03ExtendedSession, data-identifier=IpCounterWrongUdpPorts, read-class=DiagnosticReadDataByIdentifierClass  # Read_Ip_counter_wrong_udp_ports
package /ZeC/DataIdentifiers/MeasurementValue/Ip_counter_wrong_ipv6_addresses
  diagnostic data identifier IpCounterWrongIpv6Addresses: id=0x0a2c, represents-vin=false  # Ip_counter_wrong_ipv6_addresses
    diagnostic-parameter bit-offset=0:
      diagnostic data element MeasurementValue_0x0a2c_Ip_counter_wrong_ipv6_addresses_Ip_counter_wrong_ipv6_addresses: base-type=uint16  # Parameters: Ip_counter_wrong_ipv6_addresses
  diagnostic read data by identifier ReadIpCounterWrongIpv6Addresses: access-permission=READ0x01DefaultSession0x03ExtendedSession, data-identifier=IpCounterWrongIpv6Addresses, read-class=DiagnosticReadDataByIdentifierClass  # Read_Ip_counter_wrong_ipv6_addresses
package /ZeC/DataIdentifiers/MeasurementValue/Ip_return_value_test_communication_connection
  diagnostic data identifier IpReturnValueTestCommunicationConnection: id=0x014f, represents-vin=false  # Ip_return_value_test_communication_connection
    diagnostic-parameter bit-offset=0:
      diagnostic data element MeasurementValue_0x014f_Ip_return_value_test_communication_connection_Ip_ipv6_address_Ip_result_Reserved: array-size-semantics=VARIABLE-SIZE, max-number-of-elements=17, base-type=uint8  # Parameters: Ip_ipv6_address / Ip_result / Reserved
  diagnostic read data by identifier ReadIpReturnValueTestCommunicationConnection: access-permission=READ0x01DefaultSession0x03ExtendedSession, data-identifier=IpReturnValueTestCommunicationConnection, read-class=DiagnosticReadDataByIdentifierClass  # Read_Ip_return_value_test_communication_connection
package /ZeC/DataIdentifiers/MeasurementValue/Power_Path_015_Pin_Mapping
  diagnostic data identifier PowerPath015PinMapping: id=0x790f, represents-vin=false  # Power_Path_015_Pin_Mapping
    diagnostic-parameter bit-offset=0:
      diagnostic data element MeasurementValue_0x790f_Power_Path_015_Pin_Mapping_Connector_Pin_Position: array-size-semantics=VARIABLE-SIZE, max-number-of-elements=208, base-type=uint8  # Parameters: Connector_Pin_Position
  diagnostic read data by identifier ReadPowerPath015PinMapping: access-permission=READ0x01DefaultSession0x03ExtendedSession, data-identifier=PowerPath015PinMapping, read-class=DiagnosticReadDataByIdentifierClass  # Read_Power_Path_015_Pin_Mapping
package /ZeC/DataIdentifiers/MeasurementValue/Someip_counter_invalid_someip_messages_interface_version
  diagnostic data identifier SomeipCounterInvalidSomeipMessagesInterfaceVersion: id=0xb109, represents-vin=false  # Someip_counter_invalid_someip_messages_interface_version
    diagnostic-parameter bit-offset=0:
      diagnostic data element MeasurementValue_0xb109_Someip_counter_invalid_someip_messages_interface_version_Counter: base-type=uint16  # Parameters: Counter
  diagnostic read data by identifier ReadSomeipCounterInvalidSomeipMessagesInterfaceVersion: access-permission=READ0x01DefaultSession0x03ExtendedSession, data-identifier=SomeipCounterInvalidSomeipMessagesInterfaceVersion, read-class=DiagnosticReadDataByIdentifierClass  # Read_Someip_counter_invalid_someip_messages_interface_version
package /ZeC/DataIdentifiers/MeasurementValue/Power_Path_160_Pin_Mapping
  diagnostic data identifier PowerPath160PinMapping: id=0x79a0, represents-vin=false  # Power_Path_160_Pin_Mapping
    diagnostic-parameter bit-offset=0:
      diagnostic data element MeasurementValue_0x79a0_Power_Path_160_Pin_Mapping_Connector_Pin_Position: array-size-semantics=VARIABLE-SIZE, max-number-of-elements=208, base-type=uint8  # Parameters: Connector_Pin_Position
  diagnostic read data by identifier ReadPowerPath160PinMapping: access-permission=READ0x01DefaultSession0x03ExtendedSession, data-identifier=PowerPath160PinMapping, read-class=DiagnosticReadDataByIdentifierClass  # Read_Power_Path_160_Pin_Mapping
package /ZeC/DataIdentifiers/MeasurementValue/Someip_counter_invalid_someip_messages_method_id
  diagnostic data identifier SomeipCounterInvalidSomeipMessagesMethodId: id=0xb107, represents-vin=false  # Someip_counter_invalid_someip_messages_method_id
    diagnostic-parameter bit-offset=0:
      diagnostic data element MeasurementValue_0xb107_Someip_counter_invalid_someip_messages_method_id_Counter: base-type=uint16  # Parameters: Counter
  diagnostic read data by identifier ReadSomeipCounterInvalidSomeipMessagesMethodId: access-permission=READ0x01DefaultSession0x03ExtendedSession, data-identifier=SomeipCounterInvalidSomeipMessagesMethodId, read-class=DiagnosticReadDataByIdentifierClass  # Read_Someip_counter_invalid_someip_messages_method_id
package /ZeC/DataIdentifiers/MeasurementValue/Someip_counter_invalid_someip_messages_service_id
  diagnostic data identifier SomeipCounterInvalidSomeipMessagesServiceId: id=0xb108, represents-vin=false  # Someip_counter_invalid_someip_messages_service_id
    diagnostic-parameter bit-offset=0:
      diagnostic data element MeasurementValue_0xb108_Someip_counter_invalid_someip_messages_service_id_Counter: base-type=uint16  # Parameters: Counter
  diagnostic read data by identifier ReadSomeipCounterInvalidSomeipMessagesServiceId: access-permission=READ0x01DefaultSession0x03ExtendedSession, data-identifier=SomeipCounterInvalidSomeipMessagesServiceId, read-class=DiagnosticReadDataByIdentifierClass  # Read_Someip_counter_invalid_someip_messages_service_id
package /ZeC/DataIdentifiers/MeasurementValue/Someip_counter_invalid_someip_messages
  diagnostic data identifier SomeipCounterInvalidSomeipMessages: id=0xb105, represents-vin=false  # Someip_counter_invalid_someip_messages
    diagnostic-parameter bit-offset=0:
      diagnostic data element MeasurementValue_0xb105_Someip_counter_invalid_someip_messages_Counter: base-type=uint16  # Parameters: Counter
  diagnostic read data by identifier ReadSomeipCounterInvalidSomeipMessages: access-permission=READ0x01DefaultSession0x03ExtendedSession, data-identifier=SomeipCounterInvalidSomeipMessages, read-class=DiagnosticReadDataByIdentifierClass  # Read_Someip_counter_invalid_someip_messages
package /ZeC/DataIdentifiers/MeasurementValue/Power_Path_010_Pin_Mapping
  diagnostic data identifier PowerPath010PinMapping: id=0x790a, represents-vin=false  # Power_Path_010_Pin_Mapping
    diagnostic-parameter bit-offset=0:
      diagnostic data element MeasurementValue_0x790a_Power_Path_010_Pin_Mapping_Connector_Pin_Position: array-size-semantics=VARIABLE-SIZE, max-number-of-elements=208, base-type=uint8  # Parameters: Connector_Pin_Position
  diagnostic read data by identifier ReadPowerPath010PinMapping: access-permission=READ0x01DefaultSession0x03ExtendedSession, data-identifier=PowerPath010PinMapping, read-class=DiagnosticReadDataByIdentifierClass  # Read_Power_Path_010_Pin_Mapping
package /ZeC/DataIdentifiers/MeasurementValue/Someip_counter_invalid_someip_subscriptions
  diagnostic data identifier SomeipCounterInvalidSomeipSubscriptions: id=0xb103, represents-vin=false  # Someip_counter_invalid_someip_subscriptions
    diagnostic-parameter bit-offset=0:
      diagnostic data element MeasurementValue_0xb103_Someip_counter_invalid_someip_subscriptions_Counter: base-type=uint16  # Parameters: Counter
  diagnostic read data by identifier ReadSomeipCounterInvalidSomeipSubscriptions: access-permission=READ0x01DefaultSession0x03ExtendedSession, data-identifier=SomeipCounterInvalidSomeipSubscriptions, read-class=DiagnosticReadDataByIdentifierClass  # Read_Someip_counter_invalid_someip_subscriptions
package /ZeC/DataIdentifiers/MeasurementValue/Power_Path_012_Pin_Mapping
  diagnostic data identifier PowerPath012PinMapping: id=0x790c, represents-vin=false  # Power_Path_012_Pin_Mapping
    diagnostic-parameter bit-offset=0:
      diagnostic data element MeasurementValue_0x790c_Power_Path_012_Pin_Mapping_Connector_Pin_Position: array-size-semantics=VARIABLE-SIZE, max-number-of-elements=208, base-type=uint8  # Parameters: Connector_Pin_Position
  diagnostic read data by identifier ReadPowerPath012PinMapping: access-permission=READ0x01DefaultSession0x03ExtendedSession, data-identifier=PowerPath012PinMapping, read-class=DiagnosticReadDataByIdentifierClass  # Read_Power_Path_012_Pin_Mapping
package /ZeC/DataIdentifiers/MeasurementValue/Power_Path_011_Pin_Mapping
  diagnostic data identifier PowerPath011PinMapping: id=0x790b, represents-vin=false  # Power_Path_011_Pin_Mapping
    diagnostic-parameter bit-offset=0:
      diagnostic data element MeasurementValue_0x790b_Power_Path_011_Pin_Mapping_Connector_Pin_Position: array-size-semantics=VARIABLE-SIZE, max-number-of-elements=208, base-type=uint8  # Parameters: Connector_Pin_Position
  diagnostic read data by identifier ReadPowerPath011PinMapping: access-permission=READ0x01DefaultSession0x03ExtendedSession, data-identifier=PowerPath011PinMapping, read-class=DiagnosticReadDataByIdentifierClass  # Read_Power_Path_011_Pin_Mapping
package /ZeC/DataIdentifiers/MeasurementValue/Someip_counter_invalid_someip_sd_messages
  diagnostic data identifier SomeipCounterInvalidSomeipSdMessages: id=0xb104, represents-vin=false  # Someip_counter_invalid_someip_sd_messages
    diagnostic-parameter bit-offset=0:
      diagnostic data element MeasurementValue_0xb104_Someip_counter_invalid_someip_sd_messages_Counter: base-type=uint16  # Parameters: Counter
  diagnostic read data by identifier ReadSomeipCounterInvalidSomeipSdMessages: access-permission=READ0x01DefaultSession0x03ExtendedSession, data-identifier=SomeipCounterInvalidSomeipSdMessages, read-class=DiagnosticReadDataByIdentifierClass  # Read_Someip_counter_invalid_someip_sd_messages
package /ZeC/DataIdentifiers/MeasurementValue/Power_Path_014_Pin_Mapping
  diagnostic data identifier PowerPath014PinMapping: id=0x790e, represents-vin=false  # Power_Path_014_Pin_Mapping
    diagnostic-parameter bit-offset=0:
      diagnostic data element MeasurementValue_0x790e_Power_Path_014_Pin_Mapping_Connector_Pin_Position: array-size-semantics=VARIABLE-SIZE, max-number-of-elements=208, base-type=uint8  # Parameters: Connector_Pin_Position
  diagnostic read data by identifier ReadPowerPath014PinMapping: access-permission=READ0x01DefaultSession0x03ExtendedSession, data-identifier=PowerPath014PinMapping, read-class=DiagnosticReadDataByIdentifierClass  # Read_Power_Path_014_Pin_Mapping
package /ZeC/DataIdentifiers/MeasurementValue/Power_Path_013_Pin_Mapping
  diagnostic data identifier PowerPath013PinMapping: id=0x790d, represents-vin=false  # Power_Path_013_Pin_Mapping
    diagnostic-parameter bit-offset=0:
      diagnostic data element MeasurementValue_0x790d_Power_Path_013_Pin_Mapping_Connector_Pin_Position: array-size-semantics=VARIABLE-SIZE, max-number-of-elements=208, base-type=uint8  # Parameters: Connector_Pin_Position
  diagnostic read data by identifier ReadPowerPath013PinMapping: access-permission=READ0x01DefaultSession0x03ExtendedSession, data-identifier=PowerPath013PinMapping, read-class=DiagnosticReadDataByIdentifierClass  # Read_Power_Path_013_Pin_Mapping
package /ZeC/DataIdentifiers/MeasurementValue/Power_Path_007_Pin_Mapping
  diagnostic data identifier PowerPath007PinMapping: id=0x7907, represents-vin=false  # Power_Path_007_Pin_Mapping
    diagnostic-parameter bit-offset=0:
      diagnostic data element MeasurementValue_0x7907_Power_Path_007_Pin_Mapping_Connector_Pin_Position: array-size-semantics=VARIABLE-SIZE, max-number-of-elements=208, base-type=uint8  # Parameters: Connector_Pin_Position
  diagnostic read data by identifier ReadPowerPath007PinMapping: access-permission=READ0x01DefaultSession0x03ExtendedSession, data-identifier=PowerPath007PinMapping, read-class=DiagnosticReadDataByIdentifierClass  # Read_Power_Path_007_Pin_Mapping
package /ZeC/DataIdentifiers/MeasurementValue/Power_Path_006_Pin_Mapping
  diagnostic data identifier PowerPath006PinMapping: id=0x7906, represents-vin=false  # Power_Path_006_Pin_Mapping
    diagnostic-parameter bit-offset=0:
      diagnostic data element MeasurementValue_0x7906_Power_Path_006_Pin_Mapping_Connector_Pin_Position: array-size-semantics=VARIABLE-SIZE, max-number-of-elements=208, base-type=uint8  # Parameters: Connector_Pin_Position
  diagnostic read data by identifier ReadPowerPath006PinMapping: access-permission=READ0x01DefaultSession0x03ExtendedSession, data-identifier=PowerPath006PinMapping, read-class=DiagnosticReadDataByIdentifierClass  # Read_Power_Path_006_Pin_Mapping
package /ZeC/DataIdentifiers/MeasurementValue/Power_Path_009_Pin_Mapping
  diagnostic data identifier PowerPath009PinMapping: id=0x7909, represents-vin=false  # Power_Path_009_Pin_Mapping
    diagnostic-parameter bit-offset=0:
      diagnostic data element MeasurementValue_0x7909_Power_Path_009_Pin_Mapping_Connector_Pin_Position: array-size-semantics=VARIABLE-SIZE, max-number-of-elements=208, base-type=uint8  # Parameters: Connector_Pin_Position
  diagnostic read data by identifier ReadPowerPath009PinMapping: access-permission=READ0x01DefaultSession0x03ExtendedSession, data-identifier=PowerPath009PinMapping, read-class=DiagnosticReadDataByIdentifierClass  # Read_Power_Path_009_Pin_Mapping
package /ZeC/DataIdentifiers/MeasurementValue/Power_Path_008_Pin_Mapping
  diagnostic data identifier PowerPath008PinMapping: id=0x7908, represents-vin=false  # Power_Path_008_Pin_Mapping
    diagnostic-parameter bit-offset=0:
      diagnostic data element MeasurementValue_0x7908_Power_Path_008_Pin_Mapping_Connector_Pin_Position: array-size-semantics=VARIABLE-SIZE, max-number-of-elements=208, base-type=uint8  # Parameters: Connector_Pin_Position
  diagnostic read data by identifier ReadPowerPath008PinMapping: access-permission=READ0x01DefaultSession0x03ExtendedSession, data-identifier=PowerPath008PinMapping, read-class=DiagnosticReadDataByIdentifierClass  # Read_Power_Path_008_Pin_Mapping
package /ZeC/DataIdentifiers/MeasurementValue/Power_Path_001_Pin_Mapping
  diagnostic data identifier PowerPath001PinMapping: id=0x7901, represents-vin=false  # Power_Path_001_Pin_Mapping
    diagnostic-parameter bit-offset=0:
      diagnostic data element MeasurementValue_0x7901_Power_Path_001_Pin_Mapping_Connector_Pin_Position: array-size-semantics=VARIABLE-SIZE, max-number-of-elements=208, base-type=uint8  # Parameters: Connector_Pin_Position
  diagnostic read data by identifier ReadPowerPath001PinMapping: access-permission=READ0x01DefaultSession0x03ExtendedSession, data-identifier=PowerPath001PinMapping, read-class=DiagnosticReadDataByIdentifierClass  # Read_Power_Path_001_Pin_Mapping
package /ZeC/DataIdentifiers/MeasurementValue/Power_Path_003_Pin_Mapping
  diagnostic data identifier PowerPath003PinMapping: id=0x7903, represents-vin=false  # Power_Path_003_Pin_Mapping
    diagnostic-parameter bit-offset=0:
      diagnostic data element MeasurementValue_0x7903_Power_Path_003_Pin_Mapping_Connector_Pin_Position: array-size-semantics=VARIABLE-SIZE, max-number-of-elements=208, base-type=uint8  # Parameters: Connector_Pin_Position
  diagnostic read data by identifier ReadPowerPath003PinMapping: access-permission=READ0x01DefaultSession0x03ExtendedSession, data-identifier=PowerPath003PinMapping, read-class=DiagnosticReadDataByIdentifierClass  # Read_Power_Path_003_Pin_Mapping
package /ZeC/DataIdentifiers/MeasurementValue/Power_Path_002_Pin_Mapping
  diagnostic data identifier PowerPath002PinMapping: id=0x7902, represents-vin=false  # Power_Path_002_Pin_Mapping
    diagnostic-parameter bit-offset=0:
      diagnostic data element MeasurementValue_0x7902_Power_Path_002_Pin_Mapping_Connector_Pin_Position: array-size-semantics=VARIABLE-SIZE, max-number-of-elements=208, base-type=uint8  # Parameters: Connector_Pin_Position
  diagnostic read data by identifier ReadPowerPath002PinMapping: access-permission=READ0x01DefaultSession0x03ExtendedSession, data-identifier=PowerPath002PinMapping, read-class=DiagnosticReadDataByIdentifierClass  # Read_Power_Path_002_Pin_Mapping
package /ZeC/DataIdentifiers/MeasurementValue/Power_Path_005_Pin_Mapping
  diagnostic data identifier PowerPath005PinMapping: id=0x7905, represents-vin=false  # Power_Path_005_Pin_Mapping
    diagnostic-parameter bit-offset=0:
      diagnostic data element MeasurementValue_0x7905_Power_Path_005_Pin_Mapping_Connector_Pin_Position: array-size-semantics=VARIABLE-SIZE, max-number-of-elements=208, base-type=uint8  # Parameters: Connector_Pin_Position
  diagnostic read data by identifier ReadPowerPath005PinMapping: access-permission=READ0x01DefaultSession0x03ExtendedSession, data-identifier=PowerPath005PinMapping, read-class=DiagnosticReadDataByIdentifierClass  # Read_Power_Path_005_Pin_Mapping
package /ZeC/DataIdentifiers/MeasurementValue/Power_Path_004_Pin_Mapping
  diagnostic data identifier PowerPath004PinMapping: id=0x7904, represents-vin=false  # Power_Path_004_Pin_Mapping
    diagnostic-parameter bit-offset=0:
      diagnostic data element MeasurementValue_0x7904_Power_Path_004_Pin_Mapping_Connector_Pin_Position: array-size-semantics=VARIABLE-SIZE, max-number-of-elements=208, base-type=uint8  # Parameters: Connector_Pin_Position
  diagnostic read data by identifier ReadPowerPath004PinMapping: access-permission=READ0x01DefaultSession0x03ExtendedSession, data-identifier=PowerPath004PinMapping, read-class=DiagnosticReadDataByIdentifierClass  # Read_Power_Path_004_Pin_Mapping
package /ZeC/DataIdentifiers/MeasurementValue/Unlock_status_of_ECU_of_protection_of_vehicle_diagnosis
  diagnostic data identifier UnlockStatusOfECUOfProtectionOfVehicleDiagnosis: id=0x0174, represents-vin=false  # Unlock_status_of_ECU_of_protection_of_vehicle_diagnosis
    diagnostic-parameter bit-offset=0:
      diagnostic data element MeasurementValue_0x0174_Unlock_status_of_ECU_of_protection_of_vehicle_diagnosis_Role_for_protection_of_vehicle_diagnosis: base-type=uint8, compu {4=Role_for_protection_of_vehicle_diagnosis: SUPERUSER (TTR208314), 2=Role_for_protection_of_vehicle_diagnosis: BASIC (TTR208114), 6=Role_for_protection_of_vehicle_diagnosis: OTA (TTR300512), 1=Role_for_protection_of_vehicle_diagnosis: EPTI (TTR208014), 5=Role_for_protection_of_vehicle_diagnosis: PRODUCTION (TTR208414), 3=Role_for_protection_of_vehicle_diagnosis: EXTENDED (TTR208214)}  # Parameters: Role_for_protection_of_vehicle_diagnosis
    diagnostic-parameter bit-offset=8:
      diagnostic data element MeasurementValue_0x0174_Unlock_status_of_ECU_of_protection_of_vehicle_diagnosis_Type_of_protection_of_vehicle_diagnosis: base-type=uint8, compu {1=Type_of_protection_of_vehicle_diagnosis: short: time controlled 90 minutes (TTR208513), 2=Type_of_protection_of_vehicle_diagnosis: long: mileage controlled, 200 kilometers (TTR208613), 0=Type_of_protection_of_vehicle_diagnosis: no unlock active (TTR207913), 3=Type_of_protection_of_vehicle_diagnosis: persistent: requires active termination of unlock (TTR208713)}  # Parameters: Type_of_protection_of_vehicle_diagnosis
    diagnostic-parameter bit-offset=16:
      diagnostic data element MeasurementValue_0x0174_Unlock_status_of_ECU_of_protection_of_vehicle_diagnosis_Status_of_protection_of_vehicle_B1ADC21: base-type=uint8, compu {0=Status_of_protection_of_vehicle_diagnosis: group attribute set (TTR208813), 1=Status_of_protection_of_vehicle_diagnosis: PVD individual attribute set (TTR208913)}  # Parameters: Status_of_protection_of_vehicle_diagnosis
    diagnostic-parameter bit-offset=24:
      diagnostic data element MeasurementValue_0x0174_Unlock_status_of_ECU_of_protection_of_vehicle_diagnosis_Duration_of_protection_of_vehiclE707268: base-type=uint8, compu {16=Duration_of_protection_of_vehicle_diagnosis: 16_minutes (TTR930112), 72=Duration_of_protection_of_vehicle_diagnosis: 72_minutes (TTR935712), 74=Duration_of_protection_of_vehicle_diagnosis: 74_minutes (TTR935912), 48=Duration_of_protection_of_vehicle_diagnosis: 48_minutes (TTR933312), 17=Duration_of_protection_of_vehicle_diagnosis: 17_minutes (TTR930212), 83=Duration_of_protection_of_vehicle_diagnosis: 83_minutes (TTR936812), 71=Duration_of_protection_of_vehicle_diagnosis: 71_minutes (TTR935612), 31=Duration_of_protection_of_vehicle_diagnosis: 31_minutes (TTR931612), 55=Duration_of_protection_of_vehicle_diagnosis: 55_minutes (TTR934012), 70=Duration_of_protection_of_vehicle_diagnosis: 70_minutes (TTR935512), 75=Duration_of_protection_of_vehicle_diagnosis: 75_minutes (TTR936012), 69=Duration_of_protection_of_vehicle_diagnosis: 69_minutes (TTR935412), 37=Duration_of_protection_of_vehicle_diagnosis: 37_minutes (TTR932212), 43=Duration_of_protection_of_vehicle_diagnosis: 43_minutes (TTR932812), 49=Duration_of_protection_of_vehicle_diagnosis: 49_minutes (TTR933412), 12=Duration_of_protection_of_vehicle_diagnosis: 12_minutes (TTR929712), 58=Duration_of_protection_of_vehicle_diagnosis: 58_minutes (TTR934312), 18=Duration_of_protection_of_vehicle_diagnosis: 18_minutes (TTR930312), 65=Duration_of_protection_of_vehicle_diagnosis: 65_minutes (TTR935012), 35=Duration_of_protection_of_vehicle_diagnosis: 35_minutes (TTR932012), 10=Duration_of_protection_of_vehicle_diagnosis: 10_minutes (TTR929512), 67=Duration_of_protection_of_vehicle_diagnosis: 67_minutes (TTR935212), 2=Duration_of_protection_of_vehicle_diagnosis: 2_minutes (TTR928712), 68=Duration_of_protection_of_vehicle_diagnosis: 68_minutes (TTR935312), 84=Duration_of_protection_of_vehicle_diagnosis: 84_minutes (TTR936912), 86=Duration_of_protection_of_vehicle_diagnosis: 86_minutes (TTR937112), 23=Duration_of_protection_of_vehicle_diagnosis: 23_minutes (TTR930812), 51=Duration_of_protection_of_vehicle_diagnosis: 51_minutes (TTR933612), 41=Duration_of_protection_of_vehicle_diagnosis: 41_minutes (TTR932612), 30=Duration_of_protection_of_vehicle_diagnosis: 30_minutes (TTR931512), 87=Duration_of_protection_of_vehicle_diagnosis: 87_minutes (TTR937212), 26=Duration_of_protection_of_vehicle_diagnosis: 26_minutes (TTR931112), 4=Duration_of_protection_of_vehicle_diagnosis: 4_minutes (TTR928912), 77=Duration_of_protection_of_vehicle_diagnosis: 77_minutes (TTR936212), 50=Duration_of_protection_of_vehicle_diagnosis: 50_minutes (TTR933512), 36=Duration_of_protection_of_vehicle_diagnosis: 36_minutes (TTR932112), 63=Duration_of_protection_of_vehicle_diagnosis: 63_minutes (TTR934812), 9=Duration_of_protection_of_vehicle_diagnosis: 9_minutes (TTR929412), 76=Duration_of_protection_of_vehicle_diagnosis: 76_minutes (TTR936112), 38=Duration_of_protection_of_vehicle_diagnosis: 38_minutes (TTR932312), 82=Duration_of_protection_of_vehicle_diagnosis: 82_minutes (TTR936712), 14=Duration_of_protection_of_vehicle_diagnosis: 14_minutes (TTR929912), 3=Duration_of_protection_of_vehicle_diagnosis: 3_minutes (TTR928812), 45=Duration_of_protection_of_vehicle_diagnosis: 45_minutes (TTR933012), 13=Duration_of_protection_of_vehicle_diagnosis: 13_minutes (TTR929812), 62=Duration_of_protection_of_vehicle_diagnosis: 62_minutes (TTR934712), 64=Duration_of_protection_of_vehicle_diagnosis: 64_minutes (TTR934912), 15=Duration_of_protection_of_vehicle_diagnosis: 15_minutes (TTR930012), 7=Duration_of_protection_of_vehicle_diagnosis: 7_minutes (TTR929212), 81=Duration_of_protection_of_vehicle_diagnosis: 81_minutes (TTR936612), 89=Duration_of_protection_of_vehicle_diagnosis: 89_minutes (TTR937412), 44=Duration_of_protection_of_vehicle_diagnosis: 44_minutes (TTR932912), 78=Duration_of_protection_of_vehicle_diagnosis: 78_minutes (TTR936312), 80=Duration_of_protection_of_vehicle_diagnosis: 80_minutes (TTR936512), 19=Duration_of_protection_of_vehicle_diagnosis: 19_minutes (TTR930412), 56=Duration_of_protection_of_vehicle_diagnosis: 56_minutes (TTR934112), 1=Duration_of_protection_of_vehicle_diagnosis: 1 minute (TTR928612), 24=Duration_of_protection_of_vehicle_diagnosis: 24_minutes (TTR930912), 57=Duration_of_protection_of_vehicle_diagnosis: 57_minutes (TTR934212), 90=Duration_of_protection_of_vehicle_diagnosis: 90_minutes (TTR937512), 40=Duration_of_protection_of_vehicle_diagnosis: 40_minutes (TTR932512), 88=Duration_of_protection_of_vehicle_diagnosis: 88_minutes (TTR937312), 33=Duration_of_protection_of_vehicle_diagnosis: 33_minutes (TTR931812), 60=Duration_of_protection_of_vehicle_diagnosis: 60_minutes (TTR934512), 39=Duration_of_protection_of_vehicle_diagnosis: 39_minutes (TTR932412), 27=Duration_of_protection_of_vehicle_diagnosis: 27_minutes (TTR931212), 85=Duration_of_protection_of_vehicle_diagnosis: 85_minutes (TTR937012), 42=Duration_of_protection_of_vehicle_diagnosis: 42_minutes (TTR932712), 54=Duration_of_protection_of_vehicle_diagnosis: 54_minutes (TTR933912), 5=Duration_of_protection_of_vehicle_diagnosis: 5_minutes (TTR929012), 25=Duration_of_protection_of_vehicle_diagnosis: 25_minutes (TTR931012), 22=Duration_of_protection_of_vehicle_diagnosis: 22_minutes (TTR930712), 28=Duration_of_protection_of_vehicle_diagnosis: 28_minutes (TTR931312), 73=Duration_of_protection_of_vehicle_diagnosis: 73_minutes (TTR935812), 52=Duration_of_protection_of_vehicle_diagnosis: 52_minutes (TTR933712), 21=Duration_of_protection_of_vehicle_diagnosis: 21_minutes (TTR930612), 11=Duration_of_protection_of_vehicle_diagnosis: 11_mintues (TTR929612), 46=Duration_of_protection_of_vehicle_diagnosis: 46_minutes (TTR933112), 34=Duration_of_protection_of_vehicle_diagnosis: 34_minutes (TTR931912), 8=Duration_of_protection_of_vehicle_diagnosis: 8_minutes (TTR929312), 59=Duration_of_protection_of_vehicle_diagnosis: 59_minutes (TTR934412), 32=Duration_of_protection_of_vehicle_diagnosis: 32_minutes (TTR931712), 79=Duration_of_protection_of_vehicle_diagnosis: 79_minutes (TTR936412), 6=Duration_of_protection_of_vehicle_diagnosis: 6_minutes (TTR929112), 53=Duration_of_protection_of_vehicle_diagnosis: 53_minutes (TTR933812), 20=Duration_of_protection_of_vehicle_diagnosis: 20_minutes (TTR930512), 66=Duration_of_protection_of_vehicle_diagnosis: 66_minutes (TTR935112), 47=Duration_of_protection_of_vehicle_diagnosis: 47_minutes (TTR933212), 61=Duration_of_protection_of_vehicle_diagnosis: 61_minutes (TTR934612), 29=Duration_of_protection_of_vehicle_diagnosis: 29_minutes (TTR931412)}  # Parameters: Duration_of_protection_of_vehicle_diagnosis
  diagnostic read data by identifier ReadUnlockStatusOfECUOfProtectionOfVehicleDiagnosis: access-permission=READ0x01DefaultSession0x03ExtendedSession, data-identifier=UnlockStatusOfECUOfProtectionOfVehicleDiagnosis, read-class=DiagnosticReadDataByIdentifierClass  # Read_Unlock_status_of_ECU_of_protection_of_vehicle_diagnosis
package /ZeC/DataIdentifiers/MeasurementValue/Power_Path_027_Pin_Mapping
  diagnostic data identifier PowerPath027PinMapping: id=0x791b, represents-vin=false  # Power_Path_027_Pin_Mapping
    diagnostic-parameter bit-offset=0:
      diagnostic data element MeasurementValue_0x791b_Power_Path_027_Pin_Mapping_Connector_Pin_Position: array-size-semantics=VARIABLE-SIZE, max-number-of-elements=208, base-type=uint8  # Parameters: Connector_Pin_Position
  diagnostic read data by identifier ReadPowerPath027PinMapping: access-permission=READ0x01DefaultSession0x03ExtendedSession, data-identifier=PowerPath027PinMapping, read-class=DiagnosticReadDataByIdentifierClass  # Read_Power_Path_027_Pin_Mapping
package /ZeC/DataIdentifiers/MeasurementValue/Power_Path_026_Pin_Mapping
  diagnostic data identifier PowerPath026PinMapping: id=0x791a, represents-vin=false  # Power_Path_026_Pin_Mapping
    diagnostic-parameter bit-offset=0:
      diagnostic data element MeasurementValue_0x791a_Power_Path_026_Pin_Mapping_Connector_Pin_Position: array-size-semantics=VARIABLE-SIZE, max-number-of-elements=208, base-type=uint8  # Parameters: Connector_Pin_Position
  diagnostic read data by identifier ReadPowerPath026PinMapping: access-permission=READ0x01DefaultSession0x03ExtendedSession, data-identifier=PowerPath026PinMapping, read-class=DiagnosticReadDataByIdentifierClass  # Read_Power_Path_026_Pin_Mapping
package /ZeC/DataIdentifiers/MeasurementValue/IP_network_max_correction_sync_clock
  diagnostic data identifier IPNetworkMaxCorrectionSyncClock: id=0x0173, represents-vin=false  # IP_network_max_correction_sync_clock
    diagnostic-parameter bit-offset=0:
      diagnostic data element MeasurementValue_0x0173_IP_network_max_correction_sync_clock_Ip_Max_Cor_Sync_Clock: base-type=uint32  # Parameters: Ip_Max_Cor_Sync_Clock
  diagnostic read data by identifier ReadIPNetworkMaxCorrectionSyncClock: access-permission=READ0x01DefaultSession0x03ExtendedSession, data-identifier=IPNetworkMaxCorrectionSyncClock, read-class=DiagnosticReadDataByIdentifierClass  # Read_IP_network_max_correction_sync_clock
package /ZeC/DataIdentifiers/MeasurementValue/Power_Path_029_Pin_Mapping
  diagnostic data identifier PowerPath029PinMapping: id=0x791d, represents-vin=false  # Power_Path_029_Pin_Mapping
    diagnostic-parameter bit-offset=0:
      diagnostic data element MeasurementValue_0x791d_Power_Path_029_Pin_Mapping_Connector_Pin_Position: array-size-semantics=VARIABLE-SIZE, max-number-of-elements=208, base-type=uint8  # Parameters: Connector_Pin_Position
  diagnostic read data by identifier ReadPowerPath029PinMapping: access-permission=READ0x01DefaultSession0x03ExtendedSession, data-identifier=PowerPath029PinMapping, read-class=DiagnosticReadDataByIdentifierClass  # Read_Power_Path_029_Pin_Mapping
package /ZeC/DataIdentifiers/MeasurementValue/Power_Path_028_Pin_Mapping
  diagnostic data identifier PowerPath028PinMapping: id=0x791c, represents-vin=false  # Power_Path_028_Pin_Mapping
    diagnostic-parameter bit-offset=0:
      diagnostic data element MeasurementValue_0x791c_Power_Path_028_Pin_Mapping_Connector_Pin_Position: array-size-semantics=VARIABLE-SIZE, max-number-of-elements=208, base-type=uint8  # Parameters: Connector_Pin_Position
  diagnostic read data by identifier ReadPowerPath028PinMapping: access-permission=READ0x01DefaultSession0x03ExtendedSession, data-identifier=PowerPath028PinMapping, read-class=DiagnosticReadDataByIdentifierClass  # Read_Power_Path_028_Pin_Mapping
package /ZeC/DataIdentifiers/MeasurementValue/Power_Path_031_Pin_Mapping
  diagnostic data identifier PowerPath031PinMapping: id=0x791f, represents-vin=false  # Power_Path_031_Pin_Mapping
    diagnostic-parameter bit-offset=0:
      diagnostic data element MeasurementValue_0x791f_Power_Path_031_Pin_Mapping_Connector_Pin_Position: array-size-semantics=VARIABLE-SIZE, max-number-of-elements=208, base-type=uint8  # Parameters: Connector_Pin_Position
  diagnostic read data by identifier ReadPowerPath031PinMapping: access-permission=READ0x01DefaultSession0x03ExtendedSession, data-identifier=PowerPath031PinMapping, read-class=DiagnosticReadDataByIdentifierClass  # Read_Power_Path_031_Pin_Mapping
package /ZeC/DataIdentifiers/MeasurementValue/Power_Path_030_Pin_Mapping
  diagnostic data identifier PowerPath030PinMapping: id=0x791e, represents-vin=false  # Power_Path_030_Pin_Mapping
    diagnostic-parameter bit-offset=0:
      diagnostic data element MeasurementValue_0x791e_Power_Path_030_Pin_Mapping_Connector_Pin_Position: array-size-semantics=VARIABLE-SIZE, max-number-of-elements=208, base-type=uint8  # Parameters: Connector_Pin_Position
  diagnostic read data by identifier ReadPowerPath030PinMapping: access-permission=READ0x01DefaultSession0x03ExtendedSession, data-identifier=PowerPath030PinMapping, read-class=DiagnosticReadDataByIdentifierClass  # Read_Power_Path_030_Pin_Mapping
package /ZeC/DataIdentifiers/MeasurementValue/Power_Path_024_Pin_Mapping
  diagnostic data identifier PowerPath024PinMapping: id=0x7918, represents-vin=false  # Power_Path_024_Pin_Mapping
    diagnostic-parameter bit-offset=0:
      diagnostic data element MeasurementValue_0x7918_Power_Path_024_Pin_Mapping_Connector_Pin_Position: array-size-semantics=VARIABLE-SIZE, max-number-of-elements=208, base-type=uint8  # Parameters: Connector_Pin_Position
  diagnostic read data by identifier ReadPowerPath024PinMapping: access-permission=READ0x01DefaultSession0x03ExtendedSession, data-identifier=PowerPath024PinMapping, read-class=DiagnosticReadDataByIdentifierClass  # Read_Power_Path_024_Pin_Mapping
package /ZeC/DataIdentifiers/MeasurementValue/Power_Path_023_Pin_Mapping
  diagnostic data identifier PowerPath023PinMapping: id=0x7917, represents-vin=false  # Power_Path_023_Pin_Mapping
    diagnostic-parameter bit-offset=0:
      diagnostic data element MeasurementValue_0x7917_Power_Path_023_Pin_Mapping_Connector_Pin_Position: array-size-semantics=VARIABLE-SIZE, max-number-of-elements=208, base-type=uint8  # Parameters: Connector_Pin_Position
  diagnostic read data by identifier ReadPowerPath023PinMapping: access-permission=READ0x01DefaultSession0x03ExtendedSession, data-identifier=PowerPath023PinMapping, read-class=DiagnosticReadDataByIdentifierClass  # Read_Power_Path_023_Pin_Mapping
package /ZeC/DataIdentifiers/MeasurementValue/Power_Path_025_Pin_Mapping
  diagnostic data identifier PowerPath025PinMapping: id=0x7919, represents-vin=false  # Power_Path_025_Pin_Mapping
    diagnostic-parameter bit-offset=0:
      diagnostic data element MeasurementValue_0x7919_Power_Path_025_Pin_Mapping_Connector_Pin_Position: array-size-semantics=VARIABLE-SIZE, max-number-of-elements=208, base-type=uint8  # Parameters: Connector_Pin_Position
  diagnostic read data by identifier ReadPowerPath025PinMapping: access-permission=READ0x01DefaultSession0x03ExtendedSession, data-identifier=PowerPath025PinMapping, read-class=DiagnosticReadDataByIdentifierClass  # Read_Power_Path_025_Pin_Mapping
package /ZeC/DataIdentifiers/MeasurementValue/Power_Path_016_Pin_Mapping
  diagnostic data identifier PowerPath016PinMapping: id=0x7910, represents-vin=false  # Power_Path_016_Pin_Mapping
    diagnostic-parameter bit-offset=0:
      diagnostic data element MeasurementValue_0x7910_Power_Path_016_Pin_Mapping_Connector_Pin_Position: array-size-semantics=VARIABLE-SIZE, max-number-of-elements=208, base-type=uint8  # Parameters: Connector_Pin_Position
  diagnostic read data by identifier ReadPowerPath016PinMapping: access-permission=READ0x01DefaultSession0x03ExtendedSession, data-identifier=PowerPath016PinMapping, read-class=DiagnosticReadDataByIdentifierClass  # Read_Power_Path_016_Pin_Mapping
package /ZeC/DataIdentifiers/MeasurementValue/Power_Path_018_Pin_Mapping
  diagnostic data identifier PowerPath018PinMapping: id=0x7912, represents-vin=false  # Power_Path_018_Pin_Mapping
    diagnostic-parameter bit-offset=0:
      diagnostic data element MeasurementValue_0x7912_Power_Path_018_Pin_Mapping_Connector_Pin_Position: array-size-semantics=VARIABLE-SIZE, max-number-of-elements=208, base-type=uint8  # Parameters: Connector_Pin_Position
  diagnostic read data by identifier ReadPowerPath018PinMapping: access-permission=READ0x01DefaultSession0x03ExtendedSession, data-identifier=PowerPath018PinMapping, read-class=DiagnosticReadDataByIdentifierClass  # Read_Power_Path_018_Pin_Mapping
package /ZeC/DataIdentifiers/MeasurementValue/Power_Path_017_Pin_Mapping
  diagnostic data identifier PowerPath017PinMapping: id=0x7911, represents-vin=false  # Power_Path_017_Pin_Mapping
    diagnostic-parameter bit-offset=0:
      diagnostic data element MeasurementValue_0x7911_Power_Path_017_Pin_Mapping_Connector_Pin_Position: array-size-semantics=VARIABLE-SIZE, max-number-of-elements=208, base-type=uint8  # Parameters: Connector_Pin_Position
  diagnostic read data by identifier ReadPowerPath017PinMapping: access-permission=READ0x01DefaultSession0x03ExtendedSession, data-identifier=PowerPath017PinMapping, read-class=DiagnosticReadDataByIdentifierClass  # Read_Power_Path_017_Pin_Mapping
package /ZeC/DataIdentifiers/MeasurementValue/Power_Path_020_Pin_Mapping
  diagnostic data identifier PowerPath020PinMapping: id=0x7914, represents-vin=false  # Power_Path_020_Pin_Mapping
    diagnostic-parameter bit-offset=0:
      diagnostic data element MeasurementValue_0x7914_Power_Path_020_Pin_Mapping_Connector_Pin_Position: array-size-semantics=VARIABLE-SIZE, max-number-of-elements=208, base-type=uint8  # Parameters: Connector_Pin_Position
  diagnostic read data by identifier ReadPowerPath020PinMapping: access-permission=READ0x01DefaultSession0x03ExtendedSession, data-identifier=PowerPath020PinMapping, read-class=DiagnosticReadDataByIdentifierClass  # Read_Power_Path_020_Pin_Mapping
package /ZeC/DataIdentifiers/MeasurementValue/Power_Path_019_Pin_Mapping
  diagnostic data identifier PowerPath019PinMapping: id=0x7913, represents-vin=false  # Power_Path_019_Pin_Mapping
    diagnostic-parameter bit-offset=0:
      diagnostic data element MeasurementValue_0x7913_Power_Path_019_Pin_Mapping_Connector_Pin_Position: array-size-semantics=VARIABLE-SIZE, max-number-of-elements=208, base-type=uint8  # Parameters: Connector_Pin_Position
  diagnostic read data by identifier ReadPowerPath019PinMapping: access-permission=READ0x01DefaultSession0x03ExtendedSession, data-identifier=PowerPath019PinMapping, read-class=DiagnosticReadDataByIdentifierClass  # Read_Power_Path_019_Pin_Mapping
package /ZeC/DataIdentifiers/MeasurementValue/Mode_of_protection_of_vehicle_diagnosis
  diagnostic data identifier ModeOfProtectionOfVehicleDiagnosis: id=0x3c0e, represents-vin=false  # Mode_of_protection_of_vehicle_diagnosis
    diagnostic-parameter bit-offset=0:
      diagnostic data element MeasurementValue_0x3c0e_Mode_of_protection_of_vehicle_diagnosis_Mode_of_protection_of_vehicle_diagnosis: base-type=uint8, compu {3=Mode_of_protection_of_vehicle_diagnosis: PVD_access_and_end_to_end_protection (TTR209313), 1=Mode_of_protection_of_vehicle_diagnosis: PVD_access_protection (TTR209113), 0=Mode_of_protection_of_vehicle_diagnosis: No_PVD_method (TTR209013), 2=Mode_of_protection_of_vehicle_diagnosis: PVD_end_to_end_protection (TTR209213)}  # Parameters: Mode_of_protection_of_vehicle_diagnosis
  diagnostic read data by identifier ReadModeOfProtectionOfVehicleDiagnosis: access-permission=READ0x01DefaultSession0x03ExtendedSession, data-identifier=ModeOfProtectionOfVehicleDiagnosis, read-class=DiagnosticReadDataByIdentifierClass  # Read_Mode_of_protection_of_vehicle_diagnosis
package /ZeC/DataIdentifiers/MeasurementValue/Power_Path_022_Pin_Mapping
  diagnostic data identifier PowerPath022PinMapping: id=0x7916, represents-vin=false  # Power_Path_022_Pin_Mapping
    diagnostic-parameter bit-offset=0:
      diagnostic data element MeasurementValue_0x7916_Power_Path_022_Pin_Mapping_Connector_Pin_Position: array-size-semantics=VARIABLE-SIZE, max-number-of-elements=208, base-type=uint8  # Parameters: Connector_Pin_Position
  diagnostic read data by identifier ReadPowerPath022PinMapping: access-permission=READ0x01DefaultSession0x03ExtendedSession, data-identifier=PowerPath022PinMapping, read-class=DiagnosticReadDataByIdentifierClass  # Read_Power_Path_022_Pin_Mapping
package /ZeC/DataIdentifiers/MeasurementValue/Someip_counter_invalid_someip_messages_protocol_version
  diagnostic data identifier SomeipCounterInvalidSomeipMessagesProtocolVersion: id=0xb10a, represents-vin=false  # Someip_counter_invalid_someip_messages_protocol_version
    diagnostic-parameter bit-offset=0:
      diagnostic data element MeasurementValue_0xb10a_Someip_counter_invalid_someip_messages_protocol_version_Counter: base-type=uint16  # Parameters: Counter
  diagnostic read data by identifier ReadSomeipCounterInvalidSomeipMessagesProtocolVersion: access-permission=READ0x01DefaultSession0x03ExtendedSession, data-identifier=SomeipCounterInvalidSomeipMessagesProtocolVersion, read-class=DiagnosticReadDataByIdentifierClass  # Read_Someip_counter_invalid_someip_messages_protocol_version
package /ZeC/DataIdentifiers/MeasurementValue/Power_Path_021_Pin_Mapping
  diagnostic data identifier PowerPath021PinMapping: id=0x7915, represents-vin=false  # Power_Path_021_Pin_Mapping
    diagnostic-parameter bit-offset=0:
      diagnostic data element MeasurementValue_0x7915_Power_Path_021_Pin_Mapping_Connector_Pin_Position: array-size-semantics=VARIABLE-SIZE, max-number-of-elements=208, base-type=uint8  # Parameters: Connector_Pin_Position
  diagnostic read data by identifier ReadPowerPath021PinMapping: access-permission=READ0x01DefaultSession0x03ExtendedSession, data-identifier=PowerPath021PinMapping, read-class=DiagnosticReadDataByIdentifierClass  # Read_Power_Path_021_Pin_Mapping
package /ZeC/DataIdentifiers/MeasurementValue/Vkms_missing_key_history
  diagnostic data identifier VkmsMissingKeyHistory: id=0x2c57, represents-vin=false  # Vkms_missing_key_history
    diagnostic-parameter bit-offset=0:
      diagnostic data element MeasurementValue_0x2c57_Vkms_missing_key_history_Missing_keys_error_code: base-type=uint8  # Parameters: Missing_keys_error_code
    diagnostic-parameter bit-offset=8:
      diagnostic data element MeasurementValue_0x2c57_Vkms_missing_key_history_Missing_keys_number: base-type=uint8  # Parameters: Missing_keys_number
    diagnostic-parameter bit-offset=16:
      diagnostic data element MeasurementValue_0x2c57_Vkms_missing_key_history_Missing_key: array-size-semantics=VARIABLE-SIZE, max-number-of-elements=200, base-type=uint8  # Parameters: Missing_key
  diagnostic read data by identifier ReadVkmsMissingKeyHistory: access-permission=READ0x01DefaultSession0x03ExtendedSession, data-identifier=VkmsMissingKeyHistory, read-class=DiagnosticReadDataByIdentifierClass  # Read_Vkms_missing_key_history
package /ZeC/DataIdentifiers/MeasurementValue/Vkms_training_counter
  diagnostic data identifier VkmsTrainingCounter: id=0x2c56, represents-vin=false  # Vkms_training_counter
    diagnostic-parameter bit-offset=0:
      diagnostic data element MeasurementValue_0x2c56_Vkms_training_counter_Training_counter_error_code: base-type=uint8  # Parameters: Training_counter_error_code
    diagnostic-parameter bit-offset=8:
      diagnostic data element MeasurementValue_0x2c56_Vkms_training_counter_Training_counter: base-type=uint16  # Parameters: Training_counter
  diagnostic read data by identifier ReadVkmsTrainingCounter: access-permission=READ0x01DefaultSession0x03ExtendedSession, data-identifier=VkmsTrainingCounter, read-class=DiagnosticReadDataByIdentifierClass  # Read_Vkms_training_counter
package /ZeC/DataIdentifiers/MeasurementValue/Vkms_vkmsvin
  diagnostic data identifier VkmsVkmsvin: id=0x2c55, represents-vin=false  # Vkms_vkmsvin
    diagnostic-parameter bit-offset=0:
      diagnostic data element MeasurementValue_0x2c55_Vkms_vkmsvin_Vkms_vin_error_code: base-type=uint8  # Parameters: Vkms-vin_error_code
    diagnostic-parameter bit-offset=8:
      diagnostic data element MeasurementValue_0x2c55_Vkms_vkmsvin_Vkms_vin: array-size-semantics=FIXED-SIZE, max-number-of-elements=17, base-type=uint8  # Parameters: Vkms_vin
  diagnostic read data by identifier ReadVkmsVkmsvin: access-permission=READ0x01DefaultSession0x03ExtendedSession, data-identifier=VkmsVkmsvin, read-class=DiagnosticReadDataByIdentifierClass  # Read_Vkms_vkmsvin
package /ZeC/DataIdentifiers/MeasurementValue/Power_Path_048_Pin_Mapping
  diagnostic data identifier PowerPath048PinMapping: id=0x7930, represents-vin=false  # Power_Path_048_Pin_Mapping
    diagnostic-parameter bit-offset=0:
      diagnostic data element MeasurementValue_0x7930_Power_Path_048_Pin_Mapping_Connector_Pin_Position: array-size-semantics=VARIABLE-SIZE, max-number-of-elements=208, base-type=uint8  # Parameters: Connector_Pin_Position
  diagnostic read data by identifier ReadPowerPath048PinMapping: access-permission=READ0x01DefaultSession0x03ExtendedSession, data-identifier=PowerPath048PinMapping, read-class=DiagnosticReadDataByIdentifierClass  # Read_Power_Path_048_Pin_Mapping
package /ZeC/DataIdentifiers/MeasurementValue/Sec_filtered_packets_till_layer_2
  diagnostic data identifier SecFilteredPacketsTillLayer2: id=0xb008, represents-vin=false  # Sec_filtered_packets_till_layer_2
    diagnostic-parameter bit-offset=0:
      diagnostic data element MeasurementValue_0xb008_Sec_filtered_packets_till_layer_2_port_number_of_filtered_packets_ethernet_number_of_filBC97D05: array-size-semantics=VARIABLE-SIZE, max-number-of-elements=160, base-type=uint8  # Parameters: port / number_of_filtered_packets_ethernet / number_of_filtered_packets_other
  diagnostic read data by identifier ReadSecFilteredPacketsTillLayer2: access-permission=READBasicSFDRole0x03ExtendedSession, data-identifier=SecFilteredPacketsTillLayer2, read-class=DiagnosticReadDataByIdentifierClass  # Read_Sec_filtered_packets_till_layer_2
package /ZeC/DataIdentifiers/MeasurementValue/Power_Path_042_Pin_Mapping
  diagnostic data identifier PowerPath042PinMapping: id=0x792a, represents-vin=false  # Power_Path_042_Pin_Mapping
    diagnostic-parameter bit-offset=0:
      diagnostic data element MeasurementValue_0x792a_Power_Path_042_Pin_Mapping_Connector_Pin_Position: array-size-semantics=VARIABLE-SIZE, max-number-of-elements=208, base-type=uint8  # Parameters: Connector_Pin_Position
  diagnostic read data by identifier ReadPowerPath042PinMapping: access-permission=READ0x01DefaultSession0x03ExtendedSession, data-identifier=PowerPath042PinMapping, read-class=DiagnosticReadDataByIdentifierClass  # Read_Power_Path_042_Pin_Mapping
package /ZeC/DataIdentifiers/MeasurementValue/Power_Path_044_Pin_Mapping
  diagnostic data identifier PowerPath044PinMapping: id=0x792c, represents-vin=false  # Power_Path_044_Pin_Mapping
    diagnostic-parameter bit-offset=0:
      diagnostic data element MeasurementValue_0x792c_Power_Path_044_Pin_Mapping_Connector_Pin_Position: array-size-semantics=VARIABLE-SIZE, max-number-of-elements=208, base-type=uint8  # Parameters: Connector_Pin_Position
  diagnostic read data by identifier ReadPowerPath044PinMapping: access-permission=READ0x01DefaultSession0x03ExtendedSession, data-identifier=PowerPath044PinMapping, read-class=DiagnosticReadDataByIdentifierClass  # Read_Power_Path_044_Pin_Mapping
package /ZeC/DataIdentifiers/MeasurementValue/Sec_filtered_packets_above_layer_3
  diagnostic data identifier SecFilteredPacketsAboveLayer3: id=0xb006, represents-vin=false  # Sec_filtered_packets_above_layer_3
    diagnostic-parameter bit-offset=0:
      diagnostic data element MeasurementValue_0xb006_Sec_filtered_packets_above_layer_3_port_number_of_filtered_packets_udp_number_of_filtere43174B1: array-size-semantics=VARIABLE-SIZE, max-number-of-elements=288, base-type=uint8  # Parameters: port / number_of_filtered_packets_udp / number_of_filtered_packets_tcp / number_of_filtered_packets_icmp / number_of_filtered_packets_other
  diagnostic read data by identifier ReadSecFilteredPacketsAboveLayer3: access-permission=READBasicSFDRole0x03ExtendedSession, data-identifier=SecFilteredPacketsAboveLayer3, read-class=DiagnosticReadDataByIdentifierClass  # Read_Sec_filtered_packets_above_layer_3
package /ZeC/DataIdentifiers/MeasurementValue/Sec_filtered_packets_till_layer_3
  diagnostic data identifier SecFilteredPacketsTillLayer3: id=0xb007, represents-vin=false  # Sec_filtered_packets_till_layer_3
    diagnostic-parameter bit-offset=0:
      diagnostic data element MeasurementValue_0xb007_Sec_filtered_packets_till_layer_3_port_number_of_filtered_packets_ip_number_of_filtered_C2547BB: array-size-semantics=VARIABLE-SIZE, max-number-of-elements=160, base-type=uint8  # Parameters: port / number_of_filtered_packets_ip / number_of_filtered_packets_other
  diagnostic read data by identifier ReadSecFilteredPacketsTillLayer3: access-permission=READBasicSFDRole0x03ExtendedSession, data-identifier=SecFilteredPacketsTillLayer3, read-class=DiagnosticReadDataByIdentifierClass  # Read_Sec_filtered_packets_till_layer_3
package /ZeC/DataIdentifiers/MeasurementValue/Power_Path_043_Pin_Mapping
  diagnostic data identifier PowerPath043PinMapping: id=0x792b, represents-vin=false  # Power_Path_043_Pin_Mapping
    diagnostic-parameter bit-offset=0:
      diagnostic data element MeasurementValue_0x792b_Power_Path_043_Pin_Mapping_Connector_Pin_Position: array-size-semantics=VARIABLE-SIZE, max-number-of-elements=208, base-type=uint8  # Parameters: Connector_Pin_Position
  diagnostic read data by identifier ReadPowerPath043PinMapping: access-permission=READ0x01DefaultSession0x03ExtendedSession, data-identifier=PowerPath043PinMapping, read-class=DiagnosticReadDataByIdentifierClass  # Read_Power_Path_043_Pin_Mapping
package /ZeC/DataIdentifiers/MeasurementValue/Sec_tx_bytes_ethernet_port
  diagnostic data identifier SecTxBytesEthernetPort: id=0xb004, represents-vin=false  # Sec_tx_bytes_ethernet_port
    diagnostic-parameter bit-offset=0:
      diagnostic data element MeasurementValue_0xb004_Sec_tx_bytes_ethernet_port_port_counter: array-size-semantics=VARIABLE-SIZE, max-number-of-elements=288, base-type=uint8  # Parameters: port / counter
  diagnostic read data by identifier ReadSecTxBytesEthernetPort: access-permission=READBasicSFDRole0x03ExtendedSession, data-identifier=SecTxBytesEthernetPort, read-class=DiagnosticReadDataByIdentifierClass  # Read_Sec_tx_bytes_ethernet_port
package /ZeC/DataIdentifiers/MeasurementValue/Power_Path_046_Pin_Mapping
  diagnostic data identifier PowerPath046PinMapping: id=0x792e, represents-vin=false  # Power_Path_046_Pin_Mapping
    diagnostic-parameter bit-offset=0:
      diagnostic data element MeasurementValue_0x792e_Power_Path_046_Pin_Mapping_Connector_Pin_Position: array-size-semantics=VARIABLE-SIZE, max-number-of-elements=208, base-type=uint8  # Parameters: Connector_Pin_Position
  diagnostic read data by identifier ReadPowerPath046PinMapping: access-permission=READ0x01DefaultSession0x03ExtendedSession, data-identifier=PowerPath046PinMapping, read-class=DiagnosticReadDataByIdentifierClass  # Read_Power_Path_046_Pin_Mapping
package /ZeC/DataIdentifiers/MeasurementValue/Sec_rx_bytes_ethernet_port
  diagnostic data identifier SecRxBytesEthernetPort: id=0xb005, represents-vin=false  # Sec_rx_bytes_ethernet_port
    diagnostic-parameter bit-offset=0:
      diagnostic data element MeasurementValue_0xb005_Sec_rx_bytes_ethernet_port_port_counter: array-size-semantics=VARIABLE-SIZE, max-number-of-elements=288, base-type=uint8  # Parameters: port / counter
  diagnostic read data by identifier ReadSecRxBytesEthernetPort: access-permission=READBasicSFDRole0x03ExtendedSession, data-identifier=SecRxBytesEthernetPort, read-class=DiagnosticReadDataByIdentifierClass  # Read_Sec_rx_bytes_ethernet_port
package /ZeC/DataIdentifiers/MeasurementValue/Power_Path_045_Pin_Mapping
  diagnostic data identifier PowerPath045PinMapping: id=0x792d, represents-vin=false  # Power_Path_045_Pin_Mapping
    diagnostic-parameter bit-offset=0:
      diagnostic data element MeasurementValue_0x792d_Power_Path_045_Pin_Mapping_Connector_Pin_Position: array-size-semantics=VARIABLE-SIZE, max-number-of-elements=208, base-type=uint8  # Parameters: Connector_Pin_Position
  diagnostic read data by identifier ReadPowerPath045PinMapping: access-permission=READ0x01DefaultSession0x03ExtendedSession, data-identifier=PowerPath045PinMapping, read-class=DiagnosticReadDataByIdentifierClass  # Read_Power_Path_045_Pin_Mapping
package /ZeC/DataIdentifiers/MeasurementValue/Sec_tx_frames_ethernet_port
  diagnostic data identifier SecTxFramesEthernetPort: id=0xb002, represents-vin=false  # Sec_tx_frames_ethernet_port
    diagnostic-parameter bit-offset=0:
      diagnostic data element MeasurementValue_0xb002_Sec_tx_frames_ethernet_port_port_counter: array-size-semantics=VARIABLE-SIZE, max-number-of-elements=288, base-type=uint8  # Parameters: port / counter
  diagnostic read data by identifier ReadSecTxFramesEthernetPort: access-permission=READBasicSFDRole0x03ExtendedSession, data-identifier=SecTxFramesEthernetPort, read-class=DiagnosticReadDataByIdentifierClass  # Read_Sec_tx_frames_ethernet_port
package /ZeC/DataIdentifiers/MeasurementValue/Power_Path_047_Pin_Mapping
  diagnostic data identifier PowerPath047PinMapping: id=0x792f, represents-vin=false  # Power_Path_047_Pin_Mapping
    diagnostic-parameter bit-offset=0:
      diagnostic data element MeasurementValue_0x792f_Power_Path_047_Pin_Mapping_Connector_Pin_Position: array-size-semantics=VARIABLE-SIZE, max-number-of-elements=208, base-type=uint8  # Parameters: Connector_Pin_Position
  diagnostic read data by identifier ReadPowerPath047PinMapping: access-permission=READ0x01DefaultSession0x03ExtendedSession, data-identifier=PowerPath047PinMapping, read-class=DiagnosticReadDataByIdentifierClass  # Read_Power_Path_047_Pin_Mapping
package /ZeC/DataIdentifiers/MeasurementValue/Sec_rx_frames_ethernet_port
  diagnostic data identifier SecRxFramesEthernetPort: id=0xb003, represents-vin=false  # Sec_rx_frames_ethernet_port
    diagnostic-parameter bit-offset=0:
      diagnostic data element MeasurementValue_0xb003_Sec_rx_frames_ethernet_port_port_counter: array-size-semantics=VARIABLE-SIZE, max-number-of-elements=288, base-type=uint8  # Parameters: port / counter
  diagnostic read data by identifier ReadSecRxFramesEthernetPort: access-permission=READBasicSFDRole0x03ExtendedSession, data-identifier=SecRxFramesEthernetPort, read-class=DiagnosticReadDataByIdentifierClass  # Read_Sec_rx_frames_ethernet_port
package /ZeC/DataIdentifiers/MeasurementValue/Power_Path_041_Pin_Mapping
  diagnostic data identifier PowerPath041PinMapping: id=0x7929, represents-vin=false  # Power_Path_041_Pin_Mapping
    diagnostic-parameter bit-offset=0:
      diagnostic data element MeasurementValue_0x7929_Power_Path_041_Pin_Mapping_Connector_Pin_Position: array-size-semantics=VARIABLE-SIZE, max-number-of-elements=208, base-type=uint8  # Parameters: Connector_Pin_Position
  diagnostic read data by identifier ReadPowerPath041PinMapping: access-permission=READ0x01DefaultSession0x03ExtendedSession, data-identifier=PowerPath041PinMapping, read-class=DiagnosticReadDataByIdentifierClass  # Read_Power_Path_041_Pin_Mapping
package /ZeC/DataIdentifiers/MeasurementValue/Sec_dropped_frames_ethernet_port
  diagnostic data identifier SecDroppedFramesEthernetPort: id=0xb001, represents-vin=false  # Sec_dropped_frames_ethernet_port
    diagnostic-parameter bit-offset=0:
      diagnostic data element MeasurementValue_0xb001_Sec_dropped_frames_ethernet_port_port_counter: array-size-semantics=VARIABLE-SIZE, max-number-of-elements=288, base-type=uint8  # Parameters: port / counter
  diagnostic read data by identifier ReadSecDroppedFramesEthernetPort: access-permission=READBasicSFDRole0x03ExtendedSession, data-identifier=SecDroppedFramesEthernetPort, read-class=DiagnosticReadDataByIdentifierClass  # Read_Sec_dropped_frames_ethernet_port
package /ZeC/DataIdentifiers/MeasurementValue/Power_Path_040_Pin_Mapping
  diagnostic data identifier PowerPath040PinMapping: id=0x7928, represents-vin=false  # Power_Path_040_Pin_Mapping
    diagnostic-parameter bit-offset=0:
      diagnostic data element MeasurementValue_0x7928_Power_Path_040_Pin_Mapping_Connector_Pin_Position: array-size-semantics=VARIABLE-SIZE, max-number-of-elements=208, base-type=uint8  # Parameters: Connector_Pin_Position
  diagnostic read data by identifier ReadPowerPath040PinMapping: access-permission=READ0x01DefaultSession0x03ExtendedSession, data-identifier=PowerPath040PinMapping, read-class=DiagnosticReadDataByIdentifierClass  # Read_Power_Path_040_Pin_Mapping
package /ZeC/DataIdentifiers/MeasurementValue/Power_Path_033_Pin_Mapping
  diagnostic data identifier PowerPath033PinMapping: id=0x7921, represents-vin=false  # Power_Path_033_Pin_Mapping
    diagnostic-parameter bit-offset=0:
      diagnostic data element MeasurementValue_0x7921_Power_Path_033_Pin_Mapping_Connector_Pin_Position: array-size-semantics=VARIABLE-SIZE, max-number-of-elements=208, base-type=uint8  # Parameters: Connector_Pin_Position
  diagnostic read data by identifier ReadPowerPath033PinMapping: access-permission=READ0x01DefaultSession0x03ExtendedSession, data-identifier=PowerPath033PinMapping, read-class=DiagnosticReadDataByIdentifierClass  # Read_Power_Path_033_Pin_Mapping
package /ZeC/DataIdentifiers/MeasurementValue/Powerpath_Status
  diagnostic data identifier PowerpathStatus: id=0x7800, represents-vin=false  # Powerpath Status
    diagnostic-parameter bit-offset=0:
      diagnostic data element MeasurementValue_0x7800_Powerpath_Status_Number_Failure_Root_Cause_Operation_State_Operation_State_ChangedBy_Out00FCDD8: array-size-semantics=VARIABLE-SIZE, max-number-of-elements=1760, base-type=uint8  # Parameters: Number / Failure Root Cause / Operation State / Operation State ChangedBy / Output Current / Output Current Average / Output Current Max / Output Current Min
  diagnostic read data by identifier ReadPowerpathStatus: access-permission=READ0x01DefaultSession0x03ExtendedSession, data-identifier=PowerpathStatus, read-class=DiagnosticReadDataByIdentifierClass  # Read_Powerpath Status
package /ZeC/DataIdentifiers/MeasurementValue/Power_Path_032_Pin_Mapping
  diagnostic data identifier PowerPath032PinMapping: id=0x7920, represents-vin=false  # Power_Path_032_Pin_Mapping
    diagnostic-parameter bit-offset=0:
      diagnostic data element MeasurementValue_0x7920_Power_Path_032_Pin_Mapping_Connector_Pin_Position: array-size-semantics=VARIABLE-SIZE, max-number-of-elements=208, base-type=uint8  # Parameters: Connector_Pin_Position
  diagnostic read data by identifier ReadPowerPath032PinMapping: access-permission=READ0x01DefaultSession0x03ExtendedSession, data-identifier=PowerPath032PinMapping, read-class=DiagnosticReadDataByIdentifierClass  # Read_Power_Path_032_Pin_Mapping
package /ZeC/DataIdentifiers/MeasurementValue/Function_On_Demand_slave_error_counter
  diagnostic data identifier FunctionOnDemandSlaveErrorCounter: id=0x017e, represents-vin=false  # Function_On_Demand_slave_error_counter
    diagnostic-parameter bit-offset=0:
      diagnostic data element MeasurementValue_0x017e_Function_On_Demand_slave_error_counter_FoD_Slave_error_counter: base-type=uint16  # Parameters: FoD_Slave_error_counter
  diagnostic read data by identifier ReadFunctionOnDemandSlaveErrorCounter: access-permission=READ0x01DefaultSession0x03ExtendedSession, data-identifier=FunctionOnDemandSlaveErrorCounter, read-class=DiagnosticReadDataByIdentifierClass  # Read_Function_On_Demand_slave_error_counter
package /ZeC/DataIdentifiers/MeasurementValue/Power_Path_035_Pin_Mapping
  diagnostic data identifier PowerPath035PinMapping: id=0x7923, represents-vin=false  # Power_Path_035_Pin_Mapping
    diagnostic-parameter bit-offset=0:
      diagnostic data element MeasurementValue_0x7923_Power_Path_035_Pin_Mapping_Connector_Pin_Position: array-size-semantics=VARIABLE-SIZE, max-number-of-elements=208, base-type=uint8  # Parameters: Connector_Pin_Position
  diagnostic read data by identifier ReadPowerPath035PinMapping: access-permission=READ0x01DefaultSession0x03ExtendedSession, data-identifier=PowerPath035PinMapping, read-class=DiagnosticReadDataByIdentifierClass  # Read_Power_Path_035_Pin_Mapping
package /ZeC/DataIdentifiers/MeasurementValue/Power_Path_034_Pin_Mapping
  diagnostic data identifier PowerPath034PinMapping: id=0x7922, represents-vin=false  # Power_Path_034_Pin_Mapping
    diagnostic-parameter bit-offset=0:
      diagnostic data element MeasurementValue_0x7922_Power_Path_034_Pin_Mapping_Connector_Pin_Position: array-size-semantics=VARIABLE-SIZE, max-number-of-elements=208, base-type=uint8  # Parameters: Connector_Pin_Position
  diagnostic read data by identifier ReadPowerPath034PinMapping: access-permission=READ0x01DefaultSession0x03ExtendedSession, data-identifier=PowerPath034PinMapping, read-class=DiagnosticReadDataByIdentifierClass  # Read_Power_Path_034_Pin_Mapping
package /ZeC/DataIdentifiers/MeasurementValue/Power_Path_037_Pin_Mapping
  diagnostic data identifier PowerPath037PinMapping: id=0x7925, represents-vin=false  # Power_Path_037_Pin_Mapping
    diagnostic-parameter bit-offset=0:
      diagnostic data element MeasurementValue_0x7925_Power_Path_037_Pin_Mapping_Connector_Pin_Position: array-size-semantics=VARIABLE-SIZE, max-number-of-elements=208, base-type=uint8  # Parameters: Connector_Pin_Position
  diagnostic read data by identifier ReadPowerPath037PinMapping: access-permission=READ0x01DefaultSession0x03ExtendedSession, data-identifier=PowerPath037PinMapping, read-class=DiagnosticReadDataByIdentifierClass  # Read_Power_Path_037_Pin_Mapping
package /ZeC/DataIdentifiers/MeasurementValue/Power_Path_036_Pin_Mapping
  diagnostic data identifier PowerPath036PinMapping: id=0x7924, represents-vin=false  # Power_Path_036_Pin_Mapping
    diagnostic-parameter bit-offset=0:
      diagnostic data element MeasurementValue_0x7924_Power_Path_036_Pin_Mapping_Connector_Pin_Position: array-size-semantics=VARIABLE-SIZE, max-number-of-elements=208, base-type=uint8  # Parameters: Connector_Pin_Position
  diagnostic read data by identifier ReadPowerPath036PinMapping: access-permission=READ0x01DefaultSession0x03ExtendedSession, data-identifier=PowerPath036PinMapping, read-class=DiagnosticReadDataByIdentifierClass  # Read_Power_Path_036_Pin_Mapping
package /ZeC/DataIdentifiers/MeasurementValue/Function_On_Demand_Freischalt_ID_Status
  diagnostic data identifier FunctionOnDemandFreischaltIDStatus: id=0x017a, represents-vin=false  # Function_On_Demand_Freischalt_ID_Status
    diagnostic-parameter bit-offset=0:
      diagnostic data element MeasurementValue_0x017a_Function_On_Demand_Freischalt_ID_Status_number_of_FoD_FS_IDs_in_the_ECU: base-type=uint8  # Parameters: number_of_FoD_FS-IDs_in_the_ECU
    diagnostic-parameter bit-offset=8:
      diagnostic data element MeasurementValue_0x017a_Function_On_Demand_Freischalt_ID_Status_Last_mode_state: base-type=uint8, compu {0=Last_mode_state: not_active (TTR202213), 1=Last_mode_state: active (TTR202313)}  # Parameters: Last_mode_state
    diagnostic-parameter bit-offset=16:
      diagnostic data element MeasurementValue_0x017a_Function_On_Demand_Freischalt_ID_Status_SWaP_FS_ID: base-type=uint32  # Parameters: SWaP_FS-ID
    diagnostic-parameter bit-offset=48:
      diagnostic data element MeasurementValue_0x017a_Function_On_Demand_Freischalt_ID_Status_SWaP_function_crypt_data_SWaP_cancellation_SWaP_ED46B60: base-type=uint8, compu {1=SWaP_function_crypt_data: available (TTR245012), 0=SWaP_function_crypt_data: not available; SWaP-cancellation: canceled; SWaP_individualisation_feature: im_is_not_vcrn; SWaP_validation_condition: not_valid; Configuration: not_compatible; Function: not available; SWaP_authentication_check: not_valid (TTR244912TTR293712TTR294712TTR294912TTR295113TTR244912TTR294912), 2=SWaP-cancellation: not_canceled (TTR293812), 4=SWaP_individualisation_feature: im_is_vcrn (TTR294812), 8=SWaP_validation_condition: valid (TTR295012), 16=Configuration: compatible (TTR295212), 32=Function: available (TTR245012), 64=SWaP_authentication_check: valid (TTR295012)}  # Parameters: SWaP_function_crypt_data / SWaP-cancellation / SWaP_individualisation_feature / SWaP_validation_condition / Configuration / Function / SWaP_authentication_check / Reserved
  diagnostic read data by identifier ReadFunctionOnDemandFreischaltIDStatus: access-permission=READ0x01DefaultSession0x03ExtendedSession, data-identifier=FunctionOnDemandFreischaltIDStatus, read-class=DiagnosticReadDataByIdentifierClass  # Read_Function_On_Demand_Freischalt_ID_Status
package /ZeC/DataIdentifiers/MeasurementValue/Power_Path_039_Pin_Mapping
  diagnostic data identifier PowerPath039PinMapping: id=0x7927, represents-vin=false  # Power_Path_039_Pin_Mapping
    diagnostic-parameter bit-offset=0:
      diagnostic data element MeasurementValue_0x7927_Power_Path_039_Pin_Mapping_Connector_Pin_Position: array-size-semantics=VARIABLE-SIZE, max-number-of-elements=208, base-type=uint8  # Parameters: Connector_Pin_Position
  diagnostic read data by identifier ReadPowerPath039PinMapping: access-permission=READ0x01DefaultSession0x03ExtendedSession, data-identifier=PowerPath039PinMapping, read-class=DiagnosticReadDataByIdentifierClass  # Read_Power_Path_039_Pin_Mapping
package /ZeC/DataIdentifiers/MeasurementValue/Power_Path_038_Pin_Mapping
  diagnostic data identifier PowerPath038PinMapping: id=0x7926, represents-vin=false  # Power_Path_038_Pin_Mapping
    diagnostic-parameter bit-offset=0:
      diagnostic data element MeasurementValue_0x7926_Power_Path_038_Pin_Mapping_Connector_Pin_Position: array-size-semantics=VARIABLE-SIZE, max-number-of-elements=208, base-type=uint8  # Parameters: Connector_Pin_Position
  diagnostic read data by identifier ReadPowerPath038PinMapping: access-permission=READ0x01DefaultSession0x03ExtendedSession, data-identifier=PowerPath038PinMapping, read-class=DiagnosticReadDataByIdentifierClass  # Read_Power_Path_038_Pin_Mapping
package /ZeC/DataIdentifiers/MeasurementValue/Power_Path_065_Pin_Mapping
  diagnostic data identifier PowerPath065PinMapping: id=0x7941, represents-vin=false  # Power_Path_065_Pin_Mapping
    diagnostic-parameter bit-offset=0:
      diagnostic data element MeasurementValue_0x7941_Power_Path_065_Pin_Mapping_Connector_Pin_Position: array-size-semantics=VARIABLE-SIZE, max-number-of-elements=208, base-type=uint8  # Parameters: Connector_Pin_Position
  diagnostic read data by identifier ReadPowerPath065PinMapping: access-permission=READ0x01DefaultSession0x03ExtendedSession, data-identifier=PowerPath065PinMapping, read-class=DiagnosticReadDataByIdentifierClass  # Read_Power_Path_065_Pin_Mapping
package /ZeC/DataIdentifiers/MeasurementValue/Power_Path_064_Pin_Mapping
  diagnostic data identifier PowerPath064PinMapping: id=0x7940, represents-vin=false  # Power_Path_064_Pin_Mapping
    diagnostic-parameter bit-offset=0:
      diagnostic data element MeasurementValue_0x7940_Power_Path_064_Pin_Mapping_Connector_Pin_Position: array-size-semantics=VARIABLE-SIZE, max-number-of-elements=208, base-type=uint8  # Parameters: Connector_Pin_Position
  diagnostic read data by identifier ReadPowerPath064PinMapping: access-permission=READ0x01DefaultSession0x03ExtendedSession, data-identifier=PowerPath064PinMapping, read-class=DiagnosticReadDataByIdentifierClass  # Read_Power_Path_064_Pin_Mapping
package /ZeC/DataIdentifiers/MeasurementValue/Power_Path_059_Pin_Mapping
  diagnostic data identifier PowerPath059PinMapping: id=0x793b, represents-vin=false  # Power_Path_059_Pin_Mapping
    diagnostic-parameter bit-offset=0:
      diagnostic data element MeasurementValue_0x793b_Power_Path_059_Pin_Mapping_Connector_Pin_Position: array-size-semantics=VARIABLE-SIZE, max-number-of-elements=208, base-type=uint8  # Parameters: Connector_Pin_Position
  diagnostic read data by identifier ReadPowerPath059PinMapping: access-permission=READ0x01DefaultSession0x03ExtendedSession, data-identifier=PowerPath059PinMapping, read-class=DiagnosticReadDataByIdentifierClass  # Read_Power_Path_059_Pin_Mapping
package /ZeC/DataIdentifiers/MeasurementValue/Power_Path_058_Pin_Mapping
  diagnostic data identifier PowerPath058PinMapping: id=0x793a, represents-vin=false  # Power_Path_058_Pin_Mapping
    diagnostic-parameter bit-offset=0:
      diagnostic data element MeasurementValue_0x793a_Power_Path_058_Pin_Mapping_Connector_Pin_Position: array-size-semantics=VARIABLE-SIZE, max-number-of-elements=208, base-type=uint8  # Parameters: Connector_Pin_Position
  diagnostic read data by identifier ReadPowerPath058PinMapping: access-permission=READ0x01DefaultSession0x03ExtendedSession, data-identifier=PowerPath058PinMapping, read-class=DiagnosticReadDataByIdentifierClass  # Read_Power_Path_058_Pin_Mapping
package /ZeC/DataIdentifiers/MeasurementValue/SOK_missing_key_list
  diagnostic data identifier SOKMissingKeyList: id=0x0194, represents-vin=false  # SOK_missing_key_list
    diagnostic-parameter bit-offset=0:
      diagnostic data element MeasurementValue_0x0194_SOK_missing_key_list_Missing_keys_error_code: base-type=uint8  # Parameters: Missing_keys_error_code
    diagnostic-parameter bit-offset=8:
      diagnostic data element MeasurementValue_0x0194_SOK_missing_key_list_Missing_keys_number: base-type=uint8  # Parameters: Missing_keys_number
    diagnostic-parameter bit-offset=16:
      diagnostic data element MeasurementValue_0x0194_SOK_missing_key_list_Missing_key: base-type=uint16  # Parameters: Missing_key
  diagnostic read data by identifier ReadSOKMissingKeyList: access-permission=READ0x01DefaultSession0x03ExtendedSession, data-identifier=SOKMissingKeyList, read-class=DiagnosticReadDataByIdentifierClass  # Read_SOK_missing_key_list
package /ZeC/DataIdentifiers/MeasurementValue/Power_Path_061_Pin_Mapping
  diagnostic data identifier PowerPath061PinMapping: id=0x793d, represents-vin=false  # Power_Path_061_Pin_Mapping
    diagnostic-parameter bit-offset=0:
      diagnostic data element MeasurementValue_0x793d_Power_Path_061_Pin_Mapping_Connector_Pin_Position: array-size-semantics=VARIABLE-SIZE, max-number-of-elements=208, base-type=uint8  # Parameters: Connector_Pin_Position
  diagnostic read data by identifier ReadPowerPath061PinMapping: access-permission=READ0x01DefaultSession0x03ExtendedSession, data-identifier=PowerPath061PinMapping, read-class=DiagnosticReadDataByIdentifierClass  # Read_Power_Path_061_Pin_Mapping
package /ZeC/DataIdentifiers/MeasurementValue/Power_Path_060_Pin_Mapping
  diagnostic data identifier PowerPath060PinMapping: id=0x793c, represents-vin=false  # Power_Path_060_Pin_Mapping
    diagnostic-parameter bit-offset=0:
      diagnostic data element MeasurementValue_0x793c_Power_Path_060_Pin_Mapping_Connector_Pin_Position: array-size-semantics=VARIABLE-SIZE, max-number-of-elements=208, base-type=uint8  # Parameters: Connector_Pin_Position
  diagnostic read data by identifier ReadPowerPath060PinMapping: access-permission=READ0x01DefaultSession0x03ExtendedSession, data-identifier=PowerPath060PinMapping, read-class=DiagnosticReadDataByIdentifierClass  # Read_Power_Path_060_Pin_Mapping
package /ZeC/DataIdentifiers/MeasurementValue/SOK_freshness_information
  diagnostic data identifier SOKFreshnessInformation: id=0x0192, represents-vin=false  # SOK_freshness_information
    diagnostic-parameter bit-offset=0:
      diagnostic data element MeasurementValue_0x0192_SOK_freshness_information_Freshness_status: base-type=uint8  # Parameters: Freshness_status
    diagnostic-parameter bit-offset=8:
      diagnostic data element MeasurementValue_0x0192_SOK_freshness_information_Freshness_number: base-type=uint8  # Parameters: Freshness_number
    diagnostic-parameter bit-offset=16:
      diagnostic data element MeasurementValue_0x0192_SOK_freshness_information_SOK_PDU_ID_Freshness_value_Freshness_latest_verification_FreshF681BFE: array-size-semantics=VARIABLE-SIZE, max-number-of-elements=2100, base-type=uint8  # Parameters: SOK_PDU_ID / Freshness_value / Freshness_latest_verification / Freshness_counter_buffered / Freshness_counter_used
  diagnostic read data by identifier ReadSOKFreshnessInformation: access-permission=READ0x01DefaultSession0x03ExtendedSession, data-identifier=SOKFreshnessInformation, read-class=DiagnosticReadDataByIdentifierClass  # Read_SOK_freshness_information
package /ZeC/DataIdentifiers/MeasurementValue/Power_Path_063_Pin_Mapping
  diagnostic data identifier PowerPath063PinMapping: id=0x793f, represents-vin=false  # Power_Path_063_Pin_Mapping
    diagnostic-parameter bit-offset=0:
      diagnostic data element MeasurementValue_0x793f_Power_Path_063_Pin_Mapping_Connector_Pin_Position: array-size-semantics=VARIABLE-SIZE, max-number-of-elements=208, base-type=uint8  # Parameters: Connector_Pin_Position
  diagnostic read data by identifier ReadPowerPath063PinMapping: access-permission=READ0x01DefaultSession0x03ExtendedSession, data-identifier=PowerPath063PinMapping, read-class=DiagnosticReadDataByIdentifierClass  # Read_Power_Path_063_Pin_Mapping
package /ZeC/DataIdentifiers/MeasurementValue/Power_Path_062_Pin_Mapping
  diagnostic data identifier PowerPath062PinMapping: id=0x793e, represents-vin=false  # Power_Path_062_Pin_Mapping
    diagnostic-parameter bit-offset=0:
      diagnostic data element MeasurementValue_0x793e_Power_Path_062_Pin_Mapping_Connector_Pin_Position: array-size-semantics=VARIABLE-SIZE, max-number-of-elements=208, base-type=uint8  # Parameters: Connector_Pin_Position
  diagnostic read data by identifier ReadPowerPath062PinMapping: access-permission=READ0x01DefaultSession0x03ExtendedSession, data-identifier=PowerPath062PinMapping, read-class=DiagnosticReadDataByIdentifierClass  # Read_Power_Path_062_Pin_Mapping
package /ZeC/DataIdentifiers/MeasurementValue/SOK_general_information
  diagnostic data identifier SOKGeneralInformation: id=0x0190, represents-vin=false  # SOK_general_information
    diagnostic-parameter bit-offset=0:
      diagnostic data element MeasurementValue_0x0190_SOK_general_information_General_information_error_code: base-type=uint8  # Parameters: General_information_error_code
    diagnostic-parameter bit-offset=16:
      diagnostic data element MeasurementValue_0x0190_SOK_general_information_General_information_main_period: base-type=uint8  # Parameters: General_information_main_period
  diagnostic read data by identifier ReadSOKGeneralInformation: access-permission=READ0x01DefaultSession0x03ExtendedSession, data-identifier=SOKGeneralInformation, read-class=DiagnosticReadDataByIdentifierClass  # Read_SOK_general_information
package /ZeC/DataIdentifiers/MeasurementValue/SOK_time_information
  diagnostic data identifier SOKTimeInformation: id=0x0191, represents-vin=false  # SOK_time_information
    diagnostic-parameter bit-offset=0:
      diagnostic data element MeasurementValue_0x0191_SOK_time_information_Time_status: base-type=uint8  # Parameters: Time_status
    diagnostic-parameter bit-offset=8:
      diagnostic data element MeasurementValue_0x0191_SOK_time_information_Time_validity: base-type=uint8, compu {0=Time_validity: valid_time (TTR201313), 1=Time_validity: invalid_time (TTR201413)}  # Parameters: Time_validity
    diagnostic-parameter bit-offset=16:
      diagnostic data element MeasurementValue_0x0191_SOK_time_information_Time_current_sok_time: array-size-semantics=FIXED-SIZE, max-number-of-elements=8, base-type=uint8  # Parameters: Time_current_sok_time
    diagnostic-parameter bit-offset=80:
      diagnostic data element MeasurementValue_0x0191_SOK_time_information_Time_jitter_status: base-type=uint8, compu {0=Time_jitter_status: jitter_not_exceeded (TTR201613), 1=Time_jitter_status: jitter_exceeded (TTR201713)}  # Parameters: Time_jitter_status
  diagnostic read data by identifier ReadSOKTimeInformation: access-permission=READ0x01DefaultSession0x03ExtendedSession, data-identifier=SOKTimeInformation, read-class=DiagnosticReadDataByIdentifierClass  # Read_SOK_time_information
package /ZeC/DataIdentifiers/MeasurementValue/Status_ECU_Standalone_Mode
  diagnostic data identifier StatusECUStandaloneMode: id=0xc101, represents-vin=false  # Status ECU Standalone-Mode
    diagnostic-parameter bit-offset=0:
      diagnostic data element MeasurementValue_0xc101_Status_ECU_Standalone_Mode_Status_ECU_Standalone_Mode: base-type=uint8, compu {0=Status ECU Standalone-Mode: not_active (TTR202213), 1=Status ECU Standalone-Mode: active (TTR202313)}  # Parameters: Status ECU Standalone-Mode
  diagnostic read data by identifier ReadStatusECUStandaloneMode: access-permission=READ0x01DefaultSession0x03ExtendedSession, data-identifier=StatusECUStandaloneMode, read-class=DiagnosticReadDataByIdentifierClass  # Read_Status ECU Standalone-Mode
package /ZeC/DataIdentifiers/MeasurementValue/Power_Path_057_Pin_Mapping
  diagnostic data identifier PowerPath057PinMapping: id=0x7939, represents-vin=false  # Power_Path_057_Pin_Mapping
    diagnostic-parameter bit-offset=0:
      diagnostic data element MeasurementValue_0x7939_Power_Path_057_Pin_Mapping_Connector_Pin_Position: array-size-semantics=VARIABLE-SIZE, max-number-of-elements=208, base-type=uint8  # Parameters: Connector_Pin_Position
  diagnostic read data by identifier ReadPowerPath057PinMapping: access-permission=READ0x01DefaultSession0x03ExtendedSession, data-identifier=PowerPath057PinMapping, read-class=DiagnosticReadDataByIdentifierClass  # Read_Power_Path_057_Pin_Mapping
package /ZeC/DataIdentifiers/MeasurementValue/Service_identification_standard
  diagnostic data identifier ServiceIdentificationStandard: id=0xc100, represents-vin=false  # Service_identification_standard
    diagnostic-parameter bit-offset=0:
      diagnostic data element MeasurementValue_0xc100_Service_identification_standard_amount_unauthorized_service_offers: base-type=uint8  # Parameters: amount_unauthorized_service_offers
    diagnostic-parameter bit-offset=8:
      diagnostic data element MeasurementValue_0xc100_Service_identification_standard_service_id_application_protocol: array-size-semantics=VARIABLE-SIZE, max-number-of-elements=140, base-type=uint8  # Parameters: service_id / application_protocol
  diagnostic read data by identifier ReadServiceIdentificationStandard: access-permission=READ0x01DefaultSession0x02ProgrammingSession0x03ExtendedSession, data-identifier=ServiceIdentificationStandard, read-class=DiagnosticReadDataByIdentifierClass  # Read_Service_identification_standard
package /ZeC/DataIdentifiers/MeasurementValue/Power_Path_050_Pin_Mapping
  diagnostic data identifier PowerPath050PinMapping: id=0x7932, represents-vin=false  # Power_Path_050_Pin_Mapping
    diagnostic-parameter bit-offset=0:
      diagnostic data element MeasurementValue_0x7932_Power_Path_050_Pin_Mapping_Connector_Pin_Position: array-size-semantics=VARIABLE-SIZE, max-number-of-elements=208, base-type=uint8  # Parameters: Connector_Pin_Position
  diagnostic read data by identifier ReadPowerPath050PinMapping: access-permission=READ0x01DefaultSession0x03ExtendedSession, data-identifier=PowerPath050PinMapping, read-class=DiagnosticReadDataByIdentifierClass  # Read_Power_Path_050_Pin_Mapping
package /ZeC/DataIdentifiers/MeasurementValue/Power_Path_049_Pin_Mapping
  diagnostic data identifier PowerPath049PinMapping: id=0x7931, represents-vin=false  # Power_Path_049_Pin_Mapping
    diagnostic-parameter bit-offset=0:
      diagnostic data element MeasurementValue_0x7931_Power_Path_049_Pin_Mapping_Connector_Pin_Position: array-size-semantics=VARIABLE-SIZE, max-number-of-elements=208, base-type=uint8  # Parameters: Connector_Pin_Position
  diagnostic read data by identifier ReadPowerPath049PinMapping: access-permission=READ0x01DefaultSession0x03ExtendedSession, data-identifier=PowerPath049PinMapping, read-class=DiagnosticReadDataByIdentifierClass  # Read_Power_Path_049_Pin_Mapping
package /ZeC/DataIdentifiers/MeasurementValue/SOK_signature_failed_list
  diagnostic data identifier SOKSignatureFailedList: id=0x018f, represents-vin=false  # SOK_signature_failed_list
    diagnostic-parameter bit-offset=0:
      diagnostic data element MeasurementValue_0x018f_SOK_signature_failed_list_Signature_failed_error_code: base-type=uint8  # Parameters: Signature_failed_error_code
    diagnostic-parameter bit-offset=8:
      diagnostic data element MeasurementValue_0x018f_SOK_signature_failed_list_Signature_failed_number: base-type=uint8  # Parameters: Signature_failed_number
    diagnostic-parameter bit-offset=16:
      diagnostic data element MeasurementValue_0x018f_SOK_signature_failed_list_Failed_signature_creation: base-type=uint16  # Parameters: Failed_signature_creation
  diagnostic read data by identifier ReadSOKSignatureFailedList: access-permission=READ0x01DefaultSession0x03ExtendedSession, data-identifier=SOKSignatureFailedList, read-class=DiagnosticReadDataByIdentifierClass  # Read_SOK_signature_failed_list
package /ZeC/DataIdentifiers/MeasurementValue/Power_Path_052_Pin_Mapping
  diagnostic data identifier PowerPath052PinMapping: id=0x7934, represents-vin=false  # Power_Path_052_Pin_Mapping
    diagnostic-parameter bit-offset=0:
      diagnostic data element MeasurementValue_0x7934_Power_Path_052_Pin_Mapping_Connector_Pin_Position: array-size-semantics=VARIABLE-SIZE, max-number-of-elements=208, base-type=uint8  # Parameters: Connector_Pin_Position
  diagnostic read data by identifier ReadPowerPath052PinMapping: access-permission=READ0x01DefaultSession0x03ExtendedSession, data-identifier=PowerPath052PinMapping, read-class=DiagnosticReadDataByIdentifierClass  # Read_Power_Path_052_Pin_Mapping
package /ZeC/DataIdentifiers/MeasurementValue/Power_Path_051_Pin_Mapping
  diagnostic data identifier PowerPath051PinMapping: id=0x7933, represents-vin=false  # Power_Path_051_Pin_Mapping
    diagnostic-parameter bit-offset=0:
      diagnostic data element MeasurementValue_0x7933_Power_Path_051_Pin_Mapping_Connector_Pin_Position: array-size-semantics=VARIABLE-SIZE, max-number-of-elements=208, base-type=uint8  # Parameters: Connector_Pin_Position
  diagnostic read data by identifier ReadPowerPath051PinMapping: access-permission=READ0x01DefaultSession0x03ExtendedSession, data-identifier=PowerPath051PinMapping, read-class=DiagnosticReadDataByIdentifierClass  # Read_Power_Path_051_Pin_Mapping
package /ZeC/DataIdentifiers/MeasurementValue/Power_Path_054_Pin_Mapping
  diagnostic data identifier PowerPath054PinMapping: id=0x7936, represents-vin=false  # Power_Path_054_Pin_Mapping
    diagnostic-parameter bit-offset=0:
      diagnostic data element MeasurementValue_0x7936_Power_Path_054_Pin_Mapping_Connector_Pin_Position: array-size-semantics=VARIABLE-SIZE, max-number-of-elements=208, base-type=uint8  # Parameters: Connector_Pin_Position
  diagnostic read data by identifier ReadPowerPath054PinMapping: access-permission=READ0x01DefaultSession0x03ExtendedSession, data-identifier=PowerPath054PinMapping, read-class=DiagnosticReadDataByIdentifierClass  # Read_Power_Path_054_Pin_Mapping
package /ZeC/DataIdentifiers/MeasurementValue/In_use_monitor_performance_ratio
  diagnostic data identifier InUseMonitorPerformanceRatio: id=0x018a, represents-vin=false  # In_use_monitor_performance_ratio
    diagnostic-parameter bit-offset=0:
      diagnostic data element MeasurementValue_0x018a_In_use_monitor_performance_ratio_Versioning: base-type=uint8  # Parameters: Versioning
    diagnostic-parameter bit-offset=8:
      diagnostic data element MeasurementValue_0x018a_In_use_monitor_performance_ratio_Number_of_IUMPR_Records: base-type=uint16  # Parameters: Number of IUMPR Records
    diagnostic-parameter bit-offset=24:
      diagnostic data element MeasurementValue_0x018a_In_use_monitor_performance_ratio_Milage: base-type=uint16  # Parameters: Milage
    diagnostic-parameter bit-offset=40:
      diagnostic data element MeasurementValue_0x018a_In_use_monitor_performance_ratio_Ignition_Cycle_Counter: base-type=uint16  # Parameters: Ignition Cycle Counter
    diagnostic-parameter bit-offset=56:
      diagnostic data element MeasurementValue_0x018a_In_use_monitor_performance_ratio_General_Denominator: base-type=uint16  # Parameters: General Denominator
    diagnostic-parameter bit-offset=72:
      diagnostic data element MeasurementValue_0x018a_In_use_monitor_performance_ratio_DFCC_Value_Numerator_Denominator: array-size-semantics=VARIABLE-SIZE, max-number-of-elements=4060, base-type=uint8  # Parameters: DFCC_Value / Numerator / Denominator
  diagnostic read data by identifier ReadInUseMonitorPerformanceRatio: access-permission=READ0x01DefaultSession0x03ExtendedSession, data-identifier=InUseMonitorPerformanceRatio, read-class=DiagnosticReadDataByIdentifierClass  # Read_In_use_monitor_performance_ratio
package /ZeC/DataIdentifiers/MeasurementValue/Vkms_key_list
  diagnostic data identifier VkmsKeyList: id=0x2c60, represents-vin=false  # Vkms_key_list
    diagnostic-parameter bit-offset=0:
      diagnostic data element MeasurementValue_0x2c60_Vkms_key_list_Key_list_error_code: base-type=uint8  # Parameters: Key_list_error_code
    diagnostic-parameter bit-offset=8:
      diagnostic data element MeasurementValue_0x2c60_Vkms_key_list_Key_list_number: base-type=uint8  # Parameters: Key_list_number
    diagnostic-parameter bit-offset=16:
      diagnostic data element MeasurementValue_0x2c60_Vkms_key_list_Vkms_key_Vkms_type_key_counter: array-size-semantics=VARIABLE-SIZE, max-number-of-elements=400, base-type=uint8  # Parameters: Vkms_key / Vkms_type_key_counter
  diagnostic read data by identifier ReadVkmsKeyList: access-permission=READ0x01DefaultSession0x03ExtendedSession, data-identifier=VkmsKeyList, read-class=DiagnosticReadDataByIdentifierClass  # Read_Vkms_key_list
package /ZeC/DataIdentifiers/MeasurementValue/Power_Path_053_Pin_Mapping
  diagnostic data identifier PowerPath053PinMapping: id=0x7935, represents-vin=false  # Power_Path_053_Pin_Mapping
    diagnostic-parameter bit-offset=0:
      diagnostic data element MeasurementValue_0x7935_Power_Path_053_Pin_Mapping_Connector_Pin_Position: array-size-semantics=VARIABLE-SIZE, max-number-of-elements=208, base-type=uint8  # Parameters: Connector_Pin_Position
  diagnostic read data by identifier ReadPowerPath053PinMapping: access-permission=READ0x01DefaultSession0x03ExtendedSession, data-identifier=PowerPath053PinMapping, read-class=DiagnosticReadDataByIdentifierClass  # Read_Power_Path_053_Pin_Mapping
package /ZeC/DataIdentifiers/MeasurementValue/SOK_verification_failed_list
  diagnostic data identifier SOKVerificationFailedList: id=0x018b, represents-vin=false  # SOK_verification_failed_list
    diagnostic-parameter bit-offset=0:
      diagnostic data element MeasurementValue_0x018b_SOK_verification_failed_list_Verification_failed_error_code: base-type=uint8  # Parameters: Verification_failed_error_code
    diagnostic-parameter bit-offset=8:
      diagnostic data element MeasurementValue_0x018b_SOK_verification_failed_list_Verification_failed_number: base-type=uint8  # Parameters: Verification_failed_number
    diagnostic-parameter bit-offset=16:
      diagnostic data element MeasurementValue_0x018b_SOK_verification_failed_list_Failed_verification: base-type=uint16  # Parameters: Failed_verification
  diagnostic read data by identifier ReadSOKVerificationFailedList: access-permission=READ0x01DefaultSession0x03ExtendedSession, data-identifier=SOKVerificationFailedList, read-class=DiagnosticReadDataByIdentifierClass  # Read_SOK_verification_failed_list
package /ZeC/DataIdentifiers/MeasurementValue/Power_Path_056_Pin_Mapping
  diagnostic data identifier PowerPath056PinMapping: id=0x7938, represents-vin=false  # Power_Path_056_Pin_Mapping
    diagnostic-parameter bit-offset=0:
      diagnostic data element MeasurementValue_0x7938_Power_Path_056_Pin_Mapping_Connector_Pin_Position: array-size-semantics=VARIABLE-SIZE, max-number-of-elements=208, base-type=uint8  # Parameters: Connector_Pin_Position
  diagnostic read data by identifier ReadPowerPath056PinMapping: access-permission=READ0x01DefaultSession0x03ExtendedSession, data-identifier=PowerPath056PinMapping, read-class=DiagnosticReadDataByIdentifierClass  # Read_Power_Path_056_Pin_Mapping
package /ZeC/DataIdentifiers/MeasurementValue/Power_Path_055_Pin_Mapping
  diagnostic data identifier PowerPath055PinMapping: id=0x7937, represents-vin=false  # Power_Path_055_Pin_Mapping
    diagnostic-parameter bit-offset=0:
      diagnostic data element MeasurementValue_0x7937_Power_Path_055_Pin_Mapping_Connector_Pin_Position: array-size-semantics=VARIABLE-SIZE, max-number-of-elements=208, base-type=uint8  # Parameters: Connector_Pin_Position
  diagnostic read data by identifier ReadPowerPath055PinMapping: access-permission=READ0x01DefaultSession0x03ExtendedSession, data-identifier=PowerPath055PinMapping, read-class=DiagnosticReadDataByIdentifierClass  # Read_Power_Path_055_Pin_Mapping
package /ZeC/DataIdentifiers/MeasurementValue/FoD_slave_extended_state
  diagnostic data identifier FoDSlaveExtendedState: id=0xff03, represents-vin=false  # FoD_slave_extended_state
    diagnostic-parameter bit-offset=0:
      diagnostic data element MeasurementValue_0xff03_FoD_slave_extended_state_Version: base-type=uint8  # Parameters: Version
    diagnostic-parameter bit-offset=8:
      diagnostic data element MeasurementValue_0xff03_FoD_slave_extended_state_Extended_state_payload: array-size-semantics=VARIABLE-SIZE, max-number-of-elements=30, base-type=uint8  # Parameters: Extended_state_payload
  diagnostic read data by identifier ReadFoDSlaveExtendedState: access-permission=READ0x01DefaultSession0x03ExtendedSession, data-identifier=FoDSlaveExtendedState, read-class=DiagnosticReadDataByIdentifierClass  # Read_FoD_slave_extended_state
package /ZeC/DataIdentifiers/MeasurementValue/FoD_slave_operating_state
  diagnostic data identifier FoDSlaveOperatingState: id=0xff04, represents-vin=false  # FoD_slave_operating_state
    diagnostic-parameter bit-offset=0:
      diagnostic data element MeasurementValue_0xff04_FoD_slave_operating_state_FoD_slave_state: base-type=uint8, compu {1=FoD_slave_state: Init running (TTR300812), 0=FoD_slave_state: not running (TTR300713), 2=FoD_slave_state: Init completed (TTR300912), 255=FoD_slave_state: Failure / not running (TTR301012)}  # Parameters: FoD_slave_state
  diagnostic read data by identifier ReadFoDSlaveOperatingState: access-permission=READ0x01DefaultSession0x03ExtendedSession, data-identifier=FoDSlaveOperatingState, read-class=DiagnosticReadDataByIdentifierClass  # Read_FoD_slave_operating_state
package /ZeC/DataIdentifiers/MeasurementValue/Power_Path_080_Pin_Mapping
  diagnostic data identifier PowerPath080PinMapping: id=0x7950, represents-vin=false  # Power_Path_080_Pin_Mapping
    diagnostic-parameter bit-offset=0:
      diagnostic data element MeasurementValue_0x7950_Power_Path_080_Pin_Mapping_Connector_Pin_Position: array-size-semantics=VARIABLE-SIZE, max-number-of-elements=208, base-type=uint8  # Parameters: Connector_Pin_Position
  diagnostic read data by identifier ReadPowerPath080PinMapping: access-permission=READ0x01DefaultSession0x03ExtendedSession, data-identifier=PowerPath080PinMapping, read-class=DiagnosticReadDataByIdentifierClass  # Read_Power_Path_080_Pin_Mapping
package /ZeC/DataIdentifiers/MeasurementValue/Function_On_Demand_Unlock_ID_Status_Dev
  diagnostic data identifier FunctionOnDemandUnlockIDStatusDev: id=0xff05, represents-vin=false  # Function_On_Demand_Unlock_ID_Status_Dev
    diagnostic-parameter bit-offset=0:
      diagnostic data element MeasurementValue_0xff05_Function_On_Demand_Unlock_ID_Status_Dev_number_of_FoD_FS_IDs_in_the_ECU: base-type=uint8  # Parameters: number_of_FoD_FS-IDs_in_the_ECU
    diagnostic-parameter bit-offset=8:
      diagnostic data element MeasurementValue_0xff05_Function_On_Demand_Unlock_ID_Status_Dev_Last_mode_state: base-type=uint8, compu {0=Last_mode_state: not_active (TTR202213), 1=Last_mode_state: active (TTR202313)}  # Parameters: Last_mode_state
    diagnostic-parameter bit-offset=16:
      diagnostic data element MeasurementValue_0xff05_Function_On_Demand_Unlock_ID_Status_Dev_SWaP_FS_ID: base-type=uint32  # Parameters: SWaP_FS-ID
    diagnostic-parameter bit-offset=48:
      diagnostic data element MeasurementValue_0xff05_Function_On_Demand_Unlock_ID_Status_Dev_SWaP_function_crypt_data_SWaP_cancellation_SWaP_231A28C: base-type=uint8, compu {1=SWaP_function_crypt_data: available (TTR245012), 0=SWaP_function_crypt_data: not available; SWaP-cancellation: canceled; SWaP_individualisation_feature: im_is_not_vcrn; SWaP_validation_condition: not_valid; Configuration: not_compatible; Function: not available; SWaP_authentication_check: not_valid (TTR244912TTR293712TTR294712TTR294912TTR295113TTR244912TTR294912), 2=SWaP-cancellation: not_canceled (TTR293812), 4=SWaP_individualisation_feature: im_is_vcrn (TTR294812), 8=SWaP_validation_condition: valid (TTR295012), 16=Configuration: compatible (TTR295212), 32=Function: available (TTR245012), 64=SWaP_authentication_check: valid (TTR295012)}  # Parameters: SWaP_function_crypt_data / SWaP-cancellation / SWaP_individualisation_feature / SWaP_validation_condition / Configuration / Function / SWaP_authentication_check / Reserved
  diagnostic read data by identifier ReadFunctionOnDemandUnlockIDStatusDev: access-permission=READ0x01DefaultSession0x03ExtendedSession, data-identifier=FunctionOnDemandUnlockIDStatusDev, read-class=DiagnosticReadDataByIdentifierClass  # Read_Function_On_Demand_Unlock_ID_Status_Dev
package /ZeC/DataIdentifiers/MeasurementValue/Power_Path_082_Pin_Mapping
  diagnostic data identifier PowerPath082PinMapping: id=0x7952, represents-vin=false  # Power_Path_082_Pin_Mapping
    diagnostic-parameter bit-offset=0:
      diagnostic data element MeasurementValue_0x7952_Power_Path_082_Pin_Mapping_Connector_Pin_Position: array-size-semantics=VARIABLE-SIZE, max-number-of-elements=208, base-type=uint8  # Parameters: Connector_Pin_Position
  diagnostic read data by identifier ReadPowerPath082PinMapping: access-permission=READ0x01DefaultSession0x03ExtendedSession, data-identifier=PowerPath082PinMapping, read-class=DiagnosticReadDataByIdentifierClass  # Read_Power_Path_082_Pin_Mapping
package /ZeC/DataIdentifiers/MeasurementValue/Power_Path_081_Pin_Mapping
  diagnostic data identifier PowerPath081PinMapping: id=0x7951, represents-vin=false  # Power_Path_081_Pin_Mapping
    diagnostic-parameter bit-offset=0:
      diagnostic data element MeasurementValue_0x7951_Power_Path_081_Pin_Mapping_Connector_Pin_Position: array-size-semantics=VARIABLE-SIZE, max-number-of-elements=208, base-type=uint8  # Parameters: Connector_Pin_Position
  diagnostic read data by identifier ReadPowerPath081PinMapping: access-permission=READ0x01DefaultSession0x03ExtendedSession, data-identifier=PowerPath081PinMapping, read-class=DiagnosticReadDataByIdentifierClass  # Read_Power_Path_081_Pin_Mapping
package /ZeC/DataIdentifiers/MeasurementValue/Power_Path_076_Pin_Mapping
  diagnostic data identifier PowerPath076PinMapping: id=0x794c, represents-vin=false  # Power_Path_076_Pin_Mapping
    diagnostic-parameter bit-offset=0:
      diagnostic data element MeasurementValue_0x794c_Power_Path_076_Pin_Mapping_Connector_Pin_Position: array-size-semantics=VARIABLE-SIZE, max-number-of-elements=208, base-type=uint8  # Parameters: Connector_Pin_Position
  diagnostic read data by identifier ReadPowerPath076PinMapping: access-permission=READ0x01DefaultSession0x03ExtendedSession, data-identifier=PowerPath076PinMapping, read-class=DiagnosticReadDataByIdentifierClass  # Read_Power_Path_076_Pin_Mapping
package /ZeC/DataIdentifiers/MeasurementValue/Power_Path_075_Pin_Mapping
  diagnostic data identifier PowerPath075PinMapping: id=0x794b, represents-vin=false  # Power_Path_075_Pin_Mapping
    diagnostic-parameter bit-offset=0:
      diagnostic data element MeasurementValue_0x794b_Power_Path_075_Pin_Mapping_Connector_Pin_Position: array-size-semantics=VARIABLE-SIZE, max-number-of-elements=208, base-type=uint8  # Parameters: Connector_Pin_Position
  diagnostic read data by identifier ReadPowerPath075PinMapping: access-permission=READ0x01DefaultSession0x03ExtendedSession, data-identifier=PowerPath075PinMapping, read-class=DiagnosticReadDataByIdentifierClass  # Read_Power_Path_075_Pin_Mapping
package /ZeC/DataIdentifiers/MeasurementValue/Power_Path_078_Pin_Mapping
  diagnostic data identifier PowerPath078PinMapping: id=0x794e, represents-vin=false  # Power_Path_078_Pin_Mapping
    diagnostic-parameter bit-offset=0:
      diagnostic data element MeasurementValue_0x794e_Power_Path_078_Pin_Mapping_Connector_Pin_Position: array-size-semantics=VARIABLE-SIZE, max-number-of-elements=208, base-type=uint8  # Parameters: Connector_Pin_Position
  diagnostic read data by identifier ReadPowerPath078PinMapping: access-permission=READ0x01DefaultSession0x03ExtendedSession, data-identifier=PowerPath078PinMapping, read-class=DiagnosticReadDataByIdentifierClass  # Read_Power_Path_078_Pin_Mapping
package /ZeC/DataIdentifiers/MeasurementValue/Power_Path_077_Pin_Mapping
  diagnostic data identifier PowerPath077PinMapping: id=0x794d, represents-vin=false  # Power_Path_077_Pin_Mapping
    diagnostic-parameter bit-offset=0:
      diagnostic data element MeasurementValue_0x794d_Power_Path_077_Pin_Mapping_Connector_Pin_Position: array-size-semantics=VARIABLE-SIZE, max-number-of-elements=208, base-type=uint8  # Parameters: Connector_Pin_Position
  diagnostic read data by identifier ReadPowerPath077PinMapping: access-permission=READ0x01DefaultSession0x03ExtendedSession, data-identifier=PowerPath077PinMapping, read-class=DiagnosticReadDataByIdentifierClass  # Read_Power_Path_077_Pin_Mapping
package /ZeC/DataIdentifiers/MeasurementValue/Power_Path_079_Pin_Mapping
  diagnostic data identifier PowerPath079PinMapping: id=0x794f, represents-vin=false  # Power_Path_079_Pin_Mapping
    diagnostic-parameter bit-offset=0:
      diagnostic data element MeasurementValue_0x794f_Power_Path_079_Pin_Mapping_Connector_Pin_Position: array-size-semantics=VARIABLE-SIZE, max-number-of-elements=208, base-type=uint8  # Parameters: Connector_Pin_Position
  diagnostic read data by identifier ReadPowerPath079PinMapping: access-permission=READ0x01DefaultSession0x03ExtendedSession, data-identifier=PowerPath079PinMapping, read-class=DiagnosticReadDataByIdentifierClass  # Read_Power_Path_079_Pin_Mapping
package /ZeC/DataIdentifiers/MeasurementValue/Power_Path_074_Pin_Mapping
  diagnostic data identifier PowerPath074PinMapping: id=0x794a, represents-vin=false  # Power_Path_074_Pin_Mapping
    diagnostic-parameter bit-offset=0:
      diagnostic data element MeasurementValue_0x794a_Power_Path_074_Pin_Mapping_Connector_Pin_Position: array-size-semantics=VARIABLE-SIZE, max-number-of-elements=208, base-type=uint8  # Parameters: Connector_Pin_Position
  diagnostic read data by identifier ReadPowerPath074PinMapping: access-permission=READ0x01DefaultSession0x03ExtendedSession, data-identifier=PowerPath074PinMapping, read-class=DiagnosticReadDataByIdentifierClass  # Read_Power_Path_074_Pin_Mapping
package /ZeC/DataIdentifiers/MeasurementValue/Power_Path_067_Pin_Mapping
  diagnostic data identifier PowerPath067PinMapping: id=0x7943, represents-vin=false  # Power_Path_067_Pin_Mapping
    diagnostic-parameter bit-offset=0:
      diagnostic data element MeasurementValue_0x7943_Power_Path_067_Pin_Mapping_Connector_Pin_Position: array-size-semantics=VARIABLE-SIZE, max-number-of-elements=208, base-type=uint8  # Parameters: Connector_Pin_Position
  diagnostic read data by identifier ReadPowerPath067PinMapping: access-permission=READ0x01DefaultSession0x03ExtendedSession, data-identifier=PowerPath067PinMapping, read-class=DiagnosticReadDataByIdentifierClass  # Read_Power_Path_067_Pin_Mapping
package /ZeC/DataIdentifiers/MeasurementValue/Power_Path_066_Pin_Mapping
  diagnostic data identifier PowerPath066PinMapping: id=0x7942, represents-vin=false  # Power_Path_066_Pin_Mapping
    diagnostic-parameter bit-offset=0:
      diagnostic data element MeasurementValue_0x7942_Power_Path_066_Pin_Mapping_Connector_Pin_Position: array-size-semantics=VARIABLE-SIZE, max-number-of-elements=208, base-type=uint8  # Parameters: Connector_Pin_Position
  diagnostic read data by identifier ReadPowerPath066PinMapping: access-permission=READ0x01DefaultSession0x03ExtendedSession, data-identifier=PowerPath066PinMapping, read-class=DiagnosticReadDataByIdentifierClass  # Read_Power_Path_066_Pin_Mapping
package /ZeC/DataIdentifiers/MeasurementValue/Power_Path_069_Pin_Mapping
  diagnostic data identifier PowerPath069PinMapping: id=0x7945, represents-vin=false  # Power_Path_069_Pin_Mapping
    diagnostic-parameter bit-offset=0:
      diagnostic data element MeasurementValue_0x7945_Power_Path_069_Pin_Mapping_Connector_Pin_Position: array-size-semantics=VARIABLE-SIZE, max-number-of-elements=208, base-type=uint8  # Parameters: Connector_Pin_Position
  diagnostic read data by identifier ReadPowerPath069PinMapping: access-permission=READ0x01DefaultSession0x03ExtendedSession, data-identifier=PowerPath069PinMapping, read-class=DiagnosticReadDataByIdentifierClass  # Read_Power_Path_069_Pin_Mapping
package /ZeC/DataIdentifiers/MeasurementValue/Power_Path_068_Pin_Mapping
  diagnostic data identifier PowerPath068PinMapping: id=0x7944, represents-vin=false  # Power_Path_068_Pin_Mapping
    diagnostic-parameter bit-offset=0:
      diagnostic data element MeasurementValue_0x7944_Power_Path_068_Pin_Mapping_Connector_Pin_Position: array-size-semantics=VARIABLE-SIZE, max-number-of-elements=208, base-type=uint8  # Parameters: Connector_Pin_Position
  diagnostic read data by identifier ReadPowerPath068PinMapping: access-permission=READ0x01DefaultSession0x03ExtendedSession, data-identifier=PowerPath068PinMapping, read-class=DiagnosticReadDataByIdentifierClass  # Read_Power_Path_068_Pin_Mapping
package /ZeC/DataIdentifiers/MeasurementValue/Power_Path_071_Pin_Mapping
  diagnostic data identifier PowerPath071PinMapping: id=0x7947, represents-vin=false  # Power_Path_071_Pin_Mapping
    diagnostic-parameter bit-offset=0:
      diagnostic data element MeasurementValue_0x7947_Power_Path_071_Pin_Mapping_Connector_Pin_Position: array-size-semantics=VARIABLE-SIZE, max-number-of-elements=208, base-type=uint8  # Parameters: Connector_Pin_Position
  diagnostic read data by identifier ReadPowerPath071PinMapping: access-permission=READ0x01DefaultSession0x03ExtendedSession, data-identifier=PowerPath071PinMapping, read-class=DiagnosticReadDataByIdentifierClass  # Read_Power_Path_071_Pin_Mapping
package /ZeC/DataIdentifiers/MeasurementValue/IP_network_last_deviataion_sync_clock
  diagnostic data identifier IPNetworkLastDeviataionSyncClock: id=0xc10e, represents-vin=false  # IP_network_last_deviataion_sync_clock
    diagnostic-parameter bit-offset=0:
      diagnostic data element MeasurementValue_0xc10e_IP_network_last_deviataion_sync_clock_IP_network_last_deviataion_sync_clock: base-type=uint32  # Parameters: IP_network_last_deviataion_sync_clock
  diagnostic read data by identifier ReadIPNetworkLastDeviataionSyncClock: access-permission=READ0x01DefaultSession0x03ExtendedSession, data-identifier=IPNetworkLastDeviataionSyncClock, read-class=DiagnosticReadDataByIdentifierClass  # Read_IP_network_last_deviataion_sync_clock
package /ZeC/DataIdentifiers/MeasurementValue/Power_Path_070_Pin_Mapping
  diagnostic data identifier PowerPath070PinMapping: id=0x7946, represents-vin=false  # Power_Path_070_Pin_Mapping
    diagnostic-parameter bit-offset=0:
      diagnostic data element MeasurementValue_0x7946_Power_Path_070_Pin_Mapping_Connector_Pin_Position: array-size-semantics=VARIABLE-SIZE, max-number-of-elements=208, base-type=uint8  # Parameters: Connector_Pin_Position
  diagnostic read data by identifier ReadPowerPath070PinMapping: access-permission=READ0x01DefaultSession0x03ExtendedSession, data-identifier=PowerPath070PinMapping, read-class=DiagnosticReadDataByIdentifierClass  # Read_Power_Path_070_Pin_Mapping
package /ZeC/DataIdentifiers/MeasurementValue/Status_productionmode
  diagnostic data identifier StatusProductionmode: id=0x019c, represents-vin=false  # Status_productionmode
    diagnostic-parameter bit-offset=0:
      diagnostic data element MeasurementValue_0x019c_Status_productionmode_Status_productionmode: base-type=uint8, compu {1=Status_productionmode: At_least_one_function_controlled (TTR245212), 0=Status_productionmode: No_function_controlled (TTR245112)}  # Parameters: Status_productionmode
  diagnostic read data by identifier ReadStatusProductionmode: access-permission=READ0x01DefaultSession0x03ExtendedSession, data-identifier=StatusProductionmode, read-class=DiagnosticReadDataByIdentifierClass  # Read_Status_productionmode
package /ZeC/DataIdentifiers/MeasurementValue/Power_Path_073_Pin_Mapping
  diagnostic data identifier PowerPath073PinMapping: id=0x7949, represents-vin=false  # Power_Path_073_Pin_Mapping
    diagnostic-parameter bit-offset=0:
      diagnostic data element MeasurementValue_0x7949_Power_Path_073_Pin_Mapping_Connector_Pin_Position: array-size-semantics=VARIABLE-SIZE, max-number-of-elements=208, base-type=uint8  # Parameters: Connector_Pin_Position
  diagnostic read data by identifier ReadPowerPath073PinMapping: access-permission=READ0x01DefaultSession0x03ExtendedSession, data-identifier=PowerPath073PinMapping, read-class=DiagnosticReadDataByIdentifierClass  # Read_Power_Path_073_Pin_Mapping
package /ZeC/DataIdentifiers/MeasurementValue/Power_Path_072_Pin_Mapping
  diagnostic data identifier PowerPath072PinMapping: id=0x7948, represents-vin=false  # Power_Path_072_Pin_Mapping
    diagnostic-parameter bit-offset=0:
      diagnostic data element MeasurementValue_0x7948_Power_Path_072_Pin_Mapping_Connector_Pin_Position: array-size-semantics=VARIABLE-SIZE, max-number-of-elements=208, base-type=uint8  # Parameters: Connector_Pin_Position
  diagnostic read data by identifier ReadPowerPath072PinMapping: access-permission=READ0x01DefaultSession0x03ExtendedSession, data-identifier=PowerPath072PinMapping, read-class=DiagnosticReadDataByIdentifierClass  # Read_Power_Path_072_Pin_Mapping
package /ZeC/DataIdentifiers/MeasurementValue/Power_Path_097_Pin_Mapping
  diagnostic data identifier PowerPath097PinMapping: id=0x7961, represents-vin=false  # Power_Path_097_Pin_Mapping
    diagnostic-parameter bit-offset=0:
      diagnostic data element MeasurementValue_0x7961_Power_Path_097_Pin_Mapping_Connector_Pin_Position: array-size-semantics=VARIABLE-SIZE, max-number-of-elements=208, base-type=uint8  # Parameters: Connector_Pin_Position
  diagnostic read data by identifier ReadPowerPath097PinMapping: access-permission=READ0x01DefaultSession0x03ExtendedSession, data-identifier=PowerPath097PinMapping, read-class=DiagnosticReadDataByIdentifierClass  # Read_Power_Path_097_Pin_Mapping
package /ZeC/DataIdentifiers/MeasurementValue/Power_Path_096_Pin_Mapping
  diagnostic data identifier PowerPath096PinMapping: id=0x7960, represents-vin=false  # Power_Path_096_Pin_Mapping
    diagnostic-parameter bit-offset=0:
      diagnostic data element MeasurementValue_0x7960_Power_Path_096_Pin_Mapping_Connector_Pin_Position: array-size-semantics=VARIABLE-SIZE, max-number-of-elements=208, base-type=uint8  # Parameters: Connector_Pin_Position
  diagnostic read data by identifier ReadPowerPath096PinMapping: access-permission=READ0x01DefaultSession0x03ExtendedSession, data-identifier=PowerPath096PinMapping, read-class=DiagnosticReadDataByIdentifierClass  # Read_Power_Path_096_Pin_Mapping
package /ZeC/DataIdentifiers/MeasurementValue/Power_Path_099_Pin_Mapping
  diagnostic data identifier PowerPath099PinMapping: id=0x7963, represents-vin=false  # Power_Path_099_Pin_Mapping
    diagnostic-parameter bit-offset=0:
      diagnostic data element MeasurementValue_0x7963_Power_Path_099_Pin_Mapping_Connector_Pin_Position: array-size-semantics=VARIABLE-SIZE, max-number-of-elements=208, base-type=uint8  # Parameters: Connector_Pin_Position
  diagnostic read data by identifier ReadPowerPath099PinMapping: access-permission=READ0x01DefaultSession0x03ExtendedSession, data-identifier=PowerPath099PinMapping, read-class=DiagnosticReadDataByIdentifierClass  # Read_Power_Path_099_Pin_Mapping
package /ZeC/DataIdentifiers/MeasurementValue/Power_Path_098_Pin_Mapping
  diagnostic data identifier PowerPath098PinMapping: id=0x7962, represents-vin=false  # Power_Path_098_Pin_Mapping
    diagnostic-parameter bit-offset=0:
      diagnostic data element MeasurementValue_0x7962_Power_Path_098_Pin_Mapping_Connector_Pin_Position: array-size-semantics=VARIABLE-SIZE, max-number-of-elements=208, base-type=uint8  # Parameters: Connector_Pin_Position
  diagnostic read data by identifier ReadPowerPath098PinMapping: access-permission=READ0x01DefaultSession0x03ExtendedSession, data-identifier=PowerPath098PinMapping, read-class=DiagnosticReadDataByIdentifierClass  # Read_Power_Path_098_Pin_Mapping
package /ZeC/DataIdentifiers/MeasurementValue/Power_Path_093_Pin_Mapping
  diagnostic data identifier PowerPath093PinMapping: id=0x795d, represents-vin=false  # Power_Path_093_Pin_Mapping
    diagnostic-parameter bit-offset=0:
      diagnostic data element MeasurementValue_0x795d_Power_Path_093_Pin_Mapping_Connector_Pin_Position: array-size-semantics=VARIABLE-SIZE, max-number-of-elements=208, base-type=uint8  # Parameters: Connector_Pin_Position
  diagnostic read data by identifier ReadPowerPath093PinMapping: access-permission=READ0x01DefaultSession0x03ExtendedSession, data-identifier=PowerPath093PinMapping, read-class=DiagnosticReadDataByIdentifierClass  # Read_Power_Path_093_Pin_Mapping
package /ZeC/DataIdentifiers/MeasurementValue/Power_Path_092_Pin_Mapping
  diagnostic data identifier PowerPath092PinMapping: id=0x795c, represents-vin=false  # Power_Path_092_Pin_Mapping
    diagnostic-parameter bit-offset=0:
      diagnostic data element MeasurementValue_0x795c_Power_Path_092_Pin_Mapping_Connector_Pin_Position: array-size-semantics=VARIABLE-SIZE, max-number-of-elements=208, base-type=uint8  # Parameters: Connector_Pin_Position
  diagnostic read data by identifier ReadPowerPath092PinMapping: access-permission=READ0x01DefaultSession0x03ExtendedSession, data-identifier=PowerPath092PinMapping, read-class=DiagnosticReadDataByIdentifierClass  # Read_Power_Path_092_Pin_Mapping
package /ZeC/DataIdentifiers/MeasurementValue/Power_Path_095_Pin_Mapping
  diagnostic data identifier PowerPath095PinMapping: id=0x795f, represents-vin=false  # Power_Path_095_Pin_Mapping
    diagnostic-parameter bit-offset=0:
      diagnostic data element MeasurementValue_0x795f_Power_Path_095_Pin_Mapping_Connector_Pin_Position: array-size-semantics=VARIABLE-SIZE, max-number-of-elements=208, base-type=uint8  # Parameters: Connector_Pin_Position
  diagnostic read data by identifier ReadPowerPath095PinMapping: access-permission=READ0x01DefaultSession0x03ExtendedSession, data-identifier=PowerPath095PinMapping, read-class=DiagnosticReadDataByIdentifierClass  # Read_Power_Path_095_Pin_Mapping
package /ZeC/DataIdentifiers/MeasurementValue/Power_Path_094_Pin_Mapping
  diagnostic data identifier PowerPath094PinMapping: id=0x795e, represents-vin=false  # Power_Path_094_Pin_Mapping
    diagnostic-parameter bit-offset=0:
      diagnostic data element MeasurementValue_0x795e_Power_Path_094_Pin_Mapping_Connector_Pin_Position: array-size-semantics=VARIABLE-SIZE, max-number-of-elements=208, base-type=uint8  # Parameters: Connector_Pin_Position
  diagnostic read data by identifier ReadPowerPath094PinMapping: access-permission=READ0x01DefaultSession0x03ExtendedSession, data-identifier=PowerPath094PinMapping, read-class=DiagnosticReadDataByIdentifierClass  # Read_Power_Path_094_Pin_Mapping
package /ZeC/DataIdentifiers/MeasurementValue/Power_Path_091_Pin_Mapping
  diagnostic data identifier PowerPath091PinMapping: id=0x795b, represents-vin=false  # Power_Path_091_Pin_Mapping
    diagnostic-parameter bit-offset=0:
      diagnostic data element MeasurementValue_0x795b_Power_Path_091_Pin_Mapping_Connector_Pin_Position: array-size-semantics=VARIABLE-SIZE, max-number-of-elements=208, base-type=uint8  # Parameters: Connector_Pin_Position
  diagnostic read data by identifier ReadPowerPath091PinMapping: access-permission=READ0x01DefaultSession0x03ExtendedSession, data-identifier=PowerPath091PinMapping, read-class=DiagnosticReadDataByIdentifierClass  # Read_Power_Path_091_Pin_Mapping
package /ZeC/DataIdentifiers/MeasurementValue/Power_Path_090_Pin_Mapping
  diagnostic data identifier PowerPath090PinMapping: id=0x795a, represents-vin=false  # Power_Path_090_Pin_Mapping
    diagnostic-parameter bit-offset=0:
      diagnostic data element MeasurementValue_0x795a_Power_Path_090_Pin_Mapping_Connector_Pin_Position: array-size-semantics=VARIABLE-SIZE, max-number-of-elements=208, base-type=uint8  # Parameters: Connector_Pin_Position
  diagnostic read data by identifier ReadPowerPath090PinMapping: access-permission=READ0x01DefaultSession0x03ExtendedSession, data-identifier=PowerPath090PinMapping, read-class=DiagnosticReadDataByIdentifierClass  # Read_Power_Path_090_Pin_Mapping
package /ZeC/DataIdentifiers/MeasurementValue/Power_Path_084_Pin_Mapping
  diagnostic data identifier PowerPath084PinMapping: id=0x7954, represents-vin=false  # Power_Path_084_Pin_Mapping
    diagnostic-parameter bit-offset=0:
      diagnostic data element MeasurementValue_0x7954_Power_Path_084_Pin_Mapping_Connector_Pin_Position: array-size-semantics=VARIABLE-SIZE, max-number-of-elements=208, base-type=uint8  # Parameters: Connector_Pin_Position
  diagnostic read data by identifier ReadPowerPath084PinMapping: access-permission=READ0x01DefaultSession0x03ExtendedSession, data-identifier=PowerPath084PinMapping, read-class=DiagnosticReadDataByIdentifierClass  # Read_Power_Path_084_Pin_Mapping
package /ZeC/DataIdentifiers/MeasurementValue/Power_Path_083_Pin_Mapping
  diagnostic data identifier PowerPath083PinMapping: id=0x7953, represents-vin=false  # Power_Path_083_Pin_Mapping
    diagnostic-parameter bit-offset=0:
      diagnostic data element MeasurementValue_0x7953_Power_Path_083_Pin_Mapping_Connector_Pin_Position: array-size-semantics=VARIABLE-SIZE, max-number-of-elements=208, base-type=uint8  # Parameters: Connector_Pin_Position
  diagnostic read data by identifier ReadPowerPath083PinMapping: access-permission=READ0x01DefaultSession0x03ExtendedSession, data-identifier=PowerPath083PinMapping, read-class=DiagnosticReadDataByIdentifierClass  # Read_Power_Path_083_Pin_Mapping
package /ZeC/DataIdentifiers/MeasurementValue/Power_Path_086_Pin_Mapping
  diagnostic data identifier PowerPath086PinMapping: id=0x7956, represents-vin=false  # Power_Path_086_Pin_Mapping
    diagnostic-parameter bit-offset=0:
      diagnostic data element MeasurementValue_0x7956_Power_Path_086_Pin_Mapping_Connector_Pin_Position: array-size-semantics=VARIABLE-SIZE, max-number-of-elements=208, base-type=uint8  # Parameters: Connector_Pin_Position
  diagnostic read data by identifier ReadPowerPath086PinMapping: access-permission=READ0x01DefaultSession0x03ExtendedSession, data-identifier=PowerPath086PinMapping, read-class=DiagnosticReadDataByIdentifierClass  # Read_Power_Path_086_Pin_Mapping
package /ZeC/DataIdentifiers/MeasurementValue/Power_Path_085_Pin_Mapping
  diagnostic data identifier PowerPath085PinMapping: id=0x7955, represents-vin=false  # Power_Path_085_Pin_Mapping
    diagnostic-parameter bit-offset=0:
      diagnostic data element MeasurementValue_0x7955_Power_Path_085_Pin_Mapping_Connector_Pin_Position: array-size-semantics=VARIABLE-SIZE, max-number-of-elements=208, base-type=uint8  # Parameters: Connector_Pin_Position
  diagnostic read data by identifier ReadPowerPath085PinMapping: access-permission=READ0x01DefaultSession0x03ExtendedSession, data-identifier=PowerPath085PinMapping, read-class=DiagnosticReadDataByIdentifierClass  # Read_Power_Path_085_Pin_Mapping
package /ZeC/DataIdentifiers/MeasurementValue/Power_Path_088_Pin_Mapping
  diagnostic data identifier PowerPath088PinMapping: id=0x7958, represents-vin=false  # Power_Path_088_Pin_Mapping
    diagnostic-parameter bit-offset=0:
      diagnostic data element MeasurementValue_0x7958_Power_Path_088_Pin_Mapping_Connector_Pin_Position: array-size-semantics=VARIABLE-SIZE, max-number-of-elements=208, base-type=uint8  # Parameters: Connector_Pin_Position
  diagnostic read data by identifier ReadPowerPath088PinMapping: access-permission=READ0x01DefaultSession0x03ExtendedSession, data-identifier=PowerPath088PinMapping, read-class=DiagnosticReadDataByIdentifierClass  # Read_Power_Path_088_Pin_Mapping
package /ZeC/DataIdentifiers/MeasurementValue/Power_Path_087_Pin_Mapping
  diagnostic data identifier PowerPath087PinMapping: id=0x7957, represents-vin=false  # Power_Path_087_Pin_Mapping
    diagnostic-parameter bit-offset=0:
      diagnostic data element MeasurementValue_0x7957_Power_Path_087_Pin_Mapping_Connector_Pin_Position: array-size-semantics=VARIABLE-SIZE, max-number-of-elements=208, base-type=uint8  # Parameters: Connector_Pin_Position
  diagnostic read data by identifier ReadPowerPath087PinMapping: access-permission=READ0x01DefaultSession0x03ExtendedSession, data-identifier=PowerPath087PinMapping, read-class=DiagnosticReadDataByIdentifierClass  # Read_Power_Path_087_Pin_Mapping
package /ZeC/DataIdentifiers/MeasurementValue/Power_Path_089_Pin_Mapping
  diagnostic data identifier PowerPath089PinMapping: id=0x7959, represents-vin=false  # Power_Path_089_Pin_Mapping
    diagnostic-parameter bit-offset=0:
      diagnostic data element MeasurementValue_0x7959_Power_Path_089_Pin_Mapping_Connector_Pin_Position: array-size-semantics=VARIABLE-SIZE, max-number-of-elements=208, base-type=uint8  # Parameters: Connector_Pin_Position
  diagnostic read data by identifier ReadPowerPath089PinMapping: access-permission=READ0x01DefaultSession0x03ExtendedSession, data-identifier=PowerPath089PinMapping, read-class=DiagnosticReadDataByIdentifierClass  # Read_Power_Path_089_Pin_Mapping
package /ZeC/DataIdentifiers/MeasurementValue/Power_Path_112_Pin_Mapping
  diagnostic data identifier PowerPath112PinMapping: id=0x7970, represents-vin=false  # Power_Path_112_Pin_Mapping
    diagnostic-parameter bit-offset=0:
      diagnostic data element MeasurementValue_0x7970_Power_Path_112_Pin_Mapping_Connector_Pin_Position: array-size-semantics=VARIABLE-SIZE, max-number-of-elements=208, base-type=uint8  # Parameters: Connector_Pin_Position
  diagnostic read data by identifier ReadPowerPath112PinMapping: access-permission=READ0x01DefaultSession0x03ExtendedSession, data-identifier=PowerPath112PinMapping, read-class=DiagnosticReadDataByIdentifierClass  # Read_Power_Path_112_Pin_Mapping
package /ZeC/DataIdentifiers/MeasurementValue/Power_Path_114_Pin_Mapping
  diagnostic data identifier PowerPath114PinMapping: id=0x7972, represents-vin=false  # Power_Path_114_Pin_Mapping
    diagnostic-parameter bit-offset=0:
      diagnostic data element MeasurementValue_0x7972_Power_Path_114_Pin_Mapping_Connector_Pin_Position: array-size-semantics=VARIABLE-SIZE, max-number-of-elements=208, base-type=uint8  # Parameters: Connector_Pin_Position
  diagnostic read data by identifier ReadPowerPath114PinMapping: access-permission=READ0x01DefaultSession0x03ExtendedSession, data-identifier=PowerPath114PinMapping, read-class=DiagnosticReadDataByIdentifierClass  # Read_Power_Path_114_Pin_Mapping
package /ZeC/DataIdentifiers/MeasurementValue/Power_Path_113_Pin_Mapping
  diagnostic data identifier PowerPath113PinMapping: id=0x7971, represents-vin=false  # Power_Path_113_Pin_Mapping
    diagnostic-parameter bit-offset=0:
      diagnostic data element MeasurementValue_0x7971_Power_Path_113_Pin_Mapping_Connector_Pin_Position: array-size-semantics=VARIABLE-SIZE, max-number-of-elements=208, base-type=uint8  # Parameters: Connector_Pin_Position
  diagnostic read data by identifier ReadPowerPath113PinMapping: access-permission=READ0x01DefaultSession0x03ExtendedSession, data-identifier=PowerPath113PinMapping, read-class=DiagnosticReadDataByIdentifierClass  # Read_Power_Path_113_Pin_Mapping
package /ZeC/DataIdentifiers/MeasurementValue/Power_Path_116_Pin_Mapping
  diagnostic data identifier PowerPath116PinMapping: id=0x7974, represents-vin=false  # Power_Path_116_Pin_Mapping
    diagnostic-parameter bit-offset=0:
      diagnostic data element MeasurementValue_0x7974_Power_Path_116_Pin_Mapping_Connector_Pin_Position: array-size-semantics=VARIABLE-SIZE, max-number-of-elements=208, base-type=uint8  # Parameters: Connector_Pin_Position
  diagnostic read data by identifier ReadPowerPath116PinMapping: access-permission=READ0x01DefaultSession0x03ExtendedSession, data-identifier=PowerPath116PinMapping, read-class=DiagnosticReadDataByIdentifierClass  # Read_Power_Path_116_Pin_Mapping
package /ZeC/DataIdentifiers/MeasurementValue/Power_Path_115_Pin_Mapping
  diagnostic data identifier PowerPath115PinMapping: id=0x7973, represents-vin=false  # Power_Path_115_Pin_Mapping
    diagnostic-parameter bit-offset=0:
      diagnostic data element MeasurementValue_0x7973_Power_Path_115_Pin_Mapping_Connector_Pin_Position: array-size-semantics=VARIABLE-SIZE, max-number-of-elements=208, base-type=uint8  # Parameters: Connector_Pin_Position
  diagnostic read data by identifier ReadPowerPath115PinMapping: access-permission=READ0x01DefaultSession0x03ExtendedSession, data-identifier=PowerPath115PinMapping, read-class=DiagnosticReadDataByIdentifierClass  # Read_Power_Path_115_Pin_Mapping
package /ZeC/DataIdentifiers/MeasurementValue/Power_Path_110_Pin_Mapping
  diagnostic data identifier PowerPath110PinMapping: id=0x796e, represents-vin=false  # Power_Path_110_Pin_Mapping
    diagnostic-parameter bit-offset=0:
      diagnostic data element MeasurementValue_0x796e_Power_Path_110_Pin_Mapping_Connector_Pin_Position: array-size-semantics=VARIABLE-SIZE, max-number-of-elements=208, base-type=uint8  # Parameters: Connector_Pin_Position
  diagnostic read data by identifier ReadPowerPath110PinMapping: access-permission=READ0x01DefaultSession0x03ExtendedSession, data-identifier=PowerPath110PinMapping, read-class=DiagnosticReadDataByIdentifierClass  # Read_Power_Path_110_Pin_Mapping
package /ZeC/DataIdentifiers/MeasurementValue/Power_Path_109_Pin_Mapping
  diagnostic data identifier PowerPath109PinMapping: id=0x796d, represents-vin=false  # Power_Path_109_Pin_Mapping
    diagnostic-parameter bit-offset=0:
      diagnostic data element MeasurementValue_0x796d_Power_Path_109_Pin_Mapping_Connector_Pin_Position: array-size-semantics=VARIABLE-SIZE, max-number-of-elements=208, base-type=uint8  # Parameters: Connector_Pin_Position
  diagnostic read data by identifier ReadPowerPath109PinMapping: access-permission=READ0x01DefaultSession0x03ExtendedSession, data-identifier=PowerPath109PinMapping, read-class=DiagnosticReadDataByIdentifierClass  # Read_Power_Path_109_Pin_Mapping
package /ZeC/DataIdentifiers/MeasurementValue/Power_Path_111_Pin_Mapping
  diagnostic data identifier PowerPath111PinMapping: id=0x796f, represents-vin=false  # Power_Path_111_Pin_Mapping
    diagnostic-parameter bit-offset=0:
      diagnostic data element MeasurementValue_0x796f_Power_Path_111_Pin_Mapping_Connector_Pin_Position: array-size-semantics=VARIABLE-SIZE, max-number-of-elements=208, base-type=uint8  # Parameters: Connector_Pin_Position
  diagnostic read data by identifier ReadPowerPath111PinMapping: access-permission=READ0x01DefaultSession0x03ExtendedSession, data-identifier=PowerPath111PinMapping, read-class=DiagnosticReadDataByIdentifierClass  # Read_Power_Path_111_Pin_Mapping
package /ZeC/DataIdentifiers/MeasurementValue/Someip_service_identification
  diagnostic data identifier SomeipServiceIdentification: id=0xb046, represents-vin=false  # Someip_service_identification
    diagnostic-parameter bit-offset=0:
      diagnostic data element MeasurementValue_0xb046_Someip_service_identification_some_ip_faulty_service_id_counter: base-type=uint8  # Parameters: some_ip_faulty_service_id_counter
    diagnostic-parameter bit-offset=8:
      diagnostic data element MeasurementValue_0xb046_Someip_service_identification_Service_identifier_Instance_identifier_IPv6_address: array-size-semantics=VARIABLE-SIZE, max-number-of-elements=200, base-type=uint8  # Parameters: Service_identifier / Instance_identifier / IPv6_address
  diagnostic read data by identifier ReadSomeipServiceIdentification: access-permission=READ0x01DefaultSession0x03ExtendedSession, data-identifier=SomeipServiceIdentification, read-class=DiagnosticReadDataByIdentifierClass  # Read_Someip_service_identification
package /ZeC/DataIdentifiers/MeasurementValue/Power_Path_106_Pin_Mapping
  diagnostic data identifier PowerPath106PinMapping: id=0x796a, represents-vin=false  # Power_Path_106_Pin_Mapping
    diagnostic-parameter bit-offset=0:
      diagnostic data element MeasurementValue_0x796a_Power_Path_106_Pin_Mapping_Connector_Pin_Position: array-size-semantics=VARIABLE-SIZE, max-number-of-elements=208, base-type=uint8  # Parameters: Connector_Pin_Position
  diagnostic read data by identifier ReadPowerPath106PinMapping: access-permission=READ0x01DefaultSession0x03ExtendedSession, data-identifier=PowerPath106PinMapping, read-class=DiagnosticReadDataByIdentifierClass  # Read_Power_Path_106_Pin_Mapping
package /ZeC/DataIdentifiers/MeasurementValue/Power_Path_108_Pin_Mapping
  diagnostic data identifier PowerPath108PinMapping: id=0x796c, represents-vin=false  # Power_Path_108_Pin_Mapping
    diagnostic-parameter bit-offset=0:
      diagnostic data element MeasurementValue_0x796c_Power_Path_108_Pin_Mapping_Connector_Pin_Position: array-size-semantics=VARIABLE-SIZE, max-number-of-elements=208, base-type=uint8  # Parameters: Connector_Pin_Position
  diagnostic read data by identifier ReadPowerPath108PinMapping: access-permission=READ0x01DefaultSession0x03ExtendedSession, data-identifier=PowerPath108PinMapping, read-class=DiagnosticReadDataByIdentifierClass  # Read_Power_Path_108_Pin_Mapping
package /ZeC/DataIdentifiers/MeasurementValue/Power_Path_107_Pin_Mapping
  diagnostic data identifier PowerPath107PinMapping: id=0x796b, represents-vin=false  # Power_Path_107_Pin_Mapping
    diagnostic-parameter bit-offset=0:
      diagnostic data element MeasurementValue_0x796b_Power_Path_107_Pin_Mapping_Connector_Pin_Position: array-size-semantics=VARIABLE-SIZE, max-number-of-elements=208, base-type=uint8  # Parameters: Connector_Pin_Position
  diagnostic read data by identifier ReadPowerPath107PinMapping: access-permission=READ0x01DefaultSession0x03ExtendedSession, data-identifier=PowerPath107PinMapping, read-class=DiagnosticReadDataByIdentifierClass  # Read_Power_Path_107_Pin_Mapping
package /ZeC/DataIdentifiers/MeasurementValue/Power_Path_101_Pin_Mapping
  diagnostic data identifier PowerPath101PinMapping: id=0x7965, represents-vin=false  # Power_Path_101_Pin_Mapping
    diagnostic-parameter bit-offset=0:
      diagnostic data element MeasurementValue_0x7965_Power_Path_101_Pin_Mapping_Connector_Pin_Position: array-size-semantics=VARIABLE-SIZE, max-number-of-elements=208, base-type=uint8  # Parameters: Connector_Pin_Position
  diagnostic read data by identifier ReadPowerPath101PinMapping: access-permission=READ0x01DefaultSession0x03ExtendedSession, data-identifier=PowerPath101PinMapping, read-class=DiagnosticReadDataByIdentifierClass  # Read_Power_Path_101_Pin_Mapping
package /ZeC/DataIdentifiers/MeasurementValue/Power_Path_100_Pin_Mapping
  diagnostic data identifier PowerPath100PinMapping: id=0x7964, represents-vin=false  # Power_Path_100_Pin_Mapping
    diagnostic-parameter bit-offset=0:
      diagnostic data element MeasurementValue_0x7964_Power_Path_100_Pin_Mapping_Connector_Pin_Position: array-size-semantics=VARIABLE-SIZE, max-number-of-elements=208, base-type=uint8  # Parameters: Connector_Pin_Position
  diagnostic read data by identifier ReadPowerPath100PinMapping: access-permission=READ0x01DefaultSession0x03ExtendedSession, data-identifier=PowerPath100PinMapping, read-class=DiagnosticReadDataByIdentifierClass  # Read_Power_Path_100_Pin_Mapping
package /ZeC/DataIdentifiers/MeasurementValue/Power_Path_103_Pin_Mapping
  diagnostic data identifier PowerPath103PinMapping: id=0x7967, represents-vin=false  # Power_Path_103_Pin_Mapping
    diagnostic-parameter bit-offset=0:
      diagnostic data element MeasurementValue_0x7967_Power_Path_103_Pin_Mapping_Connector_Pin_Position: array-size-semantics=VARIABLE-SIZE, max-number-of-elements=208, base-type=uint8  # Parameters: Connector_Pin_Position
  diagnostic read data by identifier ReadPowerPath103PinMapping: access-permission=READ0x01DefaultSession0x03ExtendedSession, data-identifier=PowerPath103PinMapping, read-class=DiagnosticReadDataByIdentifierClass  # Read_Power_Path_103_Pin_Mapping
package /ZeC/DataIdentifiers/MeasurementValue/Power_Path_102_Pin_Mapping
  diagnostic data identifier PowerPath102PinMapping: id=0x7966, represents-vin=false  # Power_Path_102_Pin_Mapping
    diagnostic-parameter bit-offset=0:
      diagnostic data element MeasurementValue_0x7966_Power_Path_102_Pin_Mapping_Connector_Pin_Position: array-size-semantics=VARIABLE-SIZE, max-number-of-elements=208, base-type=uint8  # Parameters: Connector_Pin_Position
  diagnostic read data by identifier ReadPowerPath102PinMapping: access-permission=READ0x01DefaultSession0x03ExtendedSession, data-identifier=PowerPath102PinMapping, read-class=DiagnosticReadDataByIdentifierClass  # Read_Power_Path_102_Pin_Mapping
package /ZeC/DataIdentifiers/MeasurementValue/Power_Path_105_Pin_Mapping
  diagnostic data identifier PowerPath105PinMapping: id=0x7969, represents-vin=false  # Power_Path_105_Pin_Mapping
    diagnostic-parameter bit-offset=0:
      diagnostic data element MeasurementValue_0x7969_Power_Path_105_Pin_Mapping_Connector_Pin_Position: array-size-semantics=VARIABLE-SIZE, max-number-of-elements=208, base-type=uint8  # Parameters: Connector_Pin_Position
  diagnostic read data by identifier ReadPowerPath105PinMapping: access-permission=READ0x01DefaultSession0x03ExtendedSession, data-identifier=PowerPath105PinMapping, read-class=DiagnosticReadDataByIdentifierClass  # Read_Power_Path_105_Pin_Mapping
package /ZeC/DataIdentifiers/MeasurementValue/Power_Path_104_Pin_Mapping
  diagnostic data identifier PowerPath104PinMapping: id=0x7968, represents-vin=false  # Power_Path_104_Pin_Mapping
    diagnostic-parameter bit-offset=0:
      diagnostic data element MeasurementValue_0x7968_Power_Path_104_Pin_Mapping_Connector_Pin_Position: array-size-semantics=VARIABLE-SIZE, max-number-of-elements=208, base-type=uint8  # Parameters: Connector_Pin_Position
  diagnostic read data by identifier ReadPowerPath104PinMapping: access-permission=READ0x01DefaultSession0x03ExtendedSession, data-identifier=PowerPath104PinMapping, read-class=DiagnosticReadDataByIdentifierClass  # Read_Power_Path_104_Pin_Mapping
package /ZeC/DataIdentifiers/MeasurementValue/Power_Path_129_Pin_Mapping
  diagnostic data identifier PowerPath129PinMapping: id=0x7981, represents-vin=false  # Power_Path_129_Pin_Mapping
    diagnostic-parameter bit-offset=0:
      diagnostic data element MeasurementValue_0x7981_Power_Path_129_Pin_Mapping_Connector_Pin_Position: array-size-semantics=VARIABLE-SIZE, max-number-of-elements=208, base-type=uint8  # Parameters: Connector_Pin_Position
  diagnostic read data by identifier ReadPowerPath129PinMapping: access-permission=READ0x01DefaultSession0x03ExtendedSession, data-identifier=PowerPath129PinMapping, read-class=DiagnosticReadDataByIdentifierClass  # Read_Power_Path_129_Pin_Mapping
package /ZeC/DataIdentifiers/MeasurementValue/Power_Path_128_Pin_Mapping
  diagnostic data identifier PowerPath128PinMapping: id=0x7980, represents-vin=false  # Power_Path_128_Pin_Mapping
    diagnostic-parameter bit-offset=0:
      diagnostic data element MeasurementValue_0x7980_Power_Path_128_Pin_Mapping_Connector_Pin_Position: array-size-semantics=VARIABLE-SIZE, max-number-of-elements=208, base-type=uint8  # Parameters: Connector_Pin_Position
  diagnostic read data by identifier ReadPowerPath128PinMapping: access-permission=READ0x01DefaultSession0x03ExtendedSession, data-identifier=PowerPath128PinMapping, read-class=DiagnosticReadDataByIdentifierClass  # Read_Power_Path_128_Pin_Mapping
package /ZeC/DataIdentifiers/MeasurementValue/Power_Path_131_Pin_Mapping
  diagnostic data identifier PowerPath131PinMapping: id=0x7983, represents-vin=false  # Power_Path_131_Pin_Mapping
    diagnostic-parameter bit-offset=0:
      diagnostic data element MeasurementValue_0x7983_Power_Path_131_Pin_Mapping_Connector_Pin_Position: array-size-semantics=VARIABLE-SIZE, max-number-of-elements=208, base-type=uint8  # Parameters: Connector_Pin_Position
  diagnostic read data by identifier ReadPowerPath131PinMapping: access-permission=READ0x01DefaultSession0x03ExtendedSession, data-identifier=PowerPath131PinMapping, read-class=DiagnosticReadDataByIdentifierClass  # Read_Power_Path_131_Pin_Mapping
package /ZeC/DataIdentifiers/MeasurementValue/Power_Path_130_Pin_Mapping
  diagnostic data identifier PowerPath130PinMapping: id=0x7982, represents-vin=false  # Power_Path_130_Pin_Mapping
    diagnostic-parameter bit-offset=0:
      diagnostic data element MeasurementValue_0x7982_Power_Path_130_Pin_Mapping_Connector_Pin_Position: array-size-semantics=VARIABLE-SIZE, max-number-of-elements=208, base-type=uint8  # Parameters: Connector_Pin_Position
  diagnostic read data by identifier ReadPowerPath130PinMapping: access-permission=READ0x01DefaultSession0x03ExtendedSession, data-identifier=PowerPath130PinMapping, read-class=DiagnosticReadDataByIdentifierClass  # Read_Power_Path_130_Pin_Mapping
package /ZeC/DataIdentifiers/MeasurementValue/Power_Path_133_Pin_Mapping
  diagnostic data identifier PowerPath133PinMapping: id=0x7985, represents-vin=false  # Power_Path_133_Pin_Mapping
    diagnostic-parameter bit-offset=0:
      diagnostic data element MeasurementValue_0x7985_Power_Path_133_Pin_Mapping_Connector_Pin_Position: array-size-semantics=VARIABLE-SIZE, max-number-of-elements=208, base-type=uint8  # Parameters: Connector_Pin_Position
  diagnostic read data by identifier ReadPowerPath133PinMapping: access-permission=READ0x01DefaultSession0x03ExtendedSession, data-identifier=PowerPath133PinMapping, read-class=DiagnosticReadDataByIdentifierClass  # Read_Power_Path_133_Pin_Mapping
package /ZeC/DataIdentifiers/MeasurementValue/Power_Path_132_Pin_Mapping
  diagnostic data identifier PowerPath132PinMapping: id=0x7984, represents-vin=false  # Power_Path_132_Pin_Mapping
    diagnostic-parameter bit-offset=0:
      diagnostic data element MeasurementValue_0x7984_Power_Path_132_Pin_Mapping_Connector_Pin_Position: array-size-semantics=VARIABLE-SIZE, max-number-of-elements=208, base-type=uint8  # Parameters: Connector_Pin_Position
  diagnostic read data by identifier ReadPowerPath132PinMapping: access-permission=READ0x01DefaultSession0x03ExtendedSession, data-identifier=PowerPath132PinMapping, read-class=DiagnosticReadDataByIdentifierClass  # Read_Power_Path_132_Pin_Mapping
package /ZeC/DataIdentifiers/MeasurementValue/Power_Path_127_Pin_Mapping
  diagnostic data identifier PowerPath127PinMapping: id=0x797f, represents-vin=false  # Power_Path_127_Pin_Mapping
    diagnostic-parameter bit-offset=0:
      diagnostic data element MeasurementValue_0x797f_Power_Path_127_Pin_Mapping_Connector_Pin_Position: array-size-semantics=VARIABLE-SIZE, max-number-of-elements=208, base-type=uint8  # Parameters: Connector_Pin_Position
  diagnostic read data by identifier ReadPowerPath127PinMapping: access-permission=READ0x01DefaultSession0x03ExtendedSession, data-identifier=PowerPath127PinMapping, read-class=DiagnosticReadDataByIdentifierClass  # Read_Power_Path_127_Pin_Mapping
package /ZeC/DataIdentifiers/MeasurementValue/Power_Path_126_Pin_Mapping
  diagnostic data identifier PowerPath126PinMapping: id=0x797e, represents-vin=false  # Power_Path_126_Pin_Mapping
    diagnostic-parameter bit-offset=0:
      diagnostic data element MeasurementValue_0x797e_Power_Path_126_Pin_Mapping_Connector_Pin_Position: array-size-semantics=VARIABLE-SIZE, max-number-of-elements=208, base-type=uint8  # Parameters: Connector_Pin_Position
  diagnostic read data by identifier ReadPowerPath126PinMapping: access-permission=READ0x01DefaultSession0x03ExtendedSession, data-identifier=PowerPath126PinMapping, read-class=DiagnosticReadDataByIdentifierClass  # Read_Power_Path_126_Pin_Mapping
package /ZeC/DataIdentifiers/MeasurementValue/Power_Path_123_Pin_Mapping
  diagnostic data identifier PowerPath123PinMapping: id=0x797b, represents-vin=false  # Power_Path_123_Pin_Mapping
    diagnostic-parameter bit-offset=0:
      diagnostic data element MeasurementValue_0x797b_Power_Path_123_Pin_Mapping_Connector_Pin_Position: array-size-semantics=VARIABLE-SIZE, max-number-of-elements=208, base-type=uint8  # Parameters: Connector_Pin_Position
  diagnostic read data by identifier ReadPowerPath123PinMapping: access-permission=READ0x01DefaultSession0x03ExtendedSession, data-identifier=PowerPath123PinMapping, read-class=DiagnosticReadDataByIdentifierClass  # Read_Power_Path_123_Pin_Mapping
package /ZeC/DataIdentifiers/MeasurementValue/Power_Path_122_Pin_Mapping
  diagnostic data identifier PowerPath122PinMapping: id=0x797a, represents-vin=false  # Power_Path_122_Pin_Mapping
    diagnostic-parameter bit-offset=0:
      diagnostic data element MeasurementValue_0x797a_Power_Path_122_Pin_Mapping_Connector_Pin_Position: array-size-semantics=VARIABLE-SIZE, max-number-of-elements=208, base-type=uint8  # Parameters: Connector_Pin_Position
  diagnostic read data by identifier ReadPowerPath122PinMapping: access-permission=READ0x01DefaultSession0x03ExtendedSession, data-identifier=PowerPath122PinMapping, read-class=DiagnosticReadDataByIdentifierClass  # Read_Power_Path_122_Pin_Mapping
package /ZeC/DataIdentifiers/MeasurementValue/Ethernet_status_electric_failure
  diagnostic data identifier EthernetStatusElectricFailure: id=0x53b2, represents-vin=false  # Ethernet_status_electric_failure
    diagnostic-parameter bit-offset=0:
      diagnostic data element MeasurementValue_0x53b2_Ethernet_status_electric_failure_version_number: base-type=uint8  # Parameters: version_number
    diagnostic-parameter bit-offset=8:
      diagnostic data element MeasurementValue_0x53b2_Ethernet_status_electric_failure_Ip_count_of_status_electric_failure: base-type=uint8  # Parameters: Ip_count_of_status_electric_failure
    diagnostic-parameter bit-offset=16:
      diagnostic data element MeasurementValue_0x53b2_Ethernet_status_electric_failure_Ethernet_interface_Ethernet_status_electric_failure: array-size-semantics=VARIABLE-SIZE, max-number-of-elements=10, base-type=uint8  # Parameters: Ethernet_interface / Ethernet_status_electric_failure
  diagnostic read data by identifier ReadEthernetStatusElectricFailure: access-permission=READ0x01DefaultSession0x03ExtendedSession, data-identifier=EthernetStatusElectricFailure, read-class=DiagnosticReadDataByIdentifierClass  # Read_Ethernet_status_electric_failure
package /ZeC/DataIdentifiers/MeasurementValue/Power_Path_125_Pin_Mapping
  diagnostic data identifier PowerPath125PinMapping: id=0x797d, represents-vin=false  # Power_Path_125_Pin_Mapping
    diagnostic-parameter bit-offset=0:
      diagnostic data element MeasurementValue_0x797d_Power_Path_125_Pin_Mapping_Connector_Pin_Position: array-size-semantics=VARIABLE-SIZE, max-number-of-elements=208, base-type=uint8  # Parameters: Connector_Pin_Position
  diagnostic read data by identifier ReadPowerPath125PinMapping: access-permission=READ0x01DefaultSession0x03ExtendedSession, data-identifier=PowerPath125PinMapping, read-class=DiagnosticReadDataByIdentifierClass  # Read_Power_Path_125_Pin_Mapping
package /ZeC/DataIdentifiers/MeasurementValue/Power_Path_124_Pin_Mapping
  diagnostic data identifier PowerPath124PinMapping: id=0x797c, represents-vin=false  # Power_Path_124_Pin_Mapping
    diagnostic-parameter bit-offset=0:
      diagnostic data element MeasurementValue_0x797c_Power_Path_124_Pin_Mapping_Connector_Pin_Position: array-size-semantics=VARIABLE-SIZE, max-number-of-elements=208, base-type=uint8  # Parameters: Connector_Pin_Position
  diagnostic read data by identifier ReadPowerPath124PinMapping: access-permission=READ0x01DefaultSession0x03ExtendedSession, data-identifier=PowerPath124PinMapping, read-class=DiagnosticReadDataByIdentifierClass  # Read_Power_Path_124_Pin_Mapping
package /ZeC/DataIdentifiers/MeasurementValue/Power_Path_118_Pin_Mapping
  diagnostic data identifier PowerPath118PinMapping: id=0x7976, represents-vin=false  # Power_Path_118_Pin_Mapping
    diagnostic-parameter bit-offset=0:
      diagnostic data element MeasurementValue_0x7976_Power_Path_118_Pin_Mapping_Connector_Pin_Position: array-size-semantics=VARIABLE-SIZE, max-number-of-elements=208, base-type=uint8  # Parameters: Connector_Pin_Position
  diagnostic read data by identifier ReadPowerPath118PinMapping: access-permission=READ0x01DefaultSession0x03ExtendedSession, data-identifier=PowerPath118PinMapping, read-class=DiagnosticReadDataByIdentifierClass  # Read_Power_Path_118_Pin_Mapping
package /ZeC/DataIdentifiers/MeasurementValue/Power_Path_117_Pin_Mapping
  diagnostic data identifier PowerPath117PinMapping: id=0x7975, represents-vin=false  # Power_Path_117_Pin_Mapping
    diagnostic-parameter bit-offset=0:
      diagnostic data element MeasurementValue_0x7975_Power_Path_117_Pin_Mapping_Connector_Pin_Position: array-size-semantics=VARIABLE-SIZE, max-number-of-elements=208, base-type=uint8  # Parameters: Connector_Pin_Position
  diagnostic read data by identifier ReadPowerPath117PinMapping: access-permission=READ0x01DefaultSession0x03ExtendedSession, data-identifier=PowerPath117PinMapping, read-class=DiagnosticReadDataByIdentifierClass  # Read_Power_Path_117_Pin_Mapping
package /ZeC/DataIdentifiers/MeasurementValue/Power_Path_120_Pin_Mapping
  diagnostic data identifier PowerPath120PinMapping: id=0x7978, represents-vin=false  # Power_Path_120_Pin_Mapping
    diagnostic-parameter bit-offset=0:
      diagnostic data element MeasurementValue_0x7978_Power_Path_120_Pin_Mapping_Connector_Pin_Position: array-size-semantics=VARIABLE-SIZE, max-number-of-elements=208, base-type=uint8  # Parameters: Connector_Pin_Position
  diagnostic read data by identifier ReadPowerPath120PinMapping: access-permission=READ0x01DefaultSession0x03ExtendedSession, data-identifier=PowerPath120PinMapping, read-class=DiagnosticReadDataByIdentifierClass  # Read_Power_Path_120_Pin_Mapping
package /ZeC/DataIdentifiers/MeasurementValue/Power_Path_119_Pin_Mapping
  diagnostic data identifier PowerPath119PinMapping: id=0x7977, represents-vin=false  # Power_Path_119_Pin_Mapping
    diagnostic-parameter bit-offset=0:
      diagnostic data element MeasurementValue_0x7977_Power_Path_119_Pin_Mapping_Connector_Pin_Position: array-size-semantics=VARIABLE-SIZE, max-number-of-elements=208, base-type=uint8  # Parameters: Connector_Pin_Position
  diagnostic read data by identifier ReadPowerPath119PinMapping: access-permission=READ0x01DefaultSession0x03ExtendedSession, data-identifier=PowerPath119PinMapping, read-class=DiagnosticReadDataByIdentifierClass  # Read_Power_Path_119_Pin_Mapping
package /ZeC/DataIdentifiers/MeasurementValue/Power_Path_121_Pin_Mapping
  diagnostic data identifier PowerPath121PinMapping: id=0x7979, represents-vin=false  # Power_Path_121_Pin_Mapping
    diagnostic-parameter bit-offset=0:
      diagnostic data element MeasurementValue_0x7979_Power_Path_121_Pin_Mapping_Connector_Pin_Position: array-size-semantics=VARIABLE-SIZE, max-number-of-elements=208, base-type=uint8  # Parameters: Connector_Pin_Position
  diagnostic read data by identifier ReadPowerPath121PinMapping: access-permission=READ0x01DefaultSession0x03ExtendedSession, data-identifier=PowerPath121PinMapping, read-class=DiagnosticReadDataByIdentifierClass  # Read_Power_Path_121_Pin_Mapping
package /ZeC/DataIdentifiers/MeasurementValue/Power_Path_144_Pin_Mapping
  diagnostic data identifier PowerPath144PinMapping: id=0x7990, represents-vin=false  # Power_Path_144_Pin_Mapping
    diagnostic-parameter bit-offset=0:
      diagnostic data element MeasurementValue_0x7990_Power_Path_144_Pin_Mapping_Connector_Pin_Position: array-size-semantics=VARIABLE-SIZE, max-number-of-elements=208, base-type=uint8  # Parameters: Connector_Pin_Position
  diagnostic read data by identifier ReadPowerPath144PinMapping: access-permission=READ0x01DefaultSession0x03ExtendedSession, data-identifier=PowerPath144PinMapping, read-class=DiagnosticReadDataByIdentifierClass  # Read_Power_Path_144_Pin_Mapping
package /ZeC/DataIdentifiers/MeasurementValue/Power_Path_146_Pin_Mapping
  diagnostic data identifier PowerPath146PinMapping: id=0x7992, represents-vin=false  # Power_Path_146_Pin_Mapping
    diagnostic-parameter bit-offset=0:
      diagnostic data element MeasurementValue_0x7992_Power_Path_146_Pin_Mapping_Connector_Pin_Position: array-size-semantics=VARIABLE-SIZE, max-number-of-elements=208, base-type=uint8  # Parameters: Connector_Pin_Position
  diagnostic read data by identifier ReadPowerPath146PinMapping: access-permission=READ0x01DefaultSession0x03ExtendedSession, data-identifier=PowerPath146PinMapping, read-class=DiagnosticReadDataByIdentifierClass  # Read_Power_Path_146_Pin_Mapping
package /ZeC/DataIdentifiers/MeasurementValue/Power_Path_145_Pin_Mapping
  diagnostic data identifier PowerPath145PinMapping: id=0x7991, represents-vin=false  # Power_Path_145_Pin_Mapping
    diagnostic-parameter bit-offset=0:
      diagnostic data element MeasurementValue_0x7991_Power_Path_145_Pin_Mapping_Connector_Pin_Position: array-size-semantics=VARIABLE-SIZE, max-number-of-elements=208, base-type=uint8  # Parameters: Connector_Pin_Position
  diagnostic read data by identifier ReadPowerPath145PinMapping: access-permission=READ0x01DefaultSession0x03ExtendedSession, data-identifier=PowerPath145PinMapping, read-class=DiagnosticReadDataByIdentifierClass  # Read_Power_Path_145_Pin_Mapping
package /ZeC/DataIdentifiers/MeasurementValue/Power_Path_148_Pin_Mapping
  diagnostic data identifier PowerPath148PinMapping: id=0x7994, represents-vin=false  # Power_Path_148_Pin_Mapping
    diagnostic-parameter bit-offset=0:
      diagnostic data element MeasurementValue_0x7994_Power_Path_148_Pin_Mapping_Connector_Pin_Position: array-size-semantics=VARIABLE-SIZE, max-number-of-elements=208, base-type=uint8  # Parameters: Connector_Pin_Position
  diagnostic read data by identifier ReadPowerPath148PinMapping: access-permission=READ0x01DefaultSession0x03ExtendedSession, data-identifier=PowerPath148PinMapping, read-class=DiagnosticReadDataByIdentifierClass  # Read_Power_Path_148_Pin_Mapping
package /ZeC/DataIdentifiers/MeasurementValue/Power_Path_147_Pin_Mapping
  diagnostic data identifier PowerPath147PinMapping: id=0x7993, represents-vin=false  # Power_Path_147_Pin_Mapping
    diagnostic-parameter bit-offset=0:
      diagnostic data element MeasurementValue_0x7993_Power_Path_147_Pin_Mapping_Connector_Pin_Position: array-size-semantics=VARIABLE-SIZE, max-number-of-elements=208, base-type=uint8  # Parameters: Connector_Pin_Position
  diagnostic read data by identifier ReadPowerPath147PinMapping: access-permission=READ0x01DefaultSession0x03ExtendedSession, data-identifier=PowerPath147PinMapping, read-class=DiagnosticReadDataByIdentifierClass  # Read_Power_Path_147_Pin_Mapping
package /ZeC/DataIdentifiers/MeasurementValue/Power_Path_150_Pin_Mapping
  diagnostic data identifier PowerPath150PinMapping: id=0x7996, represents-vin=false  # Power_Path_150_Pin_Mapping
    diagnostic-parameter bit-offset=0:
      diagnostic data element MeasurementValue_0x7996_Power_Path_150_Pin_Mapping_Connector_Pin_Position: array-size-semantics=VARIABLE-SIZE, max-number-of-elements=208, base-type=uint8  # Parameters: Connector_Pin_Position
  diagnostic read data by identifier ReadPowerPath150PinMapping: access-permission=READ0x01DefaultSession0x03ExtendedSession, data-identifier=PowerPath150PinMapping, read-class=DiagnosticReadDataByIdentifierClass  # Read_Power_Path_150_Pin_Mapping
package /ZeC/DataIdentifiers/MeasurementValue/Power_Path_149_Pin_Mapping
  diagnostic data identifier PowerPath149PinMapping: id=0x7995, represents-vin=false  # Power_Path_149_Pin_Mapping
    diagnostic-parameter bit-offset=0:
      diagnostic data element MeasurementValue_0x7995_Power_Path_149_Pin_Mapping_Connector_Pin_Position: array-size-semantics=VARIABLE-SIZE, max-number-of-elements=208, base-type=uint8  # Parameters: Connector_Pin_Position
  diagnostic read data by identifier ReadPowerPath149PinMapping: access-permission=READ0x01DefaultSession0x03ExtendedSession, data-identifier=PowerPath149PinMapping, read-class=DiagnosticReadDataByIdentifierClass  # Read_Power_Path_149_Pin_Mapping
package /ZeC/DataIdentifiers/MeasurementValue/Power_Path_143_Pin_Mapping
  diagnostic data identifier PowerPath143PinMapping: id=0x798f, represents-vin=false  # Power_Path_143_Pin_Mapping
    diagnostic-parameter bit-offset=0:
      diagnostic data element MeasurementValue_0x798f_Power_Path_143_Pin_Mapping_Connector_Pin_Position: array-size-semantics=VARIABLE-SIZE, max-number-of-elements=208, base-type=uint8  # Parameters: Connector_Pin_Position
  diagnostic read data by identifier ReadPowerPath143PinMapping: access-permission=READ0x01DefaultSession0x03ExtendedSession, data-identifier=PowerPath143PinMapping, read-class=DiagnosticReadDataByIdentifierClass  # Read_Power_Path_143_Pin_Mapping
package /ZeC/DataIdentifiers/MeasurementValue/Power_Path_138_Pin_Mapping
  diagnostic data identifier PowerPath138PinMapping: id=0x798a, represents-vin=false  # Power_Path_138_Pin_Mapping
    diagnostic-parameter bit-offset=0:
      diagnostic data element MeasurementValue_0x798a_Power_Path_138_Pin_Mapping_Connector_Pin_Position: array-size-semantics=VARIABLE-SIZE, max-number-of-elements=208, base-type=uint8  # Parameters: Connector_Pin_Position
  diagnostic read data by identifier ReadPowerPath138PinMapping: access-permission=READ0x01DefaultSession0x03ExtendedSession, data-identifier=PowerPath138PinMapping, read-class=DiagnosticReadDataByIdentifierClass  # Read_Power_Path_138_Pin_Mapping
package /ZeC/DataIdentifiers/MeasurementValue/Power_Path_140_Pin_Mapping
  diagnostic data identifier PowerPath140PinMapping: id=0x798c, represents-vin=false  # Power_Path_140_Pin_Mapping
    diagnostic-parameter bit-offset=0:
      diagnostic data element MeasurementValue_0x798c_Power_Path_140_Pin_Mapping_Connector_Pin_Position: array-size-semantics=VARIABLE-SIZE, max-number-of-elements=208, base-type=uint8  # Parameters: Connector_Pin_Position
  diagnostic read data by identifier ReadPowerPath140PinMapping: access-permission=READ0x01DefaultSession0x03ExtendedSession, data-identifier=PowerPath140PinMapping, read-class=DiagnosticReadDataByIdentifierClass  # Read_Power_Path_140_Pin_Mapping
package /ZeC/DataIdentifiers/MeasurementValue/Power_Path_139_Pin_Mapping
  diagnostic data identifier PowerPath139PinMapping: id=0x798b, represents-vin=false  # Power_Path_139_Pin_Mapping
    diagnostic-parameter bit-offset=0:
      diagnostic data element MeasurementValue_0x798b_Power_Path_139_Pin_Mapping_Connector_Pin_Position: array-size-semantics=VARIABLE-SIZE, max-number-of-elements=208, base-type=uint8  # Parameters: Connector_Pin_Position
  diagnostic read data by identifier ReadPowerPath139PinMapping: access-permission=READ0x01DefaultSession0x03ExtendedSession, data-identifier=PowerPath139PinMapping, read-class=DiagnosticReadDataByIdentifierClass  # Read_Power_Path_139_Pin_Mapping
package /ZeC/DataIdentifiers/MeasurementValue/Power_Path_142_Pin_Mapping
  diagnostic data identifier PowerPath142PinMapping: id=0x798e, represents-vin=false  # Power_Path_142_Pin_Mapping
    diagnostic-parameter bit-offset=0:
      diagnostic data element MeasurementValue_0x798e_Power_Path_142_Pin_Mapping_Connector_Pin_Position: array-size-semantics=VARIABLE-SIZE, max-number-of-elements=208, base-type=uint8  # Parameters: Connector_Pin_Position
  diagnostic read data by identifier ReadPowerPath142PinMapping: access-permission=READ0x01DefaultSession0x03ExtendedSession, data-identifier=PowerPath142PinMapping, read-class=DiagnosticReadDataByIdentifierClass  # Read_Power_Path_142_Pin_Mapping
package /ZeC/DataIdentifiers/MeasurementValue/Power_Path_141_Pin_Mapping
  diagnostic data identifier PowerPath141PinMapping: id=0x798d, represents-vin=false  # Power_Path_141_Pin_Mapping
    diagnostic-parameter bit-offset=0:
      diagnostic data element MeasurementValue_0x798d_Power_Path_141_Pin_Mapping_Connector_Pin_Position: array-size-semantics=VARIABLE-SIZE, max-number-of-elements=208, base-type=uint8  # Parameters: Connector_Pin_Position
  diagnostic read data by identifier ReadPowerPath141PinMapping: access-permission=READ0x01DefaultSession0x03ExtendedSession, data-identifier=PowerPath141PinMapping, read-class=DiagnosticReadDataByIdentifierClass  # Read_Power_Path_141_Pin_Mapping
package /ZeC/DataIdentifiers/MeasurementValue/Power_Path_135_Pin_Mapping
  diagnostic data identifier PowerPath135PinMapping: id=0x7987, represents-vin=false  # Power_Path_135_Pin_Mapping
    diagnostic-parameter bit-offset=0:
      diagnostic data element MeasurementValue_0x7987_Power_Path_135_Pin_Mapping_Connector_Pin_Position: array-size-semantics=VARIABLE-SIZE, max-number-of-elements=208, base-type=uint8  # Parameters: Connector_Pin_Position
  diagnostic read data by identifier ReadPowerPath135PinMapping: access-permission=READ0x01DefaultSession0x03ExtendedSession, data-identifier=PowerPath135PinMapping, read-class=DiagnosticReadDataByIdentifierClass  # Read_Power_Path_135_Pin_Mapping
package /ZeC/DataIdentifiers/MeasurementValue/Power_Path_134_Pin_Mapping
  diagnostic data identifier PowerPath134PinMapping: id=0x7986, represents-vin=false  # Power_Path_134_Pin_Mapping
    diagnostic-parameter bit-offset=0:
      diagnostic data element MeasurementValue_0x7986_Power_Path_134_Pin_Mapping_Connector_Pin_Position: array-size-semantics=VARIABLE-SIZE, max-number-of-elements=208, base-type=uint8  # Parameters: Connector_Pin_Position
  diagnostic read data by identifier ReadPowerPath134PinMapping: access-permission=READ0x01DefaultSession0x03ExtendedSession, data-identifier=PowerPath134PinMapping, read-class=DiagnosticReadDataByIdentifierClass  # Read_Power_Path_134_Pin_Mapping
package /ZeC/DataIdentifiers/MeasurementValue/Power_Path_137_Pin_Mapping
  diagnostic data identifier PowerPath137PinMapping: id=0x7989, represents-vin=false  # Power_Path_137_Pin_Mapping
    diagnostic-parameter bit-offset=0:
      diagnostic data element MeasurementValue_0x7989_Power_Path_137_Pin_Mapping_Connector_Pin_Position: array-size-semantics=VARIABLE-SIZE, max-number-of-elements=208, base-type=uint8  # Parameters: Connector_Pin_Position
  diagnostic read data by identifier ReadPowerPath137PinMapping: access-permission=READ0x01DefaultSession0x03ExtendedSession, data-identifier=PowerPath137PinMapping, read-class=DiagnosticReadDataByIdentifierClass  # Read_Power_Path_137_Pin_Mapping
package /ZeC/DataIdentifiers/MeasurementValue/Power_Path_136_Pin_Mapping
  diagnostic data identifier PowerPath136PinMapping: id=0x7988, represents-vin=false  # Power_Path_136_Pin_Mapping
    diagnostic-parameter bit-offset=0:
      diagnostic data element MeasurementValue_0x7988_Power_Path_136_Pin_Mapping_Connector_Pin_Position: array-size-semantics=VARIABLE-SIZE, max-number-of-elements=208, base-type=uint8  # Parameters: Connector_Pin_Position
  diagnostic read data by identifier ReadPowerPath136PinMapping: access-permission=READ0x01DefaultSession0x03ExtendedSession, data-identifier=PowerPath136PinMapping, read-class=DiagnosticReadDataByIdentifierClass  # Read_Power_Path_136_Pin_Mapping
package /ZeC/DataIdentifiers/MeasurementValue/Power_Path_155_Pin_Mapping
  diagnostic data identifier PowerPath155PinMapping: id=0x799b, represents-vin=false  # Power_Path_155_Pin_Mapping
    diagnostic-parameter bit-offset=0:
      diagnostic data element MeasurementValue_0x799b_Power_Path_155_Pin_Mapping_Connector_Pin_Position: array-size-semantics=VARIABLE-SIZE, max-number-of-elements=208, base-type=uint8  # Parameters: Connector_Pin_Position
  diagnostic read data by identifier ReadPowerPath155PinMapping: access-permission=READ0x01DefaultSession0x03ExtendedSession, data-identifier=PowerPath155PinMapping, read-class=DiagnosticReadDataByIdentifierClass  # Read_Power_Path_155_Pin_Mapping
package /ZeC/DataIdentifiers/MeasurementValue/Power_Path_154_Pin_Mapping
  diagnostic data identifier PowerPath154PinMapping: id=0x799a, represents-vin=false  # Power_Path_154_Pin_Mapping
    diagnostic-parameter bit-offset=0:
      diagnostic data element MeasurementValue_0x799a_Power_Path_154_Pin_Mapping_Connector_Pin_Position: array-size-semantics=VARIABLE-SIZE, max-number-of-elements=208, base-type=uint8  # Parameters: Connector_Pin_Position
  diagnostic read data by identifier ReadPowerPath154PinMapping: access-permission=READ0x01DefaultSession0x03ExtendedSession, data-identifier=PowerPath154PinMapping, read-class=DiagnosticReadDataByIdentifierClass  # Read_Power_Path_154_Pin_Mapping
package /ZeC/DataIdentifiers/MeasurementValue/Power_Path_157_Pin_Mapping
  diagnostic data identifier PowerPath157PinMapping: id=0x799d, represents-vin=false  # Power_Path_157_Pin_Mapping
    diagnostic-parameter bit-offset=0:
      diagnostic data element MeasurementValue_0x799d_Power_Path_157_Pin_Mapping_Connector_Pin_Position: array-size-semantics=VARIABLE-SIZE, max-number-of-elements=208, base-type=uint8  # Parameters: Connector_Pin_Position
  diagnostic read data by identifier ReadPowerPath157PinMapping: access-permission=READ0x01DefaultSession0x03ExtendedSession, data-identifier=PowerPath157PinMapping, read-class=DiagnosticReadDataByIdentifierClass  # Read_Power_Path_157_Pin_Mapping
package /ZeC/DataIdentifiers/MeasurementValue/Power_Path_156_Pin_Mapping
  diagnostic data identifier PowerPath156PinMapping: id=0x799c, represents-vin=false  # Power_Path_156_Pin_Mapping
    diagnostic-parameter bit-offset=0:
      diagnostic data element MeasurementValue_0x799c_Power_Path_156_Pin_Mapping_Connector_Pin_Position: array-size-semantics=VARIABLE-SIZE, max-number-of-elements=208, base-type=uint8  # Parameters: Connector_Pin_Position
  diagnostic read data by identifier ReadPowerPath156PinMapping: access-permission=READ0x01DefaultSession0x03ExtendedSession, data-identifier=PowerPath156PinMapping, read-class=DiagnosticReadDataByIdentifierClass  # Read_Power_Path_156_Pin_Mapping
package /ZeC/DataIdentifiers/MeasurementValue/Power_Path_159_Pin_Mapping
  diagnostic data identifier PowerPath159PinMapping: id=0x799f, represents-vin=false  # Power_Path_159_Pin_Mapping
    diagnostic-parameter bit-offset=0:
      diagnostic data element MeasurementValue_0x799f_Power_Path_159_Pin_Mapping_Connector_Pin_Position: array-size-semantics=VARIABLE-SIZE, max-number-of-elements=208, base-type=uint8  # Parameters: Connector_Pin_Position
  diagnostic read data by identifier ReadPowerPath159PinMapping: access-permission=READ0x01DefaultSession0x03ExtendedSession, data-identifier=PowerPath159PinMapping, read-class=DiagnosticReadDataByIdentifierClass  # Read_Power_Path_159_Pin_Mapping
package /ZeC/DataIdentifiers/MeasurementValue/Power_Path_158_Pin_Mapping
  diagnostic data identifier PowerPath158PinMapping: id=0x799e, represents-vin=false  # Power_Path_158_Pin_Mapping
    diagnostic-parameter bit-offset=0:
      diagnostic data element MeasurementValue_0x799e_Power_Path_158_Pin_Mapping_Connector_Pin_Position: array-size-semantics=VARIABLE-SIZE, max-number-of-elements=208, base-type=uint8  # Parameters: Connector_Pin_Position
  diagnostic read data by identifier ReadPowerPath158PinMapping: access-permission=READ0x01DefaultSession0x03ExtendedSession, data-identifier=PowerPath158PinMapping, read-class=DiagnosticReadDataByIdentifierClass  # Read_Power_Path_158_Pin_Mapping
package /ZeC/DataIdentifiers/MeasurementValue/Power_Path_152_Pin_Mapping
  diagnostic data identifier PowerPath152PinMapping: id=0x7998, represents-vin=false  # Power_Path_152_Pin_Mapping
    diagnostic-parameter bit-offset=0:
      diagnostic data element MeasurementValue_0x7998_Power_Path_152_Pin_Mapping_Connector_Pin_Position: array-size-semantics=VARIABLE-SIZE, max-number-of-elements=208, base-type=uint8  # Parameters: Connector_Pin_Position
  diagnostic read data by identifier ReadPowerPath152PinMapping: access-permission=READ0x01DefaultSession0x03ExtendedSession, data-identifier=PowerPath152PinMapping, read-class=DiagnosticReadDataByIdentifierClass  # Read_Power_Path_152_Pin_Mapping
package /ZeC/DataIdentifiers/MeasurementValue/Power_Path_151_Pin_Mapping
  diagnostic data identifier PowerPath151PinMapping: id=0x7997, represents-vin=false  # Power_Path_151_Pin_Mapping
    diagnostic-parameter bit-offset=0:
      diagnostic data element MeasurementValue_0x7997_Power_Path_151_Pin_Mapping_Connector_Pin_Position: array-size-semantics=VARIABLE-SIZE, max-number-of-elements=208, base-type=uint8  # Parameters: Connector_Pin_Position
  diagnostic read data by identifier ReadPowerPath151PinMapping: access-permission=READ0x01DefaultSession0x03ExtendedSession, data-identifier=PowerPath151PinMapping, read-class=DiagnosticReadDataByIdentifierClass  # Read_Power_Path_151_Pin_Mapping
package /ZeC/DataIdentifiers/MeasurementValue/Power_Path_153_Pin_Mapping
  diagnostic data identifier PowerPath153PinMapping: id=0x7999, represents-vin=false  # Power_Path_153_Pin_Mapping
    diagnostic-parameter bit-offset=0:
      diagnostic data element MeasurementValue_0x7999_Power_Path_153_Pin_Mapping_Connector_Pin_Position: array-size-semantics=VARIABLE-SIZE, max-number-of-elements=208, base-type=uint8  # Parameters: Connector_Pin_Position
  diagnostic read data by identifier ReadPowerPath153PinMapping: access-permission=READ0x01DefaultSession0x03ExtendedSession, data-identifier=PowerPath153PinMapping, read-class=DiagnosticReadDataByIdentifierClass  # Read_Power_Path_153_Pin_Mapping
package /ZeC/DataIdentifiers/MeasurementValue/EI_AECD_tracking
  diagnostic data identifier EIAECDTracking: id=0x49d9, represents-vin=false  # EI_AECD_tracking
    diagnostic-parameter bit-offset=0:
      diagnostic data element MeasurementValue_0x49d9_EI_AECD_tracking_Versioning: base-type=uint8  # Parameters: Versioning
    diagnostic-parameter bit-offset=8:
      diagnostic data element MeasurementValue_0x49d9_EI_AECD_tracking_Number_of_EI_AECD_records: base-type=uint16  # Parameters: Number_of_EI_AECD_records
    diagnostic-parameter bit-offset=24:
      diagnostic data element MeasurementValue_0x49d9_EI_AECD_tracking_Total_time_with_propulsion_system_active: base-type=uint32  # Parameters: Total_time_with_propulsion_system_active
    diagnostic-parameter bit-offset=56:
      diagnostic data element MeasurementValue_0x49d9_EI_AECD_tracking_Total_time_with_fueled_engine_operation: base-type=uint32  # Parameters: Total_time_with_fueled_engine_operation
    diagnostic-parameter bit-offset=88:
      diagnostic data element MeasurementValue_0x49d9_EI_AECD_tracking_Total_time_with_system_active: base-type=uint32  # Parameters: Total_time_with_system_active
    diagnostic-parameter bit-offset=120:
      diagnostic data element MeasurementValue_0x49d9_EI_AECD_tracking_EI_AECD_ID_EI_AECDx_TIME1_EI_AECDx_TIME2: array-size-semantics=VARIABLE-SIZE, max-number-of-elements=3960, base-type=uint8  # Parameters: EI_AECD_ID / EI_AECDx_TIME1 / EI_AECDx_TIME2
  diagnostic read data by identifier ReadEIAECDTracking: access-permission=READ0x01DefaultSession0x03ExtendedSession, data-identifier=EIAECDTracking, read-class=DiagnosticReadDataByIdentifierClass  # Read_EI_AECD_tracking
package /ZeC/DataIdentifiers/MeasurementValue/Ethernet_link_lost_counter
  diagnostic data identifier EthernetLinkLostCounter: id=0x010e, represents-vin=false  # Ethernet_link_lost_counter
    diagnostic-parameter bit-offset=0:
      diagnostic data element MeasurementValue_0x010e_Ethernet_link_lost_counter_version_number: base-type=uint8  # Parameters: version_number
    diagnostic-parameter bit-offset=8:
      diagnostic data element MeasurementValue_0x010e_Ethernet_link_lost_counter_Ethernet_link_lost_counter: base-type=uint8  # Parameters: Ethernet_link_lost_counter
    diagnostic-parameter bit-offset=16:
      diagnostic data element MeasurementValue_0x010e_Ethernet_link_lost_counter_Ip_ethernet_interface_Ethernet_link_lost_counter: array-size-semantics=VARIABLE-SIZE, max-number-of-elements=10, base-type=uint8  # Parameters: Ip_ethernet_interface / Ethernet_link_lost_counter
  diagnostic read data by identifier ReadEthernetLinkLostCounter: access-permission=READ0x01DefaultSession0x03ExtendedSession, data-identifier=EthernetLinkLostCounter, read-class=DiagnosticReadDataByIdentifierClass  # Read_Ethernet_link_lost_counter
package /ZeC/DataIdentifiers/MeasurementValue/Ethernet_CRC_error_counter
  diagnostic data identifier EthernetCRCErrorCounter: id=0x010f, represents-vin=false  # Ethernet_CRC_error_counter
    diagnostic-parameter bit-offset=0:
      diagnostic data element MeasurementValue_0x010f_Ethernet_CRC_error_counter_version_number: base-type=uint8  # Parameters: version_number
    diagnostic-parameter bit-offset=8:
      diagnostic data element MeasurementValue_0x010f_Ethernet_CRC_error_counter_Ip_count_of_CRC_error_counters: base-type=uint8  # Parameters: Ip_count_of_CRC_error_counters
    diagnostic-parameter bit-offset=16:
      diagnostic data element MeasurementValue_0x010f_Ethernet_CRC_error_counter_Ethernet_interface_Ethernet_CRC_error_counter: array-size-semantics=VARIABLE-SIZE, max-number-of-elements=10, base-type=uint8  # Parameters: Ethernet_interface / Ethernet_CRC_error_counter
  diagnostic read data by identifier ReadEthernetCRCErrorCounter: access-permission=READ0x01DefaultSession0x03ExtendedSession, data-identifier=EthernetCRCErrorCounter, read-class=DiagnosticReadDataByIdentifierClass  # Read_Ethernet_CRC_error_counter
package /ZeC/DataIdentifiers/MeasurementValue/Ethernet_link_quality
  diagnostic data identifier EthernetLinkQuality: id=0x010d, represents-vin=false  # Ethernet_link_quality
    diagnostic-parameter bit-offset=0:
      diagnostic data element MeasurementValue_0x010d_Ethernet_link_quality_version_number: base-type=uint8  # Parameters: version_number
    diagnostic-parameter bit-offset=8:
      diagnostic data element MeasurementValue_0x010d_Ethernet_link_quality_Ip_count_of_link_quality: base-type=uint8  # Parameters: Ip_count_of_link_quality
    diagnostic-parameter bit-offset=16:
      diagnostic data element MeasurementValue_0x010d_Ethernet_link_quality_Ip_ethernet_interface_Ethernet_link_quality: array-size-semantics=VARIABLE-SIZE, max-number-of-elements=10, base-type=uint8  # Parameters: Ip_ethernet_interface / Ethernet_link_quality
  diagnostic read data by identifier ReadEthernetLinkQuality: access-permission=READ0x01DefaultSession0x03ExtendedSession, data-identifier=EthernetLinkQuality, read-class=DiagnosticReadDataByIdentifierClass  # Read_Ethernet_link_quality
package /ZeC/DataIdentifiers/MeasurementValue/IP_network_current_link_delay
  diagnostic data identifier IPNetworkCurrentLinkDelay: id=0x01a3, represents-vin=false  # IP_network_current_link_delay
    diagnostic-parameter bit-offset=0:
      diagnostic data element MeasurementValue_0x01a3_IP_network_current_link_delay_version_number: base-type=uint8  # Parameters: version_number
    diagnostic-parameter bit-offset=8:
      diagnostic data element MeasurementValue_0x01a3_IP_network_current_link_delay_Ip_count_of_Link_Delays: base-type=uint8  # Parameters: Ip_count_of_Link_Delays
    diagnostic-parameter bit-offset=16:
      diagnostic data element MeasurementValue_0x01a3_IP_network_current_link_delay_Ip_ethernet_interface: base-type=uint8  # Parameters: Ip_ethernet_interface
    diagnostic-parameter bit-offset=24:
      diagnostic data element MeasurementValue_0x01a3_IP_network_current_link_delay_Ip_Cur_Link_Delay: base-type=uint16  # Parameters: Ip_Cur_Link_Delay
  diagnostic read data by identifier ReadIPNetworkCurrentLinkDelay: access-permission=READ0x01DefaultSession0x03ExtendedSession, data-identifier=IPNetworkCurrentLinkDelay, read-class=DiagnosticReadDataByIdentifierClass  # Read_IP_network_current_link_delay
package /ZeC/DataIdentifiers/MeasurementValue/Ip_counter_dropped_ipv6_packets_layer_3
  diagnostic data identifier IpCounterDroppedIpv6PacketsLayer3: id=0x01a0, represents-vin=false  # Ip_counter_dropped_ipv6_packets_layer_3
    diagnostic-parameter bit-offset=0:
      diagnostic data element MeasurementValue_0x01a0_Ip_counter_dropped_ipv6_packets_layer_3_Ip_counter_dropped_ipv6_packets_layer_3: base-type=uint16  # Parameters: Ip_counter_dropped_ipv6_packets_layer_3
  diagnostic read data by identifier ReadIpCounterDroppedIpv6PacketsLayer3: access-permission=READ0x01DefaultSession0x03ExtendedSession, data-identifier=IpCounterDroppedIpv6PacketsLayer3, read-class=DiagnosticReadDataByIdentifierClass  # Read_Ip_counter_dropped_ipv6_packets_layer_3
package /ZeC/DataIdentifiers/MeasurementValue/Ip_counter_dropped_udp_tcp_packets_layer_4
  diagnostic data identifier IpCounterDroppedUdpTcpPacketsLayer4: id=0x01a1, represents-vin=false  # Ip_counter_dropped_udp_tcp_packets_layer_4
    diagnostic-parameter bit-offset=0:
      diagnostic data element MeasurementValue_0x01a1_Ip_counter_dropped_udp_tcp_packets_layer_4_Ip_counter_dropped_udp_tcp_packets_layer_4: base-type=uint16  # Parameters: Ip_counter_dropped_udp_tcp_packets_layer_4
  diagnostic read data by identifier ReadIpCounterDroppedUdpTcpPacketsLayer4: access-permission=READ0x01DefaultSession0x03ExtendedSession, data-identifier=IpCounterDroppedUdpTcpPacketsLayer4, read-class=DiagnosticReadDataByIdentifierClass  # Read_Ip_counter_dropped_udp_tcp_packets_layer_4
package /ZeC/DataIdentifiers/MeasurementValue/Basic_Settings_Status
  diagnostic data identifier BasicSettingsStatus: id=0x0102, represents-vin=false  # Basic Settings Status
    diagnostic-parameter bit-offset=0:
      diagnostic data element MeasurementValue_0x0102_Basic_Settings_Status_State_of_basics_settings: base-type=uint8, compu {192=State_of_basics_settings: basic_setting_routine_running (TTR202113), 0=State_of_basics_settings: basic_setting_routine_not_running (TTR202013)}  # Parameters: State_of_basics_settings
  diagnostic read data by identifier ReadBasicSettingsStatus: access-permission=READ0x01DefaultSession0x03ExtendedSession, data-identifier=BasicSettingsStatus, read-class=DiagnosticReadDataByIdentifierClass  # Read_Basic Settings Status
package /ZeC/DataIdentifiers/CalibrationData/Knockout_test_mode
  diagnostic data identifier KnockoutTestMode: id=0x09f3, represents-vin=false  # Knockout_test_mode
    diagnostic-parameter bit-offset=0:
      diagnostic data element CalibrationData_0x09f3_Knockout_test_mode_Bus_Sleep_Veto_Supress_Veto_Reserved: base-type=uint8, compu {0=Bus Sleep: not_active; Veto: not_active; Supress Veto: not_active (TTR202213TTR202213TTR202213), 1=Bus Sleep: active (TTR202313), 2=Veto: active (TTR202313), 4=Supress Veto: active (TTR202313)}  # Parameters: Bus Sleep / Veto / Supress Veto / Reserved
  diagnostic read data by identifier ReadKnockoutTestMode: access-permission=READ0x03ExtendedSession, data-identifier=KnockoutTestMode, read-class=DiagnosticReadDataByIdentifierClass  # Read_Knockout_test_mode
  diagnostic write data by identifier WriteKnockoutTestMode: access-permission=WRITEExtendedSFDRole0x03ExtendedSession, data-identifier=KnockoutTestMode, write-class=DiagnosticWriteDataByIdentifierClass  # Write_Knockout_test_mode
package /ZeC/DataIdentifiers/CalibrationData/Productionmode_deactivation_distance
  diagnostic data identifier ProductionmodeDeactivationDistance: id=0x0e40, represents-vin=false  # Productionmode_deactivation_distance
    diagnostic-parameter bit-offset=0:
      diagnostic data element CalibrationData_0x0e40_Productionmode_deactivation_distance_Deactivation_distance: base-type=uint8  # Parameters: Deactivation_distance
  diagnostic read data by identifier ReadProductionmodeDeactivationDistance: access-permission=READ0x01DefaultSession0x03ExtendedSession, data-identifier=ProductionmodeDeactivationDistance, read-class=DiagnosticReadDataByIdentifierClass  # Read_Productionmode_deactivation_distance
  diagnostic write data by identifier WriteProductionmodeDeactivationDistance: access-permission=WRITEProductionSFDRole0x03ExtendedSession, data-identifier=ProductionmodeDeactivationDistance, write-class=DiagnosticWriteDataByIdentifierClass  # Write_Productionmode_deactivation_distance
