[part 10 of 19: packages /ZeC/DTC/DTC/DB_CANFD_10_No_Communication to /ZeC/DTC/DTC/LIN_3_Slave_13_NoCommunication]
AUTOSAR XML (schema 00047)
package /ZeC/DTC/DTC/DB_CANFD_10_No_Communication
  diagnostic trouble code uds DB_CANFD_10_No_Communication: dtc-props=Dtc_Props_14158306, uds-dtc-value=0x032a02
  diagnostic event EventDBCANFD10NoCommunication: aging-allowed=true, event-kind=SWC, prestorage-freeze-frame=false  # Event_DB_CANFD_10_No_Communication
  diagnostic event to trouble code uds mapping EventDtcMapDBCANFD10NoCommunication: diagnostic-event=EventDBCANFD10NoCommunication, trouble-code-uds=DB_CANFD_10_No_Communication  # Event_Dtc_Map_DB_CANFD_10_No_Communication
  diagnostic event to operation cycle mapping EventOperCycleMapDBCANFD10NoCommunication: diagnostic-event=EventDBCANFD10NoCommunication, operation-cycle=DefaultOperationCycle  # Event_Oper_Cycle_Map_DB_CANFD_10_No_Communication
  diagnostic event to debounce algorithm mapping EventDebounceMapDBCANFD10NoCommunication: debounce-algorithm=counter_based, diagnostic-event=EventDBCANFD10NoCommunication  # EventDebounceMap_DB_CANFD_10_No_Communication
package /ZeC/DTC/DTC/DB_CANFD_10_Defect
  diagnostic trouble code uds DB_CANFD_10_Defect: dtc-props=Dtc_Props_14158306, uds-dtc-value=0x032a01
  diagnostic event EventDBCANFD10Defect: aging-allowed=true, event-kind=SWC, prestorage-freeze-frame=false  # Event_DB_CANFD_10_Defect
  diagnostic event to trouble code uds mapping EventDtcMapDBCANFD10Defect: diagnostic-event=EventDBCANFD10Defect, trouble-code-uds=DB_CANFD_10_Defect  # Event_Dtc_Map_DB_CANFD_10_Defect
  diagnostic event to operation cycle mapping EventOperCycleMapDBCANFD10Defect: diagnostic-event=EventDBCANFD10Defect, operation-cycle=DefaultOperationCycle  # Event_Oper_Cycle_Map_DB_CANFD_10_Defect
  diagnostic event to debounce algorithm mapping EventDebounceMapDBCANFD10Defect: debounce-algorithm=counter_based, diagnostic-event=EventDBCANFD10Defect  # EventDebounceMap_DB_CANFD_10_Defect
package /ZeC/DTC/DTC/CAN_10_ECU_6_No_Communication
  diagnostic trouble code uds CAN_10_ECU_6_No_Communication: dtc-props=Dtc_Props_14158306, uds-dtc-value=0x032a10
  diagnostic event EventCAN10ECU6NoCommunication: aging-allowed=true, event-kind=SWC, prestorage-freeze-frame=false  # Event_CAN_10_ECU_6_No_Communication
  diagnostic event to trouble code uds mapping EventDtcMapCAN10ECU6NoCommunication: diagnostic-event=EventCAN10ECU6NoCommunication, trouble-code-uds=CAN_10_ECU_6_No_Communication  # Event_Dtc_Map_CAN_10_ECU_6_No_Communication
  diagnostic event to operation cycle mapping EventOperCycleMapCAN10ECU6NoCommunication: diagnostic-event=EventCAN10ECU6NoCommunication, operation-cycle=DefaultOperationCycle  # Event_Oper_Cycle_Map_CAN_10_ECU_6_No_Communication
  diagnostic event to debounce algorithm mapping EventDebounceMapCAN10ECU6NoCommunication: debounce-algorithm=counter_based, diagnostic-event=EventCAN10ECU6NoCommunication  # EventDebounceMap_CAN_10_ECU_6_No_Communication
package /ZeC/DTC/DTC/LIN_7_Slave_3_NoCommunication
  diagnostic trouble code uds LIN_7_Slave_3_NoCommunication: dtc-props=Dtc_Props_358996c7, uds-dtc-value=0x030703  # LIN 7 Slave 3_NoCommunication
  diagnostic event EventLIN7Slave3NoCommunication: aging-allowed=true, event-kind=SWC, prestorage-freeze-frame=false  # Event_LIN 7 Slave 3_NoCommunication
  diagnostic event to trouble code uds mapping EventDtcMapLIN7Slave3NoCommunication: diagnostic-event=EventLIN7Slave3NoCommunication, trouble-code-uds=LIN_7_Slave_3_NoCommunication  # Event_Dtc_Map_LIN 7 Slave 3_NoCommunication
  diagnostic event to operation cycle mapping EventOperCycleMapLIN7Slave3NoCommunication: diagnostic-event=EventLIN7Slave3NoCommunication, operation-cycle=DefaultOperationCycle  # Event_Oper_Cycle_Map_LIN 7 Slave 3_NoCommunication
  diagnostic event to debounce algorithm mapping EventDebounceMapLIN7Slave3NoCommunication: debounce-algorithm=counter_based, diagnostic-event=EventLIN7Slave3NoCommunication  # EventDebounceMap_LIN 7 Slave 3_NoCommunication
package /ZeC/DTC/DTC/Power_Path_071_Over_Temperature_Failure
  diagnostic trouble code uds Power_Path_071_Over_Temperature_Failure: dtc-props=Dtc_Props_8718746b, uds-dtc-value=0x005747
  diagnostic event EventPowerPath071OverTemperatureFailure: aging-allowed=true, event-kind=SWC, prestorage-freeze-frame=false  # Event_Power_Path_071_Over_Temperature_Failure
  diagnostic event to trouble code uds mapping EventDtcMapPowerPath071OverTemperatureFailure: diagnostic-event=EventPowerPath071OverTemperatureFailure, trouble-code-uds=Power_Path_071_Over_Temperature_Failure  # Event_Dtc_Map_Power_Path_071_Over_Temperature_Failure
  diagnostic event to operation cycle mapping EventOperCycleMapPowerPath071OverTemperatureFailure: diagnostic-event=EventPowerPath071OverTemperatureFailure, operation-cycle=DefaultOperationCycle  # Event_Oper_Cycle_Map_Power_Path_071_Over_Temperature_Failure
  diagnostic event to debounce algorithm mapping EventDebounceMapPowerPath071OverTemperatureFailure: debounce-algorithm=time_based, diagnostic-event=EventPowerPath071OverTemperatureFailure  # EventDebounceMap_Power_Path_071_Over_Temperature_Failure
package /ZeC/DTC/DTC/LIN_7_Slave_3_Defect
  diagnostic trouble code uds LIN_7_Slave_3_Defect: dtc-props=Dtc_Props_358996c7, uds-dtc-value=0x030702  # LIN 7 Slave 3_Defect
  diagnostic event EventLIN7Slave3Defect: aging-allowed=true, event-kind=SWC, prestorage-freeze-frame=false  # Event_LIN 7 Slave 3_Defect
  diagnostic event to trouble code uds mapping EventDtcMapLIN7Slave3Defect: diagnostic-event=EventLIN7Slave3Defect, trouble-code-uds=LIN_7_Slave_3_Defect  # Event_Dtc_Map_LIN 7 Slave 3_Defect
  diagnostic event to operation cycle mapping EventOperCycleMapLIN7Slave3Defect: diagnostic-event=EventLIN7Slave3Defect, operation-cycle=DefaultOperationCycle  # Event_Oper_Cycle_Map_LIN 7 Slave 3_Defect
  diagnostic event to debounce algorithm mapping EventDebounceMapLIN7Slave3Defect: debounce-algorithm=counter_based, diagnostic-event=EventLIN7Slave3Defect  # EventDebounceMap_LIN 7 Slave 3_Defect
package /ZeC/DTC/DTC/Power_Path_070_Over_Temperature_Failure
  diagnostic trouble code uds Power_Path_070_Over_Temperature_Failure: dtc-props=Dtc_Props_c1017e51, uds-dtc-value=0x005746
  diagnostic event EventPowerPath070OverTemperatureFailure: aging-allowed=true, event-kind=SWC, prestorage-freeze-frame=false  # Event_Power_Path_070_Over_Temperature_Failure
  diagnostic event to trouble code uds mapping EventDtcMapPowerPath070OverTemperatureFailure: diagnostic-event=EventPowerPath070OverTemperatureFailure, trouble-code-uds=Power_Path_070_Over_Temperature_Failure  # Event_Dtc_Map_Power_Path_070_Over_Temperature_Failure
  diagnostic event to operation cycle mapping EventOperCycleMapPowerPath070OverTemperatureFailure: diagnostic-event=EventPowerPath070OverTemperatureFailure, operation-cycle=DefaultOperationCycle  # Event_Oper_Cycle_Map_Power_Path_070_Over_Temperature_Failure
  diagnostic event to debounce algorithm mapping EventDebounceMapPowerPath070OverTemperatureFailure: debounce-algorithm=time_based, diagnostic-event=EventPowerPath070OverTemperatureFailure  # EventDebounceMap_Power_Path_070_Over_Temperature_Failure
package /ZeC/DTC/DTC/LIN_7_Slave_4_NoCommunication
  diagnostic trouble code uds LIN_7_Slave_4_NoCommunication: dtc-props=Dtc_Props_358996c7, uds-dtc-value=0x030705  # LIN 7 Slave 4_NoCommunication
  diagnostic event EventLIN7Slave4NoCommunication: aging-allowed=true, event-kind=SWC, prestorage-freeze-frame=false  # Event_LIN 7 Slave 4_NoCommunication
  diagnostic event to trouble code uds mapping EventDtcMapLIN7Slave4NoCommunication: diagnostic-event=EventLIN7Slave4NoCommunication, trouble-code-uds=LIN_7_Slave_4_NoCommunication  # Event_Dtc_Map_LIN 7 Slave 4_NoCommunication
  diagnostic event to operation cycle mapping EventOperCycleMapLIN7Slave4NoCommunication: diagnostic-event=EventLIN7Slave4NoCommunication, operation-cycle=DefaultOperationCycle  # Event_Oper_Cycle_Map_LIN 7 Slave 4_NoCommunication
  diagnostic event to debounce algorithm mapping EventDebounceMapLIN7Slave4NoCommunication: debounce-algorithm=counter_based, diagnostic-event=EventLIN7Slave4NoCommunication  # EventDebounceMap_LIN 7 Slave 4_NoCommunication
package /ZeC/DTC/DTC/Power_Path_073_Over_Temperature_Failure
  diagnostic trouble code uds Power_Path_073_Over_Temperature_Failure: dtc-props=Dtc_Props_956415a5, uds-dtc-value=0x005749
  diagnostic event EventPowerPath073OverTemperatureFailure: aging-allowed=true, event-kind=SWC, prestorage-freeze-frame=false  # Event_Power_Path_073_Over_Temperature_Failure
  diagnostic event to trouble code uds mapping EventDtcMapPowerPath073OverTemperatureFailure: diagnostic-event=EventPowerPath073OverTemperatureFailure, trouble-code-uds=Power_Path_073_Over_Temperature_Failure  # Event_Dtc_Map_Power_Path_073_Over_Temperature_Failure
  diagnostic event to operation cycle mapping EventOperCycleMapPowerPath073OverTemperatureFailure: diagnostic-event=EventPowerPath073OverTemperatureFailure, operation-cycle=DefaultOperationCycle  # Event_Oper_Cycle_Map_Power_Path_073_Over_Temperature_Failure
  diagnostic event to debounce algorithm mapping EventDebounceMapPowerPath073OverTemperatureFailure: debounce-algorithm=time_based, diagnostic-event=EventPowerPath073OverTemperatureFailure  # EventDebounceMap_Power_Path_073_Over_Temperature_Failure
package /ZeC/DTC/DTC/LIN_7_Slave_4_Defect
  diagnostic trouble code uds LIN_7_Slave_4_Defect: dtc-props=Dtc_Props_358996c7, uds-dtc-value=0x030704  # LIN 7 Slave 4_Defect
  diagnostic event EventLIN7Slave4Defect: aging-allowed=true, event-kind=SWC, prestorage-freeze-frame=false  # Event_LIN 7 Slave 4_Defect
  diagnostic event to trouble code uds mapping EventDtcMapLIN7Slave4Defect: diagnostic-event=EventLIN7Slave4Defect, trouble-code-uds=LIN_7_Slave_4_Defect  # Event_Dtc_Map_LIN 7 Slave 4_Defect
  diagnostic event to operation cycle mapping EventOperCycleMapLIN7Slave4Defect: diagnostic-event=EventLIN7Slave4Defect, operation-cycle=DefaultOperationCycle  # Event_Oper_Cycle_Map_LIN 7 Slave 4_Defect
  diagnostic event to debounce algorithm mapping EventDebounceMapLIN7Slave4Defect: debounce-algorithm=counter_based, diagnostic-event=EventLIN7Slave4Defect  # EventDebounceMap_LIN 7 Slave 4_Defect
package /ZeC/DTC/DTC/Power_Path_072_Over_Temperature_Failure
  diagnostic trouble code uds Power_Path_072_Over_Temperature_Failure: dtc-props=Dtc_Props_d37d1f9f, uds-dtc-value=0x005748
  diagnostic event EventPowerPath072OverTemperatureFailure: aging-allowed=true, event-kind=SWC, prestorage-freeze-frame=false  # Event_Power_Path_072_Over_Temperature_Failure
  diagnostic event to trouble code uds mapping EventDtcMapPowerPath072OverTemperatureFailure: diagnostic-event=EventPowerPath072OverTemperatureFailure, trouble-code-uds=Power_Path_072_Over_Temperature_Failure  # Event_Dtc_Map_Power_Path_072_Over_Temperature_Failure
  diagnostic event to operation cycle mapping EventOperCycleMapPowerPath072OverTemperatureFailure: diagnostic-event=EventPowerPath072OverTemperatureFailure, operation-cycle=DefaultOperationCycle  # Event_Oper_Cycle_Map_Power_Path_072_Over_Temperature_Failure
  diagnostic event to debounce algorithm mapping EventDebounceMapPowerPath072OverTemperatureFailure: debounce-algorithm=time_based, diagnostic-event=EventPowerPath072OverTemperatureFailure  # EventDebounceMap_Power_Path_072_Over_Temperature_Failure
package /ZeC/DTC/DTC/Power_Path_067_Over_Temperature_Failure
  diagnostic trouble code uds Power_Path_067_Over_Temperature_Failure: dtc-props=Dtc_Props_440d5ac2, uds-dtc-value=0x005743
  diagnostic event EventPowerPath067OverTemperatureFailure: aging-allowed=true, event-kind=SWC, prestorage-freeze-frame=false  # Event_Power_Path_067_Over_Temperature_Failure
  diagnostic event to trouble code uds mapping EventDtcMapPowerPath067OverTemperatureFailure: diagnostic-event=EventPowerPath067OverTemperatureFailure, trouble-code-uds=Power_Path_067_Over_Temperature_Failure  # Event_Dtc_Map_Power_Path_067_Over_Temperature_Failure
  diagnostic event to operation cycle mapping EventOperCycleMapPowerPath067OverTemperatureFailure: diagnostic-event=EventPowerPath067OverTemperatureFailure, operation-cycle=DefaultOperationCycle  # Event_Oper_Cycle_Map_Power_Path_067_Over_Temperature_Failure
  diagnostic event to debounce algorithm mapping EventDebounceMapPowerPath067OverTemperatureFailure: debounce-algorithm=time_based, diagnostic-event=EventPowerPath067OverTemperatureFailure  # EventDebounceMap_Power_Path_067_Over_Temperature_Failure
package /ZeC/DTC/DTC/Power_Path_066_Over_Temperature_Failure
  diagnostic trouble code uds Power_Path_066_Over_Temperature_Failure: dtc-props=Dtc_Props_21450f8, uds-dtc-value=0x005742
  diagnostic event EventPowerPath066OverTemperatureFailure: aging-allowed=true, event-kind=SWC, prestorage-freeze-frame=false  # Event_Power_Path_066_Over_Temperature_Failure
  diagnostic event to trouble code uds mapping EventDtcMapPowerPath066OverTemperatureFailure: diagnostic-event=EventPowerPath066OverTemperatureFailure, trouble-code-uds=Power_Path_066_Over_Temperature_Failure  # Event_Dtc_Map_Power_Path_066_Over_Temperature_Failure
  diagnostic event to operation cycle mapping EventOperCycleMapPowerPath066OverTemperatureFailure: diagnostic-event=EventPowerPath066OverTemperatureFailure, operation-cycle=DefaultOperationCycle  # Event_Oper_Cycle_Map_Power_Path_066_Over_Temperature_Failure
  diagnostic event to debounce algorithm mapping EventDebounceMapPowerPath066OverTemperatureFailure: debounce-algorithm=time_based, diagnostic-event=EventPowerPath066OverTemperatureFailure  # EventDebounceMap_Power_Path_066_Over_Temperature_Failure
package /ZeC/DTC/DTC/LIN_7_Slave_2_NoCommunication
  diagnostic trouble code uds LIN_7_Slave_2_NoCommunication: dtc-props=Dtc_Props_358996c7, uds-dtc-value=0x030701  # LIN 7 Slave 2_NoCommunication
  diagnostic event EventLIN7Slave2NoCommunication: aging-allowed=true, event-kind=SWC, prestorage-freeze-frame=false  # Event_LIN 7 Slave 2_NoCommunication
  diagnostic event to trouble code uds mapping EventDtcMapLIN7Slave2NoCommunication: diagnostic-event=EventLIN7Slave2NoCommunication, trouble-code-uds=LIN_7_Slave_2_NoCommunication  # Event_Dtc_Map_LIN 7 Slave 2_NoCommunication
  diagnostic event to operation cycle mapping EventOperCycleMapLIN7Slave2NoCommunication: diagnostic-event=EventLIN7Slave2NoCommunication, operation-cycle=DefaultOperationCycle  # Event_Oper_Cycle_Map_LIN 7 Slave 2_NoCommunication
  diagnostic event to debounce algorithm mapping EventDebounceMapLIN7Slave2NoCommunication: debounce-algorithm=counter_based, diagnostic-event=EventLIN7Slave2NoCommunication  # EventDebounceMap_LIN 7 Slave 2_NoCommunication
package /ZeC/DTC/DTC/Power_Path_069_Over_Temperature_Failure
  diagnostic trouble code uds Power_Path_069_Over_Temperature_Failure: dtc-props=Dtc_Props_b2a601f, uds-dtc-value=0x005745
  diagnostic event EventPowerPath069OverTemperatureFailure: aging-allowed=true, event-kind=SWC, prestorage-freeze-frame=false  # Event_Power_Path_069_Over_Temperature_Failure
  diagnostic event to trouble code uds mapping EventDtcMapPowerPath069OverTemperatureFailure: diagnostic-event=EventPowerPath069OverTemperatureFailure, trouble-code-uds=Power_Path_069_Over_Temperature_Failure  # Event_Dtc_Map_Power_Path_069_Over_Temperature_Failure
  diagnostic event to operation cycle mapping EventOperCycleMapPowerPath069OverTemperatureFailure: diagnostic-event=EventPowerPath069OverTemperatureFailure, operation-cycle=DefaultOperationCycle  # Event_Oper_Cycle_Map_Power_Path_069_Over_Temperature_Failure
  diagnostic event to debounce algorithm mapping EventDebounceMapPowerPath069OverTemperatureFailure: debounce-algorithm=time_based, diagnostic-event=EventPowerPath069OverTemperatureFailure  # EventDebounceMap_Power_Path_069_Over_Temperature_Failure
package /ZeC/DTC/DTC/Power_Path_068_Over_Temperature_Failure
  diagnostic trouble code uds Power_Path_068_Over_Temperature_Failure: dtc-props=Dtc_Props_4d336a25, uds-dtc-value=0x005744
  diagnostic event EventPowerPath068OverTemperatureFailure: aging-allowed=true, event-kind=SWC, prestorage-freeze-frame=false  # Event_Power_Path_068_Over_Temperature_Failure
  diagnostic event to trouble code uds mapping EventDtcMapPowerPath068OverTemperatureFailure: diagnostic-event=EventPowerPath068OverTemperatureFailure, trouble-code-uds=Power_Path_068_Over_Temperature_Failure  # Event_Dtc_Map_Power_Path_068_Over_Temperature_Failure
  diagnostic event to operation cycle mapping EventOperCycleMapPowerPath068OverTemperatureFailure: diagnostic-event=EventPowerPath068OverTemperatureFailure, operation-cycle=DefaultOperationCycle  # Event_Oper_Cycle_Map_Power_Path_068_Over_Temperature_Failure
  diagnostic event to debounce algorithm mapping EventDebounceMapPowerPath068OverTemperatureFailure: debounce-algorithm=time_based, diagnostic-event=EventPowerPath068OverTemperatureFailure  # EventDebounceMap_Power_Path_068_Over_Temperature_Failure
package /ZeC/DTC/DTC/Power_Path_074_Over_Temperature_Failure
  diagnostic trouble code uds Power_Path_074_Over_Temperature_Failure: dtc-props=Dtc_Props_f5c02acb, uds-dtc-value=0x00574a
  diagnostic event EventPowerPath074OverTemperatureFailure: aging-allowed=true, event-kind=SWC, prestorage-freeze-frame=false  # Event_Power_Path_074_Over_Temperature_Failure
  diagnostic event to trouble code uds mapping EventDtcMapPowerPath074OverTemperatureFailure: diagnostic-event=EventPowerPath074OverTemperatureFailure, trouble-code-uds=Power_Path_074_Over_Temperature_Failure  # Event_Dtc_Map_Power_Path_074_Over_Temperature_Failure
  diagnostic event to operation cycle mapping EventOperCycleMapPowerPath074OverTemperatureFailure: diagnostic-event=EventPowerPath074OverTemperatureFailure, operation-cycle=DefaultOperationCycle  # Event_Oper_Cycle_Map_Power_Path_074_Over_Temperature_Failure
  diagnostic event to debounce algorithm mapping EventDebounceMapPowerPath074OverTemperatureFailure: debounce-algorithm=time_based, diagnostic-event=EventPowerPath074OverTemperatureFailure  # EventDebounceMap_Power_Path_074_Over_Temperature_Failure
package /ZeC/DTC/DTC/LIN_7_Slave_8_Defect
  diagnostic trouble code uds LIN_7_Slave_8_Defect: dtc-props=Dtc_Props_358996c7, uds-dtc-value=0x03070c  # LIN 7 Slave 8_Defect
  diagnostic event EventLIN7Slave8Defect: aging-allowed=true, event-kind=SWC, prestorage-freeze-frame=false  # Event_LIN 7 Slave 8_Defect
  diagnostic event to trouble code uds mapping EventDtcMapLIN7Slave8Defect: diagnostic-event=EventLIN7Slave8Defect, trouble-code-uds=LIN_7_Slave_8_Defect  # Event_Dtc_Map_LIN 7 Slave 8_Defect
  diagnostic event to operation cycle mapping EventOperCycleMapLIN7Slave8Defect: diagnostic-event=EventLIN7Slave8Defect, operation-cycle=DefaultOperationCycle  # Event_Oper_Cycle_Map_LIN 7 Slave 8_Defect
  diagnostic event to debounce algorithm mapping EventDebounceMapLIN7Slave8Defect: debounce-algorithm=counter_based, diagnostic-event=EventLIN7Slave8Defect  # EventDebounceMap_LIN 7 Slave 8_Defect
package /ZeC/DTC/DTC/LIN_7_Slave_7_NoCommunication
  diagnostic trouble code uds LIN_7_Slave_7_NoCommunication: dtc-props=Dtc_Props_358996c7, uds-dtc-value=0x03070b  # LIN 7 Slave 7_NoCommunication
  diagnostic event EventLIN7Slave7NoCommunication: aging-allowed=true, event-kind=SWC, prestorage-freeze-frame=false  # Event_LIN 7 Slave 7_NoCommunication
  diagnostic event to trouble code uds mapping EventDtcMapLIN7Slave7NoCommunication: diagnostic-event=EventLIN7Slave7NoCommunication, trouble-code-uds=LIN_7_Slave_7_NoCommunication  # Event_Dtc_Map_LIN 7 Slave 7_NoCommunication
  diagnostic event to operation cycle mapping EventOperCycleMapLIN7Slave7NoCommunication: diagnostic-event=EventLIN7Slave7NoCommunication, operation-cycle=DefaultOperationCycle  # Event_Oper_Cycle_Map_LIN 7 Slave 7_NoCommunication
  diagnostic event to debounce algorithm mapping EventDebounceMapLIN7Slave7NoCommunication: debounce-algorithm=counter_based, diagnostic-event=EventLIN7Slave7NoCommunication  # EventDebounceMap_LIN 7 Slave 7_NoCommunication
package /ZeC/DTC/DTC/Power_Path_079_Over_Temperature_Failure
  diagnostic trouble code uds Power_Path_079_Over_Temperature_Failure: dtc-props=Dtc_Props_fcfe1a2c, uds-dtc-value=0x00574f
  diagnostic event EventPowerPath079OverTemperatureFailure: aging-allowed=true, event-kind=SWC, prestorage-freeze-frame=false  # Event_Power_Path_079_Over_Temperature_Failure
  diagnostic event to trouble code uds mapping EventDtcMapPowerPath079OverTemperatureFailure: diagnostic-event=EventPowerPath079OverTemperatureFailure, trouble-code-uds=Power_Path_079_Over_Temperature_Failure  # Event_Dtc_Map_Power_Path_079_Over_Temperature_Failure
  diagnostic event to operation cycle mapping EventOperCycleMapPowerPath079OverTemperatureFailure: diagnostic-event=EventPowerPath079OverTemperatureFailure, operation-cycle=DefaultOperationCycle  # Event_Oper_Cycle_Map_Power_Path_079_Over_Temperature_Failure
  diagnostic event to debounce algorithm mapping EventDebounceMapPowerPath079OverTemperatureFailure: debounce-algorithm=time_based, diagnostic-event=EventPowerPath079OverTemperatureFailure  # EventDebounceMap_Power_Path_079_Over_Temperature_Failure
package /ZeC/DTC/DTC/LIN_7_Slave_9_Defect
  diagnostic trouble code uds LIN_7_Slave_9_Defect: dtc-props=Dtc_Props_358996c7, uds-dtc-value=0x03070e  # LIN 7 Slave 9_Defect
  diagnostic event EventLIN7Slave9Defect: aging-allowed=true, event-kind=SWC, prestorage-freeze-frame=false  # Event_LIN 7 Slave 9_Defect
  diagnostic event to trouble code uds mapping EventDtcMapLIN7Slave9Defect: diagnostic-event=EventLIN7Slave9Defect, trouble-code-uds=LIN_7_Slave_9_Defect  # Event_Dtc_Map_LIN 7 Slave 9_Defect
  diagnostic event to operation cycle mapping EventOperCycleMapLIN7Slave9Defect: diagnostic-event=EventLIN7Slave9Defect, operation-cycle=DefaultOperationCycle  # Event_Oper_Cycle_Map_LIN 7 Slave 9_Defect
  diagnostic event to debounce algorithm mapping EventDebounceMapLIN7Slave9Defect: debounce-algorithm=counter_based, diagnostic-event=EventLIN7Slave9Defect  # EventDebounceMap_LIN 7 Slave 9_Defect
package /ZeC/DTC/DTC/LIN_7_Slave_8_NoCommunication
  diagnostic trouble code uds LIN_7_Slave_8_NoCommunication: dtc-props=Dtc_Props_358996c7, uds-dtc-value=0x03070d  # LIN 7 Slave 8_NoCommunication
  diagnostic event EventLIN7Slave8NoCommunication: aging-allowed=true, event-kind=SWC, prestorage-freeze-frame=false  # Event_LIN 7 Slave 8_NoCommunication
  diagnostic event to trouble code uds mapping EventDtcMapLIN7Slave8NoCommunication: diagnostic-event=EventLIN7Slave8NoCommunication, trouble-code-uds=LIN_7_Slave_8_NoCommunication  # Event_Dtc_Map_LIN 7 Slave 8_NoCommunication
  diagnostic event to operation cycle mapping EventOperCycleMapLIN7Slave8NoCommunication: diagnostic-event=EventLIN7Slave8NoCommunication, operation-cycle=DefaultOperationCycle  # Event_Oper_Cycle_Map_LIN 7 Slave 8_NoCommunication
  diagnostic event to debounce algorithm mapping EventDebounceMapLIN7Slave8NoCommunication: debounce-algorithm=counter_based, diagnostic-event=EventLIN7Slave8NoCommunication  # EventDebounceMap_LIN 7 Slave 8_NoCommunication
package /ZeC/DTC/DTC/Power_Path_076_Over_Temperature_Failure
  diagnostic trouble code uds Power_Path_076_Over_Temperature_Failure: dtc-props=Dtc_Props_79f23ebf, uds-dtc-value=0x00574c
  diagnostic event EventPowerPath076OverTemperatureFailure: aging-allowed=true, event-kind=SWC, prestorage-freeze-frame=false  # Event_Power_Path_076_Over_Temperature_Failure
  diagnostic event to trouble code uds mapping EventDtcMapPowerPath076OverTemperatureFailure: diagnostic-event=EventPowerPath076OverTemperatureFailure, trouble-code-uds=Power_Path_076_Over_Temperature_Failure  # Event_Dtc_Map_Power_Path_076_Over_Temperature_Failure
  diagnostic event to operation cycle mapping EventOperCycleMapPowerPath076OverTemperatureFailure: diagnostic-event=EventPowerPath076OverTemperatureFailure, operation-cycle=DefaultOperationCycle  # Event_Oper_Cycle_Map_Power_Path_076_Over_Temperature_Failure
  diagnostic event to debounce algorithm mapping EventDebounceMapPowerPath076OverTemperatureFailure: debounce-algorithm=time_based, diagnostic-event=EventPowerPath076OverTemperatureFailure  # EventDebounceMap_Power_Path_076_Over_Temperature_Failure
package /ZeC/DTC/DTC/Power_Path_075_Over_Temperature_Failure
  diagnostic trouble code uds Power_Path_075_Over_Temperature_Failure: dtc-props=Dtc_Props_3feb3485, uds-dtc-value=0x00574b
  diagnostic event EventPowerPath075OverTemperatureFailure: aging-allowed=true, event-kind=SWC, prestorage-freeze-frame=false  # Event_Power_Path_075_Over_Temperature_Failure
  diagnostic event to trouble code uds mapping EventDtcMapPowerPath075OverTemperatureFailure: diagnostic-event=EventPowerPath075OverTemperatureFailure, trouble-code-uds=Power_Path_075_Over_Temperature_Failure  # Event_Dtc_Map_Power_Path_075_Over_Temperature_Failure
  diagnostic event to operation cycle mapping EventOperCycleMapPowerPath075OverTemperatureFailure: diagnostic-event=EventPowerPath075OverTemperatureFailure, operation-cycle=DefaultOperationCycle  # Event_Oper_Cycle_Map_Power_Path_075_Over_Temperature_Failure
  diagnostic event to debounce algorithm mapping EventDebounceMapPowerPath075OverTemperatureFailure: debounce-algorithm=time_based, diagnostic-event=EventPowerPath075OverTemperatureFailure  # EventDebounceMap_Power_Path_075_Over_Temperature_Failure
package /ZeC/DTC/DTC/LIN_7_Slave_7_Defect
  diagnostic trouble code uds LIN_7_Slave_7_Defect: dtc-props=Dtc_Props_358996c7, uds-dtc-value=0x03070a  # LIN 7 Slave 7_Defect
  diagnostic event EventLIN7Slave7Defect: aging-allowed=true, event-kind=SWC, prestorage-freeze-frame=false  # Event_LIN 7 Slave 7_Defect
  diagnostic event to trouble code uds mapping EventDtcMapLIN7Slave7Defect: diagnostic-event=EventLIN7Slave7Defect, trouble-code-uds=LIN_7_Slave_7_Defect  # Event_Dtc_Map_LIN 7 Slave 7_Defect
  diagnostic event to operation cycle mapping EventOperCycleMapLIN7Slave7Defect: diagnostic-event=EventLIN7Slave7Defect, operation-cycle=DefaultOperationCycle  # Event_Oper_Cycle_Map_LIN 7 Slave 7_Defect
  diagnostic event to debounce algorithm mapping EventDebounceMapLIN7Slave7Defect: debounce-algorithm=counter_based, diagnostic-event=EventLIN7Slave7Defect  # EventDebounceMap_LIN 7 Slave 7_Defect
package /ZeC/DTC/DTC/Power_Path_078_Over_Temperature_Failure
  diagnostic trouble code uds Power_Path_078_Over_Temperature_Failure: dtc-props=Dtc_Props_36d50462, uds-dtc-value=0x00574e
  diagnostic event EventPowerPath078OverTemperatureFailure: aging-allowed=true, event-kind=SWC, prestorage-freeze-frame=false  # Event_Power_Path_078_Over_Temperature_Failure
  diagnostic event to trouble code uds mapping EventDtcMapPowerPath078OverTemperatureFailure: diagnostic-event=EventPowerPath078OverTemperatureFailure, trouble-code-uds=Power_Path_078_Over_Temperature_Failure  # Event_Dtc_Map_Power_Path_078_Over_Temperature_Failure
  diagnostic event to operation cycle mapping EventOperCycleMapPowerPath078OverTemperatureFailure: diagnostic-event=EventPowerPath078OverTemperatureFailure, operation-cycle=DefaultOperationCycle  # Event_Oper_Cycle_Map_Power_Path_078_Over_Temperature_Failure
  diagnostic event to debounce algorithm mapping EventDebounceMapPowerPath078OverTemperatureFailure: debounce-algorithm=time_based, diagnostic-event=EventPowerPath078OverTemperatureFailure  # EventDebounceMap_Power_Path_078_Over_Temperature_Failure
package /ZeC/DTC/DTC/Power_Path_077_Over_Temperature_Failure
  diagnostic trouble code uds Power_Path_077_Over_Temperature_Failure: dtc-props=Dtc_Props_70cc0e58, uds-dtc-value=0x00574d
  diagnostic event EventPowerPath077OverTemperatureFailure: aging-allowed=true, event-kind=SWC, prestorage-freeze-frame=false  # Event_Power_Path_077_Over_Temperature_Failure
  diagnostic event to trouble code uds mapping EventDtcMapPowerPath077OverTemperatureFailure: diagnostic-event=EventPowerPath077OverTemperatureFailure, trouble-code-uds=Power_Path_077_Over_Temperature_Failure  # Event_Dtc_Map_Power_Path_077_Over_Temperature_Failure
  diagnostic event to operation cycle mapping EventOperCycleMapPowerPath077OverTemperatureFailure: diagnostic-event=EventPowerPath077OverTemperatureFailure, operation-cycle=DefaultOperationCycle  # Event_Oper_Cycle_Map_Power_Path_077_Over_Temperature_Failure
  diagnostic event to debounce algorithm mapping EventDebounceMapPowerPath077OverTemperatureFailure: debounce-algorithm=time_based, diagnostic-event=EventPowerPath077OverTemperatureFailure  # EventDebounceMap_Power_Path_077_Over_Temperature_Failure
package /ZeC/DTC/DTC/Power_Path_080_Over_Temperature_Failure
  diagnostic trouble code uds Power_Path_080_Over_Temperature_Failure: dtc-props=Dtc_Props_486c8434, uds-dtc-value=0x005750
  diagnostic event EventPowerPath080OverTemperatureFailure: aging-allowed=true, event-kind=SWC, prestorage-freeze-frame=false  # Event_Power_Path_080_Over_Temperature_Failure
  diagnostic event to trouble code uds mapping EventDtcMapPowerPath080OverTemperatureFailure: diagnostic-event=EventPowerPath080OverTemperatureFailure, trouble-code-uds=Power_Path_080_Over_Temperature_Failure  # Event_Dtc_Map_Power_Path_080_Over_Temperature_Failure
  diagnostic event to operation cycle mapping EventOperCycleMapPowerPath080OverTemperatureFailure: diagnostic-event=EventPowerPath080OverTemperatureFailure, operation-cycle=DefaultOperationCycle  # Event_Oper_Cycle_Map_Power_Path_080_Over_Temperature_Failure
  diagnostic event to debounce algorithm mapping EventDebounceMapPowerPath080OverTemperatureFailure: debounce-algorithm=time_based, diagnostic-event=EventPowerPath080OverTemperatureFailure  # EventDebounceMap_Power_Path_080_Over_Temperature_Failure
package /ZeC/DTC/DTC/Power_Path_082_Over_Temperature_Failure
  diagnostic trouble code uds Power_Path_082_Over_Temperature_Failure: dtc-props=Dtc_Props_c45e9040, uds-dtc-value=0x005752
  diagnostic event EventPowerPath082OverTemperatureFailure: aging-allowed=true, event-kind=SWC, prestorage-freeze-frame=false  # Event_Power_Path_082_Over_Temperature_Failure
  diagnostic event to trouble code uds mapping EventDtcMapPowerPath082OverTemperatureFailure: diagnostic-event=EventPowerPath082OverTemperatureFailure, trouble-code-uds=Power_Path_082_Over_Temperature_Failure  # Event_Dtc_Map_Power_Path_082_Over_Temperature_Failure
  diagnostic event to operation cycle mapping EventOperCycleMapPowerPath082OverTemperatureFailure: diagnostic-event=EventPowerPath082OverTemperatureFailure, operation-cycle=DefaultOperationCycle  # Event_Oper_Cycle_Map_Power_Path_082_Over_Temperature_Failure
  diagnostic event to debounce algorithm mapping EventDebounceMapPowerPath082OverTemperatureFailure: debounce-algorithm=time_based, diagnostic-event=EventPowerPath082OverTemperatureFailure  # EventDebounceMap_Power_Path_082_Over_Temperature_Failure
package /ZeC/DTC/DTC/Power_Path_081_Over_Temperature_Failure
  diagnostic trouble code uds Power_Path_081_Over_Temperature_Failure: dtc-props=Dtc_Props_e758e0e, uds-dtc-value=0x005751
  diagnostic event EventPowerPath081OverTemperatureFailure: aging-allowed=true, event-kind=SWC, prestorage-freeze-frame=false  # Event_Power_Path_081_Over_Temperature_Failure
  diagnostic event to trouble code uds mapping EventDtcMapPowerPath081OverTemperatureFailure: diagnostic-event=EventPowerPath081OverTemperatureFailure, trouble-code-uds=Power_Path_081_Over_Temperature_Failure  # Event_Dtc_Map_Power_Path_081_Over_Temperature_Failure
  diagnostic event to operation cycle mapping EventOperCycleMapPowerPath081OverTemperatureFailure: diagnostic-event=EventPowerPath081OverTemperatureFailure, operation-cycle=DefaultOperationCycle  # Event_Oper_Cycle_Map_Power_Path_081_Over_Temperature_Failure
  diagnostic event to debounce algorithm mapping EventDebounceMapPowerPath081OverTemperatureFailure: debounce-algorithm=time_based, diagnostic-event=EventPowerPath081OverTemperatureFailure  # EventDebounceMap_Power_Path_081_Over_Temperature_Failure
package /ZeC/DTC/DTC/LIN_7_Slave_5_NoCommunication
  diagnostic trouble code uds LIN_7_Slave_5_NoCommunication: dtc-props=Dtc_Props_358996c7, uds-dtc-value=0x030707  # LIN 7 Slave 5_NoCommunication
  diagnostic event EventLIN7Slave5NoCommunication: aging-allowed=true, event-kind=SWC, prestorage-freeze-frame=false  # Event_LIN 7 Slave 5_NoCommunication
  diagnostic event to trouble code uds mapping EventDtcMapLIN7Slave5NoCommunication: diagnostic-event=EventLIN7Slave5NoCommunication, trouble-code-uds=LIN_7_Slave_5_NoCommunication  # Event_Dtc_Map_LIN 7 Slave 5_NoCommunication
  diagnostic event to operation cycle mapping EventOperCycleMapLIN7Slave5NoCommunication: diagnostic-event=EventLIN7Slave5NoCommunication, operation-cycle=DefaultOperationCycle  # Event_Oper_Cycle_Map_LIN 7 Slave 5_NoCommunication
  diagnostic event to debounce algorithm mapping EventDebounceMapLIN7Slave5NoCommunication: debounce-algorithm=counter_based, diagnostic-event=EventLIN7Slave5NoCommunication  # EventDebounceMap_LIN 7 Slave 5_NoCommunication
package /ZeC/DTC/DTC/LIN_7_Slave_5_Defect
  diagnostic trouble code uds LIN_7_Slave_5_Defect: dtc-props=Dtc_Props_358996c7, uds-dtc-value=0x030706  # LIN 7 Slave 5_Defect
  diagnostic event EventLIN7Slave5Defect: aging-allowed=true, event-kind=SWC, prestorage-freeze-frame=false  # Event_LIN 7 Slave 5_Defect
  diagnostic event to trouble code uds mapping EventDtcMapLIN7Slave5Defect: diagnostic-event=EventLIN7Slave5Defect, trouble-code-uds=LIN_7_Slave_5_Defect  # Event_Dtc_Map_LIN 7 Slave 5_Defect
  diagnostic event to operation cycle mapping EventOperCycleMapLIN7Slave5Defect: diagnostic-event=EventLIN7Slave5Defect, operation-cycle=DefaultOperationCycle  # Event_Oper_Cycle_Map_LIN 7 Slave 5_Defect
  diagnostic event to debounce algorithm mapping EventDebounceMapLIN7Slave5Defect: debounce-algorithm=counter_based, diagnostic-event=EventLIN7Slave5Defect  # EventDebounceMap_LIN 7 Slave 5_Defect
package /ZeC/DTC/DTC/LIN_7_Slave_6_NoCommunication
  diagnostic trouble code uds LIN_7_Slave_6_NoCommunication: dtc-props=Dtc_Props_358996c7, uds-dtc-value=0x030709  # LIN 7 Slave 6_NoCommunication
  diagnostic event EventLIN7Slave6NoCommunication: aging-allowed=true, event-kind=SWC, prestorage-freeze-frame=false  # Event_LIN 7 Slave 6_NoCommunication
  diagnostic event to trouble code uds mapping EventDtcMapLIN7Slave6NoCommunication: diagnostic-event=EventLIN7Slave6NoCommunication, trouble-code-uds=LIN_7_Slave_6_NoCommunication  # Event_Dtc_Map_LIN 7 Slave 6_NoCommunication
  diagnostic event to operation cycle mapping EventOperCycleMapLIN7Slave6NoCommunication: diagnostic-event=EventLIN7Slave6NoCommunication, operation-cycle=DefaultOperationCycle  # Event_Oper_Cycle_Map_LIN 7 Slave 6_NoCommunication
  diagnostic event to debounce algorithm mapping EventDebounceMapLIN7Slave6NoCommunication: debounce-algorithm=counter_based, diagnostic-event=EventLIN7Slave6NoCommunication  # EventDebounceMap_LIN 7 Slave 6_NoCommunication
package /ZeC/DTC/DTC/LIN_7_Slave_6_Defect
  diagnostic trouble code uds LIN_7_Slave_6_Defect: dtc-props=Dtc_Props_358996c7, uds-dtc-value=0x030708  # LIN 7 Slave 6_Defect
  diagnostic event EventLIN7Slave6Defect: aging-allowed=true, event-kind=SWC, prestorage-freeze-frame=false  # Event_LIN 7 Slave 6_Defect
  diagnostic event to trouble code uds mapping EventDtcMapLIN7Slave6Defect: diagnostic-event=EventLIN7Slave6Defect, trouble-code-uds=LIN_7_Slave_6_Defect  # Event_Dtc_Map_LIN 7 Slave 6_Defect
  diagnostic event to operation cycle mapping EventOperCycleMapLIN7Slave6Defect: diagnostic-event=EventLIN7Slave6Defect, operation-cycle=DefaultOperationCycle  # Event_Oper_Cycle_Map_LIN 7 Slave 6_Defect
  diagnostic event to debounce algorithm mapping EventDebounceMapLIN7Slave6Defect: debounce-algorithm=counter_based, diagnostic-event=EventLIN7Slave6Defect  # EventDebounceMap_LIN 7 Slave 6_Defect
package /ZeC/DTC/DTC/LIN_7_Slave_11_Defect
  diagnostic trouble code uds LIN_7_Slave_11_Defect: dtc-props=Dtc_Props_358996c7, uds-dtc-value=0x030714  # LIN 7 Slave 11_Defect
  diagnostic event EventLIN7Slave11Defect: aging-allowed=true, event-kind=SWC, prestorage-freeze-frame=false  # Event_LIN 7 Slave 11_Defect
  diagnostic event to trouble code uds mapping EventDtcMapLIN7Slave11Defect: diagnostic-event=EventLIN7Slave11Defect, trouble-code-uds=LIN_7_Slave_11_Defect  # Event_Dtc_Map_LIN 7 Slave 11_Defect
  diagnostic event to operation cycle mapping EventOperCycleMapLIN7Slave11Defect: diagnostic-event=EventLIN7Slave11Defect, operation-cycle=DefaultOperationCycle  # Event_Oper_Cycle_Map_LIN 7 Slave 11_Defect
  diagnostic event to debounce algorithm mapping EventDebounceMapLIN7Slave11Defect: debounce-algorithm=counter_based, diagnostic-event=EventLIN7Slave11Defect  # EventDebounceMap_LIN 7 Slave 11_Defect
package /ZeC/DTC/DTC/Power_Path_054_Over_Temperature_Failure
  diagnostic trouble code uds Power_Path_054_Over_Temperature_Failure: dtc-props=Dtc_Props_ff6637ba, uds-dtc-value=0x005736
  diagnostic event EventPowerPath054OverTemperatureFailure: aging-allowed=true, event-kind=SWC, prestorage-freeze-frame=false  # Event_Power_Path_054_Over_Temperature_Failure
  diagnostic event to trouble code uds mapping EventDtcMapPowerPath054OverTemperatureFailure: diagnostic-event=EventPowerPath054OverTemperatureFailure, trouble-code-uds=Power_Path_054_Over_Temperature_Failure  # Event_Dtc_Map_Power_Path_054_Over_Temperature_Failure
  diagnostic event to operation cycle mapping EventOperCycleMapPowerPath054OverTemperatureFailure: diagnostic-event=EventPowerPath054OverTemperatureFailure, operation-cycle=DefaultOperationCycle  # Event_Oper_Cycle_Map_Power_Path_054_Over_Temperature_Failure
  diagnostic event to debounce algorithm mapping EventDebounceMapPowerPath054OverTemperatureFailure: debounce-algorithm=time_based, diagnostic-event=EventPowerPath054OverTemperatureFailure  # EventDebounceMap_Power_Path_054_Over_Temperature_Failure
package /ZeC/DTC/DTC/LIN_7_Slave_10_NoCommunication
  diagnostic trouble code uds LIN_7_Slave_10_NoCommunication: dtc-props=Dtc_Props_358996c7, uds-dtc-value=0x030713  # LIN 7 Slave 10_NoCommunication
  diagnostic event EventLIN7Slave10NoCommunication: aging-allowed=true, event-kind=SWC, prestorage-freeze-frame=false  # Event_LIN 7 Slave 10_NoCommunication
  diagnostic event to trouble code uds mapping EventDtcMapLIN7Slave10NoCommunication: diagnostic-event=EventLIN7Slave10NoCommunication, trouble-code-uds=LIN_7_Slave_10_NoCommunication  # Event_Dtc_Map_LIN 7 Slave 10_NoCommunication
  diagnostic event to operation cycle mapping EventOperCycleMapLIN7Slave10NoCommunication: diagnostic-event=EventLIN7Slave10NoCommunication, operation-cycle=DefaultOperationCycle  # Event_Oper_Cycle_Map_LIN 7 Slave 10_NoCommunication
  diagnostic event to debounce algorithm mapping EventDebounceMapLIN7Slave10NoCommunication: debounce-algorithm=counter_based, diagnostic-event=EventLIN7Slave10NoCommunication  # EventDebounceMap_LIN 7 Slave 10_NoCommunication
package /ZeC/DTC/DTC/Power_Path_053_Over_Temperature_Failure
  diagnostic trouble code uds Power_Path_053_Over_Temperature_Failure: dtc-props=Dtc_Props_354d29f4, uds-dtc-value=0x005735
  diagnostic event EventPowerPath053OverTemperatureFailure: aging-allowed=true, event-kind=SWC, prestorage-freeze-frame=false  # Event_Power_Path_053_Over_Temperature_Failure
  diagnostic event to trouble code uds mapping EventDtcMapPowerPath053OverTemperatureFailure: diagnostic-event=EventPowerPath053OverTemperatureFailure, trouble-code-uds=Power_Path_053_Over_Temperature_Failure  # Event_Dtc_Map_Power_Path_053_Over_Temperature_Failure
  diagnostic event to operation cycle mapping EventOperCycleMapPowerPath053OverTemperatureFailure: diagnostic-event=EventPowerPath053OverTemperatureFailure, operation-cycle=DefaultOperationCycle  # Event_Oper_Cycle_Map_Power_Path_053_Over_Temperature_Failure
  diagnostic event to debounce algorithm mapping EventDebounceMapPowerPath053OverTemperatureFailure: debounce-algorithm=time_based, diagnostic-event=EventPowerPath053OverTemperatureFailure  # EventDebounceMap_Power_Path_053_Over_Temperature_Failure
package /ZeC/DTC/DTC/LIN_7_Slave_12_Defect
  diagnostic trouble code uds LIN_7_Slave_12_Defect: dtc-props=Dtc_Props_358996c7, uds-dtc-value=0x030716  # LIN 7 Slave 12_Defect
  diagnostic event EventLIN7Slave12Defect: aging-allowed=true, event-kind=SWC, prestorage-freeze-frame=false  # Event_LIN 7 Slave 12_Defect
  diagnostic event to trouble code uds mapping EventDtcMapLIN7Slave12Defect: diagnostic-event=EventLIN7Slave12Defect, trouble-code-uds=LIN_7_Slave_12_Defect  # Event_Dtc_Map_LIN 7 Slave 12_Defect
  diagnostic event to operation cycle mapping EventOperCycleMapLIN7Slave12Defect: diagnostic-event=EventLIN7Slave12Defect, operation-cycle=DefaultOperationCycle  # Event_Oper_Cycle_Map_LIN 7 Slave 12_Defect
  diagnostic event to debounce algorithm mapping EventDebounceMapLIN7Slave12Defect: debounce-algorithm=counter_based, diagnostic-event=EventLIN7Slave12Defect  # EventDebounceMap_LIN 7 Slave 12_Defect
package /ZeC/DTC/DTC/Power_Path_056_Over_Temperature_Failure
  diagnostic trouble code uds Power_Path_056_Over_Temperature_Failure: dtc-props=Dtc_Props_ed1a5674, uds-dtc-value=0x005738
  diagnostic event EventPowerPath056OverTemperatureFailure: aging-allowed=true, event-kind=SWC, prestorage-freeze-frame=false  # Event_Power_Path_056_Over_Temperature_Failure
  diagnostic event to trouble code uds mapping EventDtcMapPowerPath056OverTemperatureFailure: diagnostic-event=EventPowerPath056OverTemperatureFailure, trouble-code-uds=Power_Path_056_Over_Temperature_Failure  # Event_Dtc_Map_Power_Path_056_Over_Temperature_Failure
  diagnostic event to operation cycle mapping EventOperCycleMapPowerPath056OverTemperatureFailure: diagnostic-event=EventPowerPath056OverTemperatureFailure, operation-cycle=DefaultOperationCycle  # Event_Oper_Cycle_Map_Power_Path_056_Over_Temperature_Failure
  diagnostic event to debounce algorithm mapping EventDebounceMapPowerPath056OverTemperatureFailure: debounce-algorithm=time_based, diagnostic-event=EventPowerPath056OverTemperatureFailure  # EventDebounceMap_Power_Path_056_Over_Temperature_Failure
package /ZeC/DTC/DTC/LIN_7_Slave_11_NoCommunication
  diagnostic trouble code uds LIN_7_Slave_11_NoCommunication: dtc-props=Dtc_Props_358996c7, uds-dtc-value=0x030715  # LIN 7 Slave 11_NoCommunication
  diagnostic event EventLIN7Slave11NoCommunication: aging-allowed=true, event-kind=SWC, prestorage-freeze-frame=false  # Event_LIN 7 Slave 11_NoCommunication
  diagnostic event to trouble code uds mapping EventDtcMapLIN7Slave11NoCommunication: diagnostic-event=EventLIN7Slave11NoCommunication, trouble-code-uds=LIN_7_Slave_11_NoCommunication  # Event_Dtc_Map_LIN 7 Slave 11_NoCommunication
  diagnostic event to operation cycle mapping EventOperCycleMapLIN7Slave11NoCommunication: diagnostic-event=EventLIN7Slave11NoCommunication, operation-cycle=DefaultOperationCycle  # Event_Oper_Cycle_Map_LIN 7 Slave 11_NoCommunication
  diagnostic event to debounce algorithm mapping EventDebounceMapLIN7Slave11NoCommunication: debounce-algorithm=counter_based, diagnostic-event=EventLIN7Slave11NoCommunication  # EventDebounceMap_LIN 7 Slave 11_NoCommunication
package /ZeC/DTC/DTC/Power_Path_055_Over_Temperature_Failure
  diagnostic trouble code uds Power_Path_055_Over_Temperature_Failure: dtc-props=Dtc_Props_b97f3d80, uds-dtc-value=0x005737
  diagnostic event EventPowerPath055OverTemperatureFailure: aging-allowed=true, event-kind=SWC, prestorage-freeze-frame=false  # Event_Power_Path_055_Over_Temperature_Failure
  diagnostic event to trouble code uds mapping EventDtcMapPowerPath055OverTemperatureFailure: diagnostic-event=EventPowerPath055OverTemperatureFailure, trouble-code-uds=Power_Path_055_Over_Temperature_Failure  # Event_Dtc_Map_Power_Path_055_Over_Temperature_Failure
  diagnostic event to operation cycle mapping EventOperCycleMapPowerPath055OverTemperatureFailure: diagnostic-event=EventPowerPath055OverTemperatureFailure, operation-cycle=DefaultOperationCycle  # Event_Oper_Cycle_Map_Power_Path_055_Over_Temperature_Failure
  diagnostic event to debounce algorithm mapping EventDebounceMapPowerPath055OverTemperatureFailure: debounce-algorithm=time_based, diagnostic-event=EventPowerPath055OverTemperatureFailure  # EventDebounceMap_Power_Path_055_Over_Temperature_Failure
package /ZeC/DTC/DTC/LIN_7_Slave_1_Defect
  diagnostic trouble code uds LIN_7_Slave_1_Defect: dtc-props=Dtc_Props_358996c7, uds-dtc-value=0x030710  # LIN 7 Slave 1_Defect
  diagnostic event EventLIN7Slave1Defect: aging-allowed=true, event-kind=SWC, prestorage-freeze-frame=false  # Event_LIN 7 Slave 1_Defect
  diagnostic event to trouble code uds mapping EventDtcMapLIN7Slave1Defect: diagnostic-event=EventLIN7Slave1Defect, trouble-code-uds=LIN_7_Slave_1_Defect  # Event_Dtc_Map_LIN 7 Slave 1_Defect
  diagnostic event to operation cycle mapping EventOperCycleMapLIN7Slave1Defect: diagnostic-event=EventLIN7Slave1Defect, operation-cycle=DefaultOperationCycle  # Event_Oper_Cycle_Map_LIN 7 Slave 1_Defect
  diagnostic event to debounce algorithm mapping EventDebounceMapLIN7Slave1Defect: debounce-algorithm=counter_based, diagnostic-event=EventLIN7Slave1Defect  # EventDebounceMap_LIN 7 Slave 1_Defect
package /ZeC/DTC/DTC/Power_Path_050_Over_Temperature_Failure
  diagnostic trouble code uds Power_Path_050_Over_Temperature_Failure: dtc-props=Dtc_Props_3c731913, uds-dtc-value=0x005732
  diagnostic event EventPowerPath050OverTemperatureFailure: aging-allowed=true, event-kind=SWC, prestorage-freeze-frame=false  # Event_Power_Path_050_Over_Temperature_Failure
  diagnostic event to trouble code uds mapping EventDtcMapPowerPath050OverTemperatureFailure: diagnostic-event=EventPowerPath050OverTemperatureFailure, trouble-code-uds=Power_Path_050_Over_Temperature_Failure  # Event_Dtc_Map_Power_Path_050_Over_Temperature_Failure
  diagnostic event to operation cycle mapping EventOperCycleMapPowerPath050OverTemperatureFailure: diagnostic-event=EventPowerPath050OverTemperatureFailure, operation-cycle=DefaultOperationCycle  # Event_Oper_Cycle_Map_Power_Path_050_Over_Temperature_Failure
  diagnostic event to debounce algorithm mapping EventDebounceMapPowerPath050OverTemperatureFailure: debounce-algorithm=time_based, diagnostic-event=EventPowerPath050OverTemperatureFailure  # EventDebounceMap_Power_Path_050_Over_Temperature_Failure
package /ZeC/DTC/DTC/Power_Path_049_Over_Temperature_Failure
  diagnostic trouble code uds Power_Path_049_Over_Temperature_Failure: dtc-props=Dtc_Props_f658075d, uds-dtc-value=0x005731
  diagnostic event EventPowerPath049OverTemperatureFailure: aging-allowed=true, event-kind=SWC, prestorage-freeze-frame=false  # Event_Power_Path_049_Over_Temperature_Failure
  diagnostic event to trouble code uds mapping EventDtcMapPowerPath049OverTemperatureFailure: diagnostic-event=EventPowerPath049OverTemperatureFailure, trouble-code-uds=Power_Path_049_Over_Temperature_Failure  # Event_Dtc_Map_Power_Path_049_Over_Temperature_Failure
  diagnostic event to operation cycle mapping EventOperCycleMapPowerPath049OverTemperatureFailure: diagnostic-event=EventPowerPath049OverTemperatureFailure, operation-cycle=DefaultOperationCycle  # Event_Oper_Cycle_Map_Power_Path_049_Over_Temperature_Failure
  diagnostic event to debounce algorithm mapping EventDebounceMapPowerPath049OverTemperatureFailure: debounce-algorithm=time_based, diagnostic-event=EventPowerPath049OverTemperatureFailure  # EventDebounceMap_Power_Path_049_Over_Temperature_Failure
package /ZeC/DTC/DTC/LIN_7_Slave_10_Defect
  diagnostic trouble code uds LIN_7_Slave_10_Defect: dtc-props=Dtc_Props_358996c7, uds-dtc-value=0x030712  # LIN 7 Slave 10_Defect
  diagnostic event EventLIN7Slave10Defect: aging-allowed=true, event-kind=SWC, prestorage-freeze-frame=false  # Event_LIN 7 Slave 10_Defect
  diagnostic event to trouble code uds mapping EventDtcMapLIN7Slave10Defect: diagnostic-event=EventLIN7Slave10Defect, trouble-code-uds=LIN_7_Slave_10_Defect  # Event_Dtc_Map_LIN 7 Slave 10_Defect
  diagnostic event to operation cycle mapping EventOperCycleMapLIN7Slave10Defect: diagnostic-event=EventLIN7Slave10Defect, operation-cycle=DefaultOperationCycle  # Event_Oper_Cycle_Map_LIN 7 Slave 10_Defect
  diagnostic event to debounce algorithm mapping EventDebounceMapLIN7Slave10Defect: debounce-algorithm=counter_based, diagnostic-event=EventLIN7Slave10Defect  # EventDebounceMap_LIN 7 Slave 10_Defect
package /ZeC/DTC/DTC/Power_Path_052_Over_Temperature_Failure
  diagnostic trouble code uds Power_Path_052_Over_Temperature_Failure: dtc-props=Dtc_Props_735423ce, uds-dtc-value=0x005734
  diagnostic event EventPowerPath052OverTemperatureFailure: aging-allowed=true, event-kind=SWC, prestorage-freeze-frame=false  # Event_Power_Path_052_Over_Temperature_Failure
  diagnostic event to trouble code uds mapping EventDtcMapPowerPath052OverTemperatureFailure: diagnostic-event=EventPowerPath052OverTemperatureFailure, trouble-code-uds=Power_Path_052_Over_Temperature_Failure  # Event_Dtc_Map_Power_Path_052_Over_Temperature_Failure
  diagnostic event to operation cycle mapping EventOperCycleMapPowerPath052OverTemperatureFailure: diagnostic-event=EventPowerPath052OverTemperatureFailure, operation-cycle=DefaultOperationCycle  # Event_Oper_Cycle_Map_Power_Path_052_Over_Temperature_Failure
  diagnostic event to debounce algorithm mapping EventDebounceMapPowerPath052OverTemperatureFailure: debounce-algorithm=time_based, diagnostic-event=EventPowerPath052OverTemperatureFailure  # EventDebounceMap_Power_Path_052_Over_Temperature_Failure
package /ZeC/DTC/DTC/LIN_7_Slave_1_NoCommunication
  diagnostic trouble code uds LIN_7_Slave_1_NoCommunication: dtc-props=Dtc_Props_358996c7, uds-dtc-value=0x030711  # LIN 7 Slave 1_NoCommunication
  diagnostic event EventLIN7Slave1NoCommunication: aging-allowed=true, event-kind=SWC, prestorage-freeze-frame=false  # Event_LIN 7 Slave 1_NoCommunication
  diagnostic event to trouble code uds mapping EventDtcMapLIN7Slave1NoCommunication: diagnostic-event=EventLIN7Slave1NoCommunication, trouble-code-uds=LIN_7_Slave_1_NoCommunication  # Event_Dtc_Map_LIN 7 Slave 1_NoCommunication
  diagnostic event to operation cycle mapping EventOperCycleMapLIN7Slave1NoCommunication: diagnostic-event=EventLIN7Slave1NoCommunication, operation-cycle=DefaultOperationCycle  # Event_Oper_Cycle_Map_LIN 7 Slave 1_NoCommunication
  diagnostic event to debounce algorithm mapping EventDebounceMapLIN7Slave1NoCommunication: debounce-algorithm=counter_based, diagnostic-event=EventLIN7Slave1NoCommunication  # EventDebounceMap_LIN 7 Slave 1_NoCommunication
package /ZeC/DTC/DTC/Power_Path_051_Over_Temperature_Failure
  diagnostic trouble code uds Power_Path_051_Over_Temperature_Failure: dtc-props=Dtc_Props_7a6a1329, uds-dtc-value=0x005733
  diagnostic event EventPowerPath051OverTemperatureFailure: aging-allowed=true, event-kind=SWC, prestorage-freeze-frame=false  # Event_Power_Path_051_Over_Temperature_Failure
  diagnostic event to trouble code uds mapping EventDtcMapPowerPath051OverTemperatureFailure: diagnostic-event=EventPowerPath051OverTemperatureFailure, trouble-code-uds=Power_Path_051_Over_Temperature_Failure  # Event_Dtc_Map_Power_Path_051_Over_Temperature_Failure
  diagnostic event to operation cycle mapping EventOperCycleMapPowerPath051OverTemperatureFailure: diagnostic-event=EventPowerPath051OverTemperatureFailure, operation-cycle=DefaultOperationCycle  # Event_Oper_Cycle_Map_Power_Path_051_Over_Temperature_Failure
  diagnostic event to debounce algorithm mapping EventDebounceMapPowerPath051OverTemperatureFailure: debounce-algorithm=time_based, diagnostic-event=EventPowerPath051OverTemperatureFailure  # EventDebounceMap_Power_Path_051_Over_Temperature_Failure
package /ZeC/DTC/DTC/LIN_7_Slave_9_NoCommunication
  diagnostic trouble code uds LIN_7_Slave_9_NoCommunication: dtc-props=Dtc_Props_358996c7, uds-dtc-value=0x03070f  # LIN 7 Slave 9_NoCommunication
  diagnostic event EventLIN7Slave9NoCommunication: aging-allowed=true, event-kind=SWC, prestorage-freeze-frame=false  # Event_LIN 7 Slave 9_NoCommunication
  diagnostic event to trouble code uds mapping EventDtcMapLIN7Slave9NoCommunication: diagnostic-event=EventLIN7Slave9NoCommunication, trouble-code-uds=LIN_7_Slave_9_NoCommunication  # Event_Dtc_Map_LIN 7 Slave 9_NoCommunication
  diagnostic event to operation cycle mapping EventOperCycleMapLIN7Slave9NoCommunication: diagnostic-event=EventLIN7Slave9NoCommunication, operation-cycle=DefaultOperationCycle  # Event_Oper_Cycle_Map_LIN 7 Slave 9_NoCommunication
  diagnostic event to debounce algorithm mapping EventDebounceMapLIN7Slave9NoCommunication: debounce-algorithm=counter_based, diagnostic-event=EventLIN7Slave9NoCommunication  # EventDebounceMap_LIN 7 Slave 9_NoCommunication
package /ZeC/DTC/DTC/Power_Path_057_Over_Temperature_Failure
  diagnostic trouble code uds Power_Path_057_Over_Temperature_Failure: dtc-props=Dtc_Props_ab035c4e, uds-dtc-value=0x005739
  diagnostic event EventPowerPath057OverTemperatureFailure: aging-allowed=true, event-kind=SWC, prestorage-freeze-frame=false  # Event_Power_Path_057_Over_Temperature_Failure
  diagnostic event to trouble code uds mapping EventDtcMapPowerPath057OverTemperatureFailure: diagnostic-event=EventPowerPath057OverTemperatureFailure, trouble-code-uds=Power_Path_057_Over_Temperature_Failure  # Event_Dtc_Map_Power_Path_057_Over_Temperature_Failure
  diagnostic event to operation cycle mapping EventOperCycleMapPowerPath057OverTemperatureFailure: diagnostic-event=EventPowerPath057OverTemperatureFailure, operation-cycle=DefaultOperationCycle  # Event_Oper_Cycle_Map_Power_Path_057_Over_Temperature_Failure
  diagnostic event to debounce algorithm mapping EventDebounceMapPowerPath057OverTemperatureFailure: debounce-algorithm=time_based, diagnostic-event=EventPowerPath057OverTemperatureFailure  # EventDebounceMap_Power_Path_057_Over_Temperature_Failure
package /ZeC/DTC/DTC/LIN_7_Slave_15_NoCommunication
  diagnostic trouble code uds LIN_7_Slave_15_NoCommunication: dtc-props=Dtc_Props_358996c7, uds-dtc-value=0x03071d  # LIN 7 Slave 15_NoCommunication
  diagnostic event EventLIN7Slave15NoCommunication: aging-allowed=true, event-kind=SWC, prestorage-freeze-frame=false  # Event_LIN 7 Slave 15_NoCommunication
  diagnostic event to trouble code uds mapping EventDtcMapLIN7Slave15NoCommunication: diagnostic-event=EventLIN7Slave15NoCommunication, trouble-code-uds=LIN_7_Slave_15_NoCommunication  # Event_Dtc_Map_LIN 7 Slave 15_NoCommunication
  diagnostic event to operation cycle mapping EventOperCycleMapLIN7Slave15NoCommunication: diagnostic-event=EventLIN7Slave15NoCommunication, operation-cycle=DefaultOperationCycle  # Event_Oper_Cycle_Map_LIN 7 Slave 15_NoCommunication
  diagnostic event to debounce algorithm mapping EventDebounceMapLIN7Slave15NoCommunication: debounce-algorithm=counter_based, diagnostic-event=EventLIN7Slave15NoCommunication  # EventDebounceMap_LIN 7 Slave 15_NoCommunication
package /ZeC/DTC/DTC/Power_Path_063_Over_Temperature_Failure
  diagnostic trouble code uds Power_Path_063_Over_Temperature_Failure: dtc-props=Dtc_Props_c29953c7, uds-dtc-value=0x00573f
  diagnostic event EventPowerPath063OverTemperatureFailure: aging-allowed=true, event-kind=SWC, prestorage-freeze-frame=false  # Event_Power_Path_063_Over_Temperature_Failure
  diagnostic event to trouble code uds mapping EventDtcMapPowerPath063OverTemperatureFailure: diagnostic-event=EventPowerPath063OverTemperatureFailure, trouble-code-uds=Power_Path_063_Over_Temperature_Failure  # Event_Dtc_Map_Power_Path_063_Over_Temperature_Failure
  diagnostic event to operation cycle mapping EventOperCycleMapPowerPath063OverTemperatureFailure: diagnostic-event=EventPowerPath063OverTemperatureFailure, operation-cycle=DefaultOperationCycle  # Event_Oper_Cycle_Map_Power_Path_063_Over_Temperature_Failure
  diagnostic event to debounce algorithm mapping EventDebounceMapPowerPath063OverTemperatureFailure: debounce-algorithm=time_based, diagnostic-event=EventPowerPath063OverTemperatureFailure  # EventDebounceMap_Power_Path_063_Over_Temperature_Failure
package /ZeC/DTC/DTC/LIN_7_Slave_15_Defect
  diagnostic trouble code uds LIN_7_Slave_15_Defect: dtc-props=Dtc_Props_358996c7, uds-dtc-value=0x03071c  # LIN 7 Slave 15_Defect
  diagnostic event EventLIN7Slave15Defect: aging-allowed=true, event-kind=SWC, prestorage-freeze-frame=false  # Event_LIN 7 Slave 15_Defect
  diagnostic event to trouble code uds mapping EventDtcMapLIN7Slave15Defect: diagnostic-event=EventLIN7Slave15Defect, trouble-code-uds=LIN_7_Slave_15_Defect  # Event_Dtc_Map_LIN 7 Slave 15_Defect
  diagnostic event to operation cycle mapping EventOperCycleMapLIN7Slave15Defect: diagnostic-event=EventLIN7Slave15Defect, operation-cycle=DefaultOperationCycle  # Event_Oper_Cycle_Map_LIN 7 Slave 15_Defect
  diagnostic event to debounce algorithm mapping EventDebounceMapLIN7Slave15Defect: debounce-algorithm=counter_based, diagnostic-event=EventLIN7Slave15Defect  # EventDebounceMap_LIN 7 Slave 15_Defect
package /ZeC/DTC/DTC/Power_Path_062_Over_Temperature_Failure
  diagnostic trouble code uds Power_Path_062_Over_Temperature_Failure: dtc-props=Dtc_Props_8b24d89, uds-dtc-value=0x00573e
  diagnostic event EventPowerPath062OverTemperatureFailure: aging-allowed=true, event-kind=SWC, prestorage-freeze-frame=false  # Event_Power_Path_062_Over_Temperature_Failure
  diagnostic event to trouble code uds mapping EventDtcMapPowerPath062OverTemperatureFailure: diagnostic-event=EventPowerPath062OverTemperatureFailure, trouble-code-uds=Power_Path_062_Over_Temperature_Failure  # Event_Dtc_Map_Power_Path_062_Over_Temperature_Failure
  diagnostic event to operation cycle mapping EventOperCycleMapPowerPath062OverTemperatureFailure: diagnostic-event=EventPowerPath062OverTemperatureFailure, operation-cycle=DefaultOperationCycle  # Event_Oper_Cycle_Map_Power_Path_062_Over_Temperature_Failure
  diagnostic event to debounce algorithm mapping EventDebounceMapPowerPath062OverTemperatureFailure: debounce-algorithm=time_based, diagnostic-event=EventPowerPath062OverTemperatureFailure  # EventDebounceMap_Power_Path_062_Over_Temperature_Failure
package /ZeC/DTC/DTC/LIN_7_Slave_2_Defect
  diagnostic trouble code uds LIN_7_Slave_2_Defect: dtc-props=Dtc_Props_358996c7, uds-dtc-value=0x03071e  # LIN 7 Slave 2_Defect
  diagnostic event EventLIN7Slave2Defect: aging-allowed=true, event-kind=SWC, prestorage-freeze-frame=false  # Event_LIN 7 Slave 2_Defect
  diagnostic event to trouble code uds mapping EventDtcMapLIN7Slave2Defect: diagnostic-event=EventLIN7Slave2Defect, trouble-code-uds=LIN_7_Slave_2_Defect  # Event_Dtc_Map_LIN 7 Slave 2_Defect
  diagnostic event to operation cycle mapping EventOperCycleMapLIN7Slave2Defect: diagnostic-event=EventLIN7Slave2Defect, operation-cycle=DefaultOperationCycle  # Event_Oper_Cycle_Map_LIN 7 Slave 2_Defect
  diagnostic event to debounce algorithm mapping EventDebounceMapLIN7Slave2Defect: debounce-algorithm=counter_based, diagnostic-event=EventLIN7Slave2Defect  # EventDebounceMap_LIN 7 Slave 2_Defect
package /ZeC/DTC/DTC/Power_Path_059_Over_Temperature_Failure
  diagnostic trouble code uds Power_Path_059_Over_Temperature_Failure: dtc-props=Dtc_Props_18c7d6e, uds-dtc-value=0x00573b
  diagnostic event EventPowerPath059OverTemperatureFailure: aging-allowed=true, event-kind=SWC, prestorage-freeze-frame=false  # Event_Power_Path_059_Over_Temperature_Failure
  diagnostic event to trouble code uds mapping EventDtcMapPowerPath059OverTemperatureFailure: diagnostic-event=EventPowerPath059OverTemperatureFailure, trouble-code-uds=Power_Path_059_Over_Temperature_Failure  # Event_Dtc_Map_Power_Path_059_Over_Temperature_Failure
  diagnostic event to operation cycle mapping EventOperCycleMapPowerPath059OverTemperatureFailure: diagnostic-event=EventPowerPath059OverTemperatureFailure, operation-cycle=DefaultOperationCycle  # Event_Oper_Cycle_Map_Power_Path_059_Over_Temperature_Failure
  diagnostic event to debounce algorithm mapping EventDebounceMapPowerPath059OverTemperatureFailure: debounce-algorithm=time_based, diagnostic-event=EventPowerPath059OverTemperatureFailure  # EventDebounceMap_Power_Path_059_Over_Temperature_Failure
package /ZeC/DTC/DTC/Power_Path_058_Over_Temperature_Failure
  diagnostic trouble code uds Power_Path_058_Over_Temperature_Failure: dtc-props=Dtc_Props_cba76320, uds-dtc-value=0x00573a
  diagnostic event EventPowerPath058OverTemperatureFailure: aging-allowed=true, event-kind=SWC, prestorage-freeze-frame=false  # Event_Power_Path_058_Over_Temperature_Failure
  diagnostic event to trouble code uds mapping EventDtcMapPowerPath058OverTemperatureFailure: diagnostic-event=EventPowerPath058OverTemperatureFailure, trouble-code-uds=Power_Path_058_Over_Temperature_Failure  # Event_Dtc_Map_Power_Path_058_Over_Temperature_Failure
  diagnostic event to operation cycle mapping EventOperCycleMapPowerPath058OverTemperatureFailure: diagnostic-event=EventPowerPath058OverTemperatureFailure, operation-cycle=DefaultOperationCycle  # Event_Oper_Cycle_Map_Power_Path_058_Over_Temperature_Failure
  diagnostic event to debounce algorithm mapping EventDebounceMapPowerPath058OverTemperatureFailure: debounce-algorithm=time_based, diagnostic-event=EventPowerPath058OverTemperatureFailure  # EventDebounceMap_Power_Path_058_Over_Temperature_Failure
package /ZeC/DTC/DTC/LIN_7_Slave_14_NoCommunication
  diagnostic trouble code uds LIN_7_Slave_14_NoCommunication: dtc-props=Dtc_Props_358996c7, uds-dtc-value=0x03071b  # LIN 7 Slave 14_NoCommunication
  diagnostic event EventLIN7Slave14NoCommunication: aging-allowed=true, event-kind=SWC, prestorage-freeze-frame=false  # Event_LIN 7 Slave 14_NoCommunication
  diagnostic event to trouble code uds mapping EventDtcMapLIN7Slave14NoCommunication: diagnostic-event=EventLIN7Slave14NoCommunication, trouble-code-uds=LIN_7_Slave_14_NoCommunication  # Event_Dtc_Map_LIN 7 Slave 14_NoCommunication
  diagnostic event to operation cycle mapping EventOperCycleMapLIN7Slave14NoCommunication: diagnostic-event=EventLIN7Slave14NoCommunication, operation-cycle=DefaultOperationCycle  # Event_Oper_Cycle_Map_LIN 7 Slave 14_NoCommunication
  diagnostic event to debounce algorithm mapping EventDebounceMapLIN7Slave14NoCommunication: debounce-algorithm=counter_based, diagnostic-event=EventLIN7Slave14NoCommunication  # EventDebounceMap_LIN 7 Slave 14_NoCommunication
package /ZeC/DTC/DTC/Power_Path_061_Over_Temperature_Failure
  diagnostic trouble code uds Power_Path_061_Over_Temperature_Failure: dtc-props=Dtc_Props_4eab47b3, uds-dtc-value=0x00573d
  diagnostic event EventPowerPath061OverTemperatureFailure: aging-allowed=true, event-kind=SWC, prestorage-freeze-frame=false  # Event_Power_Path_061_Over_Temperature_Failure
  diagnostic event to trouble code uds mapping EventDtcMapPowerPath061OverTemperatureFailure: diagnostic-event=EventPowerPath061OverTemperatureFailure, trouble-code-uds=Power_Path_061_Over_Temperature_Failure  # Event_Dtc_Map_Power_Path_061_Over_Temperature_Failure
  diagnostic event to operation cycle mapping EventOperCycleMapPowerPath061OverTemperatureFailure: diagnostic-event=EventPowerPath061OverTemperatureFailure, operation-cycle=DefaultOperationCycle  # Event_Oper_Cycle_Map_Power_Path_061_Over_Temperature_Failure
  diagnostic event to debounce algorithm mapping EventDebounceMapPowerPath061OverTemperatureFailure: debounce-algorithm=time_based, diagnostic-event=EventPowerPath061OverTemperatureFailure  # EventDebounceMap_Power_Path_061_Over_Temperature_Failure
package /ZeC/DTC/DTC/LIN_7_Slave_14_Defect
  diagnostic trouble code uds LIN_7_Slave_14_Defect: dtc-props=Dtc_Props_358996c7, uds-dtc-value=0x03071a  # LIN 7 Slave 14_Defect
  diagnostic event EventLIN7Slave14Defect: aging-allowed=true, event-kind=SWC, prestorage-freeze-frame=false  # Event_LIN 7 Slave 14_Defect
  diagnostic event to trouble code uds mapping EventDtcMapLIN7Slave14Defect: diagnostic-event=EventLIN7Slave14Defect, trouble-code-uds=LIN_7_Slave_14_Defect  # Event_Dtc_Map_LIN 7 Slave 14_Defect
  diagnostic event to operation cycle mapping EventOperCycleMapLIN7Slave14Defect: diagnostic-event=EventLIN7Slave14Defect, operation-cycle=DefaultOperationCycle  # Event_Oper_Cycle_Map_LIN 7 Slave 14_Defect
  diagnostic event to debounce algorithm mapping EventDebounceMapLIN7Slave14Defect: debounce-algorithm=counter_based, diagnostic-event=EventLIN7Slave14Defect  # EventDebounceMap_LIN 7 Slave 14_Defect
package /ZeC/DTC/DTC/Power_Path_060_Over_Temperature_Failure
  diagnostic trouble code uds Power_Path_060_Over_Temperature_Failure: dtc-props=Dtc_Props_47957754, uds-dtc-value=0x00573c
  diagnostic event EventPowerPath060OverTemperatureFailure: aging-allowed=true, event-kind=SWC, prestorage-freeze-frame=false  # Event_Power_Path_060_Over_Temperature_Failure
  diagnostic event to trouble code uds mapping EventDtcMapPowerPath060OverTemperatureFailure: diagnostic-event=EventPowerPath060OverTemperatureFailure, trouble-code-uds=Power_Path_060_Over_Temperature_Failure  # Event_Dtc_Map_Power_Path_060_Over_Temperature_Failure
  diagnostic event to operation cycle mapping EventOperCycleMapPowerPath060OverTemperatureFailure: diagnostic-event=EventPowerPath060OverTemperatureFailure, operation-cycle=DefaultOperationCycle  # Event_Oper_Cycle_Map_Power_Path_060_Over_Temperature_Failure
  diagnostic event to debounce algorithm mapping EventDebounceMapPowerPath060OverTemperatureFailure: debounce-algorithm=time_based, diagnostic-event=EventPowerPath060OverTemperatureFailure  # EventDebounceMap_Power_Path_060_Over_Temperature_Failure
package /ZeC/DTC/DTC/Power_Path_065_Over_Temperature_Failure
  diagnostic trouble code uds Power_Path_065_Over_Temperature_Failure: dtc-props=Dtc_Props_c83f4eb6, uds-dtc-value=0x005741
  diagnostic event EventPowerPath065OverTemperatureFailure: aging-allowed=true, event-kind=SWC, prestorage-freeze-frame=false  # Event_Power_Path_065_Over_Temperature_Failure
  diagnostic event to trouble code uds mapping EventDtcMapPowerPath065OverTemperatureFailure: diagnostic-event=EventPowerPath065OverTemperatureFailure, trouble-code-uds=Power_Path_065_Over_Temperature_Failure  # Event_Dtc_Map_Power_Path_065_Over_Temperature_Failure
  diagnostic event to operation cycle mapping EventOperCycleMapPowerPath065OverTemperatureFailure: diagnostic-event=EventPowerPath065OverTemperatureFailure, operation-cycle=DefaultOperationCycle  # Event_Oper_Cycle_Map_Power_Path_065_Over_Temperature_Failure
  diagnostic event to debounce algorithm mapping EventDebounceMapPowerPath065OverTemperatureFailure: debounce-algorithm=time_based, diagnostic-event=EventPowerPath065OverTemperatureFailure  # EventDebounceMap_Power_Path_065_Over_Temperature_Failure
package /ZeC/DTC/DTC/Power_Path_064_Over_Temperature_Failure
  diagnostic trouble code uds Power_Path_064_Over_Temperature_Failure: dtc-props=Dtc_Props_8e26448c, uds-dtc-value=0x005740
  diagnostic event EventPowerPath064OverTemperatureFailure: aging-allowed=true, event-kind=SWC, prestorage-freeze-frame=false  # Event_Power_Path_064_Over_Temperature_Failure
  diagnostic event to trouble code uds mapping EventDtcMapPowerPath064OverTemperatureFailure: diagnostic-event=EventPowerPath064OverTemperatureFailure, trouble-code-uds=Power_Path_064_Over_Temperature_Failure  # Event_Dtc_Map_Power_Path_064_Over_Temperature_Failure
  diagnostic event to operation cycle mapping EventOperCycleMapPowerPath064OverTemperatureFailure: diagnostic-event=EventPowerPath064OverTemperatureFailure, operation-cycle=DefaultOperationCycle  # Event_Oper_Cycle_Map_Power_Path_064_Over_Temperature_Failure
  diagnostic event to debounce algorithm mapping EventDebounceMapPowerPath064OverTemperatureFailure: debounce-algorithm=time_based, diagnostic-event=EventPowerPath064OverTemperatureFailure  # EventDebounceMap_Power_Path_064_Over_Temperature_Failure
package /ZeC/DTC/DTC/LIN_7_Slave_13_Defect
  diagnostic trouble code uds LIN_7_Slave_13_Defect: dtc-props=Dtc_Props_358996c7, uds-dtc-value=0x030718  # LIN 7 Slave 13_Defect
  diagnostic event EventLIN7Slave13Defect: aging-allowed=true, event-kind=SWC, prestorage-freeze-frame=false  # Event_LIN 7 Slave 13_Defect
  diagnostic event to trouble code uds mapping EventDtcMapLIN7Slave13Defect: diagnostic-event=EventLIN7Slave13Defect, trouble-code-uds=LIN_7_Slave_13_Defect  # Event_Dtc_Map_LIN 7 Slave 13_Defect
  diagnostic event to operation cycle mapping EventOperCycleMapLIN7Slave13Defect: diagnostic-event=EventLIN7Slave13Defect, operation-cycle=DefaultOperationCycle  # Event_Oper_Cycle_Map_LIN 7 Slave 13_Defect
  diagnostic event to debounce algorithm mapping EventDebounceMapLIN7Slave13Defect: debounce-algorithm=counter_based, diagnostic-event=EventLIN7Slave13Defect  # EventDebounceMap_LIN 7 Slave 13_Defect
package /ZeC/DTC/DTC/LIN_7_Slave_12_NoCommunication
  diagnostic trouble code uds LIN_7_Slave_12_NoCommunication: dtc-props=Dtc_Props_358996c7, uds-dtc-value=0x030717  # LIN 7 Slave 12_NoCommunication
  diagnostic event EventLIN7Slave12NoCommunication: aging-allowed=true, event-kind=SWC, prestorage-freeze-frame=false  # Event_LIN 7 Slave 12_NoCommunication
  diagnostic event to trouble code uds mapping EventDtcMapLIN7Slave12NoCommunication: diagnostic-event=EventLIN7Slave12NoCommunication, trouble-code-uds=LIN_7_Slave_12_NoCommunication  # Event_Dtc_Map_LIN 7 Slave 12_NoCommunication
  diagnostic event to operation cycle mapping EventOperCycleMapLIN7Slave12NoCommunication: diagnostic-event=EventLIN7Slave12NoCommunication, operation-cycle=DefaultOperationCycle  # Event_Oper_Cycle_Map_LIN 7 Slave 12_NoCommunication
  diagnostic event to debounce algorithm mapping EventDebounceMapLIN7Slave12NoCommunication: debounce-algorithm=counter_based, diagnostic-event=EventLIN7Slave12NoCommunication  # EventDebounceMap_LIN 7 Slave 12_NoCommunication
package /ZeC/DTC/DTC/LIN_7_Slave_13_NoCommunication
  diagnostic trouble code uds LIN_7_Slave_13_NoCommunication: dtc-props=Dtc_Props_358996c7, uds-dtc-value=0x030719  # LIN 7 Slave 13_NoCommunication
  diagnostic event EventLIN7Slave13NoCommunication: aging-allowed=true, event-kind=SWC, prestorage-freeze-frame=false  # Event_LIN 7 Slave 13_NoCommunication
  diagnostic event to trouble code uds mapping EventDtcMapLIN7Slave13NoCommunication: diagnostic-event=EventLIN7Slave13NoCommunication, trouble-code-uds=LIN_7_Slave_13_NoCommunication  # Event_Dtc_Map_LIN 7 Slave 13_NoCommunication
  diagnostic event to operation cycle mapping EventOperCycleMapLIN7Slave13NoCommunication: diagnostic-event=EventLIN7Slave13NoCommunication, operation-cycle=DefaultOperationCycle  # Event_Oper_Cycle_Map_LIN 7 Slave 13_NoCommunication
  diagnostic event to debounce algorithm mapping EventDebounceMapLIN7Slave13NoCommunication: debounce-algorithm=counter_based, diagnostic-event=EventLIN7Slave13NoCommunication  # EventDebounceMap_LIN 7 Slave 13_NoCommunication
package /ZeC/DTC/DTC/Power_Path_105_Over_Temperature_Failure
  diagnostic trouble code uds Power_Path_105_Over_Temperature_Failure: dtc-props=Dtc_Props_c2809294, uds-dtc-value=0x005769
  diagnostic event EventPowerPath105OverTemperatureFailure: aging-allowed=true, event-kind=SWC, prestorage-freeze-frame=false  # Event_Power_Path_105_Over_Temperature_Failure
  diagnostic event to trouble code uds mapping EventDtcMapPowerPath105OverTemperatureFailure: diagnostic-event=EventPowerPath105OverTemperatureFailure, trouble-code-uds=Power_Path_105_Over_Temperature_Failure  # Event_Dtc_Map_Power_Path_105_Over_Temperature_Failure
  diagnostic event to operation cycle mapping EventOperCycleMapPowerPath105OverTemperatureFailure: diagnostic-event=EventPowerPath105OverTemperatureFailure, operation-cycle=DefaultOperationCycle  # Event_Oper_Cycle_Map_Power_Path_105_Over_Temperature_Failure
  diagnostic event to debounce algorithm mapping EventDebounceMapPowerPath105OverTemperatureFailure: debounce-algorithm=time_based, diagnostic-event=EventPowerPath105OverTemperatureFailure  # EventDebounceMap_Power_Path_105_Over_Temperature_Failure
package /ZeC/DTC/DTC/Power_Path_104_Over_Temperature_Failure
  diagnostic trouble code uds Power_Path_104_Over_Temperature_Failure: dtc-props=Dtc_Props_849998ae, uds-dtc-value=0x005768
  diagnostic event EventPowerPath104OverTemperatureFailure: aging-allowed=true, event-kind=SWC, prestorage-freeze-frame=false  # Event_Power_Path_104_Over_Temperature_Failure
  diagnostic event to trouble code uds mapping EventDtcMapPowerPath104OverTemperatureFailure: diagnostic-event=EventPowerPath104OverTemperatureFailure, trouble-code-uds=Power_Path_104_Over_Temperature_Failure  # Event_Dtc_Map_Power_Path_104_Over_Temperature_Failure
  diagnostic event to operation cycle mapping EventOperCycleMapPowerPath104OverTemperatureFailure: diagnostic-event=EventPowerPath104OverTemperatureFailure, operation-cycle=DefaultOperationCycle  # Event_Oper_Cycle_Map_Power_Path_104_Over_Temperature_Failure
  diagnostic event to debounce algorithm mapping EventDebounceMapPowerPath104OverTemperatureFailure: debounce-algorithm=time_based, diagnostic-event=EventPowerPath104OverTemperatureFailure  # EventDebounceMap_Power_Path_104_Over_Temperature_Failure
package /ZeC/DTC/DTC/Power_Path_101_Over_Temperature_Failure
  diagnostic trouble code uds Power_Path_101_Over_Temperature_Failure: dtc-props=Dtc_Props_5ccee72e, uds-dtc-value=0x005765
  diagnostic event EventPowerPath101OverTemperatureFailure: aging-allowed=true, event-kind=SWC, prestorage-freeze-frame=false  # Event_Power_Path_101_Over_Temperature_Failure
  diagnostic event to trouble code uds mapping EventDtcMapPowerPath101OverTemperatureFailure: diagnostic-event=EventPowerPath101OverTemperatureFailure, trouble-code-uds=Power_Path_101_Over_Temperature_Failure  # Event_Dtc_Map_Power_Path_101_Over_Temperature_Failure
  diagnostic event to operation cycle mapping EventOperCycleMapPowerPath101OverTemperatureFailure: diagnostic-event=EventPowerPath101OverTemperatureFailure, operation-cycle=DefaultOperationCycle  # Event_Oper_Cycle_Map_Power_Path_101_Over_Temperature_Failure
  diagnostic event to debounce algorithm mapping EventDebounceMapPowerPath101OverTemperatureFailure: debounce-algorithm=time_based, diagnostic-event=EventPowerPath101OverTemperatureFailure  # EventDebounceMap_Power_Path_101_Over_Temperature_Failure
package /ZeC/DTC/DTC/Power_Path_100_Over_Temperature_Failure
  diagnostic trouble code uds Power_Path_100_Over_Temperature_Failure: dtc-props=Dtc_Props_1ad7ed14, uds-dtc-value=0x005764
  diagnostic event EventPowerPath100OverTemperatureFailure: aging-allowed=true, event-kind=SWC, prestorage-freeze-frame=false  # Event_Power_Path_100_Over_Temperature_Failure
  diagnostic event to trouble code uds mapping EventDtcMapPowerPath100OverTemperatureFailure: diagnostic-event=EventPowerPath100OverTemperatureFailure, trouble-code-uds=Power_Path_100_Over_Temperature_Failure  # Event_Dtc_Map_Power_Path_100_Over_Temperature_Failure
  diagnostic event to operation cycle mapping EventOperCycleMapPowerPath100OverTemperatureFailure: diagnostic-event=EventPowerPath100OverTemperatureFailure, operation-cycle=DefaultOperationCycle  # Event_Oper_Cycle_Map_Power_Path_100_Over_Temperature_Failure
  diagnostic event to debounce algorithm mapping EventDebounceMapPowerPath100OverTemperatureFailure: debounce-algorithm=time_based, diagnostic-event=EventPowerPath100OverTemperatureFailure  # EventDebounceMap_Power_Path_100_Over_Temperature_Failure
package /ZeC/DTC/DTC/Power_Path_103_Over_Temperature_Failure
  diagnostic trouble code uds Power_Path_103_Over_Temperature_Failure: dtc-props=Dtc_Props_d0fcf35a, uds-dtc-value=0x005767
  diagnostic event EventPowerPath103OverTemperatureFailure: aging-allowed=true, event-kind=SWC, prestorage-freeze-frame=false  # Event_Power_Path_103_Over_Temperature_Failure
  diagnostic event to trouble code uds mapping EventDtcMapPowerPath103OverTemperatureFailure: diagnostic-event=EventPowerPath103OverTemperatureFailure, trouble-code-uds=Power_Path_103_Over_Temperature_Failure  # Event_Dtc_Map_Power_Path_103_Over_Temperature_Failure
  diagnostic event to operation cycle mapping EventOperCycleMapPowerPath103OverTemperatureFailure: diagnostic-event=EventPowerPath103OverTemperatureFailure, operation-cycle=DefaultOperationCycle  # Event_Oper_Cycle_Map_Power_Path_103_Over_Temperature_Failure
  diagnostic event to debounce algorithm mapping EventDebounceMapPowerPath103OverTemperatureFailure: debounce-algorithm=time_based, diagnostic-event=EventPowerPath103OverTemperatureFailure  # EventDebounceMap_Power_Path_103_Over_Temperature_Failure
package /ZeC/DTC/DTC/Power_Path_102_Over_Temperature_Failure
  diagnostic trouble code uds Power_Path_102_Over_Temperature_Failure: dtc-props=Dtc_Props_96e5f960, uds-dtc-value=0x005766
  diagnostic event EventPowerPath102OverTemperatureFailure: aging-allowed=true, event-kind=SWC, prestorage-freeze-frame=false  # Event_Power_Path_102_Over_Temperature_Failure
  diagnostic event to trouble code uds mapping EventDtcMapPowerPath102OverTemperatureFailure: diagnostic-event=EventPowerPath102OverTemperatureFailure, trouble-code-uds=Power_Path_102_Over_Temperature_Failure  # Event_Dtc_Map_Power_Path_102_Over_Temperature_Failure
  diagnostic event to operation cycle mapping EventOperCycleMapPowerPath102OverTemperatureFailure: diagnostic-event=EventPowerPath102OverTemperatureFailure, operation-cycle=DefaultOperationCycle  # Event_Oper_Cycle_Map_Power_Path_102_Over_Temperature_Failure
  diagnostic event to debounce algorithm mapping EventDebounceMapPowerPath102OverTemperatureFailure: debounce-algorithm=time_based, diagnostic-event=EventPowerPath102OverTemperatureFailure  # EventDebounceMap_Power_Path_102_Over_Temperature_Failure
package /ZeC/DTC/DTC/Power_Path_106_Over_Temperature_Failure
  diagnostic trouble code uds Power_Path_106_Over_Temperature_Failure: dtc-props=Dtc_Props_a224adfa, uds-dtc-value=0x00576a
  diagnostic event EventPowerPath106OverTemperatureFailure: aging-allowed=true, event-kind=SWC, prestorage-freeze-frame=false  # Event_Power_Path_106_Over_Temperature_Failure
  diagnostic event to trouble code uds mapping EventDtcMapPowerPath106OverTemperatureFailure: diagnostic-event=EventPowerPath106OverTemperatureFailure, trouble-code-uds=Power_Path_106_Over_Temperature_Failure  # Event_Dtc_Map_Power_Path_106_Over_Temperature_Failure
  diagnostic event to operation cycle mapping EventOperCycleMapPowerPath106OverTemperatureFailure: diagnostic-event=EventPowerPath106OverTemperatureFailure, operation-cycle=DefaultOperationCycle  # Event_Oper_Cycle_Map_Power_Path_106_Over_Temperature_Failure
  diagnostic event to debounce algorithm mapping EventDebounceMapPowerPath106OverTemperatureFailure: debounce-algorithm=time_based, diagnostic-event=EventPowerPath106OverTemperatureFailure  # EventDebounceMap_Power_Path_106_Over_Temperature_Failure
package /ZeC/DTC/DTC/Power_Path_108_Over_Temperature_Failure
  diagnostic trouble code uds Power_Path_108_Over_Temperature_Failure: dtc-props=Dtc_Props_2e16b98e, uds-dtc-value=0x00576c
  diagnostic event EventPowerPath108OverTemperatureFailure: aging-allowed=true, event-kind=SWC, prestorage-freeze-frame=false  # Event_Power_Path_108_Over_Temperature_Failure
  diagnostic event to trouble code uds mapping EventDtcMapPowerPath108OverTemperatureFailure: diagnostic-event=EventPowerPath108OverTemperatureFailure, trouble-code-uds=Power_Path_108_Over_Temperature_Failure  # Event_Dtc_Map_Power_Path_108_Over_Temperature_Failure
  diagnostic event to operation cycle mapping EventOperCycleMapPowerPath108OverTemperatureFailure: diagnostic-event=EventPowerPath108OverTemperatureFailure, operation-cycle=DefaultOperationCycle  # Event_Oper_Cycle_Map_Power_Path_108_Over_Temperature_Failure
  diagnostic event to debounce algorithm mapping EventDebounceMapPowerPath108OverTemperatureFailure: debounce-algorithm=time_based, diagnostic-event=EventPowerPath108OverTemperatureFailure  # EventDebounceMap_Power_Path_108_Over_Temperature_Failure
package /ZeC/DTC/DTC/Power_Path_107_Over_Temperature_Failure
  diagnostic trouble code uds Power_Path_107_Over_Temperature_Failure: dtc-props=Dtc_Props_680fb3b4, uds-dtc-value=0x00576b
  diagnostic event EventPowerPath107OverTemperatureFailure: aging-allowed=true, event-kind=SWC, prestorage-freeze-frame=false  # Event_Power_Path_107_Over_Temperature_Failure
  diagnostic event to trouble code uds mapping EventDtcMapPowerPath107OverTemperatureFailure: diagnostic-event=EventPowerPath107OverTemperatureFailure, trouble-code-uds=Power_Path_107_Over_Temperature_Failure  # Event_Dtc_Map_Power_Path_107_Over_Temperature_Failure
  diagnostic event to operation cycle mapping EventOperCycleMapPowerPath107OverTemperatureFailure: diagnostic-event=EventPowerPath107OverTemperatureFailure, operation-cycle=DefaultOperationCycle  # Event_Oper_Cycle_Map_Power_Path_107_Over_Temperature_Failure
  diagnostic event to debounce algorithm mapping EventDebounceMapPowerPath107OverTemperatureFailure: debounce-algorithm=time_based, diagnostic-event=EventPowerPath107OverTemperatureFailure  # EventDebounceMap_Power_Path_107_Over_Temperature_Failure
package /ZeC/DTC/DTC/Power_Path_110_Over_Temperature_Failure
  diagnostic trouble code uds Power_Path_110_Over_Temperature_Failure: dtc-props=Dtc_Props_61318353, uds-dtc-value=0x00576e
  diagnostic event EventPowerPath110OverTemperatureFailure: aging-allowed=true, event-kind=SWC, prestorage-freeze-frame=false  # Event_Power_Path_110_Over_Temperature_Failure
  diagnostic event to trouble code uds mapping EventDtcMapPowerPath110OverTemperatureFailure: diagnostic-event=EventPowerPath110OverTemperatureFailure, trouble-code-uds=Power_Path_110_Over_Temperature_Failure  # Event_Dtc_Map_Power_Path_110_Over_Temperature_Failure
  diagnostic event to operation cycle mapping EventOperCycleMapPowerPath110OverTemperatureFailure: diagnostic-event=EventPowerPath110OverTemperatureFailure, operation-cycle=DefaultOperationCycle  # Event_Oper_Cycle_Map_Power_Path_110_Over_Temperature_Failure
  diagnostic event to debounce algorithm mapping EventDebounceMapPowerPath110OverTemperatureFailure: debounce-algorithm=time_based, diagnostic-event=EventPowerPath110OverTemperatureFailure  # EventDebounceMap_Power_Path_110_Over_Temperature_Failure
package /ZeC/DTC/DTC/Power_Path_109_Over_Temperature_Failure
  diagnostic trouble code uds Power_Path_109_Over_Temperature_Failure: dtc-props=Dtc_Props_27288969, uds-dtc-value=0x00576d
  diagnostic event EventPowerPath109OverTemperatureFailure: aging-allowed=true, event-kind=SWC, prestorage-freeze-frame=false  # Event_Power_Path_109_Over_Temperature_Failure
  diagnostic event to trouble code uds mapping EventDtcMapPowerPath109OverTemperatureFailure: diagnostic-event=EventPowerPath109OverTemperatureFailure, trouble-code-uds=Power_Path_109_Over_Temperature_Failure  # Event_Dtc_Map_Power_Path_109_Over_Temperature_Failure
  diagnostic event to operation cycle mapping EventOperCycleMapPowerPath109OverTemperatureFailure: diagnostic-event=EventPowerPath109OverTemperatureFailure, operation-cycle=DefaultOperationCycle  # Event_Oper_Cycle_Map_Power_Path_109_Over_Temperature_Failure
  diagnostic event to debounce algorithm mapping EventDebounceMapPowerPath109OverTemperatureFailure: debounce-algorithm=time_based, diagnostic-event=EventPowerPath109OverTemperatureFailure  # EventDebounceMap_Power_Path_109_Over_Temperature_Failure
package /ZeC/DTC/DTC/Power_Path_111_Over_Temperature_Failure
  diagnostic trouble code uds Power_Path_111_Over_Temperature_Failure: dtc-props=Dtc_Props_ab1a9d1d, uds-dtc-value=0x00576f
  diagnostic event EventPowerPath111OverTemperatureFailure: aging-allowed=true, event-kind=SWC, prestorage-freeze-frame=false  # Event_Power_Path_111_Over_Temperature_Failure
  diagnostic event to trouble code uds mapping EventDtcMapPowerPath111OverTemperatureFailure: diagnostic-event=EventPowerPath111OverTemperatureFailure, trouble-code-uds=Power_Path_111_Over_Temperature_Failure  # Event_Dtc_Map_Power_Path_111_Over_Temperature_Failure
  diagnostic event to operation cycle mapping EventOperCycleMapPowerPath111OverTemperatureFailure: diagnostic-event=EventPowerPath111OverTemperatureFailure, operation-cycle=DefaultOperationCycle  # Event_Oper_Cycle_Map_Power_Path_111_Over_Temperature_Failure
  diagnostic event to debounce algorithm mapping EventDebounceMapPowerPath111OverTemperatureFailure: debounce-algorithm=time_based, diagnostic-event=EventPowerPath111OverTemperatureFailure  # EventDebounceMap_Power_Path_111_Over_Temperature_Failure
package /ZeC/DTC/DTC/Power_Path_114_Over_Temperature_Failure
  diagnostic trouble code uds Power_Path_114_Over_Temperature_Failure: dtc-props=Dtc_Props_93ba1771, uds-dtc-value=0x005772
  diagnostic event EventPowerPath114OverTemperatureFailure: aging-allowed=true, event-kind=SWC, prestorage-freeze-frame=false  # Event_Power_Path_114_Over_Temperature_Failure
  diagnostic event to trouble code uds mapping EventDtcMapPowerPath114OverTemperatureFailure: diagnostic-event=EventPowerPath114OverTemperatureFailure, trouble-code-uds=Power_Path_114_Over_Temperature_Failure  # Event_Dtc_Map_Power_Path_114_Over_Temperature_Failure
  diagnostic event to operation cycle mapping EventOperCycleMapPowerPath114OverTemperatureFailure: diagnostic-event=EventPowerPath114OverTemperatureFailure, operation-cycle=DefaultOperationCycle  # Event_Oper_Cycle_Map_Power_Path_114_Over_Temperature_Failure
  diagnostic event to debounce algorithm mapping EventDebounceMapPowerPath114OverTemperatureFailure: debounce-algorithm=time_based, diagnostic-event=EventPowerPath114OverTemperatureFailure  # EventDebounceMap_Power_Path_114_Over_Temperature_Failure
package /ZeC/DTC/DTC/Power_Path_113_Over_Temperature_Failure
  diagnostic trouble code uds Power_Path_113_Over_Temperature_Failure: dtc-props=Dtc_Props_5991093f, uds-dtc-value=0x005771
  diagnostic event EventPowerPath113OverTemperatureFailure: aging-allowed=true, event-kind=SWC, prestorage-freeze-frame=false  # Event_Power_Path_113_Over_Temperature_Failure
  diagnostic event to trouble code uds mapping EventDtcMapPowerPath113OverTemperatureFailure: diagnostic-event=EventPowerPath113OverTemperatureFailure, trouble-code-uds=Power_Path_113_Over_Temperature_Failure  # Event_Dtc_Map_Power_Path_113_Over_Temperature_Failure
  diagnostic event to operation cycle mapping EventOperCycleMapPowerPath113OverTemperatureFailure: diagnostic-event=EventPowerPath113OverTemperatureFailure, operation-cycle=DefaultOperationCycle  # Event_Oper_Cycle_Map_Power_Path_113_Over_Temperature_Failure
  diagnostic event to debounce algorithm mapping EventDebounceMapPowerPath113OverTemperatureFailure: debounce-algorithm=time_based, diagnostic-event=EventPowerPath113OverTemperatureFailure  # EventDebounceMap_Power_Path_113_Over_Temperature_Failure
package /ZeC/DTC/DTC/Power_Path_116_Over_Temperature_Failure
  diagnostic trouble code uds Power_Path_116_Over_Temperature_Failure: dtc-props=Dtc_Props_dc9d2dac, uds-dtc-value=0x005774
  diagnostic event EventPowerPath116OverTemperatureFailure: aging-allowed=true, event-kind=SWC, prestorage-freeze-frame=false  # Event_Power_Path_116_Over_Temperature_Failure
  diagnostic event to trouble code uds mapping EventDtcMapPowerPath116OverTemperatureFailure: diagnostic-event=EventPowerPath116OverTemperatureFailure, trouble-code-uds=Power_Path_116_Over_Temperature_Failure  # Event_Dtc_Map_Power_Path_116_Over_Temperature_Failure
  diagnostic event to operation cycle mapping EventOperCycleMapPowerPath116OverTemperatureFailure: diagnostic-event=EventPowerPath116OverTemperatureFailure, operation-cycle=DefaultOperationCycle  # Event_Oper_Cycle_Map_Power_Path_116_Over_Temperature_Failure
  diagnostic event to debounce algorithm mapping EventDebounceMapPowerPath116OverTemperatureFailure: debounce-algorithm=time_based, diagnostic-event=EventPowerPath116OverTemperatureFailure  # EventDebounceMap_Power_Path_116_Over_Temperature_Failure
package /ZeC/DTC/DTC/Power_Path_115_Over_Temperature_Failure
  diagnostic trouble code uds Power_Path_115_Over_Temperature_Failure: dtc-props=Dtc_Props_d5a31d4b, uds-dtc-value=0x005773
  diagnostic event EventPowerPath115OverTemperatureFailure: aging-allowed=true, event-kind=SWC, prestorage-freeze-frame=false  # Event_Power_Path_115_Over_Temperature_Failure
  diagnostic event to trouble code uds mapping EventDtcMapPowerPath115OverTemperatureFailure: diagnostic-event=EventPowerPath115OverTemperatureFailure, trouble-code-uds=Power_Path_115_Over_Temperature_Failure  # Event_Dtc_Map_Power_Path_115_Over_Temperature_Failure
  diagnostic event to operation cycle mapping EventOperCycleMapPowerPath115OverTemperatureFailure: diagnostic-event=EventPowerPath115OverTemperatureFailure, operation-cycle=DefaultOperationCycle  # Event_Oper_Cycle_Map_Power_Path_115_Over_Temperature_Failure
  diagnostic event to debounce algorithm mapping EventDebounceMapPowerPath115OverTemperatureFailure: debounce-algorithm=time_based, diagnostic-event=EventPowerPath115OverTemperatureFailure  # EventDebounceMap_Power_Path_115_Over_Temperature_Failure
package /ZeC/DTC/DTC/Power_Path_112_Over_Temperature_Failure
  diagnostic trouble code uds Power_Path_112_Over_Temperature_Failure: dtc-props=Dtc_Props_1f880305, uds-dtc-value=0x005770
  diagnostic event EventPowerPath112OverTemperatureFailure: aging-allowed=true, event-kind=SWC, prestorage-freeze-frame=false  # Event_Power_Path_112_Over_Temperature_Failure
  diagnostic event to trouble code uds mapping EventDtcMapPowerPath112OverTemperatureFailure: diagnostic-event=EventPowerPath112OverTemperatureFailure, trouble-code-uds=Power_Path_112_Over_Temperature_Failure  # Event_Dtc_Map_Power_Path_112_Over_Temperature_Failure
  diagnostic event to operation cycle mapping EventOperCycleMapPowerPath112OverTemperatureFailure: diagnostic-event=EventPowerPath112OverTemperatureFailure, operation-cycle=DefaultOperationCycle  # Event_Oper_Cycle_Map_Power_Path_112_Over_Temperature_Failure
  diagnostic event to debounce algorithm mapping EventDebounceMapPowerPath112OverTemperatureFailure: debounce-algorithm=time_based, diagnostic-event=EventPowerPath112OverTemperatureFailure  # EventDebounceMap_Power_Path_112_Over_Temperature_Failure
package /ZeC/DTC/DTC/Power_Path_088_Over_Temperature_Failure
  diagnostic trouble code uds Power_Path_088_Over_Temperature_Failure: dtc-props=Dtc_Props_1537df27, uds-dtc-value=0x005758
  diagnostic event EventPowerPath088OverTemperatureFailure: aging-allowed=true, event-kind=SWC, prestorage-freeze-frame=false  # Event_Power_Path_088_Over_Temperature_Failure
  diagnostic event to trouble code uds mapping EventDtcMapPowerPath088OverTemperatureFailure: diagnostic-event=EventPowerPath088OverTemperatureFailure, trouble-code-uds=Power_Path_088_Over_Temperature_Failure  # Event_Dtc_Map_Power_Path_088_Over_Temperature_Failure
  diagnostic event to operation cycle mapping EventOperCycleMapPowerPath088OverTemperatureFailure: diagnostic-event=EventPowerPath088OverTemperatureFailure, operation-cycle=DefaultOperationCycle  # Event_Oper_Cycle_Map_Power_Path_088_Over_Temperature_Failure
  diagnostic event to debounce algorithm mapping EventDebounceMapPowerPath088OverTemperatureFailure: debounce-algorithm=time_based, diagnostic-event=EventPowerPath088OverTemperatureFailure  # EventDebounceMap_Power_Path_088_Over_Temperature_Failure
package /ZeC/DTC/DTC/Power_Path_087_Over_Temperature_Failure
  diagnostic trouble code uds Power_Path_087_Over_Temperature_Failure: dtc-props=Dtc_Props_4152b4d3, uds-dtc-value=0x005757
  diagnostic event EventPowerPath087OverTemperatureFailure: aging-allowed=true, event-kind=SWC, prestorage-freeze-frame=false  # Event_Power_Path_087_Over_Temperature_Failure
  diagnostic event to trouble code uds mapping EventDtcMapPowerPath087OverTemperatureFailure: diagnostic-event=EventPowerPath087OverTemperatureFailure, trouble-code-uds=Power_Path_087_Over_Temperature_Failure  # Event_Dtc_Map_Power_Path_087_Over_Temperature_Failure
  diagnostic event to operation cycle mapping EventOperCycleMapPowerPath087OverTemperatureFailure: diagnostic-event=EventPowerPath087OverTemperatureFailure, operation-cycle=DefaultOperationCycle  # Event_Oper_Cycle_Map_Power_Path_087_Over_Temperature_Failure
  diagnostic event to debounce algorithm mapping EventDebounceMapPowerPath087OverTemperatureFailure: debounce-algorithm=time_based, diagnostic-event=EventPowerPath087OverTemperatureFailure  # EventDebounceMap_Power_Path_087_Over_Temperature_Failure
package /ZeC/DTC/DTC/Power_Path_089_Over_Temperature_Failure
  diagnostic trouble code uds Power_Path_089_Over_Temperature_Failure: dtc-props=Dtc_Props_532ed51d, uds-dtc-value=0x005759
  diagnostic event EventPowerPath089OverTemperatureFailure: aging-allowed=true, event-kind=SWC, prestorage-freeze-frame=false  # Event_Power_Path_089_Over_Temperature_Failure
  diagnostic event to trouble code uds mapping EventDtcMapPowerPath089OverTemperatureFailure: diagnostic-event=EventPowerPath089OverTemperatureFailure, trouble-code-uds=Power_Path_089_Over_Temperature_Failure  # Event_Dtc_Map_Power_Path_089_Over_Temperature_Failure
  diagnostic event to operation cycle mapping EventOperCycleMapPowerPath089OverTemperatureFailure: diagnostic-event=EventPowerPath089OverTemperatureFailure, operation-cycle=DefaultOperationCycle  # Event_Oper_Cycle_Map_Power_Path_089_Over_Temperature_Failure
  diagnostic event to debounce algorithm mapping EventDebounceMapPowerPath089OverTemperatureFailure: debounce-algorithm=time_based, diagnostic-event=EventPowerPath089OverTemperatureFailure  # EventDebounceMap_Power_Path_089_Over_Temperature_Failure
package /ZeC/DTC/DTC/Power_Path_084_Over_Temperature_Failure
  diagnostic trouble code uds Power_Path_084_Over_Temperature_Failure: dtc-props=Dtc_Props_8b79aa9d, uds-dtc-value=0x005754
  diagnostic event EventPowerPath084OverTemperatureFailure: aging-allowed=true, event-kind=SWC, prestorage-freeze-frame=false  # Event_Power_Path_084_Over_Temperature_Failure
  diagnostic event to trouble code uds mapping EventDtcMapPowerPath084OverTemperatureFailure: diagnostic-event=EventPowerPath084OverTemperatureFailure, trouble-code-uds=Power_Path_084_Over_Temperature_Failure  # Event_Dtc_Map_Power_Path_084_Over_Temperature_Failure
  diagnostic event to operation cycle mapping EventOperCycleMapPowerPath084OverTemperatureFailure: diagnostic-event=EventPowerPath084OverTemperatureFailure, operation-cycle=DefaultOperationCycle  # Event_Oper_Cycle_Map_Power_Path_084_Over_Temperature_Failure
  diagnostic event to debounce algorithm mapping EventDebounceMapPowerPath084OverTemperatureFailure: debounce-algorithm=time_based, diagnostic-event=EventPowerPath084OverTemperatureFailure  # EventDebounceMap_Power_Path_084_Over_Temperature_Failure
package /ZeC/DTC/DTC/Power_Path_083_Over_Temperature_Failure
  diagnostic trouble code uds Power_Path_083_Over_Temperature_Failure: dtc-props=Dtc_Props_82479a7a, uds-dtc-value=0x005753
  diagnostic event EventPowerPath083OverTemperatureFailure: aging-allowed=true, event-kind=SWC, prestorage-freeze-frame=false  # Event_Power_Path_083_Over_Temperature_Failure
  diagnostic event to trouble code uds mapping EventDtcMapPowerPath083OverTemperatureFailure: diagnostic-event=EventPowerPath083OverTemperatureFailure, trouble-code-uds=Power_Path_083_Over_Temperature_Failure  # Event_Dtc_Map_Power_Path_083_Over_Temperature_Failure
  diagnostic event to operation cycle mapping EventOperCycleMapPowerPath083OverTemperatureFailure: diagnostic-event=EventPowerPath083OverTemperatureFailure, operation-cycle=DefaultOperationCycle  # Event_Oper_Cycle_Map_Power_Path_083_Over_Temperature_Failure
  diagnostic event to debounce algorithm mapping EventDebounceMapPowerPath083OverTemperatureFailure: debounce-algorithm=time_based, diagnostic-event=EventPowerPath083OverTemperatureFailure  # EventDebounceMap_Power_Path_083_Over_Temperature_Failure
package /ZeC/DTC/DTC/Power_Path_086_Over_Temperature_Failure
  diagnostic trouble code uds Power_Path_086_Over_Temperature_Failure: dtc-props=Dtc_Props_74bbee9, uds-dtc-value=0x005756
  diagnostic event EventPowerPath086OverTemperatureFailure: aging-allowed=true, event-kind=SWC, prestorage-freeze-frame=false  # Event_Power_Path_086_Over_Temperature_Failure
  diagnostic event to trouble code uds mapping EventDtcMapPowerPath086OverTemperatureFailure: diagnostic-event=EventPowerPath086OverTemperatureFailure, trouble-code-uds=Power_Path_086_Over_Temperature_Failure  # Event_Dtc_Map_Power_Path_086_Over_Temperature_Failure
  diagnostic event to operation cycle mapping EventOperCycleMapPowerPath086OverTemperatureFailure: diagnostic-event=EventPowerPath086OverTemperatureFailure, operation-cycle=DefaultOperationCycle  # Event_Oper_Cycle_Map_Power_Path_086_Over_Temperature_Failure
  diagnostic event to debounce algorithm mapping EventDebounceMapPowerPath086OverTemperatureFailure: debounce-algorithm=time_based, diagnostic-event=EventPowerPath086OverTemperatureFailure  # EventDebounceMap_Power_Path_086_Over_Temperature_Failure
package /ZeC/DTC/DTC/Power_Path_085_Over_Temperature_Failure
  diagnostic trouble code uds Power_Path_085_Over_Temperature_Failure: dtc-props=Dtc_Props_cd60a0a7, uds-dtc-value=0x005755
  diagnostic event EventPowerPath085OverTemperatureFailure: aging-allowed=true, event-kind=SWC, prestorage-freeze-frame=false  # Event_Power_Path_085_Over_Temperature_Failure
  diagnostic event to trouble code uds mapping EventDtcMapPowerPath085OverTemperatureFailure: diagnostic-event=EventPowerPath085OverTemperatureFailure, trouble-code-uds=Power_Path_085_Over_Temperature_Failure  # Event_Dtc_Map_Power_Path_085_Over_Temperature_Failure
  diagnostic event to operation cycle mapping EventOperCycleMapPowerPath085OverTemperatureFailure: diagnostic-event=EventPowerPath085OverTemperatureFailure, operation-cycle=DefaultOperationCycle  # Event_Oper_Cycle_Map_Power_Path_085_Over_Temperature_Failure
  diagnostic event to debounce algorithm mapping EventDebounceMapPowerPath085OverTemperatureFailure: debounce-algorithm=time_based, diagnostic-event=EventPowerPath085OverTemperatureFailure  # EventDebounceMap_Power_Path_085_Over_Temperature_Failure
package /ZeC/DTC/DTC/Power_Path_091_Over_Temperature_Failure
  diagnostic trouble code uds Power_Path_091_Over_Temperature_Failure: dtc-props=Dtc_Props_f9a1f43d, uds-dtc-value=0x00575b
  diagnostic event EventPowerPath091OverTemperatureFailure: aging-allowed=true, event-kind=SWC, prestorage-freeze-frame=false  # Event_Power_Path_091_Over_Temperature_Failure
  diagnostic event to trouble code uds mapping EventDtcMapPowerPath091OverTemperatureFailure: diagnostic-event=EventPowerPath091OverTemperatureFailure, trouble-code-uds=Power_Path_091_Over_Temperature_Failure  # Event_Dtc_Map_Power_Path_091_Over_Temperature_Failure
  diagnostic event to operation cycle mapping EventOperCycleMapPowerPath091OverTemperatureFailure: diagnostic-event=EventPowerPath091OverTemperatureFailure, operation-cycle=DefaultOperationCycle  # Event_Oper_Cycle_Map_Power_Path_091_Over_Temperature_Failure
  diagnostic event to debounce algorithm mapping EventDebounceMapPowerPath091OverTemperatureFailure: debounce-algorithm=time_based, diagnostic-event=EventPowerPath091OverTemperatureFailure  # EventDebounceMap_Power_Path_091_Over_Temperature_Failure
package /ZeC/DTC/DTC/Power_Path_090_Over_Temperature_Failure
  diagnostic trouble code uds Power_Path_090_Over_Temperature_Failure: dtc-props=Dtc_Props_338aea73, uds-dtc-value=0x00575a
  diagnostic event EventPowerPath090OverTemperatureFailure: aging-allowed=true, event-kind=SWC, prestorage-freeze-frame=false  # Event_Power_Path_090_Over_Temperature_Failure
  diagnostic event to trouble code uds mapping EventDtcMapPowerPath090OverTemperatureFailure: diagnostic-event=EventPowerPath090OverTemperatureFailure, trouble-code-uds=Power_Path_090_Over_Temperature_Failure  # Event_Dtc_Map_Power_Path_090_Over_Temperature_Failure
  diagnostic event to operation cycle mapping EventOperCycleMapPowerPath090OverTemperatureFailure: diagnostic-event=EventPowerPath090OverTemperatureFailure, operation-cycle=DefaultOperationCycle  # Event_Oper_Cycle_Map_Power_Path_090_Over_Temperature_Failure
  diagnostic event to debounce algorithm mapping EventDebounceMapPowerPath090OverTemperatureFailure: debounce-algorithm=time_based, diagnostic-event=EventPowerPath090OverTemperatureFailure  # EventDebounceMap_Power_Path_090_Over_Temperature_Failure
package /ZeC/DTC/DTC/Power_Path_093_Over_Temperature_Failure
  diagnostic trouble code uds Power_Path_093_Over_Temperature_Failure: dtc-props=Dtc_Props_b686cee0, uds-dtc-value=0x00575d
  diagnostic event EventPowerPath093OverTemperatureFailure: aging-allowed=true, event-kind=SWC, prestorage-freeze-frame=false  # Event_Power_Path_093_Over_Temperature_Failure
  diagnostic event to trouble code uds mapping EventDtcMapPowerPath093OverTemperatureFailure: diagnostic-event=EventPowerPath093OverTemperatureFailure, trouble-code-uds=Power_Path_093_Over_Temperature_Failure  # Event_Dtc_Map_Power_Path_093_Over_Temperature_Failure
  diagnostic event to operation cycle mapping EventOperCycleMapPowerPath093OverTemperatureFailure: diagnostic-event=EventPowerPath093OverTemperatureFailure, operation-cycle=DefaultOperationCycle  # Event_Oper_Cycle_Map_Power_Path_093_Over_Temperature_Failure
  diagnostic event to debounce algorithm mapping EventDebounceMapPowerPath093OverTemperatureFailure: debounce-algorithm=time_based, diagnostic-event=EventPowerPath093OverTemperatureFailure  # EventDebounceMap_Power_Path_093_Over_Temperature_Failure
package /ZeC/DTC/DTC/Power_Path_092_Over_Temperature_Failure
  diagnostic trouble code uds Power_Path_092_Over_Temperature_Failure: dtc-props=Dtc_Props_bfb8fe07, uds-dtc-value=0x00575c
  diagnostic event EventPowerPath092OverTemperatureFailure: aging-allowed=true, event-kind=SWC, prestorage-freeze-frame=false  # Event_Power_Path_092_Over_Temperature_Failure
  diagnostic event to trouble code uds mapping EventDtcMapPowerPath092OverTemperatureFailure: diagnostic-event=EventPowerPath092OverTemperatureFailure, trouble-code-uds=Power_Path_092_Over_Temperature_Failure  # Event_Dtc_Map_Power_Path_092_Over_Temperature_Failure
  diagnostic event to operation cycle mapping EventOperCycleMapPowerPath092OverTemperatureFailure: diagnostic-event=EventPowerPath092OverTemperatureFailure, operation-cycle=DefaultOperationCycle  # Event_Oper_Cycle_Map_Power_Path_092_Over_Temperature_Failure
  diagnostic event to debounce algorithm mapping EventDebounceMapPowerPath092OverTemperatureFailure: debounce-algorithm=time_based, diagnostic-event=EventPowerPath092OverTemperatureFailure  # EventDebounceMap_Power_Path_092_Over_Temperature_Failure
package /ZeC/DTC/DTC/Power_Path_095_Over_Temperature_Failure
  diagnostic trouble code uds Power_Path_095_Over_Temperature_Failure: dtc-props=Dtc_Props_3ab4da94, uds-dtc-value=0x00575f
  diagnostic event EventPowerPath095OverTemperatureFailure: aging-allowed=true, event-kind=SWC, prestorage-freeze-frame=false  # Event_Power_Path_095_Over_Temperature_Failure
  diagnostic event to trouble code uds mapping EventDtcMapPowerPath095OverTemperatureFailure: diagnostic-event=EventPowerPath095OverTemperatureFailure, trouble-code-uds=Power_Path_095_Over_Temperature_Failure  # Event_Dtc_Map_Power_Path_095_Over_Temperature_Failure
  diagnostic event to operation cycle mapping EventOperCycleMapPowerPath095OverTemperatureFailure: diagnostic-event=EventPowerPath095OverTemperatureFailure, operation-cycle=DefaultOperationCycle  # Event_Oper_Cycle_Map_Power_Path_095_Over_Temperature_Failure
  diagnostic event to debounce algorithm mapping EventDebounceMapPowerPath095OverTemperatureFailure: debounce-algorithm=time_based, diagnostic-event=EventPowerPath095OverTemperatureFailure  # EventDebounceMap_Power_Path_095_Over_Temperature_Failure
package /ZeC/DTC/DTC/Power_Path_094_Over_Temperature_Failure
  diagnostic trouble code uds Power_Path_094_Over_Temperature_Failure: dtc-props=Dtc_Props_f09fc4da, uds-dtc-value=0x00575e
  diagnostic event EventPowerPath094OverTemperatureFailure: aging-allowed=true, event-kind=SWC, prestorage-freeze-frame=false  # Event_Power_Path_094_Over_Temperature_Failure
  diagnostic event to trouble code uds mapping EventDtcMapPowerPath094OverTemperatureFailure: diagnostic-event=EventPowerPath094OverTemperatureFailure, trouble-code-uds=Power_Path_094_Over_Temperature_Failure  # Event_Dtc_Map_Power_Path_094_Over_Temperature_Failure
  diagnostic event to operation cycle mapping EventOperCycleMapPowerPath094OverTemperatureFailure: diagnostic-event=EventPowerPath094OverTemperatureFailure, operation-cycle=DefaultOperationCycle  # Event_Oper_Cycle_Map_Power_Path_094_Over_Temperature_Failure
  diagnostic event to debounce algorithm mapping EventDebounceMapPowerPath094OverTemperatureFailure: debounce-algorithm=time_based, diagnostic-event=EventPowerPath094OverTemperatureFailure  # EventDebounceMap_Power_Path_094_Over_Temperature_Failure
package /ZeC/DTC/DTC/Power_Path_097_Over_Temperature_Failure
  diagnostic trouble code uds Power_Path_097_Over_Temperature_Failure: dtc-props=Dtc_Props_9fdbc987, uds-dtc-value=0x005761
  diagnostic event EventPowerPath097OverTemperatureFailure: aging-allowed=true, event-kind=SWC, prestorage-freeze-frame=false  # Event_Power_Path_097_Over_Temperature_Failure
  diagnostic event to trouble code uds mapping EventDtcMapPowerPath097OverTemperatureFailure: diagnostic-event=EventPowerPath097OverTemperatureFailure, trouble-code-uds=Power_Path_097_Over_Temperature_Failure  # Event_Dtc_Map_Power_Path_097_Over_Temperature_Failure
  diagnostic event to operation cycle mapping EventOperCycleMapPowerPath097OverTemperatureFailure: diagnostic-event=EventPowerPath097OverTemperatureFailure, operation-cycle=DefaultOperationCycle  # Event_Oper_Cycle_Map_Power_Path_097_Over_Temperature_Failure
  diagnostic event to debounce algorithm mapping EventDebounceMapPowerPath097OverTemperatureFailure: debounce-algorithm=time_based, diagnostic-event=EventPowerPath097OverTemperatureFailure  # EventDebounceMap_Power_Path_097_Over_Temperature_Failure
package /ZeC/DTC/DTC/Power_Path_096_Over_Temperature_Failure
  diagnostic trouble code uds Power_Path_096_Over_Temperature_Failure: dtc-props=Dtc_Props_d9c2c3bd, uds-dtc-value=0x005760
  diagnostic event EventPowerPath096OverTemperatureFailure: aging-allowed=true, event-kind=SWC, prestorage-freeze-frame=false  # Event_Power_Path_096_Over_Temperature_Failure
  diagnostic event to trouble code uds mapping EventDtcMapPowerPath096OverTemperatureFailure: diagnostic-event=EventPowerPath096OverTemperatureFailure, trouble-code-uds=Power_Path_096_Over_Temperature_Failure  # Event_Dtc_Map_Power_Path_096_Over_Temperature_Failure
  diagnostic event to operation cycle mapping EventOperCycleMapPowerPath096OverTemperatureFailure: diagnostic-event=EventPowerPath096OverTemperatureFailure, operation-cycle=DefaultOperationCycle  # Event_Oper_Cycle_Map_Power_Path_096_Over_Temperature_Failure
  diagnostic event to debounce algorithm mapping EventDebounceMapPowerPath096OverTemperatureFailure: debounce-algorithm=time_based, diagnostic-event=EventPowerPath096OverTemperatureFailure  # EventDebounceMap_Power_Path_096_Over_Temperature_Failure
package /ZeC/DTC/DTC/Power_Path_099_Over_Temperature_Failure
  diagnostic trouble code uds Power_Path_099_Over_Temperature_Failure: dtc-props=Dtc_Props_13e9ddf3, uds-dtc-value=0x005763
  diagnostic event EventPowerPath099OverTemperatureFailure: aging-allowed=true, event-kind=SWC, prestorage-freeze-frame=false  # Event_Power_Path_099_Over_Temperature_Failure
  diagnostic event to trouble code uds mapping EventDtcMapPowerPath099OverTemperatureFailure: diagnostic-event=EventPowerPath099OverTemperatureFailure, trouble-code-uds=Power_Path_099_Over_Temperature_Failure  # Event_Dtc_Map_Power_Path_099_Over_Temperature_Failure
  diagnostic event to operation cycle mapping EventOperCycleMapPowerPath099OverTemperatureFailure: diagnostic-event=EventPowerPath099OverTemperatureFailure, operation-cycle=DefaultOperationCycle  # Event_Oper_Cycle_Map_Power_Path_099_Over_Temperature_Failure
  diagnostic event to debounce algorithm mapping EventDebounceMapPowerPath099OverTemperatureFailure: debounce-algorithm=time_based, diagnostic-event=EventPowerPath099OverTemperatureFailure  # EventDebounceMap_Power_Path_099_Over_Temperature_Failure
package /ZeC/DTC/DTC/Power_Path_098_Over_Temperature_Failure
  diagnostic trouble code uds Power_Path_098_Over_Temperature_Failure: dtc-props=Dtc_Props_55f0d7c9, uds-dtc-value=0x005762
  diagnostic event EventPowerPath098OverTemperatureFailure: aging-allowed=true, event-kind=SWC, prestorage-freeze-frame=false  # Event_Power_Path_098_Over_Temperature_Failure
  diagnostic event to trouble code uds mapping EventDtcMapPowerPath098OverTemperatureFailure: diagnostic-event=EventPowerPath098OverTemperatureFailure, trouble-code-uds=Power_Path_098_Over_Temperature_Failure  # Event_Dtc_Map_Power_Path_098_Over_Temperature_Failure
  diagnostic event to operation cycle mapping EventOperCycleMapPowerPath098OverTemperatureFailure: diagnostic-event=EventPowerPath098OverTemperatureFailure, operation-cycle=DefaultOperationCycle  # Event_Oper_Cycle_Map_Power_Path_098_Over_Temperature_Failure
  diagnostic event to debounce algorithm mapping EventDebounceMapPowerPath098OverTemperatureFailure: debounce-algorithm=time_based, diagnostic-event=EventPowerPath098OverTemperatureFailure  # EventDebounceMap_Power_Path_098_Over_Temperature_Failure
package /ZeC/DTC/DTC/Power_Path_003_Over_Temperature_Failure
  diagnostic trouble code uds Power_Path_003_Over_Temperature_Failure: dtc-props=Dtc_Props_ebc454a0, uds-dtc-value=0x005703
  diagnostic event EventPowerPath003OverTemperatureFailure: aging-allowed=true, event-kind=SWC, prestorage-freeze-frame=false  # Event_Power_Path_003_Over_Temperature_Failure
  diagnostic event to trouble code uds mapping EventDtcMapPowerPath003OverTemperatureFailure: diagnostic-event=EventPowerPath003OverTemperatureFailure, trouble-code-uds=Power_Path_003_Over_Temperature_Failure  # Event_Dtc_Map_Power_Path_003_Over_Temperature_Failure
  diagnostic event to operation cycle mapping EventOperCycleMapPowerPath003OverTemperatureFailure: diagnostic-event=EventPowerPath003OverTemperatureFailure, operation-cycle=DefaultOperationCycle  # Event_Oper_Cycle_Map_Power_Path_003_Over_Temperature_Failure
  diagnostic event to debounce algorithm mapping EventDebounceMapPowerPath003OverTemperatureFailure: debounce-algorithm=time_based, diagnostic-event=EventPowerPath003OverTemperatureFailure  # EventDebounceMap_Power_Path_003_Over_Temperature_Failure
package /ZeC/DTC/DTC/Power_Path_002_Over_Temperature_Failure
  diagnostic trouble code uds Power_Path_002_Over_Temperature_Failure: dtc-props=Dtc_Props_addd5e9a, uds-dtc-value=0x005702
  diagnostic event EventPowerPath002OverTemperatureFailure: aging-allowed=true, event-kind=SWC, prestorage-freeze-frame=false  # Event_Power_Path_002_Over_Temperature_Failure
  diagnostic event to trouble code uds mapping EventDtcMapPowerPath002OverTemperatureFailure: diagnostic-event=EventPowerPath002OverTemperatureFailure, trouble-code-uds=Power_Path_002_Over_Temperature_Failure  # Event_Dtc_Map_Power_Path_002_Over_Temperature_Failure
  diagnostic event to operation cycle mapping EventOperCycleMapPowerPath002OverTemperatureFailure: diagnostic-event=EventPowerPath002OverTemperatureFailure, operation-cycle=DefaultOperationCycle  # Event_Oper_Cycle_Map_Power_Path_002_Over_Temperature_Failure
  diagnostic event to debounce algorithm mapping EventDebounceMapPowerPath002OverTemperatureFailure: debounce-algorithm=time_based, diagnostic-event=EventPowerPath002OverTemperatureFailure  # EventDebounceMap_Power_Path_002_Over_Temperature_Failure
package /ZeC/DTC/DTC/Power_Path_005_Over_Temperature_Failure
  diagnostic trouble code uds Power_Path_005_Over_Temperature_Failure: dtc-props=Dtc_Props_67f640d4, uds-dtc-value=0x005705
  diagnostic event EventPowerPath005OverTemperatureFailure: aging-allowed=true, event-kind=SWC, prestorage-freeze-frame=false  # Event_Power_Path_005_Over_Temperature_Failure
  diagnostic event to trouble code uds mapping EventDtcMapPowerPath005OverTemperatureFailure: diagnostic-event=EventPowerPath005OverTemperatureFailure, trouble-code-uds=Power_Path_005_Over_Temperature_Failure  # Event_Dtc_Map_Power_Path_005_Over_Temperature_Failure
  diagnostic event to operation cycle mapping EventOperCycleMapPowerPath005OverTemperatureFailure: diagnostic-event=EventPowerPath005OverTemperatureFailure, operation-cycle=DefaultOperationCycle  # Event_Oper_Cycle_Map_Power_Path_005_Over_Temperature_Failure
  diagnostic event to debounce algorithm mapping EventDebounceMapPowerPath005OverTemperatureFailure: debounce-algorithm=time_based, diagnostic-event=EventPowerPath005OverTemperatureFailure  # EventDebounceMap_Power_Path_005_Over_Temperature_Failure
package /ZeC/DTC/DTC/Power_Path_004_Over_Temperature_Failure
  diagnostic trouble code uds Power_Path_004_Over_Temperature_Failure: dtc-props=Dtc_Props_e2fa6447, uds-dtc-value=0x005704
  diagnostic event EventPowerPath004OverTemperatureFailure: aging-allowed=true, event-kind=SWC, prestorage-freeze-frame=false  # Event_Power_Path_004_Over_Temperature_Failure
  diagnostic event to trouble code uds mapping EventDtcMapPowerPath004OverTemperatureFailure: diagnostic-event=EventPowerPath004OverTemperatureFailure, trouble-code-uds=Power_Path_004_Over_Temperature_Failure  # Event_Dtc_Map_Power_Path_004_Over_Temperature_Failure
  diagnostic event to operation cycle mapping EventOperCycleMapPowerPath004OverTemperatureFailure: diagnostic-event=EventPowerPath004OverTemperatureFailure, operation-cycle=DefaultOperationCycle  # Event_Oper_Cycle_Map_Power_Path_004_Over_Temperature_Failure
  diagnostic event to debounce algorithm mapping EventDebounceMapPowerPath004OverTemperatureFailure: debounce-algorithm=time_based, diagnostic-event=EventPowerPath004OverTemperatureFailure  # EventDebounceMap_Power_Path_004_Over_Temperature_Failure
package /ZeC/DTC/DTC/Power_Path_001_Over_Temperature_Failure
  diagnostic trouble code uds Power_Path_001_Over_Temperature_Failure: dtc-props=Dtc_Props_67f640d4, uds-dtc-value=0x005701
  diagnostic event EventPowerPath001OverTemperatureFailure: aging-allowed=true, event-kind=SWC, prestorage-freeze-frame=false  # Event_Power_Path_001_Over_Temperature_Failure
  diagnostic event to trouble code uds mapping EventDtcMapPowerPath001OverTemperatureFailure: diagnostic-event=EventPowerPath001OverTemperatureFailure, trouble-code-uds=Power_Path_001_Over_Temperature_Failure  # Event_Dtc_Map_Power_Path_001_Over_Temperature_Failure
  diagnostic event to operation cycle mapping EventOperCycleMapPowerPath001OverTemperatureFailure: diagnostic-event=EventPowerPath001OverTemperatureFailure, operation-cycle=DefaultOperationCycle  # Event_Oper_Cycle_Map_Power_Path_001_Over_Temperature_Failure
  diagnostic event to debounce algorithm mapping EventDebounceMapPowerPath001OverTemperatureFailure: debounce-algorithm=time_based, diagnostic-event=EventPowerPath001OverTemperatureFailure  # EventDebounceMap_Power_Path_001_Over_Temperature_Failure
package /ZeC/DTC/DTC/Power_Path_007_Over_Temperature_Failure
  diagnostic trouble code uds Power_Path_007_Over_Temperature_Failure: dtc-props=Dtc_Props_28d17a09, uds-dtc-value=0x005707
  diagnostic event EventPowerPath007OverTemperatureFailure: aging-allowed=true, event-kind=SWC, prestorage-freeze-frame=false  # Event_Power_Path_007_Over_Temperature_Failure
  diagnostic event to trouble code uds mapping EventDtcMapPowerPath007OverTemperatureFailure: diagnostic-event=EventPowerPath007OverTemperatureFailure, trouble-code-uds=Power_Path_007_Over_Temperature_Failure  # Event_Dtc_Map_Power_Path_007_Over_Temperature_Failure
  diagnostic event to operation cycle mapping EventOperCycleMapPowerPath007OverTemperatureFailure: diagnostic-event=EventPowerPath007OverTemperatureFailure, operation-cycle=DefaultOperationCycle  # Event_Oper_Cycle_Map_Power_Path_007_Over_Temperature_Failure
  diagnostic event to debounce algorithm mapping EventDebounceMapPowerPath007OverTemperatureFailure: debounce-algorithm=time_based, diagnostic-event=EventPowerPath007OverTemperatureFailure  # EventDebounceMap_Power_Path_007_Over_Temperature_Failure
package /ZeC/DTC/DTC/Power_Path_006_Over_Temperature_Failure
  diagnostic trouble code uds Power_Path_006_Over_Temperature_Failure: dtc-props=Dtc_Props_6ec87033, uds-dtc-value=0x005706
  diagnostic event EventPowerPath006OverTemperatureFailure: aging-allowed=true, event-kind=SWC, prestorage-freeze-frame=false  # Event_Power_Path_006_Over_Temperature_Failure
  diagnostic event to trouble code uds mapping EventDtcMapPowerPath006OverTemperatureFailure: diagnostic-event=EventPowerPath006OverTemperatureFailure, trouble-code-uds=Power_Path_006_Over_Temperature_Failure  # Event_Dtc_Map_Power_Path_006_Over_Temperature_Failure
  diagnostic event to operation cycle mapping EventOperCycleMapPowerPath006OverTemperatureFailure: diagnostic-event=EventPowerPath006OverTemperatureFailure, operation-cycle=DefaultOperationCycle  # Event_Oper_Cycle_Map_Power_Path_006_Over_Temperature_Failure
  diagnostic event to debounce algorithm mapping EventDebounceMapPowerPath006OverTemperatureFailure: debounce-algorithm=time_based, diagnostic-event=EventPowerPath006OverTemperatureFailure  # EventDebounceMap_Power_Path_006_Over_Temperature_Failure
package /ZeC/DTC/DTC/Power_Path_009_Over_Temperature_Failure
  diagnostic trouble code uds Power_Path_009_Over_Temperature_Failure: dtc-props=Dtc_Props_3aad1bc7, uds-dtc-value=0x005709
  diagnostic event EventPowerPath009OverTemperatureFailure: aging-allowed=true, event-kind=SWC, prestorage-freeze-frame=false  # Event_Power_Path_009_Over_Temperature_Failure
  diagnostic event to trouble code uds mapping EventDtcMapPowerPath009OverTemperatureFailure: diagnostic-event=EventPowerPath009OverTemperatureFailure, trouble-code-uds=Power_Path_009_Over_Temperature_Failure  # Event_Dtc_Map_Power_Path_009_Over_Temperature_Failure
  diagnostic event to operation cycle mapping EventOperCycleMapPowerPath009OverTemperatureFailure: diagnostic-event=EventPowerPath009OverTemperatureFailure, operation-cycle=DefaultOperationCycle  # Event_Oper_Cycle_Map_Power_Path_009_Over_Temperature_Failure
  diagnostic event to debounce algorithm mapping EventDebounceMapPowerPath009OverTemperatureFailure: debounce-algorithm=time_based, diagnostic-event=EventPowerPath009OverTemperatureFailure  # EventDebounceMap_Power_Path_009_Over_Temperature_Failure
package /ZeC/DTC/DTC/Power_Path_008_Over_Temperature_Failure
  diagnostic trouble code uds Power_Path_008_Over_Temperature_Failure: dtc-props=Dtc_Props_7cb411fd, uds-dtc-value=0x005708
  diagnostic event EventPowerPath008OverTemperatureFailure: aging-allowed=true, event-kind=SWC, prestorage-freeze-frame=false  # Event_Power_Path_008_Over_Temperature_Failure
  diagnostic event to trouble code uds mapping EventDtcMapPowerPath008OverTemperatureFailure: diagnostic-event=EventPowerPath008OverTemperatureFailure, trouble-code-uds=Power_Path_008_Over_Temperature_Failure  # Event_Dtc_Map_Power_Path_008_Over_Temperature_Failure
  diagnostic event to operation cycle mapping EventOperCycleMapPowerPath008OverTemperatureFailure: diagnostic-event=EventPowerPath008OverTemperatureFailure, operation-cycle=DefaultOperationCycle  # Event_Oper_Cycle_Map_Power_Path_008_Over_Temperature_Failure
  diagnostic event to debounce algorithm mapping EventDebounceMapPowerPath008OverTemperatureFailure: debounce-algorithm=time_based, diagnostic-event=EventPowerPath008OverTemperatureFailure  # EventDebounceMap_Power_Path_008_Over_Temperature_Failure
package /ZeC/DTC/DTC/Power_Path_012_Over_Temperature_Failure
  diagnostic trouble code uds Power_Path_012_Over_Temperature_Failure: dtc-props=Dtc_Props_d63b30dd, uds-dtc-value=0x00570c
  diagnostic event EventPowerPath012OverTemperatureFailure: aging-allowed=true, event-kind=SWC, prestorage-freeze-frame=false  # Event_Power_Path_012_Over_Temperature_Failure
  diagnostic event to trouble code uds mapping EventDtcMapPowerPath012OverTemperatureFailure: diagnostic-event=EventPowerPath012OverTemperatureFailure, trouble-code-uds=Power_Path_012_Over_Temperature_Failure  # Event_Dtc_Map_Power_Path_012_Over_Temperature_Failure
  diagnostic event to operation cycle mapping EventOperCycleMapPowerPath012OverTemperatureFailure: diagnostic-event=EventPowerPath012OverTemperatureFailure, operation-cycle=DefaultOperationCycle  # Event_Oper_Cycle_Map_Power_Path_012_Over_Temperature_Failure
  diagnostic event to debounce algorithm mapping EventDebounceMapPowerPath012OverTemperatureFailure: debounce-algorithm=time_based, diagnostic-event=EventPowerPath012OverTemperatureFailure  # EventDebounceMap_Power_Path_012_Over_Temperature_Failure
package /ZeC/DTC/DTC/Power_Path_011_Over_Temperature_Failure
  diagnostic trouble code uds Power_Path_011_Over_Temperature_Failure: dtc-props=Dtc_Props_90223ae7, uds-dtc-value=0x00570b
  diagnostic event EventPowerPath011OverTemperatureFailure: aging-allowed=true, event-kind=SWC, prestorage-freeze-frame=false  # Event_Power_Path_011_Over_Temperature_Failure
  diagnostic event to trouble code uds mapping EventDtcMapPowerPath011OverTemperatureFailure: diagnostic-event=EventPowerPath011OverTemperatureFailure, trouble-code-uds=Power_Path_011_Over_Temperature_Failure  # Event_Dtc_Map_Power_Path_011_Over_Temperature_Failure
  diagnostic event to operation cycle mapping EventOperCycleMapPowerPath011OverTemperatureFailure: diagnostic-event=EventPowerPath011OverTemperatureFailure, operation-cycle=DefaultOperationCycle  # Event_Oper_Cycle_Map_Power_Path_011_Over_Temperature_Failure
  diagnostic event to debounce algorithm mapping EventDebounceMapPowerPath011OverTemperatureFailure: debounce-algorithm=time_based, diagnostic-event=EventPowerPath011OverTemperatureFailure  # EventDebounceMap_Power_Path_011_Over_Temperature_Failure
package /ZeC/DTC/DTC/Power_Path_014_Over_Temperature_Failure
  diagnostic trouble code uds Power_Path_014_Over_Temperature_Failure: dtc-props=Dtc_Props_991c0a00, uds-dtc-value=0x00570e
  diagnostic event EventPowerPath014OverTemperatureFailure: aging-allowed=true, event-kind=SWC, prestorage-freeze-frame=false  # Event_Power_Path_014_Over_Temperature_Failure
  diagnostic event to trouble code uds mapping EventDtcMapPowerPath014OverTemperatureFailure: diagnostic-event=EventPowerPath014OverTemperatureFailure, trouble-code-uds=Power_Path_014_Over_Temperature_Failure  # Event_Dtc_Map_Power_Path_014_Over_Temperature_Failure
  diagnostic event to operation cycle mapping EventOperCycleMapPowerPath014OverTemperatureFailure: diagnostic-event=EventPowerPath014OverTemperatureFailure, operation-cycle=DefaultOperationCycle  # Event_Oper_Cycle_Map_Power_Path_014_Over_Temperature_Failure
  diagnostic event to debounce algorithm mapping EventDebounceMapPowerPath014OverTemperatureFailure: debounce-algorithm=time_based, diagnostic-event=EventPowerPath014OverTemperatureFailure  # EventDebounceMap_Power_Path_014_Over_Temperature_Failure
package /ZeC/DTC/DTC/Power_Path_013_Over_Temperature_Failure
  diagnostic trouble code uds Power_Path_013_Over_Temperature_Failure: dtc-props=Dtc_Props_df05003a, uds-dtc-value=0x00570d
  diagnostic event EventPowerPath013OverTemperatureFailure: aging-allowed=true, event-kind=SWC, prestorage-freeze-frame=false  # Event_Power_Path_013_Over_Temperature_Failure
  diagnostic event to trouble code uds mapping EventDtcMapPowerPath013OverTemperatureFailure: diagnostic-event=EventPowerPath013OverTemperatureFailure, trouble-code-uds=Power_Path_013_Over_Temperature_Failure  # Event_Dtc_Map_Power_Path_013_Over_Temperature_Failure
  diagnostic event to operation cycle mapping EventOperCycleMapPowerPath013OverTemperatureFailure: diagnostic-event=EventPowerPath013OverTemperatureFailure, operation-cycle=DefaultOperationCycle  # Event_Oper_Cycle_Map_Power_Path_013_Over_Temperature_Failure
  diagnostic event to debounce algorithm mapping EventDebounceMapPowerPath013OverTemperatureFailure: debounce-algorithm=time_based, diagnostic-event=EventPowerPath013OverTemperatureFailure  # EventDebounceMap_Power_Path_013_Over_Temperature_Failure
package /ZeC/DTC/DTC/Power_Path_010_Over_Temperature_Failure
  diagnostic trouble code uds Power_Path_010_Over_Temperature_Failure: dtc-props=Dtc_Props_5a0924a9, uds-dtc-value=0x00570a
  diagnostic event EventPowerPath010OverTemperatureFailure: aging-allowed=true, event-kind=SWC, prestorage-freeze-frame=false  # Event_Power_Path_010_Over_Temperature_Failure
  diagnostic event to trouble code uds mapping EventDtcMapPowerPath010OverTemperatureFailure: diagnostic-event=EventPowerPath010OverTemperatureFailure, trouble-code-uds=Power_Path_010_Over_Temperature_Failure  # Event_Dtc_Map_Power_Path_010_Over_Temperature_Failure
  diagnostic event to operation cycle mapping EventOperCycleMapPowerPath010OverTemperatureFailure: diagnostic-event=EventPowerPath010OverTemperatureFailure, operation-cycle=DefaultOperationCycle  # Event_Oper_Cycle_Map_Power_Path_010_Over_Temperature_Failure
  diagnostic event to debounce algorithm mapping EventDebounceMapPowerPath010OverTemperatureFailure: debounce-algorithm=time_based, diagnostic-event=EventPowerPath010OverTemperatureFailure  # EventDebounceMap_Power_Path_010_Over_Temperature_Failure
package /ZeC/DTC/DTC/Power_Path_015_Over_Temperature_Failure
  diagnostic trouble code uds Power_Path_015_Over_Temperature_Failure: dtc-props=Dtc_Props_5337144e, uds-dtc-value=0x00570f
  diagnostic event EventPowerPath015OverTemperatureFailure: aging-allowed=true, event-kind=SWC, prestorage-freeze-frame=false  # Event_Power_Path_015_Over_Temperature_Failure
  diagnostic event to trouble code uds mapping EventDtcMapPowerPath015OverTemperatureFailure: diagnostic-event=EventPowerPath015OverTemperatureFailure, trouble-code-uds=Power_Path_015_Over_Temperature_Failure  # Event_Dtc_Map_Power_Path_015_Over_Temperature_Failure
  diagnostic event to operation cycle mapping EventOperCycleMapPowerPath015OverTemperatureFailure: diagnostic-event=EventPowerPath015OverTemperatureFailure, operation-cycle=DefaultOperationCycle  # Event_Oper_Cycle_Map_Power_Path_015_Over_Temperature_Failure
  diagnostic event to debounce algorithm mapping EventDebounceMapPowerPath015OverTemperatureFailure: debounce-algorithm=time_based, diagnostic-event=EventPowerPath015OverTemperatureFailure  # EventDebounceMap_Power_Path_015_Over_Temperature_Failure
package /ZeC/DTC/DTC/Power_Path_037_Over_Temperature_Failure
  diagnostic trouble code uds Power_Path_037_Over_Temperature_Failure: dtc-props=Dtc_Props_f307e94c, uds-dtc-value=0x005725
  diagnostic event EventPowerPath037OverTemperatureFailure: aging-allowed=true, event-kind=SWC, prestorage-freeze-frame=false  # Event_Power_Path_037_Over_Temperature_Failure
  diagnostic event to trouble code uds mapping EventDtcMapPowerPath037OverTemperatureFailure: diagnostic-event=EventPowerPath037OverTemperatureFailure, trouble-code-uds=Power_Path_037_Over_Temperature_Failure  # Event_Dtc_Map_Power_Path_037_Over_Temperature_Failure
  diagnostic event to operation cycle mapping EventOperCycleMapPowerPath037OverTemperatureFailure: diagnostic-event=EventPowerPath037OverTemperatureFailure, operation-cycle=DefaultOperationCycle  # Event_Oper_Cycle_Map_Power_Path_037_Over_Temperature_Failure
  diagnostic event to debounce algorithm mapping EventDebounceMapPowerPath037OverTemperatureFailure: debounce-algorithm=time_based, diagnostic-event=EventPowerPath037OverTemperatureFailure  # EventDebounceMap_Power_Path_037_Over_Temperature_Failure
package /ZeC/DTC/DTC/Power_Path_036_Over_Temperature_Failure
  diagnostic trouble code uds Power_Path_036_Over_Temperature_Failure: dtc-props=Dtc_Props_b51ee376, uds-dtc-value=0x005724
  diagnostic event EventPowerPath036OverTemperatureFailure: aging-allowed=true, event-kind=SWC, prestorage-freeze-frame=false  # Event_Power_Path_036_Over_Temperature_Failure
  diagnostic event to trouble code uds mapping EventDtcMapPowerPath036OverTemperatureFailure: diagnostic-event=EventPowerPath036OverTemperatureFailure, trouble-code-uds=Power_Path_036_Over_Temperature_Failure  # Event_Dtc_Map_Power_Path_036_Over_Temperature_Failure
  diagnostic event to operation cycle mapping EventOperCycleMapPowerPath036OverTemperatureFailure: diagnostic-event=EventPowerPath036OverTemperatureFailure, operation-cycle=DefaultOperationCycle  # Event_Oper_Cycle_Map_Power_Path_036_Over_Temperature_Failure
  diagnostic event to debounce algorithm mapping EventDebounceMapPowerPath036OverTemperatureFailure: debounce-algorithm=time_based, diagnostic-event=EventPowerPath036OverTemperatureFailure  # EventDebounceMap_Power_Path_036_Over_Temperature_Failure
package /ZeC/DTC/DTC/Power_Path_039_Over_Temperature_Failure
  diagnostic trouble code uds Power_Path_039_Over_Temperature_Failure: dtc-props=Dtc_Props_7f35fd38, uds-dtc-value=0x005727
  diagnostic event EventPowerPath039OverTemperatureFailure: aging-allowed=true, event-kind=SWC, prestorage-freeze-frame=false  # Event_Power_Path_039_Over_Temperature_Failure
  diagnostic event to trouble code uds mapping EventDtcMapPowerPath039OverTemperatureFailure: diagnostic-event=EventPowerPath039OverTemperatureFailure, trouble-code-uds=Power_Path_039_Over_Temperature_Failure  # Event_Dtc_Map_Power_Path_039_Over_Temperature_Failure
  diagnostic event to operation cycle mapping EventOperCycleMapPowerPath039OverTemperatureFailure: diagnostic-event=EventPowerPath039OverTemperatureFailure, operation-cycle=DefaultOperationCycle  # Event_Oper_Cycle_Map_Power_Path_039_Over_Temperature_Failure
  diagnostic event to debounce algorithm mapping EventDebounceMapPowerPath039OverTemperatureFailure: debounce-algorithm=time_based, diagnostic-event=EventPowerPath039OverTemperatureFailure  # EventDebounceMap_Power_Path_039_Over_Temperature_Failure
package /ZeC/DTC/DTC/Power_Path_038_Over_Temperature_Failure
  diagnostic trouble code uds Power_Path_038_Over_Temperature_Failure: dtc-props=Dtc_Props_392cf702, uds-dtc-value=0x005726
  diagnostic event EventPowerPath038OverTemperatureFailure: aging-allowed=true, event-kind=SWC, prestorage-freeze-frame=false  # Event_Power_Path_038_Over_Temperature_Failure
  diagnostic event to trouble code uds mapping EventDtcMapPowerPath038OverTemperatureFailure: diagnostic-event=EventPowerPath038OverTemperatureFailure, trouble-code-uds=Power_Path_038_Over_Temperature_Failure  # Event_Dtc_Map_Power_Path_038_Over_Temperature_Failure
  diagnostic event to operation cycle mapping EventOperCycleMapPowerPath038OverTemperatureFailure: diagnostic-event=EventPowerPath038OverTemperatureFailure, operation-cycle=DefaultOperationCycle  # Event_Oper_Cycle_Map_Power_Path_038_Over_Temperature_Failure
  diagnostic event to debounce algorithm mapping EventDebounceMapPowerPath038OverTemperatureFailure: debounce-algorithm=time_based, diagnostic-event=EventPowerPath038OverTemperatureFailure  # EventDebounceMap_Power_Path_038_Over_Temperature_Failure
package /ZeC/DTC/DTC/Power_Path_033_Over_Temperature_Failure
  diagnostic trouble code uds Power_Path_033_Over_Temperature_Failure: dtc-props=Dtc_Props_3012c7e5, uds-dtc-value=0x005721
  diagnostic event EventPowerPath033OverTemperatureFailure: aging-allowed=true, event-kind=SWC, prestorage-freeze-frame=false  # Event_Power_Path_033_Over_Temperature_Failure
  diagnostic event to trouble code uds mapping EventDtcMapPowerPath033OverTemperatureFailure: diagnostic-event=EventPowerPath033OverTemperatureFailure, trouble-code-uds=Power_Path_033_Over_Temperature_Failure  # Event_Dtc_Map_Power_Path_033_Over_Temperature_Failure
  diagnostic event to operation cycle mapping EventOperCycleMapPowerPath033OverTemperatureFailure: diagnostic-event=EventPowerPath033OverTemperatureFailure, operation-cycle=DefaultOperationCycle  # Event_Oper_Cycle_Map_Power_Path_033_Over_Temperature_Failure
  diagnostic event to debounce algorithm mapping EventDebounceMapPowerPath033OverTemperatureFailure: debounce-algorithm=time_based, diagnostic-event=EventPowerPath033OverTemperatureFailure  # EventDebounceMap_Power_Path_033_Over_Temperature_Failure
package /ZeC/DTC/DTC/Power_Path_032_Over_Temperature_Failure
  diagnostic trouble code uds Power_Path_032_Over_Temperature_Failure: dtc-props=Dtc_Props_760bcddf, uds-dtc-value=0x005720
  diagnostic event EventPowerPath032OverTemperatureFailure: aging-allowed=true, event-kind=SWC, prestorage-freeze-frame=false  # Event_Power_Path_032_Over_Temperature_Failure
  diagnostic event to trouble code uds mapping EventDtcMapPowerPath032OverTemperatureFailure: diagnostic-event=EventPowerPath032OverTemperatureFailure, trouble-code-uds=Power_Path_032_Over_Temperature_Failure  # Event_Dtc_Map_Power_Path_032_Over_Temperature_Failure
  diagnostic event to operation cycle mapping EventOperCycleMapPowerPath032OverTemperatureFailure: diagnostic-event=EventPowerPath032OverTemperatureFailure, operation-cycle=DefaultOperationCycle  # Event_Oper_Cycle_Map_Power_Path_032_Over_Temperature_Failure
  diagnostic event to debounce algorithm mapping EventDebounceMapPowerPath032OverTemperatureFailure: debounce-algorithm=time_based, diagnostic-event=EventPowerPath032OverTemperatureFailure  # EventDebounceMap_Power_Path_032_Over_Temperature_Failure
package /ZeC/DTC/DTC/Power_Path_035_Over_Temperature_Failure
  diagnostic trouble code uds Power_Path_035_Over_Temperature_Failure: dtc-props=Dtc_Props_bc20d391, uds-dtc-value=0x005723
  diagnostic event EventPowerPath035OverTemperatureFailure: aging-allowed=true, event-kind=SWC, prestorage-freeze-frame=false  # Event_Power_Path_035_Over_Temperature_Failure
  diagnostic event to trouble code uds mapping EventDtcMapPowerPath035OverTemperatureFailure: diagnostic-event=EventPowerPath035OverTemperatureFailure, trouble-code-uds=Power_Path_035_Over_Temperature_Failure  # Event_Dtc_Map_Power_Path_035_Over_Temperature_Failure
  diagnostic event to operation cycle mapping EventOperCycleMapPowerPath035OverTemperatureFailure: diagnostic-event=EventPowerPath035OverTemperatureFailure, operation-cycle=DefaultOperationCycle  # Event_Oper_Cycle_Map_Power_Path_035_Over_Temperature_Failure
  diagnostic event to debounce algorithm mapping EventDebounceMapPowerPath035OverTemperatureFailure: debounce-algorithm=time_based, diagnostic-event=EventPowerPath035OverTemperatureFailure  # EventDebounceMap_Power_Path_035_Over_Temperature_Failure
package /ZeC/DTC/DTC/Power_Path_034_Over_Temperature_Failure
  diagnostic trouble code uds Power_Path_034_Over_Temperature_Failure: dtc-props=Dtc_Props_fa39d9ab, uds-dtc-value=0x005722
  diagnostic event EventPowerPath034OverTemperatureFailure: aging-allowed=true, event-kind=SWC, prestorage-freeze-frame=false  # Event_Power_Path_034_Over_Temperature_Failure
  diagnostic event to trouble code uds mapping EventDtcMapPowerPath034OverTemperatureFailure: diagnostic-event=EventPowerPath034OverTemperatureFailure, trouble-code-uds=Power_Path_034_Over_Temperature_Failure  # Event_Dtc_Map_Power_Path_034_Over_Temperature_Failure
  diagnostic event to operation cycle mapping EventOperCycleMapPowerPath034OverTemperatureFailure: diagnostic-event=EventPowerPath034OverTemperatureFailure, operation-cycle=DefaultOperationCycle  # Event_Oper_Cycle_Map_Power_Path_034_Over_Temperature_Failure
  diagnostic event to debounce algorithm mapping EventDebounceMapPowerPath034OverTemperatureFailure: debounce-algorithm=time_based, diagnostic-event=EventPowerPath034OverTemperatureFailure  # EventDebounceMap_Power_Path_034_Over_Temperature_Failure
package /ZeC/DTC/DTC/Power_Path_041_Over_Temperature_Failure
  diagnostic trouble code uds Power_Path_041_Over_Temperature_Failure: dtc-props=Dtc_Props_6d499cf6, uds-dtc-value=0x005729
  diagnostic event EventPowerPath041OverTemperatureFailure: aging-allowed=true, event-kind=SWC, prestorage-freeze-frame=false  # Event_Power_Path_041_Over_Temperature_Failure
  diagnostic event to trouble code uds mapping EventDtcMapPowerPath041OverTemperatureFailure: diagnostic-event=EventPowerPath041OverTemperatureFailure, trouble-code-uds=Power_Path_041_Over_Temperature_Failure  # Event_Dtc_Map_Power_Path_041_Over_Temperature_Failure
  diagnostic event to operation cycle mapping EventOperCycleMapPowerPath041OverTemperatureFailure: diagnostic-event=EventPowerPath041OverTemperatureFailure, operation-cycle=DefaultOperationCycle  # Event_Oper_Cycle_Map_Power_Path_041_Over_Temperature_Failure
  diagnostic event to debounce algorithm mapping EventDebounceMapPowerPath041OverTemperatureFailure: debounce-algorithm=time_based, diagnostic-event=EventPowerPath041OverTemperatureFailure  # EventDebounceMap_Power_Path_041_Over_Temperature_Failure
package /ZeC/DTC/DTC/Power_Path_040_Over_Temperature_Failure
  diagnostic trouble code uds Power_Path_040_Over_Temperature_Failure: dtc-props=Dtc_Props_2b5096cc, uds-dtc-value=0x005728
  diagnostic event EventPowerPath040OverTemperatureFailure: aging-allowed=true, event-kind=SWC, prestorage-freeze-frame=false  # Event_Power_Path_040_Over_Temperature_Failure
  diagnostic event to trouble code uds mapping EventDtcMapPowerPath040OverTemperatureFailure: diagnostic-event=EventPowerPath040OverTemperatureFailure, trouble-code-uds=Power_Path_040_Over_Temperature_Failure  # Event_Dtc_Map_Power_Path_040_Over_Temperature_Failure
  diagnostic event to operation cycle mapping EventOperCycleMapPowerPath040OverTemperatureFailure: diagnostic-event=EventPowerPath040OverTemperatureFailure, operation-cycle=DefaultOperationCycle  # Event_Oper_Cycle_Map_Power_Path_040_Over_Temperature_Failure
  diagnostic event to debounce algorithm mapping EventDebounceMapPowerPath040OverTemperatureFailure: debounce-algorithm=time_based, diagnostic-event=EventPowerPath040OverTemperatureFailure  # EventDebounceMap_Power_Path_040_Over_Temperature_Failure
package /ZeC/DTC/DTC/Power_Path_046_Over_Temperature_Failure
  diagnostic trouble code uds Power_Path_046_Over_Temperature_Failure: dtc-props=Dtc_Props_cef88d31, uds-dtc-value=0x00572e
  diagnostic event EventPowerPath046OverTemperatureFailure: aging-allowed=true, event-kind=SWC, prestorage-freeze-frame=false  # Event_Power_Path_046_Over_Temperature_Failure
  diagnostic event to trouble code uds mapping EventDtcMapPowerPath046OverTemperatureFailure: diagnostic-event=EventPowerPath046OverTemperatureFailure, trouble-code-uds=Power_Path_046_Over_Temperature_Failure  # Event_Dtc_Map_Power_Path_046_Over_Temperature_Failure
  diagnostic event to operation cycle mapping EventOperCycleMapPowerPath046OverTemperatureFailure: diagnostic-event=EventPowerPath046OverTemperatureFailure, operation-cycle=DefaultOperationCycle  # Event_Oper_Cycle_Map_Power_Path_046_Over_Temperature_Failure
  diagnostic event to debounce algorithm mapping EventDebounceMapPowerPath046OverTemperatureFailure: debounce-algorithm=time_based, diagnostic-event=EventPowerPath046OverTemperatureFailure  # EventDebounceMap_Power_Path_046_Over_Temperature_Failure
package /ZeC/DTC/DTC/Power_Path_045_Over_Temperature_Failure
  diagnostic trouble code uds Power_Path_045_Over_Temperature_Failure: dtc-props=Dtc_Props_88e1870b, uds-dtc-value=0x00572d
  diagnostic event EventPowerPath045OverTemperatureFailure: aging-allowed=true, event-kind=SWC, prestorage-freeze-frame=false  # Event_Power_Path_045_Over_Temperature_Failure
  diagnostic event to trouble code uds mapping EventDtcMapPowerPath045OverTemperatureFailure: diagnostic-event=EventPowerPath045OverTemperatureFailure, trouble-code-uds=Power_Path_045_Over_Temperature_Failure  # Event_Dtc_Map_Power_Path_045_Over_Temperature_Failure
  diagnostic event to operation cycle mapping EventOperCycleMapPowerPath045OverTemperatureFailure: diagnostic-event=EventPowerPath045OverTemperatureFailure, operation-cycle=DefaultOperationCycle  # Event_Oper_Cycle_Map_Power_Path_045_Over_Temperature_Failure
  diagnostic event to debounce algorithm mapping EventDebounceMapPowerPath045OverTemperatureFailure: debounce-algorithm=time_based, diagnostic-event=EventPowerPath045OverTemperatureFailure  # EventDebounceMap_Power_Path_045_Over_Temperature_Failure
package /ZeC/DTC/DTC/Power_Path_047_Over_Temperature_Failure
  diagnostic trouble code uds Power_Path_047_Over_Temperature_Failure: dtc-props=Dtc_Props_4d3937f, uds-dtc-value=0x00572f
  diagnostic event EventPowerPath047OverTemperatureFailure: aging-allowed=true, event-kind=SWC, prestorage-freeze-frame=false  # Event_Power_Path_047_Over_Temperature_Failure
  diagnostic event to trouble code uds mapping EventDtcMapPowerPath047OverTemperatureFailure: diagnostic-event=EventPowerPath047OverTemperatureFailure, trouble-code-uds=Power_Path_047_Over_Temperature_Failure  # Event_Dtc_Map_Power_Path_047_Over_Temperature_Failure
  diagnostic event to operation cycle mapping EventOperCycleMapPowerPath047OverTemperatureFailure: diagnostic-event=EventPowerPath047OverTemperatureFailure, operation-cycle=DefaultOperationCycle  # Event_Oper_Cycle_Map_Power_Path_047_Over_Temperature_Failure
  diagnostic event to debounce algorithm mapping EventDebounceMapPowerPath047OverTemperatureFailure: debounce-algorithm=time_based, diagnostic-event=EventPowerPath047OverTemperatureFailure  # EventDebounceMap_Power_Path_047_Over_Temperature_Failure
package /ZeC/DTC/DTC/Power_Path_042_Over_Temperature_Failure
  diagnostic trouble code uds Power_Path_042_Over_Temperature_Failure: dtc-props=Dtc_Props_deda398, uds-dtc-value=0x00572a
  diagnostic event EventPowerPath042OverTemperatureFailure: aging-allowed=true, event-kind=SWC, prestorage-freeze-frame=false  # Event_Power_Path_042_Over_Temperature_Failure
  diagnostic event to trouble code uds mapping EventDtcMapPowerPath042OverTemperatureFailure: diagnostic-event=EventPowerPath042OverTemperatureFailure, trouble-code-uds=Power_Path_042_Over_Temperature_Failure  # Event_Dtc_Map_Power_Path_042_Over_Temperature_Failure
  diagnostic event to operation cycle mapping EventOperCycleMapPowerPath042OverTemperatureFailure: diagnostic-event=EventPowerPath042OverTemperatureFailure, operation-cycle=DefaultOperationCycle  # Event_Oper_Cycle_Map_Power_Path_042_Over_Temperature_Failure
  diagnostic event to debounce algorithm mapping EventDebounceMapPowerPath042OverTemperatureFailure: debounce-algorithm=time_based, diagnostic-event=EventPowerPath042OverTemperatureFailure  # EventDebounceMap_Power_Path_042_Over_Temperature_Failure
package /ZeC/DTC/DTC/Power_Path_044_Over_Temperature_Failure
  diagnostic trouble code uds Power_Path_044_Over_Temperature_Failure: dtc-props=Dtc_Props_81dfb7ec, uds-dtc-value=0x00572c
  diagnostic event EventPowerPath044OverTemperatureFailure: aging-allowed=true, event-kind=SWC, prestorage-freeze-frame=false  # Event_Power_Path_044_Over_Temperature_Failure
  diagnostic event to trouble code uds mapping EventDtcMapPowerPath044OverTemperatureFailure: diagnostic-event=EventPowerPath044OverTemperatureFailure, trouble-code-uds=Power_Path_044_Over_Temperature_Failure  # Event_Dtc_Map_Power_Path_044_Over_Temperature_Failure
  diagnostic event to operation cycle mapping EventOperCycleMapPowerPath044OverTemperatureFailure: diagnostic-event=EventPowerPath044OverTemperatureFailure, operation-cycle=DefaultOperationCycle  # Event_Oper_Cycle_Map_Power_Path_044_Over_Temperature_Failure
  diagnostic event to debounce algorithm mapping EventDebounceMapPowerPath044OverTemperatureFailure: debounce-algorithm=time_based, diagnostic-event=EventPowerPath044OverTemperatureFailure  # EventDebounceMap_Power_Path_044_Over_Temperature_Failure
package /ZeC/DTC/DTC/Power_Path_043_Over_Temperature_Failure
  diagnostic trouble code uds Power_Path_043_Over_Temperature_Failure: dtc-props=Dtc_Props_c7c6bdd6, uds-dtc-value=0x00572b
  diagnostic event EventPowerPath043OverTemperatureFailure: aging-allowed=true, event-kind=SWC, prestorage-freeze-frame=false  # Event_Power_Path_043_Over_Temperature_Failure
  diagnostic event to trouble code uds mapping EventDtcMapPowerPath043OverTemperatureFailure: diagnostic-event=EventPowerPath043OverTemperatureFailure, trouble-code-uds=Power_Path_043_Over_Temperature_Failure  # Event_Dtc_Map_Power_Path_043_Over_Temperature_Failure
  diagnostic event to operation cycle mapping EventOperCycleMapPowerPath043OverTemperatureFailure: diagnostic-event=EventPowerPath043OverTemperatureFailure, operation-cycle=DefaultOperationCycle  # Event_Oper_Cycle_Map_Power_Path_043_Over_Temperature_Failure
  diagnostic event to debounce algorithm mapping EventDebounceMapPowerPath043OverTemperatureFailure: debounce-algorithm=time_based, diagnostic-event=EventPowerPath043OverTemperatureFailure  # EventDebounceMap_Power_Path_043_Over_Temperature_Failure
package /ZeC/DTC/DTC/Power_Path_048_Over_Temperature_Failure
  diagnostic trouble code uds Power_Path_048_Over_Temperature_Failure: dtc-props=Dtc_Props_b0410d67, uds-dtc-value=0x005730
  diagnostic event EventPowerPath048OverTemperatureFailure: aging-allowed=true, event-kind=SWC, prestorage-freeze-frame=false  # Event_Power_Path_048_Over_Temperature_Failure
  diagnostic event to trouble code uds mapping EventDtcMapPowerPath048OverTemperatureFailure: diagnostic-event=EventPowerPath048OverTemperatureFailure, trouble-code-uds=Power_Path_048_Over_Temperature_Failure  # Event_Dtc_Map_Power_Path_048_Over_Temperature_Failure
  diagnostic event to operation cycle mapping EventOperCycleMapPowerPath048OverTemperatureFailure: diagnostic-event=EventPowerPath048OverTemperatureFailure, operation-cycle=DefaultOperationCycle  # Event_Oper_Cycle_Map_Power_Path_048_Over_Temperature_Failure
  diagnostic event to debounce algorithm mapping EventDebounceMapPowerPath048OverTemperatureFailure: debounce-algorithm=time_based, diagnostic-event=EventPowerPath048OverTemperatureFailure  # EventDebounceMap_Power_Path_048_Over_Temperature_Failure
package /ZeC/DTC/DTC/Power_Path_020_Over_Temperature_Failure
  diagnostic trouble code uds Power_Path_020_Over_Temperature_Failure: dtc-props=Dtc_Props_24b0a4ff, uds-dtc-value=0x005714
  diagnostic event EventPowerPath020OverTemperatureFailure: aging-allowed=true, event-kind=SWC, prestorage-freeze-frame=false  # Event_Power_Path_020_Over_Temperature_Failure
  diagnostic event to trouble code uds mapping EventDtcMapPowerPath020OverTemperatureFailure: diagnostic-event=EventPowerPath020OverTemperatureFailure, trouble-code-uds=Power_Path_020_Over_Temperature_Failure  # Event_Dtc_Map_Power_Path_020_Over_Temperature_Failure
  diagnostic event to operation cycle mapping EventOperCycleMapPowerPath020OverTemperatureFailure: diagnostic-event=EventPowerPath020OverTemperatureFailure, operation-cycle=DefaultOperationCycle  # Event_Oper_Cycle_Map_Power_Path_020_Over_Temperature_Failure
  diagnostic event to debounce algorithm mapping EventDebounceMapPowerPath020OverTemperatureFailure: debounce-algorithm=time_based, diagnostic-event=EventPowerPath020OverTemperatureFailure  # EventDebounceMap_Power_Path_020_Over_Temperature_Failure
package /ZeC/DTC/DTC/Power_Path_019_Over_Temperature_Failure
  diagnostic trouble code uds Power_Path_019_Over_Temperature_Failure: dtc-props=Dtc_Props_2d8e9418, uds-dtc-value=0x005713
  diagnostic event EventPowerPath019OverTemperatureFailure: aging-allowed=true, event-kind=SWC, prestorage-freeze-frame=false  # Event_Power_Path_019_Over_Temperature_Failure
  diagnostic event to trouble code uds mapping EventDtcMapPowerPath019OverTemperatureFailure: diagnostic-event=EventPowerPath019OverTemperatureFailure, trouble-code-uds=Power_Path_019_Over_Temperature_Failure  # Event_Dtc_Map_Power_Path_019_Over_Temperature_Failure
  diagnostic event to operation cycle mapping EventOperCycleMapPowerPath019OverTemperatureFailure: diagnostic-event=EventPowerPath019OverTemperatureFailure, operation-cycle=DefaultOperationCycle  # Event_Oper_Cycle_Map_Power_Path_019_Over_Temperature_Failure
  diagnostic event to debounce algorithm mapping EventDebounceMapPowerPath019OverTemperatureFailure: debounce-algorithm=time_based, diagnostic-event=EventPowerPath019OverTemperatureFailure  # EventDebounceMap_Power_Path_019_Over_Temperature_Failure
package /ZeC/DTC/DTC/Power_Path_022_Over_Temperature_Failure
  diagnostic trouble code uds Power_Path_022_Over_Temperature_Failure: dtc-props=Dtc_Props_a882b08b, uds-dtc-value=0x005716
  diagnostic event EventPowerPath022OverTemperatureFailure: aging-allowed=true, event-kind=SWC, prestorage-freeze-frame=false  # Event_Power_Path_022_Over_Temperature_Failure
  diagnostic event to trouble code uds mapping EventDtcMapPowerPath022OverTemperatureFailure: diagnostic-event=EventPowerPath022OverTemperatureFailure, trouble-code-uds=Power_Path_022_Over_Temperature_Failure  # Event_Dtc_Map_Power_Path_022_Over_Temperature_Failure
  diagnostic event to operation cycle mapping EventOperCycleMapPowerPath022OverTemperatureFailure: diagnostic-event=EventPowerPath022OverTemperatureFailure, operation-cycle=DefaultOperationCycle  # Event_Oper_Cycle_Map_Power_Path_022_Over_Temperature_Failure
  diagnostic event to debounce algorithm mapping EventDebounceMapPowerPath022OverTemperatureFailure: debounce-algorithm=time_based, diagnostic-event=EventPowerPath022OverTemperatureFailure  # EventDebounceMap_Power_Path_022_Over_Temperature_Failure
package /ZeC/DTC/DTC/Power_Path_021_Over_Temperature_Failure
  diagnostic trouble code uds Power_Path_021_Over_Temperature_Failure: dtc-props=Dtc_Props_62a9aec5, uds-dtc-value=0x005715
  diagnostic event EventPowerPath021OverTemperatureFailure: aging-allowed=true, event-kind=SWC, prestorage-freeze-frame=false  # Event_Power_Path_021_Over_Temperature_Failure
  diagnostic event to trouble code uds mapping EventDtcMapPowerPath021OverTemperatureFailure: diagnostic-event=EventPowerPath021OverTemperatureFailure, trouble-code-uds=Power_Path_021_Over_Temperature_Failure  # Event_Dtc_Map_Power_Path_021_Over_Temperature_Failure
  diagnostic event to operation cycle mapping EventOperCycleMapPowerPath021OverTemperatureFailure: diagnostic-event=EventPowerPath021OverTemperatureFailure, operation-cycle=DefaultOperationCycle  # Event_Oper_Cycle_Map_Power_Path_021_Over_Temperature_Failure
  diagnostic event to debounce algorithm mapping EventDebounceMapPowerPath021OverTemperatureFailure: debounce-algorithm=time_based, diagnostic-event=EventPowerPath021OverTemperatureFailure  # EventDebounceMap_Power_Path_021_Over_Temperature_Failure
package /ZeC/DTC/DTC/Power_Path_016_Over_Temperature_Failure
  diagnostic trouble code uds Power_Path_016_Over_Temperature_Failure: dtc-props=Dtc_Props_e7a58a56, uds-dtc-value=0x005710
  diagnostic event EventPowerPath016OverTemperatureFailure: aging-allowed=true, event-kind=SWC, prestorage-freeze-frame=false  # Event_Power_Path_016_Over_Temperature_Failure
  diagnostic event to trouble code uds mapping EventDtcMapPowerPath016OverTemperatureFailure: diagnostic-event=EventPowerPath016OverTemperatureFailure, trouble-code-uds=Power_Path_016_Over_Temperature_Failure  # Event_Dtc_Map_Power_Path_016_Over_Temperature_Failure
  diagnostic event to operation cycle mapping EventOperCycleMapPowerPath016OverTemperatureFailure: diagnostic-event=EventPowerPath016OverTemperatureFailure, operation-cycle=DefaultOperationCycle  # Event_Oper_Cycle_Map_Power_Path_016_Over_Temperature_Failure
  diagnostic event to debounce algorithm mapping EventDebounceMapPowerPath016OverTemperatureFailure: debounce-algorithm=time_based, diagnostic-event=EventPowerPath016OverTemperatureFailure  # EventDebounceMap_Power_Path_016_Over_Temperature_Failure
package /ZeC/DTC/DTC/Power_Path_018_Over_Temperature_Failure
  diagnostic trouble code uds Power_Path_018_Over_Temperature_Failure: dtc-props=Dtc_Props_6b979e22, uds-dtc-value=0x005712
  diagnostic event EventPowerPath018OverTemperatureFailure: aging-allowed=true, event-kind=SWC, prestorage-freeze-frame=false  # Event_Power_Path_018_Over_Temperature_Failure
  diagnostic event to trouble code uds mapping EventDtcMapPowerPath018OverTemperatureFailure: diagnostic-event=EventPowerPath018OverTemperatureFailure, trouble-code-uds=Power_Path_018_Over_Temperature_Failure  # Event_Dtc_Map_Power_Path_018_Over_Temperature_Failure
  diagnostic event to operation cycle mapping EventOperCycleMapPowerPath018OverTemperatureFailure: diagnostic-event=EventPowerPath018OverTemperatureFailure, operation-cycle=DefaultOperationCycle  # Event_Oper_Cycle_Map_Power_Path_018_Over_Temperature_Failure
  diagnostic event to debounce algorithm mapping EventDebounceMapPowerPath018OverTemperatureFailure: debounce-algorithm=time_based, diagnostic-event=EventPowerPath018OverTemperatureFailure  # EventDebounceMap_Power_Path_018_Over_Temperature_Failure
package /ZeC/DTC/DTC/Power_Path_017_Over_Temperature_Failure
  diagnostic trouble code uds Power_Path_017_Over_Temperature_Failure: dtc-props=Dtc_Props_a1bc806c, uds-dtc-value=0x005711
  diagnostic event EventPowerPath017OverTemperatureFailure: aging-allowed=true, event-kind=SWC, prestorage-freeze-frame=false  # Event_Power_Path_017_Over_Temperature_Failure
  diagnostic event to trouble code uds mapping EventDtcMapPowerPath017OverTemperatureFailure: diagnostic-event=EventPowerPath017OverTemperatureFailure, trouble-code-uds=Power_Path_017_Over_Temperature_Failure  # Event_Dtc_Map_Power_Path_017_Over_Temperature_Failure
  diagnostic event to operation cycle mapping EventOperCycleMapPowerPath017OverTemperatureFailure: diagnostic-event=EventPowerPath017OverTemperatureFailure, operation-cycle=DefaultOperationCycle  # Event_Oper_Cycle_Map_Power_Path_017_Over_Temperature_Failure
  diagnostic event to debounce algorithm mapping EventDebounceMapPowerPath017OverTemperatureFailure: debounce-algorithm=time_based, diagnostic-event=EventPowerPath017OverTemperatureFailure  # EventDebounceMap_Power_Path_017_Over_Temperature_Failure
package /ZeC/DTC/DTC/Power_Path_024_Over_Temperature_Failure
  diagnostic trouble code uds Power_Path_024_Over_Temperature_Failure: dtc-props=Dtc_Props_bafed145, uds-dtc-value=0x005718
  diagnostic event EventPowerPath024OverTemperatureFailure: aging-allowed=true, event-kind=SWC, prestorage-freeze-frame=false  # Event_Power_Path_024_Over_Temperature_Failure
  diagnostic event to trouble code uds mapping EventDtcMapPowerPath024OverTemperatureFailure: diagnostic-event=EventPowerPath024OverTemperatureFailure, trouble-code-uds=Power_Path_024_Over_Temperature_Failure  # Event_Dtc_Map_Power_Path_024_Over_Temperature_Failure
  diagnostic event to operation cycle mapping EventOperCycleMapPowerPath024OverTemperatureFailure: diagnostic-event=EventPowerPath024OverTemperatureFailure, operation-cycle=DefaultOperationCycle  # Event_Oper_Cycle_Map_Power_Path_024_Over_Temperature_Failure
  diagnostic event to debounce algorithm mapping EventDebounceMapPowerPath024OverTemperatureFailure: debounce-algorithm=time_based, diagnostic-event=EventPowerPath024OverTemperatureFailure  # EventDebounceMap_Power_Path_024_Over_Temperature_Failure
package /ZeC/DTC/DTC/Power_Path_023_Over_Temperature_Failure
  diagnostic trouble code uds Power_Path_023_Over_Temperature_Failure: dtc-props=Dtc_Props_ee9bbab1, uds-dtc-value=0x005717
  diagnostic event EventPowerPath023OverTemperatureFailure: aging-allowed=true, event-kind=SWC, prestorage-freeze-frame=false  # Event_Power_Path_023_Over_Temperature_Failure
  diagnostic event to trouble code uds mapping EventDtcMapPowerPath023OverTemperatureFailure: diagnostic-event=EventPowerPath023OverTemperatureFailure, trouble-code-uds=Power_Path_023_Over_Temperature_Failure  # Event_Dtc_Map_Power_Path_023_Over_Temperature_Failure
  diagnostic event to operation cycle mapping EventOperCycleMapPowerPath023OverTemperatureFailure: diagnostic-event=EventPowerPath023OverTemperatureFailure, operation-cycle=DefaultOperationCycle  # Event_Oper_Cycle_Map_Power_Path_023_Over_Temperature_Failure
  diagnostic event to debounce algorithm mapping EventDebounceMapPowerPath023OverTemperatureFailure: debounce-algorithm=time_based, diagnostic-event=EventPowerPath023OverTemperatureFailure  # EventDebounceMap_Power_Path_023_Over_Temperature_Failure
package /ZeC/DTC/DTC/Power_Path_025_Over_Temperature_Failure
  diagnostic trouble code uds Power_Path_025_Over_Temperature_Failure: dtc-props=Dtc_Props_fce7db7f, uds-dtc-value=0x005719
  diagnostic event EventPowerPath025OverTemperatureFailure: aging-allowed=true, event-kind=SWC, prestorage-freeze-frame=false  # Event_Power_Path_025_Over_Temperature_Failure
  diagnostic event to trouble code uds mapping EventDtcMapPowerPath025OverTemperatureFailure: diagnostic-event=EventPowerPath025OverTemperatureFailure, trouble-code-uds=Power_Path_025_Over_Temperature_Failure  # Event_Dtc_Map_Power_Path_025_Over_Temperature_Failure
  diagnostic event to operation cycle mapping EventOperCycleMapPowerPath025OverTemperatureFailure: diagnostic-event=EventPowerPath025OverTemperatureFailure, operation-cycle=DefaultOperationCycle  # Event_Oper_Cycle_Map_Power_Path_025_Over_Temperature_Failure
  diagnostic event to debounce algorithm mapping EventDebounceMapPowerPath025OverTemperatureFailure: debounce-algorithm=time_based, diagnostic-event=EventPowerPath025OverTemperatureFailure  # EventDebounceMap_Power_Path_025_Over_Temperature_Failure
package /ZeC/DTC/DTC/Power_Path_029_Over_Temperature_Failure
  diagnostic trouble code uds Power_Path_029_Over_Temperature_Failure: dtc-props=Dtc_Props_194fc082, uds-dtc-value=0x00571d
  diagnostic event EventPowerPath029OverTemperatureFailure: aging-allowed=true, event-kind=SWC, prestorage-freeze-frame=false  # Event_Power_Path_029_Over_Temperature_Failure
  diagnostic event to trouble code uds mapping EventDtcMapPowerPath029OverTemperatureFailure: diagnostic-event=EventPowerPath029OverTemperatureFailure, trouble-code-uds=Power_Path_029_Over_Temperature_Failure  # Event_Dtc_Map_Power_Path_029_Over_Temperature_Failure
  diagnostic event to operation cycle mapping EventOperCycleMapPowerPath029OverTemperatureFailure: diagnostic-event=EventPowerPath029OverTemperatureFailure, operation-cycle=DefaultOperationCycle  # Event_Oper_Cycle_Map_Power_Path_029_Over_Temperature_Failure
  diagnostic event to debounce algorithm mapping EventDebounceMapPowerPath029OverTemperatureFailure: debounce-algorithm=time_based, diagnostic-event=EventPowerPath029OverTemperatureFailure  # EventDebounceMap_Power_Path_029_Over_Temperature_Failure
package /ZeC/DTC/DTC/Power_Path_028_Over_Temperature_Failure
  diagnostic trouble code uds Power_Path_028_Over_Temperature_Failure: dtc-props=Dtc_Props_1071f065, uds-dtc-value=0x00571c
  diagnostic event EventPowerPath028OverTemperatureFailure: aging-allowed=true, event-kind=SWC, prestorage-freeze-frame=false  # Event_Power_Path_028_Over_Temperature_Failure
  diagnostic event to trouble code uds mapping EventDtcMapPowerPath028OverTemperatureFailure: diagnostic-event=EventPowerPath028OverTemperatureFailure, trouble-code-uds=Power_Path_028_Over_Temperature_Failure  # Event_Dtc_Map_Power_Path_028_Over_Temperature_Failure
  diagnostic event to operation cycle mapping EventOperCycleMapPowerPath028OverTemperatureFailure: diagnostic-event=EventPowerPath028OverTemperatureFailure, operation-cycle=DefaultOperationCycle  # Event_Oper_Cycle_Map_Power_Path_028_Over_Temperature_Failure
  diagnostic event to debounce algorithm mapping EventDebounceMapPowerPath028OverTemperatureFailure: debounce-algorithm=time_based, diagnostic-event=EventPowerPath028OverTemperatureFailure  # EventDebounceMap_Power_Path_028_Over_Temperature_Failure
package /ZeC/DTC/DTC/Power_Path_031_Over_Temperature_Failure
  diagnostic trouble code uds Power_Path_031_Over_Temperature_Failure: dtc-props=Dtc_Props_957dd4f6, uds-dtc-value=0x00571f
  diagnostic event EventPowerPath031OverTemperatureFailure: aging-allowed=true, event-kind=SWC, prestorage-freeze-frame=false  # Event_Power_Path_031_Over_Temperature_Failure
  diagnostic event to trouble code uds mapping EventDtcMapPowerPath031OverTemperatureFailure: diagnostic-event=EventPowerPath031OverTemperatureFailure, trouble-code-uds=Power_Path_031_Over_Temperature_Failure  # Event_Dtc_Map_Power_Path_031_Over_Temperature_Failure
  diagnostic event to operation cycle mapping EventOperCycleMapPowerPath031OverTemperatureFailure: diagnostic-event=EventPowerPath031OverTemperatureFailure, operation-cycle=DefaultOperationCycle  # Event_Oper_Cycle_Map_Power_Path_031_Over_Temperature_Failure
  diagnostic event to debounce algorithm mapping EventDebounceMapPowerPath031OverTemperatureFailure: debounce-algorithm=time_based, diagnostic-event=EventPowerPath031OverTemperatureFailure  # EventDebounceMap_Power_Path_031_Over_Temperature_Failure
package /ZeC/DTC/DTC/Power_Path_030_Over_Temperature_Failure
  diagnostic trouble code uds Power_Path_030_Over_Temperature_Failure: dtc-props=Dtc_Props_5f56cab8, uds-dtc-value=0x00571e
  diagnostic event EventPowerPath030OverTemperatureFailure: aging-allowed=true, event-kind=SWC, prestorage-freeze-frame=false  # Event_Power_Path_030_Over_Temperature_Failure
  diagnostic event to trouble code uds mapping EventDtcMapPowerPath030OverTemperatureFailure: diagnostic-event=EventPowerPath030OverTemperatureFailure, trouble-code-uds=Power_Path_030_Over_Temperature_Failure  # Event_Dtc_Map_Power_Path_030_Over_Temperature_Failure
  diagnostic event to operation cycle mapping EventOperCycleMapPowerPath030OverTemperatureFailure: diagnostic-event=EventPowerPath030OverTemperatureFailure, operation-cycle=DefaultOperationCycle  # Event_Oper_Cycle_Map_Power_Path_030_Over_Temperature_Failure
  diagnostic event to debounce algorithm mapping EventDebounceMapPowerPath030OverTemperatureFailure: debounce-algorithm=time_based, diagnostic-event=EventPowerPath030OverTemperatureFailure  # EventDebounceMap_Power_Path_030_Over_Temperature_Failure
package /ZeC/DTC/DTC/Power_Path_027_Over_Temperature_Failure
  diagnostic trouble code uds Power_Path_027_Over_Temperature_Failure: dtc-props=Dtc_Props_5668fa5f, uds-dtc-value=0x00571b
  diagnostic event EventPowerPath027OverTemperatureFailure: aging-allowed=true, event-kind=SWC, prestorage-freeze-frame=false  # Event_Power_Path_027_Over_Temperature_Failure
  diagnostic event to trouble code uds mapping EventDtcMapPowerPath027OverTemperatureFailure: diagnostic-event=EventPowerPath027OverTemperatureFailure, trouble-code-uds=Power_Path_027_Over_Temperature_Failure  # Event_Dtc_Map_Power_Path_027_Over_Temperature_Failure
  diagnostic event to operation cycle mapping EventOperCycleMapPowerPath027OverTemperatureFailure: diagnostic-event=EventPowerPath027OverTemperatureFailure, operation-cycle=DefaultOperationCycle  # Event_Oper_Cycle_Map_Power_Path_027_Over_Temperature_Failure
  diagnostic event to debounce algorithm mapping EventDebounceMapPowerPath027OverTemperatureFailure: debounce-algorithm=time_based, diagnostic-event=EventPowerPath027OverTemperatureFailure  # EventDebounceMap_Power_Path_027_Over_Temperature_Failure
package /ZeC/DTC/DTC/Power_Path_026_Over_Temperature_Failure
  diagnostic trouble code uds Power_Path_026_Over_Temperature_Failure: dtc-props=Dtc_Props_9c43e411, uds-dtc-value=0x00571a
  diagnostic event EventPowerPath026OverTemperatureFailure: aging-allowed=true, event-kind=SWC, prestorage-freeze-frame=false  # Event_Power_Path_026_Over_Temperature_Failure
  diagnostic event to trouble code uds mapping EventDtcMapPowerPath026OverTemperatureFailure: diagnostic-event=EventPowerPath026OverTemperatureFailure, trouble-code-uds=Power_Path_026_Over_Temperature_Failure  # Event_Dtc_Map_Power_Path_026_Over_Temperature_Failure
  diagnostic event to operation cycle mapping EventOperCycleMapPowerPath026OverTemperatureFailure: diagnostic-event=EventPowerPath026OverTemperatureFailure, operation-cycle=DefaultOperationCycle  # Event_Oper_Cycle_Map_Power_Path_026_Over_Temperature_Failure
  diagnostic event to debounce algorithm mapping EventDebounceMapPowerPath026OverTemperatureFailure: debounce-algorithm=time_based, diagnostic-event=EventPowerPath026OverTemperatureFailure  # EventDebounceMap_Power_Path_026_Over_Temperature_Failure
package /ZeC/DTC/DTC/LIN_3_Slave_12_Defect
  diagnostic trouble code uds LIN_3_Slave_12_Defect: dtc-props=Dtc_Props_358996c7, uds-dtc-value=0x030307  # LIN 3 Slave 12_Defect
  diagnostic event EventLIN3Slave12Defect: aging-allowed=true, event-kind=SWC, prestorage-freeze-frame=false  # Event_LIN 3 Slave 12_Defect
  diagnostic event to trouble code uds mapping EventDtcMapLIN3Slave12Defect: diagnostic-event=EventLIN3Slave12Defect, trouble-code-uds=LIN_3_Slave_12_Defect  # Event_Dtc_Map_LIN 3 Slave 12_Defect
  diagnostic event to operation cycle mapping EventOperCycleMapLIN3Slave12Defect: diagnostic-event=EventLIN3Slave12Defect, operation-cycle=DefaultOperationCycle  # Event_Oper_Cycle_Map_LIN 3 Slave 12_Defect
  diagnostic event to debounce algorithm mapping EventDebounceMapLIN3Slave12Defect: debounce-algorithm=counter_based, diagnostic-event=EventLIN3Slave12Defect  # EventDebounceMap_LIN 3 Slave 12_Defect
package /ZeC/DTC/DTC/LIN_3_Slave_11_NoCommunication
  diagnostic trouble code uds LIN_3_Slave_11_NoCommunication: dtc-props=Dtc_Props_358996c7, uds-dtc-value=0x030306  # LIN 3 Slave 11_NoCommunication
  diagnostic event EventLIN3Slave11NoCommunication: aging-allowed=true, event-kind=SWC, prestorage-freeze-frame=false  # Event_LIN 3 Slave 11_NoCommunication
  diagnostic event to trouble code uds mapping EventDtcMapLIN3Slave11NoCommunication: diagnostic-event=EventLIN3Slave11NoCommunication, trouble-code-uds=LIN_3_Slave_11_NoCommunication  # Event_Dtc_Map_LIN 3 Slave 11_NoCommunication
  diagnostic event to operation cycle mapping EventOperCycleMapLIN3Slave11NoCommunication: diagnostic-event=EventLIN3Slave11NoCommunication, operation-cycle=DefaultOperationCycle  # Event_Oper_Cycle_Map_LIN 3 Slave 11_NoCommunication
  diagnostic event to debounce algorithm mapping EventDebounceMapLIN3Slave11NoCommunication: debounce-algorithm=counter_based, diagnostic-event=EventLIN3Slave11NoCommunication  # EventDebounceMap_LIN 3 Slave 11_NoCommunication
package /ZeC/DTC/DTC/LIN_3_Slave_13_Defect
  diagnostic trouble code uds LIN_3_Slave_13_Defect: dtc-props=Dtc_Props_358996c7, uds-dtc-value=0x030309  # LIN 3 Slave 13_Defect
  diagnostic event EventLIN3Slave13Defect: aging-allowed=true, event-kind=SWC, prestorage-freeze-frame=false  # Event_LIN 3 Slave 13_Defect
  diagnostic event to trouble code uds mapping EventDtcMapLIN3Slave13Defect: diagnostic-event=EventLIN3Slave13Defect, trouble-code-uds=LIN_3_Slave_13_Defect  # Event_Dtc_Map_LIN 3 Slave 13_Defect
  diagnostic event to operation cycle mapping EventOperCycleMapLIN3Slave13Defect: diagnostic-event=EventLIN3Slave13Defect, operation-cycle=DefaultOperationCycle  # Event_Oper_Cycle_Map_LIN 3 Slave 13_Defect
  diagnostic event to debounce algorithm mapping EventDebounceMapLIN3Slave13Defect: debounce-algorithm=counter_based, diagnostic-event=EventLIN3Slave13Defect  # EventDebounceMap_LIN 3 Slave 13_Defect
package /ZeC/DTC/DTC/LIN_3_Slave_12_NoCommunication
  diagnostic trouble code uds LIN_3_Slave_12_NoCommunication: dtc-props=Dtc_Props_358996c7, uds-dtc-value=0x030308  # LIN 3 Slave 12_NoCommunication
  diagnostic event EventLIN3Slave12NoCommunication: aging-allowed=true, event-kind=SWC, prestorage-freeze-frame=false  # Event_LIN 3 Slave 12_NoCommunication
  diagnostic event to trouble code uds mapping EventDtcMapLIN3Slave12NoCommunication: diagnostic-event=EventLIN3Slave12NoCommunication, trouble-code-uds=LIN_3_Slave_12_NoCommunication  # Event_Dtc_Map_LIN 3 Slave 12_NoCommunication
  diagnostic event to operation cycle mapping EventOperCycleMapLIN3Slave12NoCommunication: diagnostic-event=EventLIN3Slave12NoCommunication, operation-cycle=DefaultOperationCycle  # Event_Oper_Cycle_Map_LIN 3 Slave 12_NoCommunication
  diagnostic event to debounce algorithm mapping EventDebounceMapLIN3Slave12NoCommunication: debounce-algorithm=counter_based, diagnostic-event=EventLIN3Slave12NoCommunication  # EventDebounceMap_LIN 3 Slave 12_NoCommunication
package /ZeC/DTC/DTC/LIN_13_Slave_5_Defect
  diagnostic trouble code uds LIN_13_Slave_5_Defect: dtc-props=Dtc_Props_358996c7, uds-dtc-value=0x030d1d  # LIN 13 Slave 5_Defect
  diagnostic event EventLIN13Slave5Defect: aging-allowed=true, event-kind=SWC, prestorage-freeze-frame=false  # Event_LIN 13 Slave 5_Defect
  diagnostic event to trouble code uds mapping EventDtcMapLIN13Slave5Defect: diagnostic-event=EventLIN13Slave5Defect, trouble-code-uds=LIN_13_Slave_5_Defect  # Event_Dtc_Map_LIN 13 Slave 5_Defect
  diagnostic event to operation cycle mapping EventOperCycleMapLIN13Slave5Defect: diagnostic-event=EventLIN13Slave5Defect, operation-cycle=DefaultOperationCycle  # Event_Oper_Cycle_Map_LIN 13 Slave 5_Defect
  diagnostic event to debounce algorithm mapping EventDebounceMapLIN13Slave5Defect: debounce-algorithm=counter_based, diagnostic-event=EventLIN13Slave5Defect  # EventDebounceMap_LIN 13 Slave 5_Defect
package /ZeC/DTC/DTC/LIN_3_Slave_10_Defect
  diagnostic trouble code uds LIN_3_Slave_10_Defect: dtc-props=Dtc_Props_358996c7, uds-dtc-value=0x030303  # LIN 3 Slave 10_Defect
  diagnostic event EventLIN3Slave10Defect: aging-allowed=true, event-kind=SWC, prestorage-freeze-frame=false  # Event_LIN 3 Slave 10_Defect
  diagnostic event to trouble code uds mapping EventDtcMapLIN3Slave10Defect: diagnostic-event=EventLIN3Slave10Defect, trouble-code-uds=LIN_3_Slave_10_Defect  # Event_Dtc_Map_LIN 3 Slave 10_Defect
  diagnostic event to operation cycle mapping EventOperCycleMapLIN3Slave10Defect: diagnostic-event=EventLIN3Slave10Defect, operation-cycle=DefaultOperationCycle  # Event_Oper_Cycle_Map_LIN 3 Slave 10_Defect
  diagnostic event to debounce algorithm mapping EventDebounceMapLIN3Slave10Defect: debounce-algorithm=counter_based, diagnostic-event=EventLIN3Slave10Defect  # EventDebounceMap_LIN 3 Slave 10_Defect
package /ZeC/DTC/DTC/Power_Path_071_Open_Load_Failure
  diagnostic trouble code uds Power_Path_071_Open_Load_Failure: dtc-props=Dtc_Props_8718746b, uds-dtc-value=0x005347
  diagnostic event EventPowerPath071OpenLoadFailure: aging-allowed=true, event-kind=SWC, prestorage-freeze-frame=false  # Event_Power_Path_071_Open_Load_Failure
  diagnostic event to trouble code uds mapping EventDtcMapPowerPath071OpenLoadFailure: diagnostic-event=EventPowerPath071OpenLoadFailure, trouble-code-uds=Power_Path_071_Open_Load_Failure  # Event_Dtc_Map_Power_Path_071_Open_Load_Failure
  diagnostic event to operation cycle mapping EventOperCycleMapPowerPath071OpenLoadFailure: diagnostic-event=EventPowerPath071OpenLoadFailure, operation-cycle=DefaultOperationCycle  # Event_Oper_Cycle_Map_Power_Path_071_Open_Load_Failure
  diagnostic event to debounce algorithm mapping EventDebounceMapPowerPath071OpenLoadFailure: debounce-algorithm=time_based, diagnostic-event=EventPowerPath071OpenLoadFailure  # EventDebounceMap_Power_Path_071_Open_Load_Failure
package /ZeC/DTC/DTC/LIN_13_Slave_5_NoCommunication
  diagnostic trouble code uds LIN_13_Slave_5_NoCommunication: dtc-props=Dtc_Props_358996c7, uds-dtc-value=0x030d1e  # LIN 13 Slave 5_NoCommunication
  diagnostic event EventLIN13Slave5NoCommunication: aging-allowed=true, event-kind=SWC, prestorage-freeze-frame=false  # Event_LIN 13 Slave 5_NoCommunication
  diagnostic event to trouble code uds mapping EventDtcMapLIN13Slave5NoCommunication: diagnostic-event=EventLIN13Slave5NoCommunication, trouble-code-uds=LIN_13_Slave_5_NoCommunication  # Event_Dtc_Map_LIN 13 Slave 5_NoCommunication
  diagnostic event to operation cycle mapping EventOperCycleMapLIN13Slave5NoCommunication: diagnostic-event=EventLIN13Slave5NoCommunication, operation-cycle=DefaultOperationCycle  # Event_Oper_Cycle_Map_LIN 13 Slave 5_NoCommunication
  diagnostic event to debounce algorithm mapping EventDebounceMapLIN13Slave5NoCommunication: debounce-algorithm=counter_based, diagnostic-event=EventLIN13Slave5NoCommunication  # EventDebounceMap_LIN 13 Slave 5_NoCommunication
package /ZeC/DTC/DTC/LIN_3_Slave_1_NoCommunication
  diagnostic trouble code uds LIN_3_Slave_1_NoCommunication: dtc-props=Dtc_Props_358996c7, uds-dtc-value=0x030302  # LIN 3 Slave 1_NoCommunication
  diagnostic event EventLIN3Slave1NoCommunication: aging-allowed=true, event-kind=SWC, prestorage-freeze-frame=false  # Event_LIN 3 Slave 1_NoCommunication
  diagnostic event to trouble code uds mapping EventDtcMapLIN3Slave1NoCommunication: diagnostic-event=EventLIN3Slave1NoCommunication, trouble-code-uds=LIN_3_Slave_1_NoCommunication  # Event_Dtc_Map_LIN 3 Slave 1_NoCommunication
  diagnostic event to operation cycle mapping EventOperCycleMapLIN3Slave1NoCommunication: diagnostic-event=EventLIN3Slave1NoCommunication, operation-cycle=DefaultOperationCycle  # Event_Oper_Cycle_Map_LIN 3 Slave 1_NoCommunication
  diagnostic event to debounce algorithm mapping EventDebounceMapLIN3Slave1NoCommunication: debounce-algorithm=counter_based, diagnostic-event=EventLIN3Slave1NoCommunication  # EventDebounceMap_LIN 3 Slave 1_NoCommunication
package /ZeC/DTC/DTC/Power_Path_070_Open_Load_Failure
  diagnostic trouble code uds Power_Path_070_Open_Load_Failure: dtc-props=Dtc_Props_c1017e51, uds-dtc-value=0x005346
  diagnostic event EventPowerPath070OpenLoadFailure: aging-allowed=true, event-kind=SWC, prestorage-freeze-frame=false  # Event_Power_Path_070_Open_Load_Failure
  diagnostic event to trouble code uds mapping EventDtcMapPowerPath070OpenLoadFailure: diagnostic-event=EventPowerPath070OpenLoadFailure, trouble-code-uds=Power_Path_070_Open_Load_Failure  # Event_Dtc_Map_Power_Path_070_Open_Load_Failure
  diagnostic event to operation cycle mapping EventOperCycleMapPowerPath070OpenLoadFailure: diagnostic-event=EventPowerPath070OpenLoadFailure, operation-cycle=DefaultOperationCycle  # Event_Oper_Cycle_Map_Power_Path_070_Open_Load_Failure
  diagnostic event to debounce algorithm mapping EventDebounceMapPowerPath070OpenLoadFailure: debounce-algorithm=time_based, diagnostic-event=EventPowerPath070OpenLoadFailure  # EventDebounceMap_Power_Path_070_Open_Load_Failure
package /ZeC/DTC/DTC/LIN_13_Slave_4_Defect
  diagnostic trouble code uds LIN_13_Slave_4_Defect: dtc-props=Dtc_Props_358996c7, uds-dtc-value=0x030d1b  # LIN 13 Slave 4_Defect
  diagnostic event EventLIN13Slave4Defect: aging-allowed=true, event-kind=SWC, prestorage-freeze-frame=false  # Event_LIN 13 Slave 4_Defect
  diagnostic event to trouble code uds mapping EventDtcMapLIN13Slave4Defect: diagnostic-event=EventLIN13Slave4Defect, trouble-code-uds=LIN_13_Slave_4_Defect  # Event_Dtc_Map_LIN 13 Slave 4_Defect
  diagnostic event to operation cycle mapping EventOperCycleMapLIN13Slave4Defect: diagnostic-event=EventLIN13Slave4Defect, operation-cycle=DefaultOperationCycle  # Event_Oper_Cycle_Map_LIN 13 Slave 4_Defect
  diagnostic event to debounce algorithm mapping EventDebounceMapLIN13Slave4Defect: debounce-algorithm=counter_based, diagnostic-event=EventLIN13Slave4Defect  # EventDebounceMap_LIN 13 Slave 4_Defect
package /ZeC/DTC/DTC/LIN_3_Slave_11_Defect
  diagnostic trouble code uds LIN_3_Slave_11_Defect: dtc-props=Dtc_Props_358996c7, uds-dtc-value=0x030305  # LIN 3 Slave 11_Defect
  diagnostic event EventLIN3Slave11Defect: aging-allowed=true, event-kind=SWC, prestorage-freeze-frame=false  # Event_LIN 3 Slave 11_Defect
  diagnostic event to trouble code uds mapping EventDtcMapLIN3Slave11Defect: diagnostic-event=EventLIN3Slave11Defect, trouble-code-uds=LIN_3_Slave_11_Defect  # Event_Dtc_Map_LIN 3 Slave 11_Defect
  diagnostic event to operation cycle mapping EventOperCycleMapLIN3Slave11Defect: diagnostic-event=EventLIN3Slave11Defect, operation-cycle=DefaultOperationCycle  # Event_Oper_Cycle_Map_LIN 3 Slave 11_Defect
  diagnostic event to debounce algorithm mapping EventDebounceMapLIN3Slave11Defect: debounce-algorithm=counter_based, diagnostic-event=EventLIN3Slave11Defect  # EventDebounceMap_LIN 3 Slave 11_Defect
package /ZeC/DTC/DTC/Power_Path_073_Open_Load_Failure
  diagnostic trouble code uds Power_Path_073_Open_Load_Failure: dtc-props=Dtc_Props_956415a5, uds-dtc-value=0x005349
  diagnostic event EventPowerPath073OpenLoadFailure: aging-allowed=true, event-kind=SWC, prestorage-freeze-frame=false  # Event_Power_Path_073_Open_Load_Failure
  diagnostic event to trouble code uds mapping EventDtcMapPowerPath073OpenLoadFailure: diagnostic-event=EventPowerPath073OpenLoadFailure, trouble-code-uds=Power_Path_073_Open_Load_Failure  # Event_Dtc_Map_Power_Path_073_Open_Load_Failure
  diagnostic event to operation cycle mapping EventOperCycleMapPowerPath073OpenLoadFailure: diagnostic-event=EventPowerPath073OpenLoadFailure, operation-cycle=DefaultOperationCycle  # Event_Oper_Cycle_Map_Power_Path_073_Open_Load_Failure
  diagnostic event to debounce algorithm mapping EventDebounceMapPowerPath073OpenLoadFailure: debounce-algorithm=time_based, diagnostic-event=EventPowerPath073OpenLoadFailure  # EventDebounceMap_Power_Path_073_Open_Load_Failure
package /ZeC/DTC/DTC/LIN_13_Slave_4_NoCommunication
  diagnostic trouble code uds LIN_13_Slave_4_NoCommunication: dtc-props=Dtc_Props_358996c7, uds-dtc-value=0x030d1c  # LIN 13 Slave 4_NoCommunication
  diagnostic event EventLIN13Slave4NoCommunication: aging-allowed=true, event-kind=SWC, prestorage-freeze-frame=false  # Event_LIN 13 Slave 4_NoCommunication
  diagnostic event to trouble code uds mapping EventDtcMapLIN13Slave4NoCommunication: diagnostic-event=EventLIN13Slave4NoCommunication, trouble-code-uds=LIN_13_Slave_4_NoCommunication  # Event_Dtc_Map_LIN 13 Slave 4_NoCommunication
  diagnostic event to operation cycle mapping EventOperCycleMapLIN13Slave4NoCommunication: diagnostic-event=EventLIN13Slave4NoCommunication, operation-cycle=DefaultOperationCycle  # Event_Oper_Cycle_Map_LIN 13 Slave 4_NoCommunication
  diagnostic event to debounce algorithm mapping EventDebounceMapLIN13Slave4NoCommunication: debounce-algorithm=counter_based, diagnostic-event=EventLIN13Slave4NoCommunication  # EventDebounceMap_LIN 13 Slave 4_NoCommunication
package /ZeC/DTC/DTC/LIN_3_Slave_10_NoCommunication
  diagnostic trouble code uds LIN_3_Slave_10_NoCommunication: dtc-props=Dtc_Props_358996c7, uds-dtc-value=0x030304  # LIN 3 Slave 10_NoCommunication
  diagnostic event EventLIN3Slave10NoCommunication: aging-allowed=true, event-kind=SWC, prestorage-freeze-frame=false  # Event_LIN 3 Slave 10_NoCommunication
  diagnostic event to trouble code uds mapping EventDtcMapLIN3Slave10NoCommunication: diagnostic-event=EventLIN3Slave10NoCommunication, trouble-code-uds=LIN_3_Slave_10_NoCommunication  # Event_Dtc_Map_LIN 3 Slave 10_NoCommunication
  diagnostic event to operation cycle mapping EventOperCycleMapLIN3Slave10NoCommunication: diagnostic-event=EventLIN3Slave10NoCommunication, operation-cycle=DefaultOperationCycle  # Event_Oper_Cycle_Map_LIN 3 Slave 10_NoCommunication
  diagnostic event to debounce algorithm mapping EventDebounceMapLIN3Slave10NoCommunication: debounce-algorithm=counter_based, diagnostic-event=EventLIN3Slave10NoCommunication  # EventDebounceMap_LIN 3 Slave 10_NoCommunication
package /ZeC/DTC/DTC/Power_Path_072_Open_Load_Failure
  diagnostic trouble code uds Power_Path_072_Open_Load_Failure: dtc-props=Dtc_Props_d37d1f9f, uds-dtc-value=0x005348
  diagnostic event EventPowerPath072OpenLoadFailure: aging-allowed=true, event-kind=SWC, prestorage-freeze-frame=false  # Event_Power_Path_072_Open_Load_Failure
  diagnostic event to trouble code uds mapping EventDtcMapPowerPath072OpenLoadFailure: diagnostic-event=EventPowerPath072OpenLoadFailure, trouble-code-uds=Power_Path_072_Open_Load_Failure  # Event_Dtc_Map_Power_Path_072_Open_Load_Failure
  diagnostic event to operation cycle mapping EventOperCycleMapPowerPath072OpenLoadFailure: diagnostic-event=EventPowerPath072OpenLoadFailure, operation-cycle=DefaultOperationCycle  # Event_Oper_Cycle_Map_Power_Path_072_Open_Load_Failure
  diagnostic event to debounce algorithm mapping EventDebounceMapPowerPath072OpenLoadFailure: debounce-algorithm=time_based, diagnostic-event=EventPowerPath072OpenLoadFailure  # EventDebounceMap_Power_Path_072_Open_Load_Failure
package /ZeC/DTC/DTC/Power_Path_076_Open_Load_Failure
  diagnostic trouble code uds Power_Path_076_Open_Load_Failure: dtc-props=Dtc_Props_79f23ebf, uds-dtc-value=0x00534c
  diagnostic event EventPowerPath076OpenLoadFailure: aging-allowed=true, event-kind=SWC, prestorage-freeze-frame=false  # Event_Power_Path_076_Open_Load_Failure
  diagnostic event to trouble code uds mapping EventDtcMapPowerPath076OpenLoadFailure: diagnostic-event=EventPowerPath076OpenLoadFailure, trouble-code-uds=Power_Path_076_Open_Load_Failure  # Event_Dtc_Map_Power_Path_076_Open_Load_Failure
  diagnostic event to operation cycle mapping EventOperCycleMapPowerPath076OpenLoadFailure: diagnostic-event=EventPowerPath076OpenLoadFailure, operation-cycle=DefaultOperationCycle  # Event_Oper_Cycle_Map_Power_Path_076_Open_Load_Failure
  diagnostic event to debounce algorithm mapping EventDebounceMapPowerPath076OpenLoadFailure: debounce-algorithm=time_based, diagnostic-event=EventPowerPath076OpenLoadFailure  # EventDebounceMap_Power_Path_076_Open_Load_Failure
package /ZeC/DTC/DTC/LIN_13_Slave_3_NoCommunication
  diagnostic trouble code uds LIN_13_Slave_3_NoCommunication: dtc-props=Dtc_Props_358996c7, uds-dtc-value=0x030d1a  # LIN 13 Slave 3_NoCommunication
  diagnostic event EventLIN13Slave3NoCommunication: aging-allowed=true, event-kind=SWC, prestorage-freeze-frame=false  # Event_LIN 13 Slave 3_NoCommunication
  diagnostic event to trouble code uds mapping EventDtcMapLIN13Slave3NoCommunication: diagnostic-event=EventLIN13Slave3NoCommunication, trouble-code-uds=LIN_13_Slave_3_NoCommunication  # Event_Dtc_Map_LIN 13 Slave 3_NoCommunication
  diagnostic event to operation cycle mapping EventOperCycleMapLIN13Slave3NoCommunication: diagnostic-event=EventLIN13Slave3NoCommunication, operation-cycle=DefaultOperationCycle  # Event_Oper_Cycle_Map_LIN 13 Slave 3_NoCommunication
  diagnostic event to debounce algorithm mapping EventDebounceMapLIN13Slave3NoCommunication: debounce-algorithm=counter_based, diagnostic-event=EventLIN13Slave3NoCommunication  # EventDebounceMap_LIN 13 Slave 3_NoCommunication
package /ZeC/DTC/DTC/Power_Path_075_Open_Load_Failure
  diagnostic trouble code uds Power_Path_075_Open_Load_Failure: dtc-props=Dtc_Props_3feb3485, uds-dtc-value=0x00534b
  diagnostic event EventPowerPath075OpenLoadFailure: aging-allowed=true, event-kind=SWC, prestorage-freeze-frame=false  # Event_Power_Path_075_Open_Load_Failure
  diagnostic event to trouble code uds mapping EventDtcMapPowerPath075OpenLoadFailure: diagnostic-event=EventPowerPath075OpenLoadFailure, trouble-code-uds=Power_Path_075_Open_Load_Failure  # Event_Dtc_Map_Power_Path_075_Open_Load_Failure
  diagnostic event to operation cycle mapping EventOperCycleMapPowerPath075OpenLoadFailure: diagnostic-event=EventPowerPath075OpenLoadFailure, operation-cycle=DefaultOperationCycle  # Event_Oper_Cycle_Map_Power_Path_075_Open_Load_Failure
  diagnostic event to debounce algorithm mapping EventDebounceMapPowerPath075OpenLoadFailure: debounce-algorithm=time_based, diagnostic-event=EventPowerPath075OpenLoadFailure  # EventDebounceMap_Power_Path_075_Open_Load_Failure
package /ZeC/DTC/DTC/LIN_3_Slave_1_Defect
  diagnostic trouble code uds LIN_3_Slave_1_Defect: dtc-props=Dtc_Props_358996c7, uds-dtc-value=0x030301  # LIN 3 Slave 1_Defect
  diagnostic event EventLIN3Slave1Defect: aging-allowed=true, event-kind=SWC, prestorage-freeze-frame=false  # Event_LIN 3 Slave 1_Defect
  diagnostic event to trouble code uds mapping EventDtcMapLIN3Slave1Defect: diagnostic-event=EventLIN3Slave1Defect, trouble-code-uds=LIN_3_Slave_1_Defect  # Event_Dtc_Map_LIN 3 Slave 1_Defect
  diagnostic event to operation cycle mapping EventOperCycleMapLIN3Slave1Defect: diagnostic-event=EventLIN3Slave1Defect, operation-cycle=DefaultOperationCycle  # Event_Oper_Cycle_Map_LIN 3 Slave 1_Defect
  diagnostic event to debounce algorithm mapping EventDebounceMapLIN3Slave1Defect: debounce-algorithm=counter_based, diagnostic-event=EventLIN3Slave1Defect  # EventDebounceMap_LIN 3 Slave 1_Defect
package /ZeC/DTC/DTC/Power_Path_078_Open_Load_Failure
  diagnostic trouble code uds Power_Path_078_Open_Load_Failure: dtc-props=Dtc_Props_36d50462, uds-dtc-value=0x00534e
  diagnostic event EventPowerPath078OpenLoadFailure: aging-allowed=true, event-kind=SWC, prestorage-freeze-frame=false  # Event_Power_Path_078_Open_Load_Failure
  diagnostic event to trouble code uds mapping EventDtcMapPowerPath078OpenLoadFailure: diagnostic-event=EventPowerPath078OpenLoadFailure, trouble-code-uds=Power_Path_078_Open_Load_Failure  # Event_Dtc_Map_Power_Path_078_Open_Load_Failure
  diagnostic event to operation cycle mapping EventOperCycleMapPowerPath078OpenLoadFailure: diagnostic-event=EventPowerPath078OpenLoadFailure, operation-cycle=DefaultOperationCycle  # Event_Oper_Cycle_Map_Power_Path_078_Open_Load_Failure
  diagnostic event to debounce algorithm mapping EventDebounceMapPowerPath078OpenLoadFailure: debounce-algorithm=time_based, diagnostic-event=EventPowerPath078OpenLoadFailure  # EventDebounceMap_Power_Path_078_Open_Load_Failure
package /ZeC/DTC/DTC/Power_Path_077_Open_Load_Failure
  diagnostic trouble code uds Power_Path_077_Open_Load_Failure: dtc-props=Dtc_Props_70cc0e58, uds-dtc-value=0x00534d
  diagnostic event EventPowerPath077OpenLoadFailure: aging-allowed=true, event-kind=SWC, prestorage-freeze-frame=false  # Event_Power_Path_077_Open_Load_Failure
  diagnostic event to trouble code uds mapping EventDtcMapPowerPath077OpenLoadFailure: diagnostic-event=EventPowerPath077OpenLoadFailure, trouble-code-uds=Power_Path_077_Open_Load_Failure  # Event_Dtc_Map_Power_Path_077_Open_Load_Failure
  diagnostic event to operation cycle mapping EventOperCycleMapPowerPath077OpenLoadFailure: diagnostic-event=EventPowerPath077OpenLoadFailure, operation-cycle=DefaultOperationCycle  # Event_Oper_Cycle_Map_Power_Path_077_Open_Load_Failure
  diagnostic event to debounce algorithm mapping EventDebounceMapPowerPath077OpenLoadFailure: debounce-algorithm=time_based, diagnostic-event=EventPowerPath077OpenLoadFailure  # EventDebounceMap_Power_Path_077_Open_Load_Failure
package /ZeC/DTC/DTC/Power_Path_074_Open_Load_Failure
  diagnostic trouble code uds Power_Path_074_Open_Load_Failure: dtc-props=Dtc_Props_f5c02acb, uds-dtc-value=0x00534a
  diagnostic event EventPowerPath074OpenLoadFailure: aging-allowed=true, event-kind=SWC, prestorage-freeze-frame=false  # Event_Power_Path_074_Open_Load_Failure
  diagnostic event to trouble code uds mapping EventDtcMapPowerPath074OpenLoadFailure: diagnostic-event=EventPowerPath074OpenLoadFailure, trouble-code-uds=Power_Path_074_Open_Load_Failure  # Event_Dtc_Map_Power_Path_074_Open_Load_Failure
  diagnostic event to operation cycle mapping EventOperCycleMapPowerPath074OpenLoadFailure: diagnostic-event=EventPowerPath074OpenLoadFailure, operation-cycle=DefaultOperationCycle  # Event_Oper_Cycle_Map_Power_Path_074_Open_Load_Failure
  diagnostic event to debounce algorithm mapping EventDebounceMapPowerPath074OpenLoadFailure: debounce-algorithm=time_based, diagnostic-event=EventPowerPath074OpenLoadFailure  # EventDebounceMap_Power_Path_074_Open_Load_Failure
package /ZeC/DTC/DTC/LIN_3_Slave_2_Defect
  diagnostic trouble code uds LIN_3_Slave_2_Defect: dtc-props=Dtc_Props_358996c7, uds-dtc-value=0x03030f  # LIN 3 Slave 2_Defect
  diagnostic event EventLIN3Slave2Defect: aging-allowed=true, event-kind=SWC, prestorage-freeze-frame=false  # Event_LIN 3 Slave 2_Defect
  diagnostic event to trouble code uds mapping EventDtcMapLIN3Slave2Defect: diagnostic-event=EventLIN3Slave2Defect, trouble-code-uds=LIN_3_Slave_2_Defect  # Event_Dtc_Map_LIN 3 Slave 2_Defect
  diagnostic event to operation cycle mapping EventOperCycleMapLIN3Slave2Defect: diagnostic-event=EventLIN3Slave2Defect, operation-cycle=DefaultOperationCycle  # Event_Oper_Cycle_Map_LIN 3 Slave 2_Defect
  diagnostic event to debounce algorithm mapping EventDebounceMapLIN3Slave2Defect: debounce-algorithm=counter_based, diagnostic-event=EventLIN3Slave2Defect  # EventDebounceMap_LIN 3 Slave 2_Defect
package /ZeC/DTC/DTC/LIN_3_Slave_14_NoCommunication
  diagnostic trouble code uds LIN_3_Slave_14_NoCommunication: dtc-props=Dtc_Props_358996c7, uds-dtc-value=0x03030c  # LIN 3 Slave 14_NoCommunication
  diagnostic event EventLIN3Slave14NoCommunication: aging-allowed=true, event-kind=SWC, prestorage-freeze-frame=false  # Event_LIN 3 Slave 14_NoCommunication
  diagnostic event to trouble code uds mapping EventDtcMapLIN3Slave14NoCommunication: diagnostic-event=EventLIN3Slave14NoCommunication, trouble-code-uds=LIN_3_Slave_14_NoCommunication  # Event_Dtc_Map_LIN 3 Slave 14_NoCommunication
  diagnostic event to operation cycle mapping EventOperCycleMapLIN3Slave14NoCommunication: diagnostic-event=EventLIN3Slave14NoCommunication, operation-cycle=DefaultOperationCycle  # Event_Oper_Cycle_Map_LIN 3 Slave 14_NoCommunication
  diagnostic event to debounce algorithm mapping EventDebounceMapLIN3Slave14NoCommunication: debounce-algorithm=counter_based, diagnostic-event=EventLIN3Slave14NoCommunication  # EventDebounceMap_LIN 3 Slave 14_NoCommunication
package /ZeC/DTC/DTC/LIN_3_Slave_14_Defect
  diagnostic trouble code uds LIN_3_Slave_14_Defect: dtc-props=Dtc_Props_358996c7, uds-dtc-value=0x03030b  # LIN 3 Slave 14_Defect
  diagnostic event EventLIN3Slave14Defect: aging-allowed=true, event-kind=SWC, prestorage-freeze-frame=false  # Event_LIN 3 Slave 14_Defect
  diagnostic event to trouble code uds mapping EventDtcMapLIN3Slave14Defect: diagnostic-event=EventLIN3Slave14Defect, trouble-code-uds=LIN_3_Slave_14_Defect  # Event_Dtc_Map_LIN 3 Slave 14_Defect
  diagnostic event to operation cycle mapping EventOperCycleMapLIN3Slave14Defect: diagnostic-event=EventLIN3Slave14Defect, operation-cycle=DefaultOperationCycle  # Event_Oper_Cycle_Map_LIN 3 Slave 14_Defect
  diagnostic event to debounce algorithm mapping EventDebounceMapLIN3Slave14Defect: debounce-algorithm=counter_based, diagnostic-event=EventLIN3Slave14Defect  # EventDebounceMap_LIN 3 Slave 14_Defect
package /ZeC/DTC/DTC/Power_Path_079_Open_Load_Failure
  diagnostic trouble code uds Power_Path_079_Open_Load_Failure: dtc-props=Dtc_Props_fcfe1a2c, uds-dtc-value=0x00534f
  diagnostic event EventPowerPath079OpenLoadFailure: aging-allowed=true, event-kind=SWC, prestorage-freeze-frame=false  # Event_Power_Path_079_Open_Load_Failure
  diagnostic event to trouble code uds mapping EventDtcMapPowerPath079OpenLoadFailure: diagnostic-event=EventPowerPath079OpenLoadFailure, trouble-code-uds=Power_Path_079_Open_Load_Failure  # Event_Dtc_Map_Power_Path_079_Open_Load_Failure
  diagnostic event to operation cycle mapping EventOperCycleMapPowerPath079OpenLoadFailure: diagnostic-event=EventPowerPath079OpenLoadFailure, operation-cycle=DefaultOperationCycle  # Event_Oper_Cycle_Map_Power_Path_079_Open_Load_Failure
  diagnostic event to debounce algorithm mapping EventDebounceMapPowerPath079OpenLoadFailure: debounce-algorithm=time_based, diagnostic-event=EventPowerPath079OpenLoadFailure  # EventDebounceMap_Power_Path_079_Open_Load_Failure
package /ZeC/DTC/DTC/LIN_3_Slave_15_NoCommunication
  diagnostic trouble code uds LIN_3_Slave_15_NoCommunication: dtc-props=Dtc_Props_358996c7, uds-dtc-value=0x03030e  # LIN 3 Slave 15_NoCommunication
  diagnostic event EventLIN3Slave15NoCommunication: aging-allowed=true, event-kind=SWC, prestorage-freeze-frame=false  # Event_LIN 3 Slave 15_NoCommunication
  diagnostic event to trouble code uds mapping EventDtcMapLIN3Slave15NoCommunication: diagnostic-event=EventLIN3Slave15NoCommunication, trouble-code-uds=LIN_3_Slave_15_NoCommunication  # Event_Dtc_Map_LIN 3 Slave 15_NoCommunication
  diagnostic event to operation cycle mapping EventOperCycleMapLIN3Slave15NoCommunication: diagnostic-event=EventLIN3Slave15NoCommunication, operation-cycle=DefaultOperationCycle  # Event_Oper_Cycle_Map_LIN 3 Slave 15_NoCommunication
  diagnostic event to debounce algorithm mapping EventDebounceMapLIN3Slave15NoCommunication: debounce-algorithm=counter_based, diagnostic-event=EventLIN3Slave15NoCommunication  # EventDebounceMap_LIN 3 Slave 15_NoCommunication
package /ZeC/DTC/DTC/LIN_3_Slave_15_Defect
  diagnostic trouble code uds LIN_3_Slave_15_Defect: dtc-props=Dtc_Props_358996c7, uds-dtc-value=0x03030d  # LIN 3 Slave 15_Defect
  diagnostic event EventLIN3Slave15Defect: aging-allowed=true, event-kind=SWC, prestorage-freeze-frame=false  # Event_LIN 3 Slave 15_Defect
  diagnostic event to trouble code uds mapping EventDtcMapLIN3Slave15Defect: diagnostic-event=EventLIN3Slave15Defect, trouble-code-uds=LIN_3_Slave_15_Defect  # Event_Dtc_Map_LIN 3 Slave 15_Defect
  diagnostic event to operation cycle mapping EventOperCycleMapLIN3Slave15Defect: diagnostic-event=EventLIN3Slave15Defect, operation-cycle=DefaultOperationCycle  # Event_Oper_Cycle_Map_LIN 3 Slave 15_Defect
  diagnostic event to debounce algorithm mapping EventDebounceMapLIN3Slave15Defect: debounce-algorithm=counter_based, diagnostic-event=EventLIN3Slave15Defect  # EventDebounceMap_LIN 3 Slave 15_Defect
package /ZeC/DTC/DTC/LIN_13_Local_Databus_Electrical_Failure
  diagnostic trouble code uds LIN_13_Local_Databus_Electrical_Failure: dtc-props=Dtc_Props_358996c7, uds-dtc-value=0x030d21  # LIN 13 Local_Databus_Electrical_Failure
  diagnostic event EventLIN13LocalDatabusElectricalFailure: aging-allowed=true, event-kind=SWC, prestorage-freeze-frame=false  # Event_LIN 13 Local_Databus_Electrical_Failure
  diagnostic event to trouble code uds mapping EventDtcMapLIN13LocalDatabusElectricalFailure: diagnostic-event=EventLIN13LocalDatabusElectricalFailure, trouble-code-uds=LIN_13_Local_Databus_Electrical_Failure  # Event_Dtc_Map_LIN 13 Local_Databus_Electrical_Failure
  diagnostic event to operation cycle mapping EventOperCycleMapLIN13LocalDatabusElectricalFailure: diagnostic-event=EventLIN13LocalDatabusElectricalFailure, operation-cycle=DefaultOperationCycle  # Event_Oper_Cycle_Map_LIN 13 Local_Databus_Electrical_Failure
  diagnostic event to debounce algorithm mapping EventDebounceMapLIN13LocalDatabusElectricalFailure: debounce-algorithm=counter_based, diagnostic-event=EventLIN13LocalDatabusElectricalFailure  # EventDebounceMap_LIN 13 Local_Databus_Electrical_Failure
package /ZeC/DTC/DTC/Power_Path_084_Open_Load_Failure
  diagnostic trouble code uds Power_Path_084_Open_Load_Failure: dtc-props=Dtc_Props_8b79aa9d, uds-dtc-value=0x005354
  diagnostic event EventPowerPath084OpenLoadFailure: aging-allowed=true, event-kind=SWC, prestorage-freeze-frame=false  # Event_Power_Path_084_Open_Load_Failure
  diagnostic event to trouble code uds mapping EventDtcMapPowerPath084OpenLoadFailure: diagnostic-event=EventPowerPath084OpenLoadFailure, trouble-code-uds=Power_Path_084_Open_Load_Failure  # Event_Dtc_Map_Power_Path_084_Open_Load_Failure
  diagnostic event to operation cycle mapping EventOperCycleMapPowerPath084OpenLoadFailure: diagnostic-event=EventPowerPath084OpenLoadFailure, operation-cycle=DefaultOperationCycle  # Event_Oper_Cycle_Map_Power_Path_084_Open_Load_Failure
  diagnostic event to debounce algorithm mapping EventDebounceMapPowerPath084OpenLoadFailure: debounce-algorithm=time_based, diagnostic-event=EventPowerPath084OpenLoadFailure  # EventDebounceMap_Power_Path_084_Open_Load_Failure
package /ZeC/DTC/DTC/Power_Path_083_Open_Load_Failure
  diagnostic trouble code uds Power_Path_083_Open_Load_Failure: dtc-props=Dtc_Props_82479a7a, uds-dtc-value=0x005353
  diagnostic event EventPowerPath083OpenLoadFailure: aging-allowed=true, event-kind=SWC, prestorage-freeze-frame=false  # Event_Power_Path_083_Open_Load_Failure
  diagnostic event to trouble code uds mapping EventDtcMapPowerPath083OpenLoadFailure: diagnostic-event=EventPowerPath083OpenLoadFailure, trouble-code-uds=Power_Path_083_Open_Load_Failure  # Event_Dtc_Map_Power_Path_083_Open_Load_Failure
  diagnostic event to operation cycle mapping EventOperCycleMapPowerPath083OpenLoadFailure: diagnostic-event=EventPowerPath083OpenLoadFailure, operation-cycle=DefaultOperationCycle  # Event_Oper_Cycle_Map_Power_Path_083_Open_Load_Failure
  diagnostic event to debounce algorithm mapping EventDebounceMapPowerPath083OpenLoadFailure: debounce-algorithm=time_based, diagnostic-event=EventPowerPath083OpenLoadFailure  # EventDebounceMap_Power_Path_083_Open_Load_Failure
package /ZeC/DTC/DTC/LIN_3_Slave_13_NoCommunication
  diagnostic trouble code uds LIN_3_Slave_13_NoCommunication: dtc-props=Dtc_Props_358996c7, uds-dtc-value=0x03030a  # LIN 3 Slave 13_NoCommunication
  diagnostic event EventLIN3Slave13NoCommunication: aging-allowed=true, event-kind=SWC, prestorage-freeze-frame=false  # Event_LIN 3 Slave 13_NoCommunication
  diagnostic event to trouble code uds mapping EventDtcMapLIN3Slave13NoCommunication: diagnostic-event=EventLIN3Slave13NoCommunication, trouble-code-uds=LIN_3_Slave_13_NoCommunication  # Event_Dtc_Map_LIN 3 Slave 13_NoCommunication
  diagnostic event to operation cycle mapping EventOperCycleMapLIN3Slave13NoCommunication: diagnostic-event=EventLIN3Slave13NoCommunication, operation-cycle=DefaultOperationCycle  # Event_Oper_Cycle_Map_LIN 3 Slave 13_NoCommunication
  diagnostic event to debounce algorithm mapping EventDebounceMapLIN3Slave13NoCommunication: debounce-algorithm=counter_based, diagnostic-event=EventLIN3Slave13NoCommunication  # EventDebounceMap_LIN 3 Slave 13_NoCommunication
