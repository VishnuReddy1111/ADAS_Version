[part 11 of 19: packages /ZeC/DTC/DTC/Power_Path_086_Open_Load_Failure to /ZeC/DTC/DTC/Power_Path_039_Open_Load_Failure]
AUTOSAR XML (schema 00047)
package /ZeC/DTC/DTC/Power_Path_086_Open_Load_Failure
  diagnostic trouble code uds Power_Path_086_Open_Load_Failure: dtc-props=Dtc_Props_74bbee9, uds-dtc-value=0x005356
  diagnostic event EventPowerPath086OpenLoadFailure: aging-allowed=true, event-kind=SWC, prestorage-freeze-frame=false  # Event_Power_Path_086_Open_Load_Failure
  diagnostic event to trouble code uds mapping EventDtcMapPowerPath086OpenLoadFailure: diagnostic-event=EventPowerPath086OpenLoadFailure, trouble-code-uds=Power_Path_086_Open_Load_Failure  # Event_Dtc_Map_Power_Path_086_Open_Load_Failure
  diagnostic event to operation cycle mapping EventOperCycleMapPowerPath086OpenLoadFailure: diagnostic-event=EventPowerPath086OpenLoadFailure, operation-cycle=DefaultOperationCycle  # Event_Oper_Cycle_Map_Power_Path_086_Open_Load_Failure
  diagnostic event to debounce algorithm mapping EventDebounceMapPowerPath086OpenLoadFailure: debounce-algorithm=time_based, diagnostic-event=EventPowerPath086OpenLoadFailure  # EventDebounceMap_Power_Path_086_Open_Load_Failure
package /ZeC/DTC/DTC/LIN_13_Databus_No_Comm
  diagnostic trouble code uds LIN_13_Databus_No_Comm: dtc-props=Dtc_Props_358996c7, uds-dtc-value=0x030d20  # LIN 13 Databus_No_Comm
  diagnostic event EventLIN13DatabusNoComm: aging-allowed=true, event-kind=SWC, prestorage-freeze-frame=false  # Event_LIN 13 Databus_No_Comm
  diagnostic event to trouble code uds mapping EventDtcMapLIN13DatabusNoComm: diagnostic-event=EventLIN13DatabusNoComm, trouble-code-uds=LIN_13_Databus_No_Comm  # Event_Dtc_Map_LIN 13 Databus_No_Comm
  diagnostic event to operation cycle mapping EventOperCycleMapLIN13DatabusNoComm: diagnostic-event=EventLIN13DatabusNoComm, operation-cycle=DefaultOperationCycle  # Event_Oper_Cycle_Map_LIN 13 Databus_No_Comm
  diagnostic event to debounce algorithm mapping EventDebounceMapLIN13DatabusNoComm: debounce-algorithm=counter_based, diagnostic-event=EventLIN13DatabusNoComm  # EventDebounceMap_LIN 13 Databus_No_Comm
package /ZeC/DTC/DTC/Power_Path_085_Open_Load_Failure
  diagnostic trouble code uds Power_Path_085_Open_Load_Failure: dtc-props=Dtc_Props_cd60a0a7, uds-dtc-value=0x005355
  diagnostic event EventPowerPath085OpenLoadFailure: aging-allowed=true, event-kind=SWC, prestorage-freeze-frame=false  # Event_Power_Path_085_Open_Load_Failure
  diagnostic event to trouble code uds mapping EventDtcMapPowerPath085OpenLoadFailure: diagnostic-event=EventPowerPath085OpenLoadFailure, trouble-code-uds=Power_Path_085_Open_Load_Failure  # Event_Dtc_Map_Power_Path_085_Open_Load_Failure
  diagnostic event to operation cycle mapping EventOperCycleMapPowerPath085OpenLoadFailure: diagnostic-event=EventPowerPath085OpenLoadFailure, operation-cycle=DefaultOperationCycle  # Event_Oper_Cycle_Map_Power_Path_085_Open_Load_Failure
  diagnostic event to debounce algorithm mapping EventDebounceMapPowerPath085OpenLoadFailure: debounce-algorithm=time_based, diagnostic-event=EventPowerPath085OpenLoadFailure  # EventDebounceMap_Power_Path_085_Open_Load_Failure
package /ZeC/DTC/DTC/Power_Path_080_Open_Load_Failure
  diagnostic trouble code uds Power_Path_080_Open_Load_Failure: dtc-props=Dtc_Props_486c8434, uds-dtc-value=0x005350
  diagnostic event EventPowerPath080OpenLoadFailure: aging-allowed=true, event-kind=SWC, prestorage-freeze-frame=false  # Event_Power_Path_080_Open_Load_Failure
  diagnostic event to trouble code uds mapping EventDtcMapPowerPath080OpenLoadFailure: diagnostic-event=EventPowerPath080OpenLoadFailure, trouble-code-uds=Power_Path_080_Open_Load_Failure  # Event_Dtc_Map_Power_Path_080_Open_Load_Failure
  diagnostic event to operation cycle mapping EventOperCycleMapPowerPath080OpenLoadFailure: diagnostic-event=EventPowerPath080OpenLoadFailure, operation-cycle=DefaultOperationCycle  # Event_Oper_Cycle_Map_Power_Path_080_Open_Load_Failure
  diagnostic event to debounce algorithm mapping EventDebounceMapPowerPath080OpenLoadFailure: debounce-algorithm=time_based, diagnostic-event=EventPowerPath080OpenLoadFailure  # EventDebounceMap_Power_Path_080_Open_Load_Failure
package /ZeC/DTC/DTC/Power_Path_082_Open_Load_Failure
  diagnostic trouble code uds Power_Path_082_Open_Load_Failure: dtc-props=Dtc_Props_c45e9040, uds-dtc-value=0x005352
  diagnostic event EventPowerPath082OpenLoadFailure: aging-allowed=true, event-kind=SWC, prestorage-freeze-frame=false  # Event_Power_Path_082_Open_Load_Failure
  diagnostic event to trouble code uds mapping EventDtcMapPowerPath082OpenLoadFailure: diagnostic-event=EventPowerPath082OpenLoadFailure, trouble-code-uds=Power_Path_082_Open_Load_Failure  # Event_Dtc_Map_Power_Path_082_Open_Load_Failure
  diagnostic event to operation cycle mapping EventOperCycleMapPowerPath082OpenLoadFailure: diagnostic-event=EventPowerPath082OpenLoadFailure, operation-cycle=DefaultOperationCycle  # Event_Oper_Cycle_Map_Power_Path_082_Open_Load_Failure
  diagnostic event to debounce algorithm mapping EventDebounceMapPowerPath082OpenLoadFailure: debounce-algorithm=time_based, diagnostic-event=EventPowerPath082OpenLoadFailure  # EventDebounceMap_Power_Path_082_Open_Load_Failure
package /ZeC/DTC/DTC/Power_Path_081_Open_Load_Failure
  diagnostic trouble code uds Power_Path_081_Open_Load_Failure: dtc-props=Dtc_Props_e758e0e, uds-dtc-value=0x005351
  diagnostic event EventPowerPath081OpenLoadFailure: aging-allowed=true, event-kind=SWC, prestorage-freeze-frame=false  # Event_Power_Path_081_Open_Load_Failure
  diagnostic event to trouble code uds mapping EventDtcMapPowerPath081OpenLoadFailure: diagnostic-event=EventPowerPath081OpenLoadFailure, trouble-code-uds=Power_Path_081_Open_Load_Failure  # Event_Dtc_Map_Power_Path_081_Open_Load_Failure
  diagnostic event to operation cycle mapping EventOperCycleMapPowerPath081OpenLoadFailure: diagnostic-event=EventPowerPath081OpenLoadFailure, operation-cycle=DefaultOperationCycle  # Event_Oper_Cycle_Map_Power_Path_081_Open_Load_Failure
  diagnostic event to debounce algorithm mapping EventDebounceMapPowerPath081OpenLoadFailure: debounce-algorithm=time_based, diagnostic-event=EventPowerPath081OpenLoadFailure  # EventDebounceMap_Power_Path_081_Open_Load_Failure
package /ZeC/DTC/DTC/LIN_3_Slave_6_NoCommunication
  diagnostic trouble code uds LIN_3_Slave_6_NoCommunication: dtc-props=Dtc_Props_358996c7, uds-dtc-value=0x030318  # LIN 3 Slave 6_NoCommunication
  diagnostic event EventLIN3Slave6NoCommunication: aging-allowed=true, event-kind=SWC, prestorage-freeze-frame=false  # Event_LIN 3 Slave 6_NoCommunication
  diagnostic event to trouble code uds mapping EventDtcMapLIN3Slave6NoCommunication: diagnostic-event=EventLIN3Slave6NoCommunication, trouble-code-uds=LIN_3_Slave_6_NoCommunication  # Event_Dtc_Map_LIN 3 Slave 6_NoCommunication
  diagnostic event to operation cycle mapping EventOperCycleMapLIN3Slave6NoCommunication: diagnostic-event=EventLIN3Slave6NoCommunication, operation-cycle=DefaultOperationCycle  # Event_Oper_Cycle_Map_LIN 3 Slave 6_NoCommunication
  diagnostic event to debounce algorithm mapping EventDebounceMapLIN3Slave6NoCommunication: debounce-algorithm=counter_based, diagnostic-event=EventLIN3Slave6NoCommunication  # EventDebounceMap_LIN 3 Slave 6_NoCommunication
package /ZeC/DTC/DTC/LIN_3_Slave_6_Defect
  diagnostic trouble code uds LIN_3_Slave_6_Defect: dtc-props=Dtc_Props_358996c7, uds-dtc-value=0x030317  # LIN 3 Slave 6_Defect
  diagnostic event EventLIN3Slave6Defect: aging-allowed=true, event-kind=SWC, prestorage-freeze-frame=false  # Event_LIN 3 Slave 6_Defect
  diagnostic event to trouble code uds mapping EventDtcMapLIN3Slave6Defect: diagnostic-event=EventLIN3Slave6Defect, trouble-code-uds=LIN_3_Slave_6_Defect  # Event_Dtc_Map_LIN 3 Slave 6_Defect
  diagnostic event to operation cycle mapping EventOperCycleMapLIN3Slave6Defect: diagnostic-event=EventLIN3Slave6Defect, operation-cycle=DefaultOperationCycle  # Event_Oper_Cycle_Map_LIN 3 Slave 6_Defect
  diagnostic event to debounce algorithm mapping EventDebounceMapLIN3Slave6Defect: debounce-algorithm=counter_based, diagnostic-event=EventLIN3Slave6Defect  # EventDebounceMap_LIN 3 Slave 6_Defect
package /ZeC/DTC/DTC/Power_Path_057_Open_Load_Failure
  diagnostic trouble code uds Power_Path_057_Open_Load_Failure: dtc-props=Dtc_Props_ab035c4e, uds-dtc-value=0x005339
  diagnostic event EventPowerPath057OpenLoadFailure: aging-allowed=true, event-kind=SWC, prestorage-freeze-frame=false  # Event_Power_Path_057_Open_Load_Failure
  diagnostic event to trouble code uds mapping EventDtcMapPowerPath057OpenLoadFailure: diagnostic-event=EventPowerPath057OpenLoadFailure, trouble-code-uds=Power_Path_057_Open_Load_Failure  # Event_Dtc_Map_Power_Path_057_Open_Load_Failure
  diagnostic event to operation cycle mapping EventOperCycleMapPowerPath057OpenLoadFailure: diagnostic-event=EventPowerPath057OpenLoadFailure, operation-cycle=DefaultOperationCycle  # Event_Oper_Cycle_Map_Power_Path_057_Open_Load_Failure
  diagnostic event to debounce algorithm mapping EventDebounceMapPowerPath057OpenLoadFailure: debounce-algorithm=time_based, diagnostic-event=EventPowerPath057OpenLoadFailure  # EventDebounceMap_Power_Path_057_Open_Load_Failure
package /ZeC/DTC/DTC/LIN_3_Slave_7_Defect
  diagnostic trouble code uds LIN_3_Slave_7_Defect: dtc-props=Dtc_Props_358996c7, uds-dtc-value=0x030319  # LIN 3 Slave 7_Defect
  diagnostic event EventLIN3Slave7Defect: aging-allowed=true, event-kind=SWC, prestorage-freeze-frame=false  # Event_LIN 3 Slave 7_Defect
  diagnostic event to trouble code uds mapping EventDtcMapLIN3Slave7Defect: diagnostic-event=EventLIN3Slave7Defect, trouble-code-uds=LIN_3_Slave_7_Defect  # Event_Dtc_Map_LIN 3 Slave 7_Defect
  diagnostic event to operation cycle mapping EventOperCycleMapLIN3Slave7Defect: diagnostic-event=EventLIN3Slave7Defect, operation-cycle=DefaultOperationCycle  # Event_Oper_Cycle_Map_LIN 3 Slave 7_Defect
  diagnostic event to debounce algorithm mapping EventDebounceMapLIN3Slave7Defect: debounce-algorithm=counter_based, diagnostic-event=EventLIN3Slave7Defect  # EventDebounceMap_LIN 3 Slave 7_Defect
package /ZeC/DTC/DTC/LIN_3_Slave_4_NoCommunication
  diagnostic trouble code uds LIN_3_Slave_4_NoCommunication: dtc-props=Dtc_Props_358996c7, uds-dtc-value=0x030314  # LIN 3 Slave 4_NoCommunication
  diagnostic event EventLIN3Slave4NoCommunication: aging-allowed=true, event-kind=SWC, prestorage-freeze-frame=false  # Event_LIN 3 Slave 4_NoCommunication
  diagnostic event to trouble code uds mapping EventDtcMapLIN3Slave4NoCommunication: diagnostic-event=EventLIN3Slave4NoCommunication, trouble-code-uds=LIN_3_Slave_4_NoCommunication  # Event_Dtc_Map_LIN 3 Slave 4_NoCommunication
  diagnostic event to operation cycle mapping EventOperCycleMapLIN3Slave4NoCommunication: diagnostic-event=EventLIN3Slave4NoCommunication, operation-cycle=DefaultOperationCycle  # Event_Oper_Cycle_Map_LIN 3 Slave 4_NoCommunication
  diagnostic event to debounce algorithm mapping EventDebounceMapLIN3Slave4NoCommunication: debounce-algorithm=counter_based, diagnostic-event=EventLIN3Slave4NoCommunication  # EventDebounceMap_LIN 3 Slave 4_NoCommunication
package /ZeC/DTC/DTC/Power_Path_054_Open_Load_Failure
  diagnostic trouble code uds Power_Path_054_Open_Load_Failure: dtc-props=Dtc_Props_ff6637ba, uds-dtc-value=0x005336
  diagnostic event EventPowerPath054OpenLoadFailure: aging-allowed=true, event-kind=SWC, prestorage-freeze-frame=false  # Event_Power_Path_054_Open_Load_Failure
  diagnostic event to trouble code uds mapping EventDtcMapPowerPath054OpenLoadFailure: diagnostic-event=EventPowerPath054OpenLoadFailure, trouble-code-uds=Power_Path_054_Open_Load_Failure  # Event_Dtc_Map_Power_Path_054_Open_Load_Failure
  diagnostic event to operation cycle mapping EventOperCycleMapPowerPath054OpenLoadFailure: diagnostic-event=EventPowerPath054OpenLoadFailure, operation-cycle=DefaultOperationCycle  # Event_Oper_Cycle_Map_Power_Path_054_Open_Load_Failure
  diagnostic event to debounce algorithm mapping EventDebounceMapPowerPath054OpenLoadFailure: debounce-algorithm=time_based, diagnostic-event=EventPowerPath054OpenLoadFailure  # EventDebounceMap_Power_Path_054_Open_Load_Failure
package /ZeC/DTC/DTC/LIN_3_Slave_4_Defect
  diagnostic trouble code uds LIN_3_Slave_4_Defect: dtc-props=Dtc_Props_358996c7, uds-dtc-value=0x030313  # LIN 3 Slave 4_Defect
  diagnostic event EventLIN3Slave4Defect: aging-allowed=true, event-kind=SWC, prestorage-freeze-frame=false  # Event_LIN 3 Slave 4_Defect
  diagnostic event to trouble code uds mapping EventDtcMapLIN3Slave4Defect: diagnostic-event=EventLIN3Slave4Defect, trouble-code-uds=LIN_3_Slave_4_Defect  # Event_Dtc_Map_LIN 3 Slave 4_Defect
  diagnostic event to operation cycle mapping EventOperCycleMapLIN3Slave4Defect: diagnostic-event=EventLIN3Slave4Defect, operation-cycle=DefaultOperationCycle  # Event_Oper_Cycle_Map_LIN 3 Slave 4_Defect
  diagnostic event to debounce algorithm mapping EventDebounceMapLIN3Slave4Defect: debounce-algorithm=counter_based, diagnostic-event=EventLIN3Slave4Defect  # EventDebounceMap_LIN 3 Slave 4_Defect
package /ZeC/DTC/DTC/Power_Path_053_Open_Load_Failure
  diagnostic trouble code uds Power_Path_053_Open_Load_Failure: dtc-props=Dtc_Props_354d29f4, uds-dtc-value=0x005335
  diagnostic event EventPowerPath053OpenLoadFailure: aging-allowed=true, event-kind=SWC, prestorage-freeze-frame=false  # Event_Power_Path_053_Open_Load_Failure
  diagnostic event to trouble code uds mapping EventDtcMapPowerPath053OpenLoadFailure: diagnostic-event=EventPowerPath053OpenLoadFailure, trouble-code-uds=Power_Path_053_Open_Load_Failure  # Event_Dtc_Map_Power_Path_053_Open_Load_Failure
  diagnostic event to operation cycle mapping EventOperCycleMapPowerPath053OpenLoadFailure: diagnostic-event=EventPowerPath053OpenLoadFailure, operation-cycle=DefaultOperationCycle  # Event_Oper_Cycle_Map_Power_Path_053_Open_Load_Failure
  diagnostic event to debounce algorithm mapping EventDebounceMapPowerPath053OpenLoadFailure: debounce-algorithm=time_based, diagnostic-event=EventPowerPath053OpenLoadFailure  # EventDebounceMap_Power_Path_053_Open_Load_Failure
package /ZeC/DTC/DTC/LIN_3_Slave_5_NoCommunication
  diagnostic trouble code uds LIN_3_Slave_5_NoCommunication: dtc-props=Dtc_Props_358996c7, uds-dtc-value=0x030316  # LIN 3 Slave 5_NoCommunication
  diagnostic event EventLIN3Slave5NoCommunication: aging-allowed=true, event-kind=SWC, prestorage-freeze-frame=false  # Event_LIN 3 Slave 5_NoCommunication
  diagnostic event to trouble code uds mapping EventDtcMapLIN3Slave5NoCommunication: diagnostic-event=EventLIN3Slave5NoCommunication, trouble-code-uds=LIN_3_Slave_5_NoCommunication  # Event_Dtc_Map_LIN 3 Slave 5_NoCommunication
  diagnostic event to operation cycle mapping EventOperCycleMapLIN3Slave5NoCommunication: diagnostic-event=EventLIN3Slave5NoCommunication, operation-cycle=DefaultOperationCycle  # Event_Oper_Cycle_Map_LIN 3 Slave 5_NoCommunication
  diagnostic event to debounce algorithm mapping EventDebounceMapLIN3Slave5NoCommunication: debounce-algorithm=counter_based, diagnostic-event=EventLIN3Slave5NoCommunication  # EventDebounceMap_LIN 3 Slave 5_NoCommunication
package /ZeC/DTC/DTC/Power_Path_056_Open_Load_Failure
  diagnostic trouble code uds Power_Path_056_Open_Load_Failure: dtc-props=Dtc_Props_ed1a5674, uds-dtc-value=0x005338
  diagnostic event EventPowerPath056OpenLoadFailure: aging-allowed=true, event-kind=SWC, prestorage-freeze-frame=false  # Event_Power_Path_056_Open_Load_Failure
  diagnostic event to trouble code uds mapping EventDtcMapPowerPath056OpenLoadFailure: diagnostic-event=EventPowerPath056OpenLoadFailure, trouble-code-uds=Power_Path_056_Open_Load_Failure  # Event_Dtc_Map_Power_Path_056_Open_Load_Failure
  diagnostic event to operation cycle mapping EventOperCycleMapPowerPath056OpenLoadFailure: diagnostic-event=EventPowerPath056OpenLoadFailure, operation-cycle=DefaultOperationCycle  # Event_Oper_Cycle_Map_Power_Path_056_Open_Load_Failure
  diagnostic event to debounce algorithm mapping EventDebounceMapPowerPath056OpenLoadFailure: debounce-algorithm=time_based, diagnostic-event=EventPowerPath056OpenLoadFailure  # EventDebounceMap_Power_Path_056_Open_Load_Failure
package /ZeC/DTC/DTC/LIN_3_Slave_5_Defect
  diagnostic trouble code uds LIN_3_Slave_5_Defect: dtc-props=Dtc_Props_358996c7, uds-dtc-value=0x030315  # LIN 3 Slave 5_Defect
  diagnostic event EventLIN3Slave5Defect: aging-allowed=true, event-kind=SWC, prestorage-freeze-frame=false  # Event_LIN 3 Slave 5_Defect
  diagnostic event to trouble code uds mapping EventDtcMapLIN3Slave5Defect: diagnostic-event=EventLIN3Slave5Defect, trouble-code-uds=LIN_3_Slave_5_Defect  # Event_Dtc_Map_LIN 3 Slave 5_Defect
  diagnostic event to operation cycle mapping EventOperCycleMapLIN3Slave5Defect: diagnostic-event=EventLIN3Slave5Defect, operation-cycle=DefaultOperationCycle  # Event_Oper_Cycle_Map_LIN 3 Slave 5_Defect
  diagnostic event to debounce algorithm mapping EventDebounceMapLIN3Slave5Defect: debounce-algorithm=counter_based, diagnostic-event=EventLIN3Slave5Defect  # EventDebounceMap_LIN 3 Slave 5_Defect
package /ZeC/DTC/DTC/Power_Path_055_Open_Load_Failure
  diagnostic trouble code uds Power_Path_055_Open_Load_Failure: dtc-props=Dtc_Props_b97f3d80, uds-dtc-value=0x005337
  diagnostic event EventPowerPath055OpenLoadFailure: aging-allowed=true, event-kind=SWC, prestorage-freeze-frame=false  # Event_Power_Path_055_Open_Load_Failure
  diagnostic event to trouble code uds mapping EventDtcMapPowerPath055OpenLoadFailure: diagnostic-event=EventPowerPath055OpenLoadFailure, trouble-code-uds=Power_Path_055_Open_Load_Failure  # Event_Dtc_Map_Power_Path_055_Open_Load_Failure
  diagnostic event to operation cycle mapping EventOperCycleMapPowerPath055OpenLoadFailure: diagnostic-event=EventPowerPath055OpenLoadFailure, operation-cycle=DefaultOperationCycle  # Event_Oper_Cycle_Map_Power_Path_055_Open_Load_Failure
  diagnostic event to debounce algorithm mapping EventDebounceMapPowerPath055OpenLoadFailure: debounce-algorithm=time_based, diagnostic-event=EventPowerPath055OpenLoadFailure  # EventDebounceMap_Power_Path_055_Open_Load_Failure
package /ZeC/DTC/DTC/LIN_3_Slave_2_NoCommunication
  diagnostic trouble code uds LIN_3_Slave_2_NoCommunication: dtc-props=Dtc_Props_358996c7, uds-dtc-value=0x030310  # LIN 3 Slave 2_NoCommunication
  diagnostic event EventLIN3Slave2NoCommunication: aging-allowed=true, event-kind=SWC, prestorage-freeze-frame=false  # Event_LIN 3 Slave 2_NoCommunication
  diagnostic event to trouble code uds mapping EventDtcMapLIN3Slave2NoCommunication: diagnostic-event=EventLIN3Slave2NoCommunication, trouble-code-uds=LIN_3_Slave_2_NoCommunication  # Event_Dtc_Map_LIN 3 Slave 2_NoCommunication
  diagnostic event to operation cycle mapping EventOperCycleMapLIN3Slave2NoCommunication: diagnostic-event=EventLIN3Slave2NoCommunication, operation-cycle=DefaultOperationCycle  # Event_Oper_Cycle_Map_LIN 3 Slave 2_NoCommunication
  diagnostic event to debounce algorithm mapping EventDebounceMapLIN3Slave2NoCommunication: debounce-algorithm=counter_based, diagnostic-event=EventLIN3Slave2NoCommunication  # EventDebounceMap_LIN 3 Slave 2_NoCommunication
package /ZeC/DTC/DTC/Power_Path_059_Open_Load_Failure
  diagnostic trouble code uds Power_Path_059_Open_Load_Failure: dtc-props=Dtc_Props_18c7d6e, uds-dtc-value=0x00533b
  diagnostic event EventPowerPath059OpenLoadFailure: aging-allowed=true, event-kind=SWC, prestorage-freeze-frame=false  # Event_Power_Path_059_Open_Load_Failure
  diagnostic event to trouble code uds mapping EventDtcMapPowerPath059OpenLoadFailure: diagnostic-event=EventPowerPath059OpenLoadFailure, trouble-code-uds=Power_Path_059_Open_Load_Failure  # Event_Dtc_Map_Power_Path_059_Open_Load_Failure
  diagnostic event to operation cycle mapping EventOperCycleMapPowerPath059OpenLoadFailure: diagnostic-event=EventPowerPath059OpenLoadFailure, operation-cycle=DefaultOperationCycle  # Event_Oper_Cycle_Map_Power_Path_059_Open_Load_Failure
  diagnostic event to debounce algorithm mapping EventDebounceMapPowerPath059OpenLoadFailure: debounce-algorithm=time_based, diagnostic-event=EventPowerPath059OpenLoadFailure  # EventDebounceMap_Power_Path_059_Open_Load_Failure
package /ZeC/DTC/DTC/Power_Path_058_Open_Load_Failure
  diagnostic trouble code uds Power_Path_058_Open_Load_Failure: dtc-props=Dtc_Props_cba76320, uds-dtc-value=0x00533a
  diagnostic event EventPowerPath058OpenLoadFailure: aging-allowed=true, event-kind=SWC, prestorage-freeze-frame=false  # Event_Power_Path_058_Open_Load_Failure
  diagnostic event to trouble code uds mapping EventDtcMapPowerPath058OpenLoadFailure: diagnostic-event=EventPowerPath058OpenLoadFailure, trouble-code-uds=Power_Path_058_Open_Load_Failure  # Event_Dtc_Map_Power_Path_058_Open_Load_Failure
  diagnostic event to operation cycle mapping EventOperCycleMapPowerPath058OpenLoadFailure: diagnostic-event=EventPowerPath058OpenLoadFailure, operation-cycle=DefaultOperationCycle  # Event_Oper_Cycle_Map_Power_Path_058_Open_Load_Failure
  diagnostic event to debounce algorithm mapping EventDebounceMapPowerPath058OpenLoadFailure: debounce-algorithm=time_based, diagnostic-event=EventPowerPath058OpenLoadFailure  # EventDebounceMap_Power_Path_058_Open_Load_Failure
package /ZeC/DTC/DTC/LIN_3_Slave_3_NoCommunication
  diagnostic trouble code uds LIN_3_Slave_3_NoCommunication: dtc-props=Dtc_Props_358996c7, uds-dtc-value=0x030312  # LIN 3 Slave 3_NoCommunication
  diagnostic event EventLIN3Slave3NoCommunication: aging-allowed=true, event-kind=SWC, prestorage-freeze-frame=false  # Event_LIN 3 Slave 3_NoCommunication
  diagnostic event to trouble code uds mapping EventDtcMapLIN3Slave3NoCommunication: diagnostic-event=EventLIN3Slave3NoCommunication, trouble-code-uds=LIN_3_Slave_3_NoCommunication  # Event_Dtc_Map_LIN 3 Slave 3_NoCommunication
  diagnostic event to operation cycle mapping EventOperCycleMapLIN3Slave3NoCommunication: diagnostic-event=EventLIN3Slave3NoCommunication, operation-cycle=DefaultOperationCycle  # Event_Oper_Cycle_Map_LIN 3 Slave 3_NoCommunication
  diagnostic event to debounce algorithm mapping EventDebounceMapLIN3Slave3NoCommunication: debounce-algorithm=counter_based, diagnostic-event=EventLIN3Slave3NoCommunication  # EventDebounceMap_LIN 3 Slave 3_NoCommunication
package /ZeC/DTC/DTC/Power_Path_061_Open_Load_Failure
  diagnostic trouble code uds Power_Path_061_Open_Load_Failure: dtc-props=Dtc_Props_4eab47b3, uds-dtc-value=0x00533d
  diagnostic event EventPowerPath061OpenLoadFailure: aging-allowed=true, event-kind=SWC, prestorage-freeze-frame=false  # Event_Power_Path_061_Open_Load_Failure
  diagnostic event to trouble code uds mapping EventDtcMapPowerPath061OpenLoadFailure: diagnostic-event=EventPowerPath061OpenLoadFailure, trouble-code-uds=Power_Path_061_Open_Load_Failure  # Event_Dtc_Map_Power_Path_061_Open_Load_Failure
  diagnostic event to operation cycle mapping EventOperCycleMapPowerPath061OpenLoadFailure: diagnostic-event=EventPowerPath061OpenLoadFailure, operation-cycle=DefaultOperationCycle  # Event_Oper_Cycle_Map_Power_Path_061_Open_Load_Failure
  diagnostic event to debounce algorithm mapping EventDebounceMapPowerPath061OpenLoadFailure: debounce-algorithm=time_based, diagnostic-event=EventPowerPath061OpenLoadFailure  # EventDebounceMap_Power_Path_061_Open_Load_Failure
package /ZeC/DTC/DTC/LIN_3_Slave_3_Defect
  diagnostic trouble code uds LIN_3_Slave_3_Defect: dtc-props=Dtc_Props_358996c7, uds-dtc-value=0x030311  # LIN 3 Slave 3_Defect
  diagnostic event EventLIN3Slave3Defect: aging-allowed=true, event-kind=SWC, prestorage-freeze-frame=false  # Event_LIN 3 Slave 3_Defect
  diagnostic event to trouble code uds mapping EventDtcMapLIN3Slave3Defect: diagnostic-event=EventLIN3Slave3Defect, trouble-code-uds=LIN_3_Slave_3_Defect  # Event_Dtc_Map_LIN 3 Slave 3_Defect
  diagnostic event to operation cycle mapping EventOperCycleMapLIN3Slave3Defect: diagnostic-event=EventLIN3Slave3Defect, operation-cycle=DefaultOperationCycle  # Event_Oper_Cycle_Map_LIN 3 Slave 3_Defect
  diagnostic event to debounce algorithm mapping EventDebounceMapLIN3Slave3Defect: debounce-algorithm=counter_based, diagnostic-event=EventLIN3Slave3Defect  # EventDebounceMap_LIN 3 Slave 3_Defect
package /ZeC/DTC/DTC/Power_Path_060_Open_Load_Failure
  diagnostic trouble code uds Power_Path_060_Open_Load_Failure: dtc-props=Dtc_Props_47957754, uds-dtc-value=0x00533c
  diagnostic event EventPowerPath060OpenLoadFailure: aging-allowed=true, event-kind=SWC, prestorage-freeze-frame=false  # Event_Power_Path_060_Open_Load_Failure
  diagnostic event to trouble code uds mapping EventDtcMapPowerPath060OpenLoadFailure: diagnostic-event=EventPowerPath060OpenLoadFailure, trouble-code-uds=Power_Path_060_Open_Load_Failure  # Event_Dtc_Map_Power_Path_060_Open_Load_Failure
  diagnostic event to operation cycle mapping EventOperCycleMapPowerPath060OpenLoadFailure: diagnostic-event=EventPowerPath060OpenLoadFailure, operation-cycle=DefaultOperationCycle  # Event_Oper_Cycle_Map_Power_Path_060_Open_Load_Failure
  diagnostic event to debounce algorithm mapping EventDebounceMapPowerPath060OpenLoadFailure: debounce-algorithm=time_based, diagnostic-event=EventPowerPath060OpenLoadFailure  # EventDebounceMap_Power_Path_060_Open_Load_Failure
package /ZeC/DTC/DTC/LIN_3_Slave_9_Defect
  diagnostic trouble code uds LIN_3_Slave_9_Defect: dtc-props=Dtc_Props_358996c7, uds-dtc-value=0x03031d  # LIN 3 Slave 9_Defect
  diagnostic event EventLIN3Slave9Defect: aging-allowed=true, event-kind=SWC, prestorage-freeze-frame=false  # Event_LIN 3 Slave 9_Defect
  diagnostic event to trouble code uds mapping EventDtcMapLIN3Slave9Defect: diagnostic-event=EventLIN3Slave9Defect, trouble-code-uds=LIN_3_Slave_9_Defect  # Event_Dtc_Map_LIN 3 Slave 9_Defect
  diagnostic event to operation cycle mapping EventOperCycleMapLIN3Slave9Defect: diagnostic-event=EventLIN3Slave9Defect, operation-cycle=DefaultOperationCycle  # Event_Oper_Cycle_Map_LIN 3 Slave 9_Defect
  diagnostic event to debounce algorithm mapping EventDebounceMapLIN3Slave9Defect: debounce-algorithm=counter_based, diagnostic-event=EventLIN3Slave9Defect  # EventDebounceMap_LIN 3 Slave 9_Defect
package /ZeC/DTC/DTC/Power_Path_063_Open_Load_Failure
  diagnostic trouble code uds Power_Path_063_Open_Load_Failure: dtc-props=Dtc_Props_c29953c7, uds-dtc-value=0x00533f
  diagnostic event EventPowerPath063OpenLoadFailure: aging-allowed=true, event-kind=SWC, prestorage-freeze-frame=false  # Event_Power_Path_063_Open_Load_Failure
  diagnostic event to trouble code uds mapping EventDtcMapPowerPath063OpenLoadFailure: diagnostic-event=EventPowerPath063OpenLoadFailure, trouble-code-uds=Power_Path_063_Open_Load_Failure  # Event_Dtc_Map_Power_Path_063_Open_Load_Failure
  diagnostic event to operation cycle mapping EventOperCycleMapPowerPath063OpenLoadFailure: diagnostic-event=EventPowerPath063OpenLoadFailure, operation-cycle=DefaultOperationCycle  # Event_Oper_Cycle_Map_Power_Path_063_Open_Load_Failure
  diagnostic event to debounce algorithm mapping EventDebounceMapPowerPath063OpenLoadFailure: debounce-algorithm=time_based, diagnostic-event=EventPowerPath063OpenLoadFailure  # EventDebounceMap_Power_Path_063_Open_Load_Failure
package /ZeC/DTC/DTC/LIN_3_Slave_8_NoCommunication
  diagnostic trouble code uds LIN_3_Slave_8_NoCommunication: dtc-props=Dtc_Props_358996c7, uds-dtc-value=0x03031c  # LIN 3 Slave 8_NoCommunication
  diagnostic event EventLIN3Slave8NoCommunication: aging-allowed=true, event-kind=SWC, prestorage-freeze-frame=false  # Event_LIN 3 Slave 8_NoCommunication
  diagnostic event to trouble code uds mapping EventDtcMapLIN3Slave8NoCommunication: diagnostic-event=EventLIN3Slave8NoCommunication, trouble-code-uds=LIN_3_Slave_8_NoCommunication  # Event_Dtc_Map_LIN 3 Slave 8_NoCommunication
  diagnostic event to operation cycle mapping EventOperCycleMapLIN3Slave8NoCommunication: diagnostic-event=EventLIN3Slave8NoCommunication, operation-cycle=DefaultOperationCycle  # Event_Oper_Cycle_Map_LIN 3 Slave 8_NoCommunication
  diagnostic event to debounce algorithm mapping EventDebounceMapLIN3Slave8NoCommunication: debounce-algorithm=counter_based, diagnostic-event=EventLIN3Slave8NoCommunication  # EventDebounceMap_LIN 3 Slave 8_NoCommunication
package /ZeC/DTC/DTC/Power_Path_062_Open_Load_Failure
  diagnostic trouble code uds Power_Path_062_Open_Load_Failure: dtc-props=Dtc_Props_8b24d89, uds-dtc-value=0x00533e
  diagnostic event EventPowerPath062OpenLoadFailure: aging-allowed=true, event-kind=SWC, prestorage-freeze-frame=false  # Event_Power_Path_062_Open_Load_Failure
  diagnostic event to trouble code uds mapping EventDtcMapPowerPath062OpenLoadFailure: diagnostic-event=EventPowerPath062OpenLoadFailure, trouble-code-uds=Power_Path_062_Open_Load_Failure  # Event_Dtc_Map_Power_Path_062_Open_Load_Failure
  diagnostic event to operation cycle mapping EventOperCycleMapPowerPath062OpenLoadFailure: diagnostic-event=EventPowerPath062OpenLoadFailure, operation-cycle=DefaultOperationCycle  # Event_Oper_Cycle_Map_Power_Path_062_Open_Load_Failure
  diagnostic event to debounce algorithm mapping EventDebounceMapPowerPath062OpenLoadFailure: debounce-algorithm=time_based, diagnostic-event=EventPowerPath062OpenLoadFailure  # EventDebounceMap_Power_Path_062_Open_Load_Failure
package /ZeC/DTC/DTC/LIN_3_Slave_9_NoCommunication
  diagnostic trouble code uds LIN_3_Slave_9_NoCommunication: dtc-props=Dtc_Props_358996c7, uds-dtc-value=0x03031e  # LIN 3 Slave 9_NoCommunication
  diagnostic event EventLIN3Slave9NoCommunication: aging-allowed=true, event-kind=SWC, prestorage-freeze-frame=false  # Event_LIN 3 Slave 9_NoCommunication
  diagnostic event to trouble code uds mapping EventDtcMapLIN3Slave9NoCommunication: diagnostic-event=EventLIN3Slave9NoCommunication, trouble-code-uds=LIN_3_Slave_9_NoCommunication  # Event_Dtc_Map_LIN 3 Slave 9_NoCommunication
  diagnostic event to operation cycle mapping EventOperCycleMapLIN3Slave9NoCommunication: diagnostic-event=EventLIN3Slave9NoCommunication, operation-cycle=DefaultOperationCycle  # Event_Oper_Cycle_Map_LIN 3 Slave 9_NoCommunication
  diagnostic event to debounce algorithm mapping EventDebounceMapLIN3Slave9NoCommunication: debounce-algorithm=counter_based, diagnostic-event=EventLIN3Slave9NoCommunication  # EventDebounceMap_LIN 3 Slave 9_NoCommunication
package /ZeC/DTC/DTC/Power_Path_067_Open_Load_Failure
  diagnostic trouble code uds Power_Path_067_Open_Load_Failure: dtc-props=Dtc_Props_440d5ac2, uds-dtc-value=0x005343
  diagnostic event EventPowerPath067OpenLoadFailure: aging-allowed=true, event-kind=SWC, prestorage-freeze-frame=false  # Event_Power_Path_067_Open_Load_Failure
  diagnostic event to trouble code uds mapping EventDtcMapPowerPath067OpenLoadFailure: diagnostic-event=EventPowerPath067OpenLoadFailure, trouble-code-uds=Power_Path_067_Open_Load_Failure  # Event_Dtc_Map_Power_Path_067_Open_Load_Failure
  diagnostic event to operation cycle mapping EventOperCycleMapPowerPath067OpenLoadFailure: diagnostic-event=EventPowerPath067OpenLoadFailure, operation-cycle=DefaultOperationCycle  # Event_Oper_Cycle_Map_Power_Path_067_Open_Load_Failure
  diagnostic event to debounce algorithm mapping EventDebounceMapPowerPath067OpenLoadFailure: debounce-algorithm=time_based, diagnostic-event=EventPowerPath067OpenLoadFailure  # EventDebounceMap_Power_Path_067_Open_Load_Failure
package /ZeC/DTC/DTC/Power_Path_066_Open_Load_Failure
  diagnostic trouble code uds Power_Path_066_Open_Load_Failure: dtc-props=Dtc_Props_21450f8, uds-dtc-value=0x005342
  diagnostic event EventPowerPath066OpenLoadFailure: aging-allowed=true, event-kind=SWC, prestorage-freeze-frame=false  # Event_Power_Path_066_Open_Load_Failure
  diagnostic event to trouble code uds mapping EventDtcMapPowerPath066OpenLoadFailure: diagnostic-event=EventPowerPath066OpenLoadFailure, trouble-code-uds=Power_Path_066_Open_Load_Failure  # Event_Dtc_Map_Power_Path_066_Open_Load_Failure
  diagnostic event to operation cycle mapping EventOperCycleMapPowerPath066OpenLoadFailure: diagnostic-event=EventPowerPath066OpenLoadFailure, operation-cycle=DefaultOperationCycle  # Event_Oper_Cycle_Map_Power_Path_066_Open_Load_Failure
  diagnostic event to debounce algorithm mapping EventDebounceMapPowerPath066OpenLoadFailure: debounce-algorithm=time_based, diagnostic-event=EventPowerPath066OpenLoadFailure  # EventDebounceMap_Power_Path_066_Open_Load_Failure
package /ZeC/DTC/DTC/LIN_3_Slave_8_Defect
  diagnostic trouble code uds LIN_3_Slave_8_Defect: dtc-props=Dtc_Props_358996c7, uds-dtc-value=0x03031b  # LIN 3 Slave 8_Defect
  diagnostic event EventLIN3Slave8Defect: aging-allowed=true, event-kind=SWC, prestorage-freeze-frame=false  # Event_LIN 3 Slave 8_Defect
  diagnostic event to trouble code uds mapping EventDtcMapLIN3Slave8Defect: diagnostic-event=EventLIN3Slave8Defect, trouble-code-uds=LIN_3_Slave_8_Defect  # Event_Dtc_Map_LIN 3 Slave 8_Defect
  diagnostic event to operation cycle mapping EventOperCycleMapLIN3Slave8Defect: diagnostic-event=EventLIN3Slave8Defect, operation-cycle=DefaultOperationCycle  # Event_Oper_Cycle_Map_LIN 3 Slave 8_Defect
  diagnostic event to debounce algorithm mapping EventDebounceMapLIN3Slave8Defect: debounce-algorithm=counter_based, diagnostic-event=EventLIN3Slave8Defect  # EventDebounceMap_LIN 3 Slave 8_Defect
package /ZeC/DTC/DTC/Power_Path_069_Open_Load_Failure
  diagnostic trouble code uds Power_Path_069_Open_Load_Failure: dtc-props=Dtc_Props_b2a601f, uds-dtc-value=0x005345
  diagnostic event EventPowerPath069OpenLoadFailure: aging-allowed=true, event-kind=SWC, prestorage-freeze-frame=false  # Event_Power_Path_069_Open_Load_Failure
  diagnostic event to trouble code uds mapping EventDtcMapPowerPath069OpenLoadFailure: diagnostic-event=EventPowerPath069OpenLoadFailure, trouble-code-uds=Power_Path_069_Open_Load_Failure  # Event_Dtc_Map_Power_Path_069_Open_Load_Failure
  diagnostic event to operation cycle mapping EventOperCycleMapPowerPath069OpenLoadFailure: diagnostic-event=EventPowerPath069OpenLoadFailure, operation-cycle=DefaultOperationCycle  # Event_Oper_Cycle_Map_Power_Path_069_Open_Load_Failure
  diagnostic event to debounce algorithm mapping EventDebounceMapPowerPath069OpenLoadFailure: debounce-algorithm=time_based, diagnostic-event=EventPowerPath069OpenLoadFailure  # EventDebounceMap_Power_Path_069_Open_Load_Failure
package /ZeC/DTC/DTC/LIN_3_Slave_7_NoCommunication
  diagnostic trouble code uds LIN_3_Slave_7_NoCommunication: dtc-props=Dtc_Props_358996c7, uds-dtc-value=0x03031a  # LIN 3 Slave 7_NoCommunication
  diagnostic event EventLIN3Slave7NoCommunication: aging-allowed=true, event-kind=SWC, prestorage-freeze-frame=false  # Event_LIN 3 Slave 7_NoCommunication
  diagnostic event to trouble code uds mapping EventDtcMapLIN3Slave7NoCommunication: diagnostic-event=EventLIN3Slave7NoCommunication, trouble-code-uds=LIN_3_Slave_7_NoCommunication  # Event_Dtc_Map_LIN 3 Slave 7_NoCommunication
  diagnostic event to operation cycle mapping EventOperCycleMapLIN3Slave7NoCommunication: diagnostic-event=EventLIN3Slave7NoCommunication, operation-cycle=DefaultOperationCycle  # Event_Oper_Cycle_Map_LIN 3 Slave 7_NoCommunication
  diagnostic event to debounce algorithm mapping EventDebounceMapLIN3Slave7NoCommunication: debounce-algorithm=counter_based, diagnostic-event=EventLIN3Slave7NoCommunication  # EventDebounceMap_LIN 3 Slave 7_NoCommunication
package /ZeC/DTC/DTC/Power_Path_068_Open_Load_Failure
  diagnostic trouble code uds Power_Path_068_Open_Load_Failure: dtc-props=Dtc_Props_4d336a25, uds-dtc-value=0x005344
  diagnostic event EventPowerPath068OpenLoadFailure: aging-allowed=true, event-kind=SWC, prestorage-freeze-frame=false  # Event_Power_Path_068_Open_Load_Failure
  diagnostic event to trouble code uds mapping EventDtcMapPowerPath068OpenLoadFailure: diagnostic-event=EventPowerPath068OpenLoadFailure, trouble-code-uds=Power_Path_068_Open_Load_Failure  # Event_Dtc_Map_Power_Path_068_Open_Load_Failure
  diagnostic event to operation cycle mapping EventOperCycleMapPowerPath068OpenLoadFailure: diagnostic-event=EventPowerPath068OpenLoadFailure, operation-cycle=DefaultOperationCycle  # Event_Oper_Cycle_Map_Power_Path_068_Open_Load_Failure
  diagnostic event to debounce algorithm mapping EventDebounceMapPowerPath068OpenLoadFailure: debounce-algorithm=time_based, diagnostic-event=EventPowerPath068OpenLoadFailure  # EventDebounceMap_Power_Path_068_Open_Load_Failure
package /ZeC/DTC/DTC/Power_Path_065_Open_Load_Failure
  diagnostic trouble code uds Power_Path_065_Open_Load_Failure: dtc-props=Dtc_Props_c83f4eb6, uds-dtc-value=0x005341
  diagnostic event EventPowerPath065OpenLoadFailure: aging-allowed=true, event-kind=SWC, prestorage-freeze-frame=false  # Event_Power_Path_065_Open_Load_Failure
  diagnostic event to trouble code uds mapping EventDtcMapPowerPath065OpenLoadFailure: diagnostic-event=EventPowerPath065OpenLoadFailure, trouble-code-uds=Power_Path_065_Open_Load_Failure  # Event_Dtc_Map_Power_Path_065_Open_Load_Failure
  diagnostic event to operation cycle mapping EventOperCycleMapPowerPath065OpenLoadFailure: diagnostic-event=EventPowerPath065OpenLoadFailure, operation-cycle=DefaultOperationCycle  # Event_Oper_Cycle_Map_Power_Path_065_Open_Load_Failure
  diagnostic event to debounce algorithm mapping EventDebounceMapPowerPath065OpenLoadFailure: debounce-algorithm=time_based, diagnostic-event=EventPowerPath065OpenLoadFailure  # EventDebounceMap_Power_Path_065_Open_Load_Failure
package /ZeC/DTC/DTC/Power_Path_064_Open_Load_Failure
  diagnostic trouble code uds Power_Path_064_Open_Load_Failure: dtc-props=Dtc_Props_8e26448c, uds-dtc-value=0x005340
  diagnostic event EventPowerPath064OpenLoadFailure: aging-allowed=true, event-kind=SWC, prestorage-freeze-frame=false  # Event_Power_Path_064_Open_Load_Failure
  diagnostic event to trouble code uds mapping EventDtcMapPowerPath064OpenLoadFailure: diagnostic-event=EventPowerPath064OpenLoadFailure, trouble-code-uds=Power_Path_064_Open_Load_Failure  # Event_Dtc_Map_Power_Path_064_Open_Load_Failure
  diagnostic event to operation cycle mapping EventOperCycleMapPowerPath064OpenLoadFailure: diagnostic-event=EventPowerPath064OpenLoadFailure, operation-cycle=DefaultOperationCycle  # Event_Oper_Cycle_Map_Power_Path_064_Open_Load_Failure
  diagnostic event to debounce algorithm mapping EventDebounceMapPowerPath064OpenLoadFailure: debounce-algorithm=time_based, diagnostic-event=EventPowerPath064OpenLoadFailure  # EventDebounceMap_Power_Path_064_Open_Load_Failure
package /ZeC/DTC/DTC/LIN_21_Slave_9_Defect
  diagnostic trouble code uds LIN_21_Slave_9_Defect: dtc-props=Dtc_Props_358996c7, uds-dtc-value=0x031617  # LIN 21 Slave 9_Defect
  diagnostic event EventLIN21Slave9Defect: aging-allowed=true, event-kind=SWC, prestorage-freeze-frame=false  # Event_LIN 21 Slave 9_Defect
  diagnostic event to trouble code uds mapping EventDtcMapLIN21Slave9Defect: diagnostic-event=EventLIN21Slave9Defect, trouble-code-uds=LIN_21_Slave_9_Defect  # Event_Dtc_Map_LIN 21 Slave 9_Defect
  diagnostic event to operation cycle mapping EventOperCycleMapLIN21Slave9Defect: diagnostic-event=EventLIN21Slave9Defect, operation-cycle=DefaultOperationCycle  # Event_Oper_Cycle_Map_LIN 21 Slave 9_Defect
  diagnostic event to debounce algorithm mapping EventDebounceMapLIN21Slave9Defect: debounce-algorithm=counter_based, diagnostic-event=EventLIN21Slave9Defect  # EventDebounceMap_LIN 21 Slave 9_Defect
package /ZeC/DTC/DTC/LIN_21_Slave_9_NoCommunication
  diagnostic trouble code uds LIN_21_Slave_9_NoCommunication: dtc-props=Dtc_Props_358996c7, uds-dtc-value=0x031618  # LIN 21 Slave 9_NoCommunication
  diagnostic event EventLIN21Slave9NoCommunication: aging-allowed=true, event-kind=SWC, prestorage-freeze-frame=false  # Event_LIN 21 Slave 9_NoCommunication
  diagnostic event to trouble code uds mapping EventDtcMapLIN21Slave9NoCommunication: diagnostic-event=EventLIN21Slave9NoCommunication, trouble-code-uds=LIN_21_Slave_9_NoCommunication  # Event_Dtc_Map_LIN 21 Slave 9_NoCommunication
  diagnostic event to operation cycle mapping EventOperCycleMapLIN21Slave9NoCommunication: diagnostic-event=EventLIN21Slave9NoCommunication, operation-cycle=DefaultOperationCycle  # Event_Oper_Cycle_Map_LIN 21 Slave 9_NoCommunication
  diagnostic event to debounce algorithm mapping EventDebounceMapLIN21Slave9NoCommunication: debounce-algorithm=counter_based, diagnostic-event=EventLIN21Slave9NoCommunication  # EventDebounceMap_LIN 21 Slave 9_NoCommunication
package /ZeC/DTC/DTC/LIN_21_Slave_8_Defect
  diagnostic trouble code uds LIN_21_Slave_8_Defect: dtc-props=Dtc_Props_358996c7, uds-dtc-value=0x031615  # LIN 21 Slave 8_Defect
  diagnostic event EventLIN21Slave8Defect: aging-allowed=true, event-kind=SWC, prestorage-freeze-frame=false  # Event_LIN 21 Slave 8_Defect
  diagnostic event to trouble code uds mapping EventDtcMapLIN21Slave8Defect: diagnostic-event=EventLIN21Slave8Defect, trouble-code-uds=LIN_21_Slave_8_Defect  # Event_Dtc_Map_LIN 21 Slave 8_Defect
  diagnostic event to operation cycle mapping EventOperCycleMapLIN21Slave8Defect: diagnostic-event=EventLIN21Slave8Defect, operation-cycle=DefaultOperationCycle  # Event_Oper_Cycle_Map_LIN 21 Slave 8_Defect
  diagnostic event to debounce algorithm mapping EventDebounceMapLIN21Slave8Defect: debounce-algorithm=counter_based, diagnostic-event=EventLIN21Slave8Defect  # EventDebounceMap_LIN 21 Slave 8_Defect
package /ZeC/DTC/DTC/LIN_21_Slave_8_NoCommunication
  diagnostic trouble code uds LIN_21_Slave_8_NoCommunication: dtc-props=Dtc_Props_358996c7, uds-dtc-value=0x031616  # LIN 21 Slave 8_NoCommunication
  diagnostic event EventLIN21Slave8NoCommunication: aging-allowed=true, event-kind=SWC, prestorage-freeze-frame=false  # Event_LIN 21 Slave 8_NoCommunication
  diagnostic event to trouble code uds mapping EventDtcMapLIN21Slave8NoCommunication: diagnostic-event=EventLIN21Slave8NoCommunication, trouble-code-uds=LIN_21_Slave_8_NoCommunication  # Event_Dtc_Map_LIN 21 Slave 8_NoCommunication
  diagnostic event to operation cycle mapping EventOperCycleMapLIN21Slave8NoCommunication: diagnostic-event=EventLIN21Slave8NoCommunication, operation-cycle=DefaultOperationCycle  # Event_Oper_Cycle_Map_LIN 21 Slave 8_NoCommunication
  diagnostic event to debounce algorithm mapping EventDebounceMapLIN21Slave8NoCommunication: debounce-algorithm=counter_based, diagnostic-event=EventLIN21Slave8NoCommunication  # EventDebounceMap_LIN 21 Slave 8_NoCommunication
package /ZeC/DTC/DTC/LIN_21_Slave_7_Defect
  diagnostic trouble code uds LIN_21_Slave_7_Defect: dtc-props=Dtc_Props_358996c7, uds-dtc-value=0x031613  # LIN 21 Slave 7_Defect
  diagnostic event EventLIN21Slave7Defect: aging-allowed=true, event-kind=SWC, prestorage-freeze-frame=false  # Event_LIN 21 Slave 7_Defect
  diagnostic event to trouble code uds mapping EventDtcMapLIN21Slave7Defect: diagnostic-event=EventLIN21Slave7Defect, trouble-code-uds=LIN_21_Slave_7_Defect  # Event_Dtc_Map_LIN 21 Slave 7_Defect
  diagnostic event to operation cycle mapping EventOperCycleMapLIN21Slave7Defect: diagnostic-event=EventLIN21Slave7Defect, operation-cycle=DefaultOperationCycle  # Event_Oper_Cycle_Map_LIN 21 Slave 7_Defect
  diagnostic event to debounce algorithm mapping EventDebounceMapLIN21Slave7Defect: debounce-algorithm=counter_based, diagnostic-event=EventLIN21Slave7Defect  # EventDebounceMap_LIN 21 Slave 7_Defect
package /ZeC/DTC/DTC/Power_Path_105_Open_Load_Failure
  diagnostic trouble code uds Power_Path_105_Open_Load_Failure: dtc-props=Dtc_Props_c2809294, uds-dtc-value=0x005369
  diagnostic event EventPowerPath105OpenLoadFailure: aging-allowed=true, event-kind=SWC, prestorage-freeze-frame=false  # Event_Power_Path_105_Open_Load_Failure
  diagnostic event to trouble code uds mapping EventDtcMapPowerPath105OpenLoadFailure: diagnostic-event=EventPowerPath105OpenLoadFailure, trouble-code-uds=Power_Path_105_Open_Load_Failure  # Event_Dtc_Map_Power_Path_105_Open_Load_Failure
  diagnostic event to operation cycle mapping EventOperCycleMapPowerPath105OpenLoadFailure: diagnostic-event=EventPowerPath105OpenLoadFailure, operation-cycle=DefaultOperationCycle  # Event_Oper_Cycle_Map_Power_Path_105_Open_Load_Failure
  diagnostic event to debounce algorithm mapping EventDebounceMapPowerPath105OpenLoadFailure: debounce-algorithm=time_based, diagnostic-event=EventPowerPath105OpenLoadFailure  # EventDebounceMap_Power_Path_105_Open_Load_Failure
package /ZeC/DTC/DTC/LIN_21_Slave_7_NoCommunication
  diagnostic trouble code uds LIN_21_Slave_7_NoCommunication: dtc-props=Dtc_Props_358996c7, uds-dtc-value=0x031614  # LIN 21 Slave 7_NoCommunication
  diagnostic event EventLIN21Slave7NoCommunication: aging-allowed=true, event-kind=SWC, prestorage-freeze-frame=false  # Event_LIN 21 Slave 7_NoCommunication
  diagnostic event to trouble code uds mapping EventDtcMapLIN21Slave7NoCommunication: diagnostic-event=EventLIN21Slave7NoCommunication, trouble-code-uds=LIN_21_Slave_7_NoCommunication  # Event_Dtc_Map_LIN 21 Slave 7_NoCommunication
  diagnostic event to operation cycle mapping EventOperCycleMapLIN21Slave7NoCommunication: diagnostic-event=EventLIN21Slave7NoCommunication, operation-cycle=DefaultOperationCycle  # Event_Oper_Cycle_Map_LIN 21 Slave 7_NoCommunication
  diagnostic event to debounce algorithm mapping EventDebounceMapLIN21Slave7NoCommunication: debounce-algorithm=counter_based, diagnostic-event=EventLIN21Slave7NoCommunication  # EventDebounceMap_LIN 21 Slave 7_NoCommunication
package /ZeC/DTC/DTC/Power_Path_104_Open_Load_Failure
  diagnostic trouble code uds Power_Path_104_Open_Load_Failure: dtc-props=Dtc_Props_849998ae, uds-dtc-value=0x005368
  diagnostic event EventPowerPath104OpenLoadFailure: aging-allowed=true, event-kind=SWC, prestorage-freeze-frame=false  # Event_Power_Path_104_Open_Load_Failure
  diagnostic event to trouble code uds mapping EventDtcMapPowerPath104OpenLoadFailure: diagnostic-event=EventPowerPath104OpenLoadFailure, trouble-code-uds=Power_Path_104_Open_Load_Failure  # Event_Dtc_Map_Power_Path_104_Open_Load_Failure
  diagnostic event to operation cycle mapping EventOperCycleMapPowerPath104OpenLoadFailure: diagnostic-event=EventPowerPath104OpenLoadFailure, operation-cycle=DefaultOperationCycle  # Event_Oper_Cycle_Map_Power_Path_104_Open_Load_Failure
  diagnostic event to debounce algorithm mapping EventDebounceMapPowerPath104OpenLoadFailure: debounce-algorithm=time_based, diagnostic-event=EventPowerPath104OpenLoadFailure  # EventDebounceMap_Power_Path_104_Open_Load_Failure
package /ZeC/DTC/DTC/LIN_21_Slave_6_Defect
  diagnostic trouble code uds LIN_21_Slave_6_Defect: dtc-props=Dtc_Props_358996c7, uds-dtc-value=0x031611  # LIN 21 Slave 6_Defect
  diagnostic event EventLIN21Slave6Defect: aging-allowed=true, event-kind=SWC, prestorage-freeze-frame=false  # Event_LIN 21 Slave 6_Defect
  diagnostic event to trouble code uds mapping EventDtcMapLIN21Slave6Defect: diagnostic-event=EventLIN21Slave6Defect, trouble-code-uds=LIN_21_Slave_6_Defect  # Event_Dtc_Map_LIN 21 Slave 6_Defect
  diagnostic event to operation cycle mapping EventOperCycleMapLIN21Slave6Defect: diagnostic-event=EventLIN21Slave6Defect, operation-cycle=DefaultOperationCycle  # Event_Oper_Cycle_Map_LIN 21 Slave 6_Defect
  diagnostic event to debounce algorithm mapping EventDebounceMapLIN21Slave6Defect: debounce-algorithm=counter_based, diagnostic-event=EventLIN21Slave6Defect  # EventDebounceMap_LIN 21 Slave 6_Defect
package /ZeC/DTC/DTC/LIN_21_Slave_6_NoCommunication
  diagnostic trouble code uds LIN_21_Slave_6_NoCommunication: dtc-props=Dtc_Props_358996c7, uds-dtc-value=0x031612  # LIN 21 Slave 6_NoCommunication
  diagnostic event EventLIN21Slave6NoCommunication: aging-allowed=true, event-kind=SWC, prestorage-freeze-frame=false  # Event_LIN 21 Slave 6_NoCommunication
  diagnostic event to trouble code uds mapping EventDtcMapLIN21Slave6NoCommunication: diagnostic-event=EventLIN21Slave6NoCommunication, trouble-code-uds=LIN_21_Slave_6_NoCommunication  # Event_Dtc_Map_LIN 21 Slave 6_NoCommunication
  diagnostic event to operation cycle mapping EventOperCycleMapLIN21Slave6NoCommunication: diagnostic-event=EventLIN21Slave6NoCommunication, operation-cycle=DefaultOperationCycle  # Event_Oper_Cycle_Map_LIN 21 Slave 6_NoCommunication
  diagnostic event to debounce algorithm mapping EventDebounceMapLIN21Slave6NoCommunication: debounce-algorithm=counter_based, diagnostic-event=EventLIN21Slave6NoCommunication  # EventDebounceMap_LIN 21 Slave 6_NoCommunication
package /ZeC/DTC/DTC/Power_Path_110_Open_Load_Failure
  diagnostic trouble code uds Power_Path_110_Open_Load_Failure: dtc-props=Dtc_Props_61318353, uds-dtc-value=0x00536e
  diagnostic event EventPowerPath110OpenLoadFailure: aging-allowed=true, event-kind=SWC, prestorage-freeze-frame=false  # Event_Power_Path_110_Open_Load_Failure
  diagnostic event to trouble code uds mapping EventDtcMapPowerPath110OpenLoadFailure: diagnostic-event=EventPowerPath110OpenLoadFailure, trouble-code-uds=Power_Path_110_Open_Load_Failure  # Event_Dtc_Map_Power_Path_110_Open_Load_Failure
  diagnostic event to operation cycle mapping EventOperCycleMapPowerPath110OpenLoadFailure: diagnostic-event=EventPowerPath110OpenLoadFailure, operation-cycle=DefaultOperationCycle  # Event_Oper_Cycle_Map_Power_Path_110_Open_Load_Failure
  diagnostic event to debounce algorithm mapping EventDebounceMapPowerPath110OpenLoadFailure: debounce-algorithm=time_based, diagnostic-event=EventPowerPath110OpenLoadFailure  # EventDebounceMap_Power_Path_110_Open_Load_Failure
package /ZeC/DTC/DTC/LIN_21_Slave_5_NoCommunication
  diagnostic trouble code uds LIN_21_Slave_5_NoCommunication: dtc-props=Dtc_Props_358996c7, uds-dtc-value=0x031610  # LIN 21 Slave 5_NoCommunication
  diagnostic event EventLIN21Slave5NoCommunication: aging-allowed=true, event-kind=SWC, prestorage-freeze-frame=false  # Event_LIN 21 Slave 5_NoCommunication
  diagnostic event to trouble code uds mapping EventDtcMapLIN21Slave5NoCommunication: diagnostic-event=EventLIN21Slave5NoCommunication, trouble-code-uds=LIN_21_Slave_5_NoCommunication  # Event_Dtc_Map_LIN 21 Slave 5_NoCommunication
  diagnostic event to operation cycle mapping EventOperCycleMapLIN21Slave5NoCommunication: diagnostic-event=EventLIN21Slave5NoCommunication, operation-cycle=DefaultOperationCycle  # Event_Oper_Cycle_Map_LIN 21 Slave 5_NoCommunication
  diagnostic event to debounce algorithm mapping EventDebounceMapLIN21Slave5NoCommunication: debounce-algorithm=counter_based, diagnostic-event=EventLIN21Slave5NoCommunication  # EventDebounceMap_LIN 21 Slave 5_NoCommunication
package /ZeC/DTC/DTC/Power_Path_109_Open_Load_Failure
  diagnostic trouble code uds Power_Path_109_Open_Load_Failure: dtc-props=Dtc_Props_27288969, uds-dtc-value=0x00536d
  diagnostic event EventPowerPath109OpenLoadFailure: aging-allowed=true, event-kind=SWC, prestorage-freeze-frame=false  # Event_Power_Path_109_Open_Load_Failure
  diagnostic event to trouble code uds mapping EventDtcMapPowerPath109OpenLoadFailure: diagnostic-event=EventPowerPath109OpenLoadFailure, trouble-code-uds=Power_Path_109_Open_Load_Failure  # Event_Dtc_Map_Power_Path_109_Open_Load_Failure
  diagnostic event to operation cycle mapping EventOperCycleMapPowerPath109OpenLoadFailure: diagnostic-event=EventPowerPath109OpenLoadFailure, operation-cycle=DefaultOperationCycle  # Event_Oper_Cycle_Map_Power_Path_109_Open_Load_Failure
  diagnostic event to debounce algorithm mapping EventDebounceMapPowerPath109OpenLoadFailure: debounce-algorithm=time_based, diagnostic-event=EventPowerPath109OpenLoadFailure  # EventDebounceMap_Power_Path_109_Open_Load_Failure
package /ZeC/DTC/DTC/Power_Path_111_Open_Load_Failure
  diagnostic trouble code uds Power_Path_111_Open_Load_Failure: dtc-props=Dtc_Props_ab1a9d1d, uds-dtc-value=0x00536f
  diagnostic event EventPowerPath111OpenLoadFailure: aging-allowed=true, event-kind=SWC, prestorage-freeze-frame=false  # Event_Power_Path_111_Open_Load_Failure
  diagnostic event to trouble code uds mapping EventDtcMapPowerPath111OpenLoadFailure: diagnostic-event=EventPowerPath111OpenLoadFailure, trouble-code-uds=Power_Path_111_Open_Load_Failure  # Event_Dtc_Map_Power_Path_111_Open_Load_Failure
  diagnostic event to operation cycle mapping EventOperCycleMapPowerPath111OpenLoadFailure: diagnostic-event=EventPowerPath111OpenLoadFailure, operation-cycle=DefaultOperationCycle  # Event_Oper_Cycle_Map_Power_Path_111_Open_Load_Failure
  diagnostic event to debounce algorithm mapping EventDebounceMapPowerPath111OpenLoadFailure: debounce-algorithm=time_based, diagnostic-event=EventPowerPath111OpenLoadFailure  # EventDebounceMap_Power_Path_111_Open_Load_Failure
package /ZeC/DTC/DTC/Power_Path_106_Open_Load_Failure
  diagnostic trouble code uds Power_Path_106_Open_Load_Failure: dtc-props=Dtc_Props_a224adfa, uds-dtc-value=0x00536a
  diagnostic event EventPowerPath106OpenLoadFailure: aging-allowed=true, event-kind=SWC, prestorage-freeze-frame=false  # Event_Power_Path_106_Open_Load_Failure
  diagnostic event to trouble code uds mapping EventDtcMapPowerPath106OpenLoadFailure: diagnostic-event=EventPowerPath106OpenLoadFailure, trouble-code-uds=Power_Path_106_Open_Load_Failure  # Event_Dtc_Map_Power_Path_106_Open_Load_Failure
  diagnostic event to operation cycle mapping EventOperCycleMapPowerPath106OpenLoadFailure: diagnostic-event=EventPowerPath106OpenLoadFailure, operation-cycle=DefaultOperationCycle  # Event_Oper_Cycle_Map_Power_Path_106_Open_Load_Failure
  diagnostic event to debounce algorithm mapping EventDebounceMapPowerPath106OpenLoadFailure: debounce-algorithm=time_based, diagnostic-event=EventPowerPath106OpenLoadFailure  # EventDebounceMap_Power_Path_106_Open_Load_Failure
package /ZeC/DTC/DTC/Power_Path_108_Open_Load_Failure
  diagnostic trouble code uds Power_Path_108_Open_Load_Failure: dtc-props=Dtc_Props_2e16b98e, uds-dtc-value=0x00536c
  diagnostic event EventPowerPath108OpenLoadFailure: aging-allowed=true, event-kind=SWC, prestorage-freeze-frame=false  # Event_Power_Path_108_Open_Load_Failure
  diagnostic event to trouble code uds mapping EventDtcMapPowerPath108OpenLoadFailure: diagnostic-event=EventPowerPath108OpenLoadFailure, trouble-code-uds=Power_Path_108_Open_Load_Failure  # Event_Dtc_Map_Power_Path_108_Open_Load_Failure
  diagnostic event to operation cycle mapping EventOperCycleMapPowerPath108OpenLoadFailure: diagnostic-event=EventPowerPath108OpenLoadFailure, operation-cycle=DefaultOperationCycle  # Event_Oper_Cycle_Map_Power_Path_108_Open_Load_Failure
  diagnostic event to debounce algorithm mapping EventDebounceMapPowerPath108OpenLoadFailure: debounce-algorithm=time_based, diagnostic-event=EventPowerPath108OpenLoadFailure  # EventDebounceMap_Power_Path_108_Open_Load_Failure
package /ZeC/DTC/DTC/Power_Path_107_Open_Load_Failure
  diagnostic trouble code uds Power_Path_107_Open_Load_Failure: dtc-props=Dtc_Props_680fb3b4, uds-dtc-value=0x00536b
  diagnostic event EventPowerPath107OpenLoadFailure: aging-allowed=true, event-kind=SWC, prestorage-freeze-frame=false  # Event_Power_Path_107_Open_Load_Failure
  diagnostic event to trouble code uds mapping EventDtcMapPowerPath107OpenLoadFailure: diagnostic-event=EventPowerPath107OpenLoadFailure, trouble-code-uds=Power_Path_107_Open_Load_Failure  # Event_Dtc_Map_Power_Path_107_Open_Load_Failure
  diagnostic event to operation cycle mapping EventOperCycleMapPowerPath107OpenLoadFailure: diagnostic-event=EventPowerPath107OpenLoadFailure, operation-cycle=DefaultOperationCycle  # Event_Oper_Cycle_Map_Power_Path_107_Open_Load_Failure
  diagnostic event to debounce algorithm mapping EventDebounceMapPowerPath107OpenLoadFailure: debounce-algorithm=time_based, diagnostic-event=EventPowerPath107OpenLoadFailure  # EventDebounceMap_Power_Path_107_Open_Load_Failure
package /ZeC/DTC/DTC/LIN_13_Slave_9_Defect
  diagnostic trouble code uds LIN_13_Slave_9_Defect: dtc-props=Dtc_Props_358996c7, uds-dtc-value=0x030d07  # LIN 13 Slave 9_Defect
  diagnostic event EventLIN13Slave9Defect: aging-allowed=true, event-kind=SWC, prestorage-freeze-frame=false  # Event_LIN 13 Slave 9_Defect
  diagnostic event to trouble code uds mapping EventDtcMapLIN13Slave9Defect: diagnostic-event=EventLIN13Slave9Defect, trouble-code-uds=LIN_13_Slave_9_Defect  # Event_Dtc_Map_LIN 13 Slave 9_Defect
  diagnostic event to operation cycle mapping EventOperCycleMapLIN13Slave9Defect: diagnostic-event=EventLIN13Slave9Defect, operation-cycle=DefaultOperationCycle  # Event_Oper_Cycle_Map_LIN 13 Slave 9_Defect
  diagnostic event to debounce algorithm mapping EventDebounceMapLIN13Slave9Defect: debounce-algorithm=counter_based, diagnostic-event=EventLIN13Slave9Defect  # EventDebounceMap_LIN 13 Slave 9_Defect
package /ZeC/DTC/DTC/LIN_13_Slave_9_NoCommunication
  diagnostic trouble code uds LIN_13_Slave_9_NoCommunication: dtc-props=Dtc_Props_358996c7, uds-dtc-value=0x030d08  # LIN 13 Slave 9_NoCommunication
  diagnostic event EventLIN13Slave9NoCommunication: aging-allowed=true, event-kind=SWC, prestorage-freeze-frame=false  # Event_LIN 13 Slave 9_NoCommunication
  diagnostic event to trouble code uds mapping EventDtcMapLIN13Slave9NoCommunication: diagnostic-event=EventLIN13Slave9NoCommunication, trouble-code-uds=LIN_13_Slave_9_NoCommunication  # Event_Dtc_Map_LIN 13 Slave 9_NoCommunication
  diagnostic event to operation cycle mapping EventOperCycleMapLIN13Slave9NoCommunication: diagnostic-event=EventLIN13Slave9NoCommunication, operation-cycle=DefaultOperationCycle  # Event_Oper_Cycle_Map_LIN 13 Slave 9_NoCommunication
  diagnostic event to debounce algorithm mapping EventDebounceMapLIN13Slave9NoCommunication: debounce-algorithm=counter_based, diagnostic-event=EventLIN13Slave9NoCommunication  # EventDebounceMap_LIN 13 Slave 9_NoCommunication
package /ZeC/DTC/DTC/LIN_13_Slave_8_Defect
  diagnostic trouble code uds LIN_13_Slave_8_Defect: dtc-props=Dtc_Props_358996c7, uds-dtc-value=0x030d05  # LIN 13 Slave 8_Defect
  diagnostic event EventLIN13Slave8Defect: aging-allowed=true, event-kind=SWC, prestorage-freeze-frame=false  # Event_LIN 13 Slave 8_Defect
  diagnostic event to trouble code uds mapping EventDtcMapLIN13Slave8Defect: diagnostic-event=EventLIN13Slave8Defect, trouble-code-uds=LIN_13_Slave_8_Defect  # Event_Dtc_Map_LIN 13 Slave 8_Defect
  diagnostic event to operation cycle mapping EventOperCycleMapLIN13Slave8Defect: diagnostic-event=EventLIN13Slave8Defect, operation-cycle=DefaultOperationCycle  # Event_Oper_Cycle_Map_LIN 13 Slave 8_Defect
  diagnostic event to debounce algorithm mapping EventDebounceMapLIN13Slave8Defect: debounce-algorithm=counter_based, diagnostic-event=EventLIN13Slave8Defect  # EventDebounceMap_LIN 13 Slave 8_Defect
package /ZeC/DTC/DTC/LIN_21_Slave_11_NoCommunication
  diagnostic trouble code uds LIN_21_Slave_11_NoCommunication: dtc-props=Dtc_Props_358996c7, uds-dtc-value=0x03161e  # LIN 21 Slave 11_NoCommunication
  diagnostic event EventLIN21Slave11NoCommunication: aging-allowed=true, event-kind=SWC, prestorage-freeze-frame=false  # Event_LIN 21 Slave 11_NoCommunication
  diagnostic event to trouble code uds mapping EventDtcMapLIN21Slave11NoCommunication: diagnostic-event=EventLIN21Slave11NoCommunication, trouble-code-uds=LIN_21_Slave_11_NoCommunication  # Event_Dtc_Map_LIN 21 Slave 11_NoCommunication
  diagnostic event to operation cycle mapping EventOperCycleMapLIN21Slave11NoCommunication: diagnostic-event=EventLIN21Slave11NoCommunication, operation-cycle=DefaultOperationCycle  # Event_Oper_Cycle_Map_LIN 21 Slave 11_NoCommunication
  diagnostic event to debounce algorithm mapping EventDebounceMapLIN21Slave11NoCommunication: debounce-algorithm=counter_based, diagnostic-event=EventLIN21Slave11NoCommunication  # EventDebounceMap_LIN 21 Slave 11_NoCommunication
package /ZeC/DTC/DTC/Power_Path_112_Open_Load_Failure
  diagnostic trouble code uds Power_Path_112_Open_Load_Failure: dtc-props=Dtc_Props_1f880305, uds-dtc-value=0x005370
  diagnostic event EventPowerPath112OpenLoadFailure: aging-allowed=true, event-kind=SWC, prestorage-freeze-frame=false  # Event_Power_Path_112_Open_Load_Failure
  diagnostic event to trouble code uds mapping EventDtcMapPowerPath112OpenLoadFailure: diagnostic-event=EventPowerPath112OpenLoadFailure, trouble-code-uds=Power_Path_112_Open_Load_Failure  # Event_Dtc_Map_Power_Path_112_Open_Load_Failure
  diagnostic event to operation cycle mapping EventOperCycleMapPowerPath112OpenLoadFailure: diagnostic-event=EventPowerPath112OpenLoadFailure, operation-cycle=DefaultOperationCycle  # Event_Oper_Cycle_Map_Power_Path_112_Open_Load_Failure
  diagnostic event to debounce algorithm mapping EventDebounceMapPowerPath112OpenLoadFailure: debounce-algorithm=time_based, diagnostic-event=EventPowerPath112OpenLoadFailure  # EventDebounceMap_Power_Path_112_Open_Load_Failure
package /ZeC/DTC/DTC/LIN_13_Slave_8_NoCommunication
  diagnostic trouble code uds LIN_13_Slave_8_NoCommunication: dtc-props=Dtc_Props_358996c7, uds-dtc-value=0x030d06  # LIN 13 Slave 8_NoCommunication
  diagnostic event EventLIN13Slave8NoCommunication: aging-allowed=true, event-kind=SWC, prestorage-freeze-frame=false  # Event_LIN 13 Slave 8_NoCommunication
  diagnostic event to trouble code uds mapping EventDtcMapLIN13Slave8NoCommunication: diagnostic-event=EventLIN13Slave8NoCommunication, trouble-code-uds=LIN_13_Slave_8_NoCommunication  # Event_Dtc_Map_LIN 13 Slave 8_NoCommunication
  diagnostic event to operation cycle mapping EventOperCycleMapLIN13Slave8NoCommunication: diagnostic-event=EventLIN13Slave8NoCommunication, operation-cycle=DefaultOperationCycle  # Event_Oper_Cycle_Map_LIN 13 Slave 8_NoCommunication
  diagnostic event to debounce algorithm mapping EventDebounceMapLIN13Slave8NoCommunication: debounce-algorithm=counter_based, diagnostic-event=EventLIN13Slave8NoCommunication  # EventDebounceMap_LIN 13 Slave 8_NoCommunication
package /ZeC/DTC/DTC/LIN_13_Slave_7_Defect
  diagnostic trouble code uds LIN_13_Slave_7_Defect: dtc-props=Dtc_Props_358996c7, uds-dtc-value=0x030d03  # LIN 13 Slave 7_Defect
  diagnostic event EventLIN13Slave7Defect: aging-allowed=true, event-kind=SWC, prestorage-freeze-frame=false  # Event_LIN 13 Slave 7_Defect
  diagnostic event to trouble code uds mapping EventDtcMapLIN13Slave7Defect: diagnostic-event=EventLIN13Slave7Defect, trouble-code-uds=LIN_13_Slave_7_Defect  # Event_Dtc_Map_LIN 13 Slave 7_Defect
  diagnostic event to operation cycle mapping EventOperCycleMapLIN13Slave7Defect: diagnostic-event=EventLIN13Slave7Defect, operation-cycle=DefaultOperationCycle  # Event_Oper_Cycle_Map_LIN 13 Slave 7_Defect
  diagnostic event to debounce algorithm mapping EventDebounceMapLIN13Slave7Defect: debounce-algorithm=counter_based, diagnostic-event=EventLIN13Slave7Defect  # EventDebounceMap_LIN 13 Slave 7_Defect
package /ZeC/DTC/DTC/LIN_21_Slave_10_NoCommunication
  diagnostic trouble code uds LIN_21_Slave_10_NoCommunication: dtc-props=Dtc_Props_358996c7, uds-dtc-value=0x03161c  # LIN 21 Slave 10_NoCommunication
  diagnostic event EventLIN21Slave10NoCommunication: aging-allowed=true, event-kind=SWC, prestorage-freeze-frame=false  # Event_LIN 21 Slave 10_NoCommunication
  diagnostic event to trouble code uds mapping EventDtcMapLIN21Slave10NoCommunication: diagnostic-event=EventLIN21Slave10NoCommunication, trouble-code-uds=LIN_21_Slave_10_NoCommunication  # Event_Dtc_Map_LIN 21 Slave 10_NoCommunication
  diagnostic event to operation cycle mapping EventOperCycleMapLIN21Slave10NoCommunication: diagnostic-event=EventLIN21Slave10NoCommunication, operation-cycle=DefaultOperationCycle  # Event_Oper_Cycle_Map_LIN 21 Slave 10_NoCommunication
  diagnostic event to debounce algorithm mapping EventDebounceMapLIN21Slave10NoCommunication: debounce-algorithm=counter_based, diagnostic-event=EventLIN21Slave10NoCommunication  # EventDebounceMap_LIN 21 Slave 10_NoCommunication
package /ZeC/DTC/DTC/LIN_13_Slave_7_NoCommunication
  diagnostic trouble code uds LIN_13_Slave_7_NoCommunication: dtc-props=Dtc_Props_358996c7, uds-dtc-value=0x030d04  # LIN 13 Slave 7_NoCommunication
  diagnostic event EventLIN13Slave7NoCommunication: aging-allowed=true, event-kind=SWC, prestorage-freeze-frame=false  # Event_LIN 13 Slave 7_NoCommunication
  diagnostic event to trouble code uds mapping EventDtcMapLIN13Slave7NoCommunication: diagnostic-event=EventLIN13Slave7NoCommunication, trouble-code-uds=LIN_13_Slave_7_NoCommunication  # Event_Dtc_Map_LIN 13 Slave 7_NoCommunication
  diagnostic event to operation cycle mapping EventOperCycleMapLIN13Slave7NoCommunication: diagnostic-event=EventLIN13Slave7NoCommunication, operation-cycle=DefaultOperationCycle  # Event_Oper_Cycle_Map_LIN 13 Slave 7_NoCommunication
  diagnostic event to debounce algorithm mapping EventDebounceMapLIN13Slave7NoCommunication: debounce-algorithm=counter_based, diagnostic-event=EventLIN13Slave7NoCommunication  # EventDebounceMap_LIN 13 Slave 7_NoCommunication
package /ZeC/DTC/DTC/LIN_21_Slave_11_Defect
  diagnostic trouble code uds LIN_21_Slave_11_Defect: dtc-props=Dtc_Props_358996c7, uds-dtc-value=0x03161d  # LIN 21 Slave 11_Defect
  diagnostic event EventLIN21Slave11Defect: aging-allowed=true, event-kind=SWC, prestorage-freeze-frame=false  # Event_LIN 21 Slave 11_Defect
  diagnostic event to trouble code uds mapping EventDtcMapLIN21Slave11Defect: diagnostic-event=EventLIN21Slave11Defect, trouble-code-uds=LIN_21_Slave_11_Defect  # Event_Dtc_Map_LIN 21 Slave 11_Defect
  diagnostic event to operation cycle mapping EventOperCycleMapLIN21Slave11Defect: diagnostic-event=EventLIN21Slave11Defect, operation-cycle=DefaultOperationCycle  # Event_Oper_Cycle_Map_LIN 21 Slave 11_Defect
  diagnostic event to debounce algorithm mapping EventDebounceMapLIN21Slave11Defect: debounce-algorithm=counter_based, diagnostic-event=EventLIN21Slave11Defect  # EventDebounceMap_LIN 21 Slave 11_Defect
package /ZeC/DTC/DTC/LIN_13_Slave_6_Defect
  diagnostic trouble code uds LIN_13_Slave_6_Defect: dtc-props=Dtc_Props_358996c7, uds-dtc-value=0x030d01  # LIN 13 Slave 6_Defect
  diagnostic event EventLIN13Slave6Defect: aging-allowed=true, event-kind=SWC, prestorage-freeze-frame=false  # Event_LIN 13 Slave 6_Defect
  diagnostic event to trouble code uds mapping EventDtcMapLIN13Slave6Defect: diagnostic-event=EventLIN13Slave6Defect, trouble-code-uds=LIN_13_Slave_6_Defect  # Event_Dtc_Map_LIN 13 Slave 6_Defect
  diagnostic event to operation cycle mapping EventOperCycleMapLIN13Slave6Defect: diagnostic-event=EventLIN13Slave6Defect, operation-cycle=DefaultOperationCycle  # Event_Oper_Cycle_Map_LIN 13 Slave 6_Defect
  diagnostic event to debounce algorithm mapping EventDebounceMapLIN13Slave6Defect: debounce-algorithm=counter_based, diagnostic-event=EventLIN13Slave6Defect  # EventDebounceMap_LIN 13 Slave 6_Defect
package /ZeC/DTC/DTC/LIN_21_Slave_1_NoCommunication
  diagnostic trouble code uds LIN_21_Slave_1_NoCommunication: dtc-props=Dtc_Props_358996c7, uds-dtc-value=0x03161a  # LIN 21 Slave 1_NoCommunication
  diagnostic event EventLIN21Slave1NoCommunication: aging-allowed=true, event-kind=SWC, prestorage-freeze-frame=false  # Event_LIN 21 Slave 1_NoCommunication
  diagnostic event to trouble code uds mapping EventDtcMapLIN21Slave1NoCommunication: diagnostic-event=EventLIN21Slave1NoCommunication, trouble-code-uds=LIN_21_Slave_1_NoCommunication  # Event_Dtc_Map_LIN 21 Slave 1_NoCommunication
  diagnostic event to operation cycle mapping EventOperCycleMapLIN21Slave1NoCommunication: diagnostic-event=EventLIN21Slave1NoCommunication, operation-cycle=DefaultOperationCycle  # Event_Oper_Cycle_Map_LIN 21 Slave 1_NoCommunication
  diagnostic event to debounce algorithm mapping EventDebounceMapLIN21Slave1NoCommunication: debounce-algorithm=counter_based, diagnostic-event=EventLIN21Slave1NoCommunication  # EventDebounceMap_LIN 21 Slave 1_NoCommunication
package /ZeC/DTC/DTC/LIN_13_Slave_6_NoCommunication
  diagnostic trouble code uds LIN_13_Slave_6_NoCommunication: dtc-props=Dtc_Props_358996c7, uds-dtc-value=0x030d02  # LIN 13 Slave 6_NoCommunication
  diagnostic event EventLIN13Slave6NoCommunication: aging-allowed=true, event-kind=SWC, prestorage-freeze-frame=false  # Event_LIN 13 Slave 6_NoCommunication
  diagnostic event to trouble code uds mapping EventDtcMapLIN13Slave6NoCommunication: diagnostic-event=EventLIN13Slave6NoCommunication, trouble-code-uds=LIN_13_Slave_6_NoCommunication  # Event_Dtc_Map_LIN 13 Slave 6_NoCommunication
  diagnostic event to operation cycle mapping EventOperCycleMapLIN13Slave6NoCommunication: diagnostic-event=EventLIN13Slave6NoCommunication, operation-cycle=DefaultOperationCycle  # Event_Oper_Cycle_Map_LIN 13 Slave 6_NoCommunication
  diagnostic event to debounce algorithm mapping EventDebounceMapLIN13Slave6NoCommunication: debounce-algorithm=counter_based, diagnostic-event=EventLIN13Slave6NoCommunication  # EventDebounceMap_LIN 13 Slave 6_NoCommunication
package /ZeC/DTC/DTC/LIN_21_Slave_10_Defect
  diagnostic trouble code uds LIN_21_Slave_10_Defect: dtc-props=Dtc_Props_358996c7, uds-dtc-value=0x03161b  # LIN 21 Slave 10_Defect
  diagnostic event EventLIN21Slave10Defect: aging-allowed=true, event-kind=SWC, prestorage-freeze-frame=false  # Event_LIN 21 Slave 10_Defect
  diagnostic event to trouble code uds mapping EventDtcMapLIN21Slave10Defect: diagnostic-event=EventLIN21Slave10Defect, trouble-code-uds=LIN_21_Slave_10_Defect  # Event_Dtc_Map_LIN 21 Slave 10_Defect
  diagnostic event to operation cycle mapping EventOperCycleMapLIN21Slave10Defect: diagnostic-event=EventLIN21Slave10Defect, operation-cycle=DefaultOperationCycle  # Event_Oper_Cycle_Map_LIN 21 Slave 10_Defect
  diagnostic event to debounce algorithm mapping EventDebounceMapLIN21Slave10Defect: debounce-algorithm=counter_based, diagnostic-event=EventLIN21Slave10Defect  # EventDebounceMap_LIN 21 Slave 10_Defect
package /ZeC/DTC/DTC/Power_Path_118_Open_Load_Failure
  diagnostic trouble code uds Power_Path_118_Open_Load_Failure: dtc-props=Dtc_Props_50af39d8, uds-dtc-value=0x005376
  diagnostic event EventPowerPath118OpenLoadFailure: aging-allowed=true, event-kind=SWC, prestorage-freeze-frame=false  # Event_Power_Path_118_Open_Load_Failure
  diagnostic event to trouble code uds mapping EventDtcMapPowerPath118OpenLoadFailure: diagnostic-event=EventPowerPath118OpenLoadFailure, trouble-code-uds=Power_Path_118_Open_Load_Failure  # Event_Dtc_Map_Power_Path_118_Open_Load_Failure
  diagnostic event to operation cycle mapping EventOperCycleMapPowerPath118OpenLoadFailure: diagnostic-event=EventPowerPath118OpenLoadFailure, operation-cycle=DefaultOperationCycle  # Event_Oper_Cycle_Map_Power_Path_118_Open_Load_Failure
  diagnostic event to debounce algorithm mapping EventDebounceMapPowerPath118OpenLoadFailure: debounce-algorithm=time_based, diagnostic-event=EventPowerPath118OpenLoadFailure  # EventDebounceMap_Power_Path_118_Open_Load_Failure
package /ZeC/DTC/DTC/Power_Path_117_Open_Load_Failure
  diagnostic trouble code uds Power_Path_117_Open_Load_Failure: dtc-props=Dtc_Props_9a842796, uds-dtc-value=0x005375
  diagnostic event EventPowerPath117OpenLoadFailure: aging-allowed=true, event-kind=SWC, prestorage-freeze-frame=false  # Event_Power_Path_117_Open_Load_Failure
  diagnostic event to trouble code uds mapping EventDtcMapPowerPath117OpenLoadFailure: diagnostic-event=EventPowerPath117OpenLoadFailure, trouble-code-uds=Power_Path_117_Open_Load_Failure  # Event_Dtc_Map_Power_Path_117_Open_Load_Failure
  diagnostic event to operation cycle mapping EventOperCycleMapPowerPath117OpenLoadFailure: diagnostic-event=EventPowerPath117OpenLoadFailure, operation-cycle=DefaultOperationCycle  # Event_Oper_Cycle_Map_Power_Path_117_Open_Load_Failure
  diagnostic event to debounce algorithm mapping EventDebounceMapPowerPath117OpenLoadFailure: debounce-algorithm=time_based, diagnostic-event=EventPowerPath117OpenLoadFailure  # EventDebounceMap_Power_Path_117_Open_Load_Failure
package /ZeC/DTC/DTC/Power_Path_120_Open_Load_Failure
  diagnostic trouble code uds Power_Path_120_Open_Load_Failure: dtc-props=Dtc_Props_42d35816, uds-dtc-value=0x005378
  diagnostic event EventPowerPath120OpenLoadFailure: aging-allowed=true, event-kind=SWC, prestorage-freeze-frame=false  # Event_Power_Path_120_Open_Load_Failure
  diagnostic event to trouble code uds mapping EventDtcMapPowerPath120OpenLoadFailure: diagnostic-event=EventPowerPath120OpenLoadFailure, trouble-code-uds=Power_Path_120_Open_Load_Failure  # Event_Dtc_Map_Power_Path_120_Open_Load_Failure
  diagnostic event to operation cycle mapping EventOperCycleMapPowerPath120OpenLoadFailure: diagnostic-event=EventPowerPath120OpenLoadFailure, operation-cycle=DefaultOperationCycle  # Event_Oper_Cycle_Map_Power_Path_120_Open_Load_Failure
  diagnostic event to debounce algorithm mapping EventDebounceMapPowerPath120OpenLoadFailure: debounce-algorithm=time_based, diagnostic-event=EventPowerPath120OpenLoadFailure  # EventDebounceMap_Power_Path_120_Open_Load_Failure
package /ZeC/DTC/DTC/Power_Path_119_Open_Load_Failure
  diagnostic trouble code uds Power_Path_119_Open_Load_Failure: dtc-props=Dtc_Props_16b633e2, uds-dtc-value=0x005377
  diagnostic event EventPowerPath119OpenLoadFailure: aging-allowed=true, event-kind=SWC, prestorage-freeze-frame=false  # Event_Power_Path_119_Open_Load_Failure
  diagnostic event to trouble code uds mapping EventDtcMapPowerPath119OpenLoadFailure: diagnostic-event=EventPowerPath119OpenLoadFailure, trouble-code-uds=Power_Path_119_Open_Load_Failure  # Event_Dtc_Map_Power_Path_119_Open_Load_Failure
  diagnostic event to operation cycle mapping EventOperCycleMapPowerPath119OpenLoadFailure: diagnostic-event=EventPowerPath119OpenLoadFailure, operation-cycle=DefaultOperationCycle  # Event_Oper_Cycle_Map_Power_Path_119_Open_Load_Failure
  diagnostic event to debounce algorithm mapping EventDebounceMapPowerPath119OpenLoadFailure: debounce-algorithm=time_based, diagnostic-event=EventPowerPath119OpenLoadFailure  # EventDebounceMap_Power_Path_119_Open_Load_Failure
package /ZeC/DTC/DTC/Power_Path_114_Open_Load_Failure
  diagnostic trouble code uds Power_Path_114_Open_Load_Failure: dtc-props=Dtc_Props_93ba1771, uds-dtc-value=0x005372
  diagnostic event EventPowerPath114OpenLoadFailure: aging-allowed=true, event-kind=SWC, prestorage-freeze-frame=false  # Event_Power_Path_114_Open_Load_Failure
  diagnostic event to trouble code uds mapping EventDtcMapPowerPath114OpenLoadFailure: diagnostic-event=EventPowerPath114OpenLoadFailure, trouble-code-uds=Power_Path_114_Open_Load_Failure  # Event_Dtc_Map_Power_Path_114_Open_Load_Failure
  diagnostic event to operation cycle mapping EventOperCycleMapPowerPath114OpenLoadFailure: diagnostic-event=EventPowerPath114OpenLoadFailure, operation-cycle=DefaultOperationCycle  # Event_Oper_Cycle_Map_Power_Path_114_Open_Load_Failure
  diagnostic event to debounce algorithm mapping EventDebounceMapPowerPath114OpenLoadFailure: debounce-algorithm=time_based, diagnostic-event=EventPowerPath114OpenLoadFailure  # EventDebounceMap_Power_Path_114_Open_Load_Failure
package /ZeC/DTC/DTC/Power_Path_113_Open_Load_Failure
  diagnostic trouble code uds Power_Path_113_Open_Load_Failure: dtc-props=Dtc_Props_5991093f, uds-dtc-value=0x005371
  diagnostic event EventPowerPath113OpenLoadFailure: aging-allowed=true, event-kind=SWC, prestorage-freeze-frame=false  # Event_Power_Path_113_Open_Load_Failure
  diagnostic event to trouble code uds mapping EventDtcMapPowerPath113OpenLoadFailure: diagnostic-event=EventPowerPath113OpenLoadFailure, trouble-code-uds=Power_Path_113_Open_Load_Failure  # Event_Dtc_Map_Power_Path_113_Open_Load_Failure
  diagnostic event to operation cycle mapping EventOperCycleMapPowerPath113OpenLoadFailure: diagnostic-event=EventPowerPath113OpenLoadFailure, operation-cycle=DefaultOperationCycle  # Event_Oper_Cycle_Map_Power_Path_113_Open_Load_Failure
  diagnostic event to debounce algorithm mapping EventDebounceMapPowerPath113OpenLoadFailure: debounce-algorithm=time_based, diagnostic-event=EventPowerPath113OpenLoadFailure  # EventDebounceMap_Power_Path_113_Open_Load_Failure
package /ZeC/DTC/DTC/LIN_21_Slave_1_Defect
  diagnostic trouble code uds LIN_21_Slave_1_Defect: dtc-props=Dtc_Props_358996c7, uds-dtc-value=0x031619  # LIN 21 Slave 1_Defect
  diagnostic event EventLIN21Slave1Defect: aging-allowed=true, event-kind=SWC, prestorage-freeze-frame=false  # Event_LIN 21 Slave 1_Defect
  diagnostic event to trouble code uds mapping EventDtcMapLIN21Slave1Defect: diagnostic-event=EventLIN21Slave1Defect, trouble-code-uds=LIN_21_Slave_1_Defect  # Event_Dtc_Map_LIN 21 Slave 1_Defect
  diagnostic event to operation cycle mapping EventOperCycleMapLIN21Slave1Defect: diagnostic-event=EventLIN21Slave1Defect, operation-cycle=DefaultOperationCycle  # Event_Oper_Cycle_Map_LIN 21 Slave 1_Defect
  diagnostic event to debounce algorithm mapping EventDebounceMapLIN21Slave1Defect: debounce-algorithm=counter_based, diagnostic-event=EventLIN21Slave1Defect  # EventDebounceMap_LIN 21 Slave 1_Defect
package /ZeC/DTC/DTC/Power_Path_116_Open_Load_Failure
  diagnostic trouble code uds Power_Path_116_Open_Load_Failure: dtc-props=Dtc_Props_dc9d2dac, uds-dtc-value=0x005374
  diagnostic event EventPowerPath116OpenLoadFailure: aging-allowed=true, event-kind=SWC, prestorage-freeze-frame=false  # Event_Power_Path_116_Open_Load_Failure
  diagnostic event to trouble code uds mapping EventDtcMapPowerPath116OpenLoadFailure: diagnostic-event=EventPowerPath116OpenLoadFailure, trouble-code-uds=Power_Path_116_Open_Load_Failure  # Event_Dtc_Map_Power_Path_116_Open_Load_Failure
  diagnostic event to operation cycle mapping EventOperCycleMapPowerPath116OpenLoadFailure: diagnostic-event=EventPowerPath116OpenLoadFailure, operation-cycle=DefaultOperationCycle  # Event_Oper_Cycle_Map_Power_Path_116_Open_Load_Failure
  diagnostic event to debounce algorithm mapping EventDebounceMapPowerPath116OpenLoadFailure: debounce-algorithm=time_based, diagnostic-event=EventPowerPath116OpenLoadFailure  # EventDebounceMap_Power_Path_116_Open_Load_Failure
package /ZeC/DTC/DTC/Power_Path_115_Open_Load_Failure
  diagnostic trouble code uds Power_Path_115_Open_Load_Failure: dtc-props=Dtc_Props_d5a31d4b, uds-dtc-value=0x005373
  diagnostic event EventPowerPath115OpenLoadFailure: aging-allowed=true, event-kind=SWC, prestorage-freeze-frame=false  # Event_Power_Path_115_Open_Load_Failure
  diagnostic event to trouble code uds mapping EventDtcMapPowerPath115OpenLoadFailure: diagnostic-event=EventPowerPath115OpenLoadFailure, trouble-code-uds=Power_Path_115_Open_Load_Failure  # Event_Dtc_Map_Power_Path_115_Open_Load_Failure
  diagnostic event to operation cycle mapping EventOperCycleMapPowerPath115OpenLoadFailure: diagnostic-event=EventPowerPath115OpenLoadFailure, operation-cycle=DefaultOperationCycle  # Event_Oper_Cycle_Map_Power_Path_115_Open_Load_Failure
  diagnostic event to debounce algorithm mapping EventDebounceMapPowerPath115OpenLoadFailure: debounce-algorithm=time_based, diagnostic-event=EventPowerPath115OpenLoadFailure  # EventDebounceMap_Power_Path_115_Open_Load_Failure
package /ZeC/DTC/DTC/LIN_13_Slave_11_NoCommunication
  diagnostic trouble code uds LIN_13_Slave_11_NoCommunication: dtc-props=Dtc_Props_358996c7, uds-dtc-value=0x030d0e  # LIN 13 Slave 11_NoCommunication
  diagnostic event EventLIN13Slave11NoCommunication: aging-allowed=true, event-kind=SWC, prestorage-freeze-frame=false  # Event_LIN 13 Slave 11_NoCommunication
  diagnostic event to trouble code uds mapping EventDtcMapLIN13Slave11NoCommunication: diagnostic-event=EventLIN13Slave11NoCommunication, trouble-code-uds=LIN_13_Slave_11_NoCommunication  # Event_Dtc_Map_LIN 13 Slave 11_NoCommunication
  diagnostic event to operation cycle mapping EventOperCycleMapLIN13Slave11NoCommunication: diagnostic-event=EventLIN13Slave11NoCommunication, operation-cycle=DefaultOperationCycle  # Event_Oper_Cycle_Map_LIN 13 Slave 11_NoCommunication
  diagnostic event to debounce algorithm mapping EventDebounceMapLIN13Slave11NoCommunication: debounce-algorithm=counter_based, diagnostic-event=EventLIN13Slave11NoCommunication  # EventDebounceMap_LIN 13 Slave 11_NoCommunication
package /ZeC/DTC/DTC/LIN_13_Slave_12_Defect
  diagnostic trouble code uds LIN_13_Slave_12_Defect: dtc-props=Dtc_Props_358996c7, uds-dtc-value=0x030d0f  # LIN 13 Slave 12_Defect
  diagnostic event EventLIN13Slave12Defect: aging-allowed=true, event-kind=SWC, prestorage-freeze-frame=false  # Event_LIN 13 Slave 12_Defect
  diagnostic event to trouble code uds mapping EventDtcMapLIN13Slave12Defect: diagnostic-event=EventLIN13Slave12Defect, trouble-code-uds=LIN_13_Slave_12_Defect  # Event_Dtc_Map_LIN 13 Slave 12_Defect
  diagnostic event to operation cycle mapping EventOperCycleMapLIN13Slave12Defect: diagnostic-event=EventLIN13Slave12Defect, operation-cycle=DefaultOperationCycle  # Event_Oper_Cycle_Map_LIN 13 Slave 12_Defect
  diagnostic event to debounce algorithm mapping EventDebounceMapLIN13Slave12Defect: debounce-algorithm=counter_based, diagnostic-event=EventLIN13Slave12Defect  # EventDebounceMap_LIN 13 Slave 12_Defect
package /ZeC/DTC/DTC/LIN_13_Slave_10_NoCommunication
  diagnostic trouble code uds LIN_13_Slave_10_NoCommunication: dtc-props=Dtc_Props_358996c7, uds-dtc-value=0x030d0c  # LIN 13 Slave 10_NoCommunication
  diagnostic event EventLIN13Slave10NoCommunication: aging-allowed=true, event-kind=SWC, prestorage-freeze-frame=false  # Event_LIN 13 Slave 10_NoCommunication
  diagnostic event to trouble code uds mapping EventDtcMapLIN13Slave10NoCommunication: diagnostic-event=EventLIN13Slave10NoCommunication, trouble-code-uds=LIN_13_Slave_10_NoCommunication  # Event_Dtc_Map_LIN 13 Slave 10_NoCommunication
  diagnostic event to operation cycle mapping EventOperCycleMapLIN13Slave10NoCommunication: diagnostic-event=EventLIN13Slave10NoCommunication, operation-cycle=DefaultOperationCycle  # Event_Oper_Cycle_Map_LIN 13 Slave 10_NoCommunication
  diagnostic event to debounce algorithm mapping EventDebounceMapLIN13Slave10NoCommunication: debounce-algorithm=counter_based, diagnostic-event=EventLIN13Slave10NoCommunication  # EventDebounceMap_LIN 13 Slave 10_NoCommunication
package /ZeC/DTC/DTC/Power_Path_088_Open_Load_Failure
  diagnostic trouble code uds Power_Path_088_Open_Load_Failure: dtc-props=Dtc_Props_1537df27, uds-dtc-value=0x005358
  diagnostic event EventPowerPath088OpenLoadFailure: aging-allowed=true, event-kind=SWC, prestorage-freeze-frame=false  # Event_Power_Path_088_Open_Load_Failure
  diagnostic event to trouble code uds mapping EventDtcMapPowerPath088OpenLoadFailure: diagnostic-event=EventPowerPath088OpenLoadFailure, trouble-code-uds=Power_Path_088_Open_Load_Failure  # Event_Dtc_Map_Power_Path_088_Open_Load_Failure
  diagnostic event to operation cycle mapping EventOperCycleMapPowerPath088OpenLoadFailure: diagnostic-event=EventPowerPath088OpenLoadFailure, operation-cycle=DefaultOperationCycle  # Event_Oper_Cycle_Map_Power_Path_088_Open_Load_Failure
  diagnostic event to debounce algorithm mapping EventDebounceMapPowerPath088OpenLoadFailure: debounce-algorithm=time_based, diagnostic-event=EventPowerPath088OpenLoadFailure  # EventDebounceMap_Power_Path_088_Open_Load_Failure
package /ZeC/DTC/DTC/LIN_13_Slave_11_Defect
  diagnostic trouble code uds LIN_13_Slave_11_Defect: dtc-props=Dtc_Props_358996c7, uds-dtc-value=0x030d0d  # LIN 13 Slave 11_Defect
  diagnostic event EventLIN13Slave11Defect: aging-allowed=true, event-kind=SWC, prestorage-freeze-frame=false  # Event_LIN 13 Slave 11_Defect
  diagnostic event to trouble code uds mapping EventDtcMapLIN13Slave11Defect: diagnostic-event=EventLIN13Slave11Defect, trouble-code-uds=LIN_13_Slave_11_Defect  # Event_Dtc_Map_LIN 13 Slave 11_Defect
  diagnostic event to operation cycle mapping EventOperCycleMapLIN13Slave11Defect: diagnostic-event=EventLIN13Slave11Defect, operation-cycle=DefaultOperationCycle  # Event_Oper_Cycle_Map_LIN 13 Slave 11_Defect
  diagnostic event to debounce algorithm mapping EventDebounceMapLIN13Slave11Defect: debounce-algorithm=counter_based, diagnostic-event=EventLIN13Slave11Defect  # EventDebounceMap_LIN 13 Slave 11_Defect
package /ZeC/DTC/DTC/Power_Path_087_Open_Load_Failure
  diagnostic trouble code uds Power_Path_087_Open_Load_Failure: dtc-props=Dtc_Props_4152b4d3, uds-dtc-value=0x005357
  diagnostic event EventPowerPath087OpenLoadFailure: aging-allowed=true, event-kind=SWC, prestorage-freeze-frame=false  # Event_Power_Path_087_Open_Load_Failure
  diagnostic event to trouble code uds mapping EventDtcMapPowerPath087OpenLoadFailure: diagnostic-event=EventPowerPath087OpenLoadFailure, trouble-code-uds=Power_Path_087_Open_Load_Failure  # Event_Dtc_Map_Power_Path_087_Open_Load_Failure
  diagnostic event to operation cycle mapping EventOperCycleMapPowerPath087OpenLoadFailure: diagnostic-event=EventPowerPath087OpenLoadFailure, operation-cycle=DefaultOperationCycle  # Event_Oper_Cycle_Map_Power_Path_087_Open_Load_Failure
  diagnostic event to debounce algorithm mapping EventDebounceMapPowerPath087OpenLoadFailure: debounce-algorithm=time_based, diagnostic-event=EventPowerPath087OpenLoadFailure  # EventDebounceMap_Power_Path_087_Open_Load_Failure
package /ZeC/DTC/DTC/LIN_13_Slave_1_NoCommunication
  diagnostic trouble code uds LIN_13_Slave_1_NoCommunication: dtc-props=Dtc_Props_358996c7, uds-dtc-value=0x030d0a  # LIN 13 Slave 1_NoCommunication
  diagnostic event EventLIN13Slave1NoCommunication: aging-allowed=true, event-kind=SWC, prestorage-freeze-frame=false  # Event_LIN 13 Slave 1_NoCommunication
  diagnostic event to trouble code uds mapping EventDtcMapLIN13Slave1NoCommunication: diagnostic-event=EventLIN13Slave1NoCommunication, trouble-code-uds=LIN_13_Slave_1_NoCommunication  # Event_Dtc_Map_LIN 13 Slave 1_NoCommunication
  diagnostic event to operation cycle mapping EventOperCycleMapLIN13Slave1NoCommunication: diagnostic-event=EventLIN13Slave1NoCommunication, operation-cycle=DefaultOperationCycle  # Event_Oper_Cycle_Map_LIN 13 Slave 1_NoCommunication
  diagnostic event to debounce algorithm mapping EventDebounceMapLIN13Slave1NoCommunication: debounce-algorithm=counter_based, diagnostic-event=EventLIN13Slave1NoCommunication  # EventDebounceMap_LIN 13 Slave 1_NoCommunication
package /ZeC/DTC/DTC/LIN_13_Slave_10_Defect
  diagnostic trouble code uds LIN_13_Slave_10_Defect: dtc-props=Dtc_Props_358996c7, uds-dtc-value=0x030d0b  # LIN 13 Slave 10_Defect
  diagnostic event EventLIN13Slave10Defect: aging-allowed=true, event-kind=SWC, prestorage-freeze-frame=false  # Event_LIN 13 Slave 10_Defect
  diagnostic event to trouble code uds mapping EventDtcMapLIN13Slave10Defect: diagnostic-event=EventLIN13Slave10Defect, trouble-code-uds=LIN_13_Slave_10_Defect  # Event_Dtc_Map_LIN 13 Slave 10_Defect
  diagnostic event to operation cycle mapping EventOperCycleMapLIN13Slave10Defect: diagnostic-event=EventLIN13Slave10Defect, operation-cycle=DefaultOperationCycle  # Event_Oper_Cycle_Map_LIN 13 Slave 10_Defect
  diagnostic event to debounce algorithm mapping EventDebounceMapLIN13Slave10Defect: debounce-algorithm=counter_based, diagnostic-event=EventLIN13Slave10Defect  # EventDebounceMap_LIN 13 Slave 10_Defect
package /ZeC/DTC/DTC/Power_Path_089_Open_Load_Failure
  diagnostic trouble code uds Power_Path_089_Open_Load_Failure: dtc-props=Dtc_Props_532ed51d, uds-dtc-value=0x005359
  diagnostic event EventPowerPath089OpenLoadFailure: aging-allowed=true, event-kind=SWC, prestorage-freeze-frame=false  # Event_Power_Path_089_Open_Load_Failure
  diagnostic event to trouble code uds mapping EventDtcMapPowerPath089OpenLoadFailure: diagnostic-event=EventPowerPath089OpenLoadFailure, trouble-code-uds=Power_Path_089_Open_Load_Failure  # Event_Dtc_Map_Power_Path_089_Open_Load_Failure
  diagnostic event to operation cycle mapping EventOperCycleMapPowerPath089OpenLoadFailure: diagnostic-event=EventPowerPath089OpenLoadFailure, operation-cycle=DefaultOperationCycle  # Event_Oper_Cycle_Map_Power_Path_089_Open_Load_Failure
  diagnostic event to debounce algorithm mapping EventDebounceMapPowerPath089OpenLoadFailure: debounce-algorithm=time_based, diagnostic-event=EventPowerPath089OpenLoadFailure  # EventDebounceMap_Power_Path_089_Open_Load_Failure
package /ZeC/DTC/DTC/Power_Path_093_Open_Load_Failure
  diagnostic trouble code uds Power_Path_093_Open_Load_Failure: dtc-props=Dtc_Props_b686cee0, uds-dtc-value=0x00535d
  diagnostic event EventPowerPath093OpenLoadFailure: aging-allowed=true, event-kind=SWC, prestorage-freeze-frame=false  # Event_Power_Path_093_Open_Load_Failure
  diagnostic event to trouble code uds mapping EventDtcMapPowerPath093OpenLoadFailure: diagnostic-event=EventPowerPath093OpenLoadFailure, trouble-code-uds=Power_Path_093_Open_Load_Failure  # Event_Dtc_Map_Power_Path_093_Open_Load_Failure
  diagnostic event to operation cycle mapping EventOperCycleMapPowerPath093OpenLoadFailure: diagnostic-event=EventPowerPath093OpenLoadFailure, operation-cycle=DefaultOperationCycle  # Event_Oper_Cycle_Map_Power_Path_093_Open_Load_Failure
  diagnostic event to debounce algorithm mapping EventDebounceMapPowerPath093OpenLoadFailure: debounce-algorithm=time_based, diagnostic-event=EventPowerPath093OpenLoadFailure  # EventDebounceMap_Power_Path_093_Open_Load_Failure
package /ZeC/DTC/DTC/Power_Path_092_Open_Load_Failure
  diagnostic trouble code uds Power_Path_092_Open_Load_Failure: dtc-props=Dtc_Props_bfb8fe07, uds-dtc-value=0x00535c
  diagnostic event EventPowerPath092OpenLoadFailure: aging-allowed=true, event-kind=SWC, prestorage-freeze-frame=false  # Event_Power_Path_092_Open_Load_Failure
  diagnostic event to trouble code uds mapping EventDtcMapPowerPath092OpenLoadFailure: diagnostic-event=EventPowerPath092OpenLoadFailure, trouble-code-uds=Power_Path_092_Open_Load_Failure  # Event_Dtc_Map_Power_Path_092_Open_Load_Failure
  diagnostic event to operation cycle mapping EventOperCycleMapPowerPath092OpenLoadFailure: diagnostic-event=EventPowerPath092OpenLoadFailure, operation-cycle=DefaultOperationCycle  # Event_Oper_Cycle_Map_Power_Path_092_Open_Load_Failure
  diagnostic event to debounce algorithm mapping EventDebounceMapPowerPath092OpenLoadFailure: debounce-algorithm=time_based, diagnostic-event=EventPowerPath092OpenLoadFailure  # EventDebounceMap_Power_Path_092_Open_Load_Failure
package /ZeC/DTC/DTC/Power_Path_095_Open_Load_Failure
  diagnostic trouble code uds Power_Path_095_Open_Load_Failure: dtc-props=Dtc_Props_3ab4da94, uds-dtc-value=0x00535f
  diagnostic event EventPowerPath095OpenLoadFailure: aging-allowed=true, event-kind=SWC, prestorage-freeze-frame=false  # Event_Power_Path_095_Open_Load_Failure
  diagnostic event to trouble code uds mapping EventDtcMapPowerPath095OpenLoadFailure: diagnostic-event=EventPowerPath095OpenLoadFailure, trouble-code-uds=Power_Path_095_Open_Load_Failure  # Event_Dtc_Map_Power_Path_095_Open_Load_Failure
  diagnostic event to operation cycle mapping EventOperCycleMapPowerPath095OpenLoadFailure: diagnostic-event=EventPowerPath095OpenLoadFailure, operation-cycle=DefaultOperationCycle  # Event_Oper_Cycle_Map_Power_Path_095_Open_Load_Failure
  diagnostic event to debounce algorithm mapping EventDebounceMapPowerPath095OpenLoadFailure: debounce-algorithm=time_based, diagnostic-event=EventPowerPath095OpenLoadFailure  # EventDebounceMap_Power_Path_095_Open_Load_Failure
package /ZeC/DTC/DTC/Power_Path_094_Open_Load_Failure
  diagnostic trouble code uds Power_Path_094_Open_Load_Failure: dtc-props=Dtc_Props_f09fc4da, uds-dtc-value=0x00535e
  diagnostic event EventPowerPath094OpenLoadFailure: aging-allowed=true, event-kind=SWC, prestorage-freeze-frame=false  # Event_Power_Path_094_Open_Load_Failure
  diagnostic event to trouble code uds mapping EventDtcMapPowerPath094OpenLoadFailure: diagnostic-event=EventPowerPath094OpenLoadFailure, trouble-code-uds=Power_Path_094_Open_Load_Failure  # Event_Dtc_Map_Power_Path_094_Open_Load_Failure
  diagnostic event to operation cycle mapping EventOperCycleMapPowerPath094OpenLoadFailure: diagnostic-event=EventPowerPath094OpenLoadFailure, operation-cycle=DefaultOperationCycle  # Event_Oper_Cycle_Map_Power_Path_094_Open_Load_Failure
  diagnostic event to debounce algorithm mapping EventDebounceMapPowerPath094OpenLoadFailure: debounce-algorithm=time_based, diagnostic-event=EventPowerPath094OpenLoadFailure  # EventDebounceMap_Power_Path_094_Open_Load_Failure
package /ZeC/DTC/DTC/LIN_13_Slave_1_Defect
  diagnostic trouble code uds LIN_13_Slave_1_Defect: dtc-props=Dtc_Props_358996c7, uds-dtc-value=0x030d09  # LIN 13 Slave 1_Defect
  diagnostic event EventLIN13Slave1Defect: aging-allowed=true, event-kind=SWC, prestorage-freeze-frame=false  # Event_LIN 13 Slave 1_Defect
  diagnostic event to trouble code uds mapping EventDtcMapLIN13Slave1Defect: diagnostic-event=EventLIN13Slave1Defect, trouble-code-uds=LIN_13_Slave_1_Defect  # Event_Dtc_Map_LIN 13 Slave 1_Defect
  diagnostic event to operation cycle mapping EventOperCycleMapLIN13Slave1Defect: diagnostic-event=EventLIN13Slave1Defect, operation-cycle=DefaultOperationCycle  # Event_Oper_Cycle_Map_LIN 13 Slave 1_Defect
  diagnostic event to debounce algorithm mapping EventDebounceMapLIN13Slave1Defect: debounce-algorithm=counter_based, diagnostic-event=EventLIN13Slave1Defect  # EventDebounceMap_LIN 13 Slave 1_Defect
package /ZeC/DTC/DTC/Power_Path_091_Open_Load_Failure
  diagnostic trouble code uds Power_Path_091_Open_Load_Failure: dtc-props=Dtc_Props_f9a1f43d, uds-dtc-value=0x00535b
  diagnostic event EventPowerPath091OpenLoadFailure: aging-allowed=true, event-kind=SWC, prestorage-freeze-frame=false  # Event_Power_Path_091_Open_Load_Failure
  diagnostic event to trouble code uds mapping EventDtcMapPowerPath091OpenLoadFailure: diagnostic-event=EventPowerPath091OpenLoadFailure, trouble-code-uds=Power_Path_091_Open_Load_Failure  # Event_Dtc_Map_Power_Path_091_Open_Load_Failure
  diagnostic event to operation cycle mapping EventOperCycleMapPowerPath091OpenLoadFailure: diagnostic-event=EventPowerPath091OpenLoadFailure, operation-cycle=DefaultOperationCycle  # Event_Oper_Cycle_Map_Power_Path_091_Open_Load_Failure
  diagnostic event to debounce algorithm mapping EventDebounceMapPowerPath091OpenLoadFailure: debounce-algorithm=time_based, diagnostic-event=EventPowerPath091OpenLoadFailure  # EventDebounceMap_Power_Path_091_Open_Load_Failure
package /ZeC/DTC/DTC/Power_Path_090_Open_Load_Failure
  diagnostic trouble code uds Power_Path_090_Open_Load_Failure: dtc-props=Dtc_Props_338aea73, uds-dtc-value=0x00535a
  diagnostic event EventPowerPath090OpenLoadFailure: aging-allowed=true, event-kind=SWC, prestorage-freeze-frame=false  # Event_Power_Path_090_Open_Load_Failure
  diagnostic event to trouble code uds mapping EventDtcMapPowerPath090OpenLoadFailure: diagnostic-event=EventPowerPath090OpenLoadFailure, trouble-code-uds=Power_Path_090_Open_Load_Failure  # Event_Dtc_Map_Power_Path_090_Open_Load_Failure
  diagnostic event to operation cycle mapping EventOperCycleMapPowerPath090OpenLoadFailure: diagnostic-event=EventPowerPath090OpenLoadFailure, operation-cycle=DefaultOperationCycle  # Event_Oper_Cycle_Map_Power_Path_090_Open_Load_Failure
  diagnostic event to debounce algorithm mapping EventDebounceMapPowerPath090OpenLoadFailure: debounce-algorithm=time_based, diagnostic-event=EventPowerPath090OpenLoadFailure  # EventDebounceMap_Power_Path_090_Open_Load_Failure
package /ZeC/DTC/DTC/LIN_13_Slave_2_NoCommunication
  diagnostic trouble code uds LIN_13_Slave_2_NoCommunication: dtc-props=Dtc_Props_358996c7, uds-dtc-value=0x030d18  # LIN 13 Slave 2_NoCommunication
  diagnostic event EventLIN13Slave2NoCommunication: aging-allowed=true, event-kind=SWC, prestorage-freeze-frame=false  # Event_LIN 13 Slave 2_NoCommunication
  diagnostic event to trouble code uds mapping EventDtcMapLIN13Slave2NoCommunication: diagnostic-event=EventLIN13Slave2NoCommunication, trouble-code-uds=LIN_13_Slave_2_NoCommunication  # Event_Dtc_Map_LIN 13 Slave 2_NoCommunication
  diagnostic event to operation cycle mapping EventOperCycleMapLIN13Slave2NoCommunication: diagnostic-event=EventLIN13Slave2NoCommunication, operation-cycle=DefaultOperationCycle  # Event_Oper_Cycle_Map_LIN 13 Slave 2_NoCommunication
  diagnostic event to debounce algorithm mapping EventDebounceMapLIN13Slave2NoCommunication: debounce-algorithm=counter_based, diagnostic-event=EventLIN13Slave2NoCommunication  # EventDebounceMap_LIN 13 Slave 2_NoCommunication
package /ZeC/DTC/DTC/LIN_13_Slave_3_Defect
  diagnostic trouble code uds LIN_13_Slave_3_Defect: dtc-props=Dtc_Props_358996c7, uds-dtc-value=0x030d19  # LIN 13 Slave 3_Defect
  diagnostic event EventLIN13Slave3Defect: aging-allowed=true, event-kind=SWC, prestorage-freeze-frame=false  # Event_LIN 13 Slave 3_Defect
  diagnostic event to trouble code uds mapping EventDtcMapLIN13Slave3Defect: diagnostic-event=EventLIN13Slave3Defect, trouble-code-uds=LIN_13_Slave_3_Defect  # Event_Dtc_Map_LIN 13 Slave 3_Defect
  diagnostic event to operation cycle mapping EventOperCycleMapLIN13Slave3Defect: diagnostic-event=EventLIN13Slave3Defect, operation-cycle=DefaultOperationCycle  # Event_Oper_Cycle_Map_LIN 13 Slave 3_Defect
  diagnostic event to debounce algorithm mapping EventDebounceMapLIN13Slave3Defect: debounce-algorithm=counter_based, diagnostic-event=EventLIN13Slave3Defect  # EventDebounceMap_LIN 13 Slave 3_Defect
package /ZeC/DTC/DTC/LIN_13_Slave_15_NoCommunication
  diagnostic trouble code uds LIN_13_Slave_15_NoCommunication: dtc-props=Dtc_Props_358996c7, uds-dtc-value=0x030d16  # LIN 13 Slave 15_NoCommunication
  diagnostic event EventLIN13Slave15NoCommunication: aging-allowed=true, event-kind=SWC, prestorage-freeze-frame=false  # Event_LIN 13 Slave 15_NoCommunication
  diagnostic event to trouble code uds mapping EventDtcMapLIN13Slave15NoCommunication: diagnostic-event=EventLIN13Slave15NoCommunication, trouble-code-uds=LIN_13_Slave_15_NoCommunication  # Event_Dtc_Map_LIN 13 Slave 15_NoCommunication
  diagnostic event to operation cycle mapping EventOperCycleMapLIN13Slave15NoCommunication: diagnostic-event=EventLIN13Slave15NoCommunication, operation-cycle=DefaultOperationCycle  # Event_Oper_Cycle_Map_LIN 13 Slave 15_NoCommunication
  diagnostic event to debounce algorithm mapping EventDebounceMapLIN13Slave15NoCommunication: debounce-algorithm=counter_based, diagnostic-event=EventLIN13Slave15NoCommunication  # EventDebounceMap_LIN 13 Slave 15_NoCommunication
package /ZeC/DTC/DTC/LIN_13_Slave_2_Defect
  diagnostic trouble code uds LIN_13_Slave_2_Defect: dtc-props=Dtc_Props_358996c7, uds-dtc-value=0x030d17  # LIN 13 Slave 2_Defect
  diagnostic event EventLIN13Slave2Defect: aging-allowed=true, event-kind=SWC, prestorage-freeze-frame=false  # Event_LIN 13 Slave 2_Defect
  diagnostic event to trouble code uds mapping EventDtcMapLIN13Slave2Defect: diagnostic-event=EventLIN13Slave2Defect, trouble-code-uds=LIN_13_Slave_2_Defect  # Event_Dtc_Map_LIN 13 Slave 2_Defect
  diagnostic event to operation cycle mapping EventOperCycleMapLIN13Slave2Defect: diagnostic-event=EventLIN13Slave2Defect, operation-cycle=DefaultOperationCycle  # Event_Oper_Cycle_Map_LIN 13 Slave 2_Defect
  diagnostic event to debounce algorithm mapping EventDebounceMapLIN13Slave2Defect: debounce-algorithm=counter_based, diagnostic-event=EventLIN13Slave2Defect  # EventDebounceMap_LIN 13 Slave 2_Defect
package /ZeC/DTC/DTC/LIN_13_Slave_14_NoCommunication
  diagnostic trouble code uds LIN_13_Slave_14_NoCommunication: dtc-props=Dtc_Props_358996c7, uds-dtc-value=0x030d14  # LIN 13 Slave 14_NoCommunication
  diagnostic event EventLIN13Slave14NoCommunication: aging-allowed=true, event-kind=SWC, prestorage-freeze-frame=false  # Event_LIN 13 Slave 14_NoCommunication
  diagnostic event to trouble code uds mapping EventDtcMapLIN13Slave14NoCommunication: diagnostic-event=EventLIN13Slave14NoCommunication, trouble-code-uds=LIN_13_Slave_14_NoCommunication  # Event_Dtc_Map_LIN 13 Slave 14_NoCommunication
  diagnostic event to operation cycle mapping EventOperCycleMapLIN13Slave14NoCommunication: diagnostic-event=EventLIN13Slave14NoCommunication, operation-cycle=DefaultOperationCycle  # Event_Oper_Cycle_Map_LIN 13 Slave 14_NoCommunication
  diagnostic event to debounce algorithm mapping EventDebounceMapLIN13Slave14NoCommunication: debounce-algorithm=counter_based, diagnostic-event=EventLIN13Slave14NoCommunication  # EventDebounceMap_LIN 13 Slave 14_NoCommunication
package /ZeC/DTC/DTC/LIN_13_Slave_15_Defect
  diagnostic trouble code uds LIN_13_Slave_15_Defect: dtc-props=Dtc_Props_358996c7, uds-dtc-value=0x030d15  # LIN 13 Slave 15_Defect
  diagnostic event EventLIN13Slave15Defect: aging-allowed=true, event-kind=SWC, prestorage-freeze-frame=false  # Event_LIN 13 Slave 15_Defect
  diagnostic event to trouble code uds mapping EventDtcMapLIN13Slave15Defect: diagnostic-event=EventLIN13Slave15Defect, trouble-code-uds=LIN_13_Slave_15_Defect  # Event_Dtc_Map_LIN 13 Slave 15_Defect
  diagnostic event to operation cycle mapping EventOperCycleMapLIN13Slave15Defect: diagnostic-event=EventLIN13Slave15Defect, operation-cycle=DefaultOperationCycle  # Event_Oper_Cycle_Map_LIN 13 Slave 15_Defect
  diagnostic event to debounce algorithm mapping EventDebounceMapLIN13Slave15Defect: debounce-algorithm=counter_based, diagnostic-event=EventLIN13Slave15Defect  # EventDebounceMap_LIN 13 Slave 15_Defect
package /ZeC/DTC/DTC/LIN_13_Slave_13_NoCommunication
  diagnostic trouble code uds LIN_13_Slave_13_NoCommunication: dtc-props=Dtc_Props_358996c7, uds-dtc-value=0x030d12  # LIN 13 Slave 13_NoCommunication
  diagnostic event EventLIN13Slave13NoCommunication: aging-allowed=true, event-kind=SWC, prestorage-freeze-frame=false  # Event_LIN 13 Slave 13_NoCommunication
  diagnostic event to trouble code uds mapping EventDtcMapLIN13Slave13NoCommunication: diagnostic-event=EventLIN13Slave13NoCommunication, trouble-code-uds=LIN_13_Slave_13_NoCommunication  # Event_Dtc_Map_LIN 13 Slave 13_NoCommunication
  diagnostic event to operation cycle mapping EventOperCycleMapLIN13Slave13NoCommunication: diagnostic-event=EventLIN13Slave13NoCommunication, operation-cycle=DefaultOperationCycle  # Event_Oper_Cycle_Map_LIN 13 Slave 13_NoCommunication
  diagnostic event to debounce algorithm mapping EventDebounceMapLIN13Slave13NoCommunication: debounce-algorithm=counter_based, diagnostic-event=EventLIN13Slave13NoCommunication  # EventDebounceMap_LIN 13 Slave 13_NoCommunication
package /ZeC/DTC/DTC/LIN_13_Slave_14_Defect
  diagnostic trouble code uds LIN_13_Slave_14_Defect: dtc-props=Dtc_Props_358996c7, uds-dtc-value=0x030d13  # LIN 13 Slave 14_Defect
  diagnostic event EventLIN13Slave14Defect: aging-allowed=true, event-kind=SWC, prestorage-freeze-frame=false  # Event_LIN 13 Slave 14_Defect
  diagnostic event to trouble code uds mapping EventDtcMapLIN13Slave14Defect: diagnostic-event=EventLIN13Slave14Defect, trouble-code-uds=LIN_13_Slave_14_Defect  # Event_Dtc_Map_LIN 13 Slave 14_Defect
  diagnostic event to operation cycle mapping EventOperCycleMapLIN13Slave14Defect: diagnostic-event=EventLIN13Slave14Defect, operation-cycle=DefaultOperationCycle  # Event_Oper_Cycle_Map_LIN 13 Slave 14_Defect
  diagnostic event to debounce algorithm mapping EventDebounceMapLIN13Slave14Defect: debounce-algorithm=counter_based, diagnostic-event=EventLIN13Slave14Defect  # EventDebounceMap_LIN 13 Slave 14_Defect
package /ZeC/DTC/DTC/LIN_13_Slave_12_NoCommunication
  diagnostic trouble code uds LIN_13_Slave_12_NoCommunication: dtc-props=Dtc_Props_358996c7, uds-dtc-value=0x030d10  # LIN 13 Slave 12_NoCommunication
  diagnostic event EventLIN13Slave12NoCommunication: aging-allowed=true, event-kind=SWC, prestorage-freeze-frame=false  # Event_LIN 13 Slave 12_NoCommunication
  diagnostic event to trouble code uds mapping EventDtcMapLIN13Slave12NoCommunication: diagnostic-event=EventLIN13Slave12NoCommunication, trouble-code-uds=LIN_13_Slave_12_NoCommunication  # Event_Dtc_Map_LIN 13 Slave 12_NoCommunication
  diagnostic event to operation cycle mapping EventOperCycleMapLIN13Slave12NoCommunication: diagnostic-event=EventLIN13Slave12NoCommunication, operation-cycle=DefaultOperationCycle  # Event_Oper_Cycle_Map_LIN 13 Slave 12_NoCommunication
  diagnostic event to debounce algorithm mapping EventDebounceMapLIN13Slave12NoCommunication: debounce-algorithm=counter_based, diagnostic-event=EventLIN13Slave12NoCommunication  # EventDebounceMap_LIN 13 Slave 12_NoCommunication
package /ZeC/DTC/DTC/Power_Path_101_Open_Load_Failure
  diagnostic trouble code uds Power_Path_101_Open_Load_Failure: dtc-props=Dtc_Props_5ccee72e, uds-dtc-value=0x005365
  diagnostic event EventPowerPath101OpenLoadFailure: aging-allowed=true, event-kind=SWC, prestorage-freeze-frame=false  # Event_Power_Path_101_Open_Load_Failure
  diagnostic event to trouble code uds mapping EventDtcMapPowerPath101OpenLoadFailure: diagnostic-event=EventPowerPath101OpenLoadFailure, trouble-code-uds=Power_Path_101_Open_Load_Failure  # Event_Dtc_Map_Power_Path_101_Open_Load_Failure
  diagnostic event to operation cycle mapping EventOperCycleMapPowerPath101OpenLoadFailure: diagnostic-event=EventPowerPath101OpenLoadFailure, operation-cycle=DefaultOperationCycle  # Event_Oper_Cycle_Map_Power_Path_101_Open_Load_Failure
  diagnostic event to debounce algorithm mapping EventDebounceMapPowerPath101OpenLoadFailure: debounce-algorithm=time_based, diagnostic-event=EventPowerPath101OpenLoadFailure  # EventDebounceMap_Power_Path_101_Open_Load_Failure
package /ZeC/DTC/DTC/LIN_13_Slave_13_Defect
  diagnostic trouble code uds LIN_13_Slave_13_Defect: dtc-props=Dtc_Props_358996c7, uds-dtc-value=0x030d11  # LIN 13 Slave 13_Defect
  diagnostic event EventLIN13Slave13Defect: aging-allowed=true, event-kind=SWC, prestorage-freeze-frame=false  # Event_LIN 13 Slave 13_Defect
  diagnostic event to trouble code uds mapping EventDtcMapLIN13Slave13Defect: diagnostic-event=EventLIN13Slave13Defect, trouble-code-uds=LIN_13_Slave_13_Defect  # Event_Dtc_Map_LIN 13 Slave 13_Defect
  diagnostic event to operation cycle mapping EventOperCycleMapLIN13Slave13Defect: diagnostic-event=EventLIN13Slave13Defect, operation-cycle=DefaultOperationCycle  # Event_Oper_Cycle_Map_LIN 13 Slave 13_Defect
  diagnostic event to debounce algorithm mapping EventDebounceMapLIN13Slave13Defect: debounce-algorithm=counter_based, diagnostic-event=EventLIN13Slave13Defect  # EventDebounceMap_LIN 13 Slave 13_Defect
package /ZeC/DTC/DTC/Power_Path_100_Open_Load_Failure
  diagnostic trouble code uds Power_Path_100_Open_Load_Failure: dtc-props=Dtc_Props_1ad7ed14, uds-dtc-value=0x005364
  diagnostic event EventPowerPath100OpenLoadFailure: aging-allowed=true, event-kind=SWC, prestorage-freeze-frame=false  # Event_Power_Path_100_Open_Load_Failure
  diagnostic event to trouble code uds mapping EventDtcMapPowerPath100OpenLoadFailure: diagnostic-event=EventPowerPath100OpenLoadFailure, trouble-code-uds=Power_Path_100_Open_Load_Failure  # Event_Dtc_Map_Power_Path_100_Open_Load_Failure
  diagnostic event to operation cycle mapping EventOperCycleMapPowerPath100OpenLoadFailure: diagnostic-event=EventPowerPath100OpenLoadFailure, operation-cycle=DefaultOperationCycle  # Event_Oper_Cycle_Map_Power_Path_100_Open_Load_Failure
  diagnostic event to debounce algorithm mapping EventDebounceMapPowerPath100OpenLoadFailure: debounce-algorithm=time_based, diagnostic-event=EventPowerPath100OpenLoadFailure  # EventDebounceMap_Power_Path_100_Open_Load_Failure
package /ZeC/DTC/DTC/Power_Path_103_Open_Load_Failure
  diagnostic trouble code uds Power_Path_103_Open_Load_Failure: dtc-props=Dtc_Props_d0fcf35a, uds-dtc-value=0x005367
  diagnostic event EventPowerPath103OpenLoadFailure: aging-allowed=true, event-kind=SWC, prestorage-freeze-frame=false  # Event_Power_Path_103_Open_Load_Failure
  diagnostic event to trouble code uds mapping EventDtcMapPowerPath103OpenLoadFailure: diagnostic-event=EventPowerPath103OpenLoadFailure, trouble-code-uds=Power_Path_103_Open_Load_Failure  # Event_Dtc_Map_Power_Path_103_Open_Load_Failure
  diagnostic event to operation cycle mapping EventOperCycleMapPowerPath103OpenLoadFailure: diagnostic-event=EventPowerPath103OpenLoadFailure, operation-cycle=DefaultOperationCycle  # Event_Oper_Cycle_Map_Power_Path_103_Open_Load_Failure
  diagnostic event to debounce algorithm mapping EventDebounceMapPowerPath103OpenLoadFailure: debounce-algorithm=time_based, diagnostic-event=EventPowerPath103OpenLoadFailure  # EventDebounceMap_Power_Path_103_Open_Load_Failure
package /ZeC/DTC/DTC/Power_Path_102_Open_Load_Failure
  diagnostic trouble code uds Power_Path_102_Open_Load_Failure: dtc-props=Dtc_Props_96e5f960, uds-dtc-value=0x005366
  diagnostic event EventPowerPath102OpenLoadFailure: aging-allowed=true, event-kind=SWC, prestorage-freeze-frame=false  # Event_Power_Path_102_Open_Load_Failure
  diagnostic event to trouble code uds mapping EventDtcMapPowerPath102OpenLoadFailure: diagnostic-event=EventPowerPath102OpenLoadFailure, trouble-code-uds=Power_Path_102_Open_Load_Failure  # Event_Dtc_Map_Power_Path_102_Open_Load_Failure
  diagnostic event to operation cycle mapping EventOperCycleMapPowerPath102OpenLoadFailure: diagnostic-event=EventPowerPath102OpenLoadFailure, operation-cycle=DefaultOperationCycle  # Event_Oper_Cycle_Map_Power_Path_102_Open_Load_Failure
  diagnostic event to debounce algorithm mapping EventDebounceMapPowerPath102OpenLoadFailure: debounce-algorithm=time_based, diagnostic-event=EventPowerPath102OpenLoadFailure  # EventDebounceMap_Power_Path_102_Open_Load_Failure
package /ZeC/DTC/DTC/Power_Path_097_Open_Load_Failure
  diagnostic trouble code uds Power_Path_097_Open_Load_Failure: dtc-props=Dtc_Props_9fdbc987, uds-dtc-value=0x005361
  diagnostic event EventPowerPath097OpenLoadFailure: aging-allowed=true, event-kind=SWC, prestorage-freeze-frame=false  # Event_Power_Path_097_Open_Load_Failure
  diagnostic event to trouble code uds mapping EventDtcMapPowerPath097OpenLoadFailure: diagnostic-event=EventPowerPath097OpenLoadFailure, trouble-code-uds=Power_Path_097_Open_Load_Failure  # Event_Dtc_Map_Power_Path_097_Open_Load_Failure
  diagnostic event to operation cycle mapping EventOperCycleMapPowerPath097OpenLoadFailure: diagnostic-event=EventPowerPath097OpenLoadFailure, operation-cycle=DefaultOperationCycle  # Event_Oper_Cycle_Map_Power_Path_097_Open_Load_Failure
  diagnostic event to debounce algorithm mapping EventDebounceMapPowerPath097OpenLoadFailure: debounce-algorithm=time_based, diagnostic-event=EventPowerPath097OpenLoadFailure  # EventDebounceMap_Power_Path_097_Open_Load_Failure
package /ZeC/DTC/DTC/Power_Path_096_Open_Load_Failure
  diagnostic trouble code uds Power_Path_096_Open_Load_Failure: dtc-props=Dtc_Props_d9c2c3bd, uds-dtc-value=0x005360
  diagnostic event EventPowerPath096OpenLoadFailure: aging-allowed=true, event-kind=SWC, prestorage-freeze-frame=false  # Event_Power_Path_096_Open_Load_Failure
  diagnostic event to trouble code uds mapping EventDtcMapPowerPath096OpenLoadFailure: diagnostic-event=EventPowerPath096OpenLoadFailure, trouble-code-uds=Power_Path_096_Open_Load_Failure  # Event_Dtc_Map_Power_Path_096_Open_Load_Failure
  diagnostic event to operation cycle mapping EventOperCycleMapPowerPath096OpenLoadFailure: diagnostic-event=EventPowerPath096OpenLoadFailure, operation-cycle=DefaultOperationCycle  # Event_Oper_Cycle_Map_Power_Path_096_Open_Load_Failure
  diagnostic event to debounce algorithm mapping EventDebounceMapPowerPath096OpenLoadFailure: debounce-algorithm=time_based, diagnostic-event=EventPowerPath096OpenLoadFailure  # EventDebounceMap_Power_Path_096_Open_Load_Failure
package /ZeC/DTC/DTC/Power_Path_099_Open_Load_Failure
  diagnostic trouble code uds Power_Path_099_Open_Load_Failure: dtc-props=Dtc_Props_13e9ddf3, uds-dtc-value=0x005363
  diagnostic event EventPowerPath099OpenLoadFailure: aging-allowed=true, event-kind=SWC, prestorage-freeze-frame=false  # Event_Power_Path_099_Open_Load_Failure
  diagnostic event to trouble code uds mapping EventDtcMapPowerPath099OpenLoadFailure: diagnostic-event=EventPowerPath099OpenLoadFailure, trouble-code-uds=Power_Path_099_Open_Load_Failure  # Event_Dtc_Map_Power_Path_099_Open_Load_Failure
  diagnostic event to operation cycle mapping EventOperCycleMapPowerPath099OpenLoadFailure: diagnostic-event=EventPowerPath099OpenLoadFailure, operation-cycle=DefaultOperationCycle  # Event_Oper_Cycle_Map_Power_Path_099_Open_Load_Failure
  diagnostic event to debounce algorithm mapping EventDebounceMapPowerPath099OpenLoadFailure: debounce-algorithm=time_based, diagnostic-event=EventPowerPath099OpenLoadFailure  # EventDebounceMap_Power_Path_099_Open_Load_Failure
package /ZeC/DTC/DTC/Power_Path_098_Open_Load_Failure
  diagnostic trouble code uds Power_Path_098_Open_Load_Failure: dtc-props=Dtc_Props_55f0d7c9, uds-dtc-value=0x005362
  diagnostic event EventPowerPath098OpenLoadFailure: aging-allowed=true, event-kind=SWC, prestorage-freeze-frame=false  # Event_Power_Path_098_Open_Load_Failure
  diagnostic event to trouble code uds mapping EventDtcMapPowerPath098OpenLoadFailure: diagnostic-event=EventPowerPath098OpenLoadFailure, trouble-code-uds=Power_Path_098_Open_Load_Failure  # Event_Dtc_Map_Power_Path_098_Open_Load_Failure
  diagnostic event to operation cycle mapping EventOperCycleMapPowerPath098OpenLoadFailure: diagnostic-event=EventPowerPath098OpenLoadFailure, operation-cycle=DefaultOperationCycle  # Event_Oper_Cycle_Map_Power_Path_098_Open_Load_Failure
  diagnostic event to debounce algorithm mapping EventDebounceMapPowerPath098OpenLoadFailure: debounce-algorithm=time_based, diagnostic-event=EventPowerPath098OpenLoadFailure  # EventDebounceMap_Power_Path_098_Open_Load_Failure
package /ZeC/DTC/DTC/Power_Path_007_Open_Load_Failure
  diagnostic trouble code uds Power_Path_007_Open_Load_Failure: dtc-props=Dtc_Props_28d17a09, uds-dtc-value=0x005307
  diagnostic event EventPowerPath007OpenLoadFailure: aging-allowed=true, event-kind=SWC, prestorage-freeze-frame=false  # Event_Power_Path_007_Open_Load_Failure
  diagnostic event to trouble code uds mapping EventDtcMapPowerPath007OpenLoadFailure: diagnostic-event=EventPowerPath007OpenLoadFailure, trouble-code-uds=Power_Path_007_Open_Load_Failure  # Event_Dtc_Map_Power_Path_007_Open_Load_Failure
  diagnostic event to operation cycle mapping EventOperCycleMapPowerPath007OpenLoadFailure: diagnostic-event=EventPowerPath007OpenLoadFailure, operation-cycle=DefaultOperationCycle  # Event_Oper_Cycle_Map_Power_Path_007_Open_Load_Failure
  diagnostic event to debounce algorithm mapping EventDebounceMapPowerPath007OpenLoadFailure: debounce-algorithm=time_based, diagnostic-event=EventPowerPath007OpenLoadFailure  # EventDebounceMap_Power_Path_007_Open_Load_Failure
package /ZeC/DTC/DTC/Power_Path_006_Open_Load_Failure
  diagnostic trouble code uds Power_Path_006_Open_Load_Failure: dtc-props=Dtc_Props_6ec87033, uds-dtc-value=0x005306
  diagnostic event EventPowerPath006OpenLoadFailure: aging-allowed=true, event-kind=SWC, prestorage-freeze-frame=false  # Event_Power_Path_006_Open_Load_Failure
  diagnostic event to trouble code uds mapping EventDtcMapPowerPath006OpenLoadFailure: diagnostic-event=EventPowerPath006OpenLoadFailure, trouble-code-uds=Power_Path_006_Open_Load_Failure  # Event_Dtc_Map_Power_Path_006_Open_Load_Failure
  diagnostic event to operation cycle mapping EventOperCycleMapPowerPath006OpenLoadFailure: diagnostic-event=EventPowerPath006OpenLoadFailure, operation-cycle=DefaultOperationCycle  # Event_Oper_Cycle_Map_Power_Path_006_Open_Load_Failure
  diagnostic event to debounce algorithm mapping EventDebounceMapPowerPath006OpenLoadFailure: debounce-algorithm=time_based, diagnostic-event=EventPowerPath006OpenLoadFailure  # EventDebounceMap_Power_Path_006_Open_Load_Failure
package /ZeC/DTC/DTC/Power_Path_009_Open_Load_Failure
  diagnostic trouble code uds Power_Path_009_Open_Load_Failure: dtc-props=Dtc_Props_3aad1bc7, uds-dtc-value=0x005309
  diagnostic event EventPowerPath009OpenLoadFailure: aging-allowed=true, event-kind=SWC, prestorage-freeze-frame=false  # Event_Power_Path_009_Open_Load_Failure
  diagnostic event to trouble code uds mapping EventDtcMapPowerPath009OpenLoadFailure: diagnostic-event=EventPowerPath009OpenLoadFailure, trouble-code-uds=Power_Path_009_Open_Load_Failure  # Event_Dtc_Map_Power_Path_009_Open_Load_Failure
  diagnostic event to operation cycle mapping EventOperCycleMapPowerPath009OpenLoadFailure: diagnostic-event=EventPowerPath009OpenLoadFailure, operation-cycle=DefaultOperationCycle  # Event_Oper_Cycle_Map_Power_Path_009_Open_Load_Failure
  diagnostic event to debounce algorithm mapping EventDebounceMapPowerPath009OpenLoadFailure: debounce-algorithm=time_based, diagnostic-event=EventPowerPath009OpenLoadFailure  # EventDebounceMap_Power_Path_009_Open_Load_Failure
package /ZeC/DTC/DTC/Power_Path_008_Open_Load_Failure
  diagnostic trouble code uds Power_Path_008_Open_Load_Failure: dtc-props=Dtc_Props_7cb411fd, uds-dtc-value=0x005308
  diagnostic event EventPowerPath008OpenLoadFailure: aging-allowed=true, event-kind=SWC, prestorage-freeze-frame=false  # Event_Power_Path_008_Open_Load_Failure
  diagnostic event to trouble code uds mapping EventDtcMapPowerPath008OpenLoadFailure: diagnostic-event=EventPowerPath008OpenLoadFailure, trouble-code-uds=Power_Path_008_Open_Load_Failure  # Event_Dtc_Map_Power_Path_008_Open_Load_Failure
  diagnostic event to operation cycle mapping EventOperCycleMapPowerPath008OpenLoadFailure: diagnostic-event=EventPowerPath008OpenLoadFailure, operation-cycle=DefaultOperationCycle  # Event_Oper_Cycle_Map_Power_Path_008_Open_Load_Failure
  diagnostic event to debounce algorithm mapping EventDebounceMapPowerPath008OpenLoadFailure: debounce-algorithm=time_based, diagnostic-event=EventPowerPath008OpenLoadFailure  # EventDebounceMap_Power_Path_008_Open_Load_Failure
package /ZeC/DTC/DTC/Power_Path_003_Open_Load_Failure
  diagnostic trouble code uds Power_Path_003_Open_Load_Failure: dtc-props=Dtc_Props_ebc454a0, uds-dtc-value=0x005303
  diagnostic event EventPowerPath003OpenLoadFailure: aging-allowed=true, event-kind=SWC, prestorage-freeze-frame=false  # Event_Power_Path_003_Open_Load_Failure
  diagnostic event to trouble code uds mapping EventDtcMapPowerPath003OpenLoadFailure: diagnostic-event=EventPowerPath003OpenLoadFailure, trouble-code-uds=Power_Path_003_Open_Load_Failure  # Event_Dtc_Map_Power_Path_003_Open_Load_Failure
  diagnostic event to operation cycle mapping EventOperCycleMapPowerPath003OpenLoadFailure: diagnostic-event=EventPowerPath003OpenLoadFailure, operation-cycle=DefaultOperationCycle  # Event_Oper_Cycle_Map_Power_Path_003_Open_Load_Failure
  diagnostic event to debounce algorithm mapping EventDebounceMapPowerPath003OpenLoadFailure: debounce-algorithm=time_based, diagnostic-event=EventPowerPath003OpenLoadFailure  # EventDebounceMap_Power_Path_003_Open_Load_Failure
package /ZeC/DTC/DTC/Power_Path_135_Over_Temperature_Failure
  diagnostic trouble code uds Power_Path_135_Over_Temperature_Failure: dtc-props=Dtc_Props_ac32608c, uds-dtc-value=0x005787
  diagnostic event EventPowerPath135OverTemperatureFailure: aging-allowed=true, event-kind=SWC, prestorage-freeze-frame=false  # Event_Power_Path_135_Over_Temperature_Failure
  diagnostic event to trouble code uds mapping EventDtcMapPowerPath135OverTemperatureFailure: diagnostic-event=EventPowerPath135OverTemperatureFailure, trouble-code-uds=Power_Path_135_Over_Temperature_Failure  # Event_Dtc_Map_Power_Path_135_Over_Temperature_Failure
  diagnostic event to operation cycle mapping EventOperCycleMapPowerPath135OverTemperatureFailure: diagnostic-event=EventPowerPath135OverTemperatureFailure, operation-cycle=DefaultOperationCycle  # Event_Oper_Cycle_Map_Power_Path_135_Over_Temperature_Failure
  diagnostic event to debounce algorithm mapping EventDebounceMapPowerPath135OverTemperatureFailure: debounce-algorithm=time_based, diagnostic-event=EventPowerPath135OverTemperatureFailure  # EventDebounceMap_Power_Path_135_Over_Temperature_Failure
package /ZeC/DTC/DTC/Power_Path_002_Open_Load_Failure
  diagnostic trouble code uds Power_Path_002_Open_Load_Failure: dtc-props=Dtc_Props_addd5e9a, uds-dtc-value=0x005302
  diagnostic event EventPowerPath002OpenLoadFailure: aging-allowed=true, event-kind=SWC, prestorage-freeze-frame=false  # Event_Power_Path_002_Open_Load_Failure
  diagnostic event to trouble code uds mapping EventDtcMapPowerPath002OpenLoadFailure: diagnostic-event=EventPowerPath002OpenLoadFailure, trouble-code-uds=Power_Path_002_Open_Load_Failure  # Event_Dtc_Map_Power_Path_002_Open_Load_Failure
  diagnostic event to operation cycle mapping EventOperCycleMapPowerPath002OpenLoadFailure: diagnostic-event=EventPowerPath002OpenLoadFailure, operation-cycle=DefaultOperationCycle  # Event_Oper_Cycle_Map_Power_Path_002_Open_Load_Failure
  diagnostic event to debounce algorithm mapping EventDebounceMapPowerPath002OpenLoadFailure: debounce-algorithm=time_based, diagnostic-event=EventPowerPath002OpenLoadFailure  # EventDebounceMap_Power_Path_002_Open_Load_Failure
package /ZeC/DTC/DTC/Power_Path_134_Over_Temperature_Failure
  diagnostic trouble code uds Power_Path_134_Over_Temperature_Failure: dtc-props=Dtc_Props_ea2b6ab6, uds-dtc-value=0x005786
  diagnostic event EventPowerPath134OverTemperatureFailure: aging-allowed=true, event-kind=SWC, prestorage-freeze-frame=false  # Event_Power_Path_134_Over_Temperature_Failure
  diagnostic event to trouble code uds mapping EventDtcMapPowerPath134OverTemperatureFailure: diagnostic-event=EventPowerPath134OverTemperatureFailure, trouble-code-uds=Power_Path_134_Over_Temperature_Failure  # Event_Dtc_Map_Power_Path_134_Over_Temperature_Failure
  diagnostic event to operation cycle mapping EventOperCycleMapPowerPath134OverTemperatureFailure: diagnostic-event=EventPowerPath134OverTemperatureFailure, operation-cycle=DefaultOperationCycle  # Event_Oper_Cycle_Map_Power_Path_134_Over_Temperature_Failure
  diagnostic event to debounce algorithm mapping EventDebounceMapPowerPath134OverTemperatureFailure: debounce-algorithm=time_based, diagnostic-event=EventPowerPath134OverTemperatureFailure  # EventDebounceMap_Power_Path_134_Over_Temperature_Failure
package /ZeC/DTC/DTC/Power_Path_005_Open_Load_Failure
  diagnostic trouble code uds Power_Path_005_Open_Load_Failure: dtc-props=Dtc_Props_a4e36e7d, uds-dtc-value=0x005305
  diagnostic event EventPowerPath005OpenLoadFailure: aging-allowed=true, event-kind=SWC, prestorage-freeze-frame=false  # Event_Power_Path_005_Open_Load_Failure
  diagnostic event to trouble code uds mapping EventDtcMapPowerPath005OpenLoadFailure: diagnostic-event=EventPowerPath005OpenLoadFailure, trouble-code-uds=Power_Path_005_Open_Load_Failure  # Event_Dtc_Map_Power_Path_005_Open_Load_Failure
  diagnostic event to operation cycle mapping EventOperCycleMapPowerPath005OpenLoadFailure: diagnostic-event=EventPowerPath005OpenLoadFailure, operation-cycle=DefaultOperationCycle  # Event_Oper_Cycle_Map_Power_Path_005_Open_Load_Failure
  diagnostic event to debounce algorithm mapping EventDebounceMapPowerPath005OpenLoadFailure: debounce-algorithm=time_based, diagnostic-event=EventPowerPath005OpenLoadFailure  # EventDebounceMap_Power_Path_005_Open_Load_Failure
package /ZeC/DTC/DTC/Power_Path_137_Over_Temperature_Failure
  diagnostic trouble code uds Power_Path_137_Over_Temperature_Failure: dtc-props=Dtc_Props_be4e0142, uds-dtc-value=0x005789
  diagnostic event EventPowerPath137OverTemperatureFailure: aging-allowed=true, event-kind=SWC, prestorage-freeze-frame=false  # Event_Power_Path_137_Over_Temperature_Failure
  diagnostic event to trouble code uds mapping EventDtcMapPowerPath137OverTemperatureFailure: diagnostic-event=EventPowerPath137OverTemperatureFailure, trouble-code-uds=Power_Path_137_Over_Temperature_Failure  # Event_Dtc_Map_Power_Path_137_Over_Temperature_Failure
  diagnostic event to operation cycle mapping EventOperCycleMapPowerPath137OverTemperatureFailure: diagnostic-event=EventPowerPath137OverTemperatureFailure, operation-cycle=DefaultOperationCycle  # Event_Oper_Cycle_Map_Power_Path_137_Over_Temperature_Failure
  diagnostic event to debounce algorithm mapping EventDebounceMapPowerPath137OverTemperatureFailure: debounce-algorithm=time_based, diagnostic-event=EventPowerPath137OverTemperatureFailure  # EventDebounceMap_Power_Path_137_Over_Temperature_Failure
package /ZeC/DTC/DTC/Power_Path_004_Open_Load_Failure
  diagnostic trouble code uds Power_Path_004_Open_Load_Failure: dtc-props=Dtc_Props_e2fa6447, uds-dtc-value=0x005304
  diagnostic event EventPowerPath004OpenLoadFailure: aging-allowed=true, event-kind=SWC, prestorage-freeze-frame=false  # Event_Power_Path_004_Open_Load_Failure
  diagnostic event to trouble code uds mapping EventDtcMapPowerPath004OpenLoadFailure: diagnostic-event=EventPowerPath004OpenLoadFailure, trouble-code-uds=Power_Path_004_Open_Load_Failure  # Event_Dtc_Map_Power_Path_004_Open_Load_Failure
  diagnostic event to operation cycle mapping EventOperCycleMapPowerPath004OpenLoadFailure: diagnostic-event=EventPowerPath004OpenLoadFailure, operation-cycle=DefaultOperationCycle  # Event_Oper_Cycle_Map_Power_Path_004_Open_Load_Failure
  diagnostic event to debounce algorithm mapping EventDebounceMapPowerPath004OpenLoadFailure: debounce-algorithm=time_based, diagnostic-event=EventPowerPath004OpenLoadFailure  # EventDebounceMap_Power_Path_004_Open_Load_Failure
package /ZeC/DTC/DTC/Power_Path_136_Over_Temperature_Failure
  diagnostic trouble code uds Power_Path_136_Over_Temperature_Failure: dtc-props=Dtc_Props_f8570b78, uds-dtc-value=0x005788
  diagnostic event EventPowerPath136OverTemperatureFailure: aging-allowed=true, event-kind=SWC, prestorage-freeze-frame=false  # Event_Power_Path_136_Over_Temperature_Failure
  diagnostic event to trouble code uds mapping EventDtcMapPowerPath136OverTemperatureFailure: diagnostic-event=EventPowerPath136OverTemperatureFailure, trouble-code-uds=Power_Path_136_Over_Temperature_Failure  # Event_Dtc_Map_Power_Path_136_Over_Temperature_Failure
  diagnostic event to operation cycle mapping EventOperCycleMapPowerPath136OverTemperatureFailure: diagnostic-event=EventPowerPath136OverTemperatureFailure, operation-cycle=DefaultOperationCycle  # Event_Oper_Cycle_Map_Power_Path_136_Over_Temperature_Failure
  diagnostic event to debounce algorithm mapping EventDebounceMapPowerPath136OverTemperatureFailure: debounce-algorithm=time_based, diagnostic-event=EventPowerPath136OverTemperatureFailure  # EventDebounceMap_Power_Path_136_Over_Temperature_Failure
package /ZeC/DTC/DTC/Power_Path_140_Over_Temperature_Failure
  diagnostic trouble code uds Power_Path_140_Over_Temperature_Failure: dtc-props=Dtc_Props_52d82a58, uds-dtc-value=0x00578c
  diagnostic event EventPowerPath140OverTemperatureFailure: aging-allowed=true, event-kind=SWC, prestorage-freeze-frame=false  # Event_Power_Path_140_Over_Temperature_Failure
  diagnostic event to trouble code uds mapping EventDtcMapPowerPath140OverTemperatureFailure: diagnostic-event=EventPowerPath140OverTemperatureFailure, trouble-code-uds=Power_Path_140_Over_Temperature_Failure  # Event_Dtc_Map_Power_Path_140_Over_Temperature_Failure
  diagnostic event to operation cycle mapping EventOperCycleMapPowerPath140OverTemperatureFailure: diagnostic-event=EventPowerPath140OverTemperatureFailure, operation-cycle=DefaultOperationCycle  # Event_Oper_Cycle_Map_Power_Path_140_Over_Temperature_Failure
  diagnostic event to debounce algorithm mapping EventDebounceMapPowerPath140OverTemperatureFailure: debounce-algorithm=time_based, diagnostic-event=EventPowerPath140OverTemperatureFailure  # EventDebounceMap_Power_Path_140_Over_Temperature_Failure
package /ZeC/DTC/DTC/Power_Path_139_Over_Temperature_Failure
  diagnostic trouble code uds Power_Path_139_Over_Temperature_Failure: dtc-props=Dtc_Props_14c12062, uds-dtc-value=0x00578b
  diagnostic event EventPowerPath139OverTemperatureFailure: aging-allowed=true, event-kind=SWC, prestorage-freeze-frame=false  # Event_Power_Path_139_Over_Temperature_Failure
  diagnostic event to trouble code uds mapping EventDtcMapPowerPath139OverTemperatureFailure: diagnostic-event=EventPowerPath139OverTemperatureFailure, trouble-code-uds=Power_Path_139_Over_Temperature_Failure  # Event_Dtc_Map_Power_Path_139_Over_Temperature_Failure
  diagnostic event to operation cycle mapping EventOperCycleMapPowerPath139OverTemperatureFailure: diagnostic-event=EventPowerPath139OverTemperatureFailure, operation-cycle=DefaultOperationCycle  # Event_Oper_Cycle_Map_Power_Path_139_Over_Temperature_Failure
  diagnostic event to debounce algorithm mapping EventDebounceMapPowerPath139OverTemperatureFailure: debounce-algorithm=time_based, diagnostic-event=EventPowerPath139OverTemperatureFailure  # EventDebounceMap_Power_Path_139_Over_Temperature_Failure
package /ZeC/DTC/DTC/Power_Path_142_Over_Temperature_Failure
  diagnostic trouble code uds Power_Path_142_Over_Temperature_Failure: dtc-props=Dtc_Props_1dff1085, uds-dtc-value=0x00578e
  diagnostic event EventPowerPath142OverTemperatureFailure: aging-allowed=true, event-kind=SWC, prestorage-freeze-frame=false  # Event_Power_Path_142_Over_Temperature_Failure
  diagnostic event to trouble code uds mapping EventDtcMapPowerPath142OverTemperatureFailure: diagnostic-event=EventPowerPath142OverTemperatureFailure, trouble-code-uds=Power_Path_142_Over_Temperature_Failure  # Event_Dtc_Map_Power_Path_142_Over_Temperature_Failure
  diagnostic event to operation cycle mapping EventOperCycleMapPowerPath142OverTemperatureFailure: diagnostic-event=EventPowerPath142OverTemperatureFailure, operation-cycle=DefaultOperationCycle  # Event_Oper_Cycle_Map_Power_Path_142_Over_Temperature_Failure
  diagnostic event to debounce algorithm mapping EventDebounceMapPowerPath142OverTemperatureFailure: debounce-algorithm=time_based, diagnostic-event=EventPowerPath142OverTemperatureFailure  # EventDebounceMap_Power_Path_142_Over_Temperature_Failure
package /ZeC/DTC/DTC/Power_Path_010_Open_Load_Failure
  diagnostic trouble code uds Power_Path_010_Open_Load_Failure: dtc-props=Dtc_Props_5a0924a9, uds-dtc-value=0x00530a
  diagnostic event EventPowerPath010OpenLoadFailure: aging-allowed=true, event-kind=SWC, prestorage-freeze-frame=false  # Event_Power_Path_010_Open_Load_Failure
  diagnostic event to trouble code uds mapping EventDtcMapPowerPath010OpenLoadFailure: diagnostic-event=EventPowerPath010OpenLoadFailure, trouble-code-uds=Power_Path_010_Open_Load_Failure  # Event_Dtc_Map_Power_Path_010_Open_Load_Failure
  diagnostic event to operation cycle mapping EventOperCycleMapPowerPath010OpenLoadFailure: diagnostic-event=EventPowerPath010OpenLoadFailure, operation-cycle=DefaultOperationCycle  # Event_Oper_Cycle_Map_Power_Path_010_Open_Load_Failure
  diagnostic event to debounce algorithm mapping EventDebounceMapPowerPath010OpenLoadFailure: debounce-algorithm=time_based, diagnostic-event=EventPowerPath010OpenLoadFailure  # EventDebounceMap_Power_Path_010_Open_Load_Failure
package /ZeC/DTC/DTC/Power_Path_141_Over_Temperature_Failure
  diagnostic trouble code uds Power_Path_141_Over_Temperature_Failure: dtc-props=Dtc_Props_5be61abf, uds-dtc-value=0x00578d
  diagnostic event EventPowerPath141OverTemperatureFailure: aging-allowed=true, event-kind=SWC, prestorage-freeze-frame=false  # Event_Power_Path_141_Over_Temperature_Failure
  diagnostic event to trouble code uds mapping EventDtcMapPowerPath141OverTemperatureFailure: diagnostic-event=EventPowerPath141OverTemperatureFailure, trouble-code-uds=Power_Path_141_Over_Temperature_Failure  # Event_Dtc_Map_Power_Path_141_Over_Temperature_Failure
  diagnostic event to operation cycle mapping EventOperCycleMapPowerPath141OverTemperatureFailure: diagnostic-event=EventPowerPath141OverTemperatureFailure, operation-cycle=DefaultOperationCycle  # Event_Oper_Cycle_Map_Power_Path_141_Over_Temperature_Failure
  diagnostic event to debounce algorithm mapping EventDebounceMapPowerPath141OverTemperatureFailure: debounce-algorithm=time_based, diagnostic-event=EventPowerPath141OverTemperatureFailure  # EventDebounceMap_Power_Path_141_Over_Temperature_Failure
package /ZeC/DTC/DTC/Power_Path_138_Over_Temperature_Failure
  diagnostic trouble code uds Power_Path_138_Over_Temperature_Failure: dtc-props=Dtc_Props_deea3e2c, uds-dtc-value=0x00578a
  diagnostic event EventPowerPath138OverTemperatureFailure: aging-allowed=true, event-kind=SWC, prestorage-freeze-frame=false  # Event_Power_Path_138_Over_Temperature_Failure
  diagnostic event to trouble code uds mapping EventDtcMapPowerPath138OverTemperatureFailure: diagnostic-event=EventPowerPath138OverTemperatureFailure, trouble-code-uds=Power_Path_138_Over_Temperature_Failure  # Event_Dtc_Map_Power_Path_138_Over_Temperature_Failure
  diagnostic event to operation cycle mapping EventOperCycleMapPowerPath138OverTemperatureFailure: diagnostic-event=EventPowerPath138OverTemperatureFailure, operation-cycle=DefaultOperationCycle  # Event_Oper_Cycle_Map_Power_Path_138_Over_Temperature_Failure
  diagnostic event to debounce algorithm mapping EventDebounceMapPowerPath138OverTemperatureFailure: debounce-algorithm=time_based, diagnostic-event=EventPowerPath138OverTemperatureFailure  # EventDebounceMap_Power_Path_138_Over_Temperature_Failure
package /ZeC/DTC/DTC/Power_Path_015_Open_Load_Failure
  diagnostic trouble code uds Power_Path_015_Open_Load_Failure: dtc-props=Dtc_Props_5337144e, uds-dtc-value=0x00530f
  diagnostic event EventPowerPath015OpenLoadFailure: aging-allowed=true, event-kind=SWC, prestorage-freeze-frame=false  # Event_Power_Path_015_Open_Load_Failure
  diagnostic event to trouble code uds mapping EventDtcMapPowerPath015OpenLoadFailure: diagnostic-event=EventPowerPath015OpenLoadFailure, trouble-code-uds=Power_Path_015_Open_Load_Failure  # Event_Dtc_Map_Power_Path_015_Open_Load_Failure
  diagnostic event to operation cycle mapping EventOperCycleMapPowerPath015OpenLoadFailure: diagnostic-event=EventPowerPath015OpenLoadFailure, operation-cycle=DefaultOperationCycle  # Event_Oper_Cycle_Map_Power_Path_015_Open_Load_Failure
  diagnostic event to debounce algorithm mapping EventDebounceMapPowerPath015OpenLoadFailure: debounce-algorithm=time_based, diagnostic-event=EventPowerPath015OpenLoadFailure  # EventDebounceMap_Power_Path_015_Open_Load_Failure
package /ZeC/DTC/DTC/Power_Path_012_Open_Load_Failure
  diagnostic trouble code uds Power_Path_012_Open_Load_Failure: dtc-props=Dtc_Props_d63b30dd, uds-dtc-value=0x00530c
  diagnostic event EventPowerPath012OpenLoadFailure: aging-allowed=true, event-kind=SWC, prestorage-freeze-frame=false  # Event_Power_Path_012_Open_Load_Failure
  diagnostic event to trouble code uds mapping EventDtcMapPowerPath012OpenLoadFailure: diagnostic-event=EventPowerPath012OpenLoadFailure, trouble-code-uds=Power_Path_012_Open_Load_Failure  # Event_Dtc_Map_Power_Path_012_Open_Load_Failure
  diagnostic event to operation cycle mapping EventOperCycleMapPowerPath012OpenLoadFailure: diagnostic-event=EventPowerPath012OpenLoadFailure, operation-cycle=DefaultOperationCycle  # Event_Oper_Cycle_Map_Power_Path_012_Open_Load_Failure
  diagnostic event to debounce algorithm mapping EventDebounceMapPowerPath012OpenLoadFailure: debounce-algorithm=time_based, diagnostic-event=EventPowerPath012OpenLoadFailure  # EventDebounceMap_Power_Path_012_Open_Load_Failure
package /ZeC/DTC/DTC/Power_Path_143_Over_Temperature_Failure
  diagnostic trouble code uds Power_Path_143_Over_Temperature_Failure: dtc-props=Dtc_Props_d7d40ecb, uds-dtc-value=0x00578f
  diagnostic event EventPowerPath143OverTemperatureFailure: aging-allowed=true, event-kind=SWC, prestorage-freeze-frame=false  # Event_Power_Path_143_Over_Temperature_Failure
  diagnostic event to trouble code uds mapping EventDtcMapPowerPath143OverTemperatureFailure: diagnostic-event=EventPowerPath143OverTemperatureFailure, trouble-code-uds=Power_Path_143_Over_Temperature_Failure  # Event_Dtc_Map_Power_Path_143_Over_Temperature_Failure
  diagnostic event to operation cycle mapping EventOperCycleMapPowerPath143OverTemperatureFailure: diagnostic-event=EventPowerPath143OverTemperatureFailure, operation-cycle=DefaultOperationCycle  # Event_Oper_Cycle_Map_Power_Path_143_Over_Temperature_Failure
  diagnostic event to debounce algorithm mapping EventDebounceMapPowerPath143OverTemperatureFailure: debounce-algorithm=time_based, diagnostic-event=EventPowerPath143OverTemperatureFailure  # EventDebounceMap_Power_Path_143_Over_Temperature_Failure
package /ZeC/DTC/DTC/Power_Path_011_Open_Load_Failure
  diagnostic trouble code uds Power_Path_011_Open_Load_Failure: dtc-props=Dtc_Props_90223ae7, uds-dtc-value=0x00530b
  diagnostic event EventPowerPath011OpenLoadFailure: aging-allowed=true, event-kind=SWC, prestorage-freeze-frame=false  # Event_Power_Path_011_Open_Load_Failure
  diagnostic event to trouble code uds mapping EventDtcMapPowerPath011OpenLoadFailure: diagnostic-event=EventPowerPath011OpenLoadFailure, trouble-code-uds=Power_Path_011_Open_Load_Failure  # Event_Dtc_Map_Power_Path_011_Open_Load_Failure
  diagnostic event to operation cycle mapping EventOperCycleMapPowerPath011OpenLoadFailure: diagnostic-event=EventPowerPath011OpenLoadFailure, operation-cycle=DefaultOperationCycle  # Event_Oper_Cycle_Map_Power_Path_011_Open_Load_Failure
  diagnostic event to debounce algorithm mapping EventDebounceMapPowerPath011OpenLoadFailure: debounce-algorithm=time_based, diagnostic-event=EventPowerPath011OpenLoadFailure  # EventDebounceMap_Power_Path_011_Open_Load_Failure
package /ZeC/DTC/DTC/Power_Path_014_Open_Load_Failure
  diagnostic trouble code uds Power_Path_014_Open_Load_Failure: dtc-props=Dtc_Props_991c0a00, uds-dtc-value=0x00530e
  diagnostic event EventPowerPath014OpenLoadFailure: aging-allowed=true, event-kind=SWC, prestorage-freeze-frame=false  # Event_Power_Path_014_Open_Load_Failure
  diagnostic event to trouble code uds mapping EventDtcMapPowerPath014OpenLoadFailure: diagnostic-event=EventPowerPath014OpenLoadFailure, trouble-code-uds=Power_Path_014_Open_Load_Failure  # Event_Dtc_Map_Power_Path_014_Open_Load_Failure
  diagnostic event to operation cycle mapping EventOperCycleMapPowerPath014OpenLoadFailure: diagnostic-event=EventPowerPath014OpenLoadFailure, operation-cycle=DefaultOperationCycle  # Event_Oper_Cycle_Map_Power_Path_014_Open_Load_Failure
  diagnostic event to debounce algorithm mapping EventDebounceMapPowerPath014OpenLoadFailure: debounce-algorithm=time_based, diagnostic-event=EventPowerPath014OpenLoadFailure  # EventDebounceMap_Power_Path_014_Open_Load_Failure
package /ZeC/DTC/DTC/Power_Path_013_Open_Load_Failure
  diagnostic trouble code uds Power_Path_013_Open_Load_Failure: dtc-props=Dtc_Props_df05003a, uds-dtc-value=0x00530d
  diagnostic event EventPowerPath013OpenLoadFailure: aging-allowed=true, event-kind=SWC, prestorage-freeze-frame=false  # Event_Power_Path_013_Open_Load_Failure
  diagnostic event to trouble code uds mapping EventDtcMapPowerPath013OpenLoadFailure: diagnostic-event=EventPowerPath013OpenLoadFailure, trouble-code-uds=Power_Path_013_Open_Load_Failure  # Event_Dtc_Map_Power_Path_013_Open_Load_Failure
  diagnostic event to operation cycle mapping EventOperCycleMapPowerPath013OpenLoadFailure: diagnostic-event=EventPowerPath013OpenLoadFailure, operation-cycle=DefaultOperationCycle  # Event_Oper_Cycle_Map_Power_Path_013_Open_Load_Failure
  diagnostic event to debounce algorithm mapping EventDebounceMapPowerPath013OpenLoadFailure: debounce-algorithm=time_based, diagnostic-event=EventPowerPath013OpenLoadFailure  # EventDebounceMap_Power_Path_013_Open_Load_Failure
package /ZeC/DTC/DTC/Power_Path_148_Over_Temperature_Failure
  diagnostic trouble code uds Power_Path_148_Over_Temperature_Failure: dtc-props=Dtc_Props_a053be7a, uds-dtc-value=0x005794
  diagnostic event EventPowerPath148OverTemperatureFailure: aging-allowed=true, event-kind=SWC, prestorage-freeze-frame=false  # Event_Power_Path_148_Over_Temperature_Failure
  diagnostic event to trouble code uds mapping EventDtcMapPowerPath148OverTemperatureFailure: diagnostic-event=EventPowerPath148OverTemperatureFailure, trouble-code-uds=Power_Path_148_Over_Temperature_Failure  # Event_Dtc_Map_Power_Path_148_Over_Temperature_Failure
  diagnostic event to operation cycle mapping EventOperCycleMapPowerPath148OverTemperatureFailure: diagnostic-event=EventPowerPath148OverTemperatureFailure, operation-cycle=DefaultOperationCycle  # Event_Oper_Cycle_Map_Power_Path_148_Over_Temperature_Failure
  diagnostic event to debounce algorithm mapping EventDebounceMapPowerPath148OverTemperatureFailure: debounce-algorithm=time_based, diagnostic-event=EventPowerPath148OverTemperatureFailure  # EventDebounceMap_Power_Path_148_Over_Temperature_Failure
package /ZeC/DTC/DTC/Power_Path_016_Open_Load_Failure
  diagnostic trouble code uds Power_Path_016_Open_Load_Failure: dtc-props=Dtc_Props_e7a58a56, uds-dtc-value=0x005310
  diagnostic event EventPowerPath016OpenLoadFailure: aging-allowed=true, event-kind=SWC, prestorage-freeze-frame=false  # Event_Power_Path_016_Open_Load_Failure
  diagnostic event to trouble code uds mapping EventDtcMapPowerPath016OpenLoadFailure: diagnostic-event=EventPowerPath016OpenLoadFailure, trouble-code-uds=Power_Path_016_Open_Load_Failure  # Event_Dtc_Map_Power_Path_016_Open_Load_Failure
  diagnostic event to operation cycle mapping EventOperCycleMapPowerPath016OpenLoadFailure: diagnostic-event=EventPowerPath016OpenLoadFailure, operation-cycle=DefaultOperationCycle  # Event_Oper_Cycle_Map_Power_Path_016_Open_Load_Failure
  diagnostic event to debounce algorithm mapping EventDebounceMapPowerPath016OpenLoadFailure: debounce-algorithm=time_based, diagnostic-event=EventPowerPath016OpenLoadFailure  # EventDebounceMap_Power_Path_016_Open_Load_Failure
package /ZeC/DTC/DTC/Power_Path_147_Over_Temperature_Failure
  diagnostic trouble code uds Power_Path_147_Over_Temperature_Failure: dtc-props=Dtc_Props_a96d8e9d, uds-dtc-value=0x005793
  diagnostic event EventPowerPath147OverTemperatureFailure: aging-allowed=true, event-kind=SWC, prestorage-freeze-frame=false  # Event_Power_Path_147_Over_Temperature_Failure
  diagnostic event to trouble code uds mapping EventDtcMapPowerPath147OverTemperatureFailure: diagnostic-event=EventPowerPath147OverTemperatureFailure, trouble-code-uds=Power_Path_147_Over_Temperature_Failure  # Event_Dtc_Map_Power_Path_147_Over_Temperature_Failure
  diagnostic event to operation cycle mapping EventOperCycleMapPowerPath147OverTemperatureFailure: diagnostic-event=EventPowerPath147OverTemperatureFailure, operation-cycle=DefaultOperationCycle  # Event_Oper_Cycle_Map_Power_Path_147_Over_Temperature_Failure
  diagnostic event to debounce algorithm mapping EventDebounceMapPowerPath147OverTemperatureFailure: debounce-algorithm=time_based, diagnostic-event=EventPowerPath147OverTemperatureFailure  # EventDebounceMap_Power_Path_147_Over_Temperature_Failure
package /ZeC/DTC/DTC/Power_Path_150_Over_Temperature_Failure
  diagnostic trouble code uds Power_Path_150_Over_Temperature_Failure: dtc-props=Dtc_Props_2c61aa0e, uds-dtc-value=0x005796
  diagnostic event EventPowerPath150OverTemperatureFailure: aging-allowed=true, event-kind=SWC, prestorage-freeze-frame=false  # Event_Power_Path_150_Over_Temperature_Failure
  diagnostic event to trouble code uds mapping EventDtcMapPowerPath150OverTemperatureFailure: diagnostic-event=EventPowerPath150OverTemperatureFailure, trouble-code-uds=Power_Path_150_Over_Temperature_Failure  # Event_Dtc_Map_Power_Path_150_Over_Temperature_Failure
  diagnostic event to operation cycle mapping EventOperCycleMapPowerPath150OverTemperatureFailure: diagnostic-event=EventPowerPath150OverTemperatureFailure, operation-cycle=DefaultOperationCycle  # Event_Oper_Cycle_Map_Power_Path_150_Over_Temperature_Failure
  diagnostic event to debounce algorithm mapping EventDebounceMapPowerPath150OverTemperatureFailure: debounce-algorithm=time_based, diagnostic-event=EventPowerPath150OverTemperatureFailure  # EventDebounceMap_Power_Path_150_Over_Temperature_Failure
package /ZeC/DTC/DTC/Power_Path_018_Open_Load_Failure
  diagnostic trouble code uds Power_Path_018_Open_Load_Failure: dtc-props=Dtc_Props_6b979e22, uds-dtc-value=0x005312
  diagnostic event EventPowerPath018OpenLoadFailure: aging-allowed=true, event-kind=SWC, prestorage-freeze-frame=false  # Event_Power_Path_018_Open_Load_Failure
  diagnostic event to trouble code uds mapping EventDtcMapPowerPath018OpenLoadFailure: diagnostic-event=EventPowerPath018OpenLoadFailure, trouble-code-uds=Power_Path_018_Open_Load_Failure  # Event_Dtc_Map_Power_Path_018_Open_Load_Failure
  diagnostic event to operation cycle mapping EventOperCycleMapPowerPath018OpenLoadFailure: diagnostic-event=EventPowerPath018OpenLoadFailure, operation-cycle=DefaultOperationCycle  # Event_Oper_Cycle_Map_Power_Path_018_Open_Load_Failure
  diagnostic event to debounce algorithm mapping EventDebounceMapPowerPath018OpenLoadFailure: debounce-algorithm=time_based, diagnostic-event=EventPowerPath018OpenLoadFailure  # EventDebounceMap_Power_Path_018_Open_Load_Failure
package /ZeC/DTC/DTC/Power_Path_149_Over_Temperature_Failure
  diagnostic trouble code uds Power_Path_149_Over_Temperature_Failure: dtc-props=Dtc_Props_e64ab440, uds-dtc-value=0x005795
  diagnostic event EventPowerPath149OverTemperatureFailure: aging-allowed=true, event-kind=SWC, prestorage-freeze-frame=false  # Event_Power_Path_149_Over_Temperature_Failure
  diagnostic event to trouble code uds mapping EventDtcMapPowerPath149OverTemperatureFailure: diagnostic-event=EventPowerPath149OverTemperatureFailure, trouble-code-uds=Power_Path_149_Over_Temperature_Failure  # Event_Dtc_Map_Power_Path_149_Over_Temperature_Failure
  diagnostic event to operation cycle mapping EventOperCycleMapPowerPath149OverTemperatureFailure: diagnostic-event=EventPowerPath149OverTemperatureFailure, operation-cycle=DefaultOperationCycle  # Event_Oper_Cycle_Map_Power_Path_149_Over_Temperature_Failure
  diagnostic event to debounce algorithm mapping EventDebounceMapPowerPath149OverTemperatureFailure: debounce-algorithm=time_based, diagnostic-event=EventPowerPath149OverTemperatureFailure  # EventDebounceMap_Power_Path_149_Over_Temperature_Failure
package /ZeC/DTC/DTC/Power_Path_017_Open_Load_Failure
  diagnostic trouble code uds Power_Path_017_Open_Load_Failure: dtc-props=Dtc_Props_a1bc806c, uds-dtc-value=0x005311
  diagnostic event EventPowerPath017OpenLoadFailure: aging-allowed=true, event-kind=SWC, prestorage-freeze-frame=false  # Event_Power_Path_017_Open_Load_Failure
  diagnostic event to trouble code uds mapping EventDtcMapPowerPath017OpenLoadFailure: diagnostic-event=EventPowerPath017OpenLoadFailure, trouble-code-uds=Power_Path_017_Open_Load_Failure  # Event_Dtc_Map_Power_Path_017_Open_Load_Failure
  diagnostic event to operation cycle mapping EventOperCycleMapPowerPath017OpenLoadFailure: diagnostic-event=EventPowerPath017OpenLoadFailure, operation-cycle=DefaultOperationCycle  # Event_Oper_Cycle_Map_Power_Path_017_Open_Load_Failure
  diagnostic event to debounce algorithm mapping EventDebounceMapPowerPath017OpenLoadFailure: debounce-algorithm=time_based, diagnostic-event=EventPowerPath017OpenLoadFailure  # EventDebounceMap_Power_Path_017_Open_Load_Failure
package /ZeC/DTC/DTC/Power_Path_144_Over_Temperature_Failure
  diagnostic trouble code uds Power_Path_144_Over_Temperature_Failure: dtc-props=Dtc_Props_634690d3, uds-dtc-value=0x005790
  diagnostic event EventPowerPath144OverTemperatureFailure: aging-allowed=true, event-kind=SWC, prestorage-freeze-frame=false  # Event_Power_Path_144_Over_Temperature_Failure
  diagnostic event to trouble code uds mapping EventDtcMapPowerPath144OverTemperatureFailure: diagnostic-event=EventPowerPath144OverTemperatureFailure, trouble-code-uds=Power_Path_144_Over_Temperature_Failure  # Event_Dtc_Map_Power_Path_144_Over_Temperature_Failure
  diagnostic event to operation cycle mapping EventOperCycleMapPowerPath144OverTemperatureFailure: diagnostic-event=EventPowerPath144OverTemperatureFailure, operation-cycle=DefaultOperationCycle  # Event_Oper_Cycle_Map_Power_Path_144_Over_Temperature_Failure
  diagnostic event to debounce algorithm mapping EventDebounceMapPowerPath144OverTemperatureFailure: debounce-algorithm=time_based, diagnostic-event=EventPowerPath144OverTemperatureFailure  # EventDebounceMap_Power_Path_144_Over_Temperature_Failure
package /ZeC/DTC/DTC/Power_Path_146_Over_Temperature_Failure
  diagnostic trouble code uds Power_Path_146_Over_Temperature_Failure: dtc-props=Dtc_Props_ef7484a7, uds-dtc-value=0x005792
  diagnostic event EventPowerPath146OverTemperatureFailure: aging-allowed=true, event-kind=SWC, prestorage-freeze-frame=false  # Event_Power_Path_146_Over_Temperature_Failure
  diagnostic event to trouble code uds mapping EventDtcMapPowerPath146OverTemperatureFailure: diagnostic-event=EventPowerPath146OverTemperatureFailure, trouble-code-uds=Power_Path_146_Over_Temperature_Failure  # Event_Dtc_Map_Power_Path_146_Over_Temperature_Failure
  diagnostic event to operation cycle mapping EventOperCycleMapPowerPath146OverTemperatureFailure: diagnostic-event=EventPowerPath146OverTemperatureFailure, operation-cycle=DefaultOperationCycle  # Event_Oper_Cycle_Map_Power_Path_146_Over_Temperature_Failure
  diagnostic event to debounce algorithm mapping EventDebounceMapPowerPath146OverTemperatureFailure: debounce-algorithm=time_based, diagnostic-event=EventPowerPath146OverTemperatureFailure  # EventDebounceMap_Power_Path_146_Over_Temperature_Failure
package /ZeC/DTC/DTC/Power_Path_145_Over_Temperature_Failure
  diagnostic trouble code uds Power_Path_145_Over_Temperature_Failure: dtc-props=Dtc_Props_255f9ae9, uds-dtc-value=0x005791
  diagnostic event EventPowerPath145OverTemperatureFailure: aging-allowed=true, event-kind=SWC, prestorage-freeze-frame=false  # Event_Power_Path_145_Over_Temperature_Failure
  diagnostic event to trouble code uds mapping EventDtcMapPowerPath145OverTemperatureFailure: diagnostic-event=EventPowerPath145OverTemperatureFailure, trouble-code-uds=Power_Path_145_Over_Temperature_Failure  # Event_Dtc_Map_Power_Path_145_Over_Temperature_Failure
  diagnostic event to operation cycle mapping EventOperCycleMapPowerPath145OverTemperatureFailure: diagnostic-event=EventPowerPath145OverTemperatureFailure, operation-cycle=DefaultOperationCycle  # Event_Oper_Cycle_Map_Power_Path_145_Over_Temperature_Failure
  diagnostic event to debounce algorithm mapping EventDebounceMapPowerPath145OverTemperatureFailure: debounce-algorithm=time_based, diagnostic-event=EventPowerPath145OverTemperatureFailure  # EventDebounceMap_Power_Path_145_Over_Temperature_Failure
package /ZeC/DTC/DTC/LIN_21_Slave_14_NoCommunication
  diagnostic trouble code uds LIN_21_Slave_14_NoCommunication: dtc-props=Dtc_Props_358996c7, uds-dtc-value=0x031606  # LIN 21 Slave 14_NoCommunication
  diagnostic event EventLIN21Slave14NoCommunication: aging-allowed=true, event-kind=SWC, prestorage-freeze-frame=false  # Event_LIN 21 Slave 14_NoCommunication
  diagnostic event to trouble code uds mapping EventDtcMapLIN21Slave14NoCommunication: diagnostic-event=EventLIN21Slave14NoCommunication, trouble-code-uds=LIN_21_Slave_14_NoCommunication  # Event_Dtc_Map_LIN 21 Slave 14_NoCommunication
  diagnostic event to operation cycle mapping EventOperCycleMapLIN21Slave14NoCommunication: diagnostic-event=EventLIN21Slave14NoCommunication, operation-cycle=DefaultOperationCycle  # Event_Oper_Cycle_Map_LIN 21 Slave 14_NoCommunication
  diagnostic event to debounce algorithm mapping EventDebounceMapLIN21Slave14NoCommunication: debounce-algorithm=counter_based, diagnostic-event=EventLIN21Slave14NoCommunication  # EventDebounceMap_LIN 21 Slave 14_NoCommunication
package /ZeC/DTC/DTC/LIN_21_Slave_15_Defect
  diagnostic trouble code uds LIN_21_Slave_15_Defect: dtc-props=Dtc_Props_358996c7, uds-dtc-value=0x031607  # LIN 21 Slave 15_Defect
  diagnostic event EventLIN21Slave15Defect: aging-allowed=true, event-kind=SWC, prestorage-freeze-frame=false  # Event_LIN 21 Slave 15_Defect
  diagnostic event to trouble code uds mapping EventDtcMapLIN21Slave15Defect: diagnostic-event=EventLIN21Slave15Defect, trouble-code-uds=LIN_21_Slave_15_Defect  # Event_Dtc_Map_LIN 21 Slave 15_Defect
  diagnostic event to operation cycle mapping EventOperCycleMapLIN21Slave15Defect: diagnostic-event=EventLIN21Slave15Defect, operation-cycle=DefaultOperationCycle  # Event_Oper_Cycle_Map_LIN 21 Slave 15_Defect
  diagnostic event to debounce algorithm mapping EventDebounceMapLIN21Slave15Defect: debounce-algorithm=counter_based, diagnostic-event=EventLIN21Slave15Defect  # EventDebounceMap_LIN 21 Slave 15_Defect
package /ZeC/DTC/DTC/Power_Path_121_Over_Temperature_Failure
  diagnostic trouble code uds Power_Path_121_Over_Temperature_Failure: dtc-props=Dtc_Props_4ca522c, uds-dtc-value=0x005779
  diagnostic event EventPowerPath121OverTemperatureFailure: aging-allowed=true, event-kind=SWC, prestorage-freeze-frame=false  # Event_Power_Path_121_Over_Temperature_Failure
  diagnostic event to trouble code uds mapping EventDtcMapPowerPath121OverTemperatureFailure: diagnostic-event=EventPowerPath121OverTemperatureFailure, trouble-code-uds=Power_Path_121_Over_Temperature_Failure  # Event_Dtc_Map_Power_Path_121_Over_Temperature_Failure
  diagnostic event to operation cycle mapping EventOperCycleMapPowerPath121OverTemperatureFailure: diagnostic-event=EventPowerPath121OverTemperatureFailure, operation-cycle=DefaultOperationCycle  # Event_Oper_Cycle_Map_Power_Path_121_Over_Temperature_Failure
  diagnostic event to debounce algorithm mapping EventDebounceMapPowerPath121OverTemperatureFailure: debounce-algorithm=time_based, diagnostic-event=EventPowerPath121OverTemperatureFailure  # EventDebounceMap_Power_Path_121_Over_Temperature_Failure
package /ZeC/DTC/DTC/LIN_21_Slave_13_NoCommunication
  diagnostic trouble code uds LIN_21_Slave_13_NoCommunication: dtc-props=Dtc_Props_358996c7, uds-dtc-value=0x031604  # LIN 21 Slave 13_NoCommunication
  diagnostic event EventLIN21Slave13NoCommunication: aging-allowed=true, event-kind=SWC, prestorage-freeze-frame=false  # Event_LIN 21 Slave 13_NoCommunication
  diagnostic event to trouble code uds mapping EventDtcMapLIN21Slave13NoCommunication: diagnostic-event=EventLIN21Slave13NoCommunication, trouble-code-uds=LIN_21_Slave_13_NoCommunication  # Event_Dtc_Map_LIN 21 Slave 13_NoCommunication
  diagnostic event to operation cycle mapping EventOperCycleMapLIN21Slave13NoCommunication: diagnostic-event=EventLIN21Slave13NoCommunication, operation-cycle=DefaultOperationCycle  # Event_Oper_Cycle_Map_LIN 21 Slave 13_NoCommunication
  diagnostic event to debounce algorithm mapping EventDebounceMapLIN21Slave13NoCommunication: debounce-algorithm=counter_based, diagnostic-event=EventLIN21Slave13NoCommunication  # EventDebounceMap_LIN 21 Slave 13_NoCommunication
package /ZeC/DTC/DTC/LIN_21_Slave_14_Defect
  diagnostic trouble code uds LIN_21_Slave_14_Defect: dtc-props=Dtc_Props_358996c7, uds-dtc-value=0x031605  # LIN 21 Slave 14_Defect
  diagnostic event EventLIN21Slave14Defect: aging-allowed=true, event-kind=SWC, prestorage-freeze-frame=false  # Event_LIN 21 Slave 14_Defect
  diagnostic event to trouble code uds mapping EventDtcMapLIN21Slave14Defect: diagnostic-event=EventLIN21Slave14Defect, trouble-code-uds=LIN_21_Slave_14_Defect  # Event_Dtc_Map_LIN 21 Slave 14_Defect
  diagnostic event to operation cycle mapping EventOperCycleMapLIN21Slave14Defect: diagnostic-event=EventLIN21Slave14Defect, operation-cycle=DefaultOperationCycle  # Event_Oper_Cycle_Map_LIN 21 Slave 14_Defect
  diagnostic event to debounce algorithm mapping EventDebounceMapLIN21Slave14Defect: debounce-algorithm=counter_based, diagnostic-event=EventLIN21Slave14Defect  # EventDebounceMap_LIN 21 Slave 14_Defect
package /ZeC/DTC/DTC/LIN_21_Slave_12_NoCommunication
  diagnostic trouble code uds LIN_21_Slave_12_NoCommunication: dtc-props=Dtc_Props_358996c7, uds-dtc-value=0x031602  # LIN 21 Slave 12_NoCommunication
  diagnostic event EventLIN21Slave12NoCommunication: aging-allowed=true, event-kind=SWC, prestorage-freeze-frame=false  # Event_LIN 21 Slave 12_NoCommunication
  diagnostic event to trouble code uds mapping EventDtcMapLIN21Slave12NoCommunication: diagnostic-event=EventLIN21Slave12NoCommunication, trouble-code-uds=LIN_21_Slave_12_NoCommunication  # Event_Dtc_Map_LIN 21 Slave 12_NoCommunication
  diagnostic event to operation cycle mapping EventOperCycleMapLIN21Slave12NoCommunication: diagnostic-event=EventLIN21Slave12NoCommunication, operation-cycle=DefaultOperationCycle  # Event_Oper_Cycle_Map_LIN 21 Slave 12_NoCommunication
  diagnostic event to debounce algorithm mapping EventDebounceMapLIN21Slave12NoCommunication: debounce-algorithm=counter_based, diagnostic-event=EventLIN21Slave12NoCommunication  # EventDebounceMap_LIN 21 Slave 12_NoCommunication
package /ZeC/DTC/DTC/Power_Path_118_Over_Temperature_Failure
  diagnostic trouble code uds Power_Path_118_Over_Temperature_Failure: dtc-props=Dtc_Props_50af39d8, uds-dtc-value=0x005776
  diagnostic event EventPowerPath118OverTemperatureFailure: aging-allowed=true, event-kind=SWC, prestorage-freeze-frame=false  # Event_Power_Path_118_Over_Temperature_Failure
  diagnostic event to trouble code uds mapping EventDtcMapPowerPath118OverTemperatureFailure: diagnostic-event=EventPowerPath118OverTemperatureFailure, trouble-code-uds=Power_Path_118_Over_Temperature_Failure  # Event_Dtc_Map_Power_Path_118_Over_Temperature_Failure
  diagnostic event to operation cycle mapping EventOperCycleMapPowerPath118OverTemperatureFailure: diagnostic-event=EventPowerPath118OverTemperatureFailure, operation-cycle=DefaultOperationCycle  # Event_Oper_Cycle_Map_Power_Path_118_Over_Temperature_Failure
  diagnostic event to debounce algorithm mapping EventDebounceMapPowerPath118OverTemperatureFailure: debounce-algorithm=time_based, diagnostic-event=EventPowerPath118OverTemperatureFailure  # EventDebounceMap_Power_Path_118_Over_Temperature_Failure
package /ZeC/DTC/DTC/LIN_21_Slave_13_Defect
  diagnostic trouble code uds LIN_21_Slave_13_Defect: dtc-props=Dtc_Props_358996c7, uds-dtc-value=0x031603  # LIN 21 Slave 13_Defect
  diagnostic event EventLIN21Slave13Defect: aging-allowed=true, event-kind=SWC, prestorage-freeze-frame=false  # Event_LIN 21 Slave 13_Defect
  diagnostic event to trouble code uds mapping EventDtcMapLIN21Slave13Defect: diagnostic-event=EventLIN21Slave13Defect, trouble-code-uds=LIN_21_Slave_13_Defect  # Event_Dtc_Map_LIN 21 Slave 13_Defect
  diagnostic event to operation cycle mapping EventOperCycleMapLIN21Slave13Defect: diagnostic-event=EventLIN21Slave13Defect, operation-cycle=DefaultOperationCycle  # Event_Oper_Cycle_Map_LIN 21 Slave 13_Defect
  diagnostic event to debounce algorithm mapping EventDebounceMapLIN21Slave13Defect: debounce-algorithm=counter_based, diagnostic-event=EventLIN21Slave13Defect  # EventDebounceMap_LIN 21 Slave 13_Defect
package /ZeC/DTC/DTC/Power_Path_117_Over_Temperature_Failure
  diagnostic trouble code uds Power_Path_117_Over_Temperature_Failure: dtc-props=Dtc_Props_9a842796, uds-dtc-value=0x005775
  diagnostic event EventPowerPath117OverTemperatureFailure: aging-allowed=true, event-kind=SWC, prestorage-freeze-frame=false  # Event_Power_Path_117_Over_Temperature_Failure
  diagnostic event to trouble code uds mapping EventDtcMapPowerPath117OverTemperatureFailure: diagnostic-event=EventPowerPath117OverTemperatureFailure, trouble-code-uds=Power_Path_117_Over_Temperature_Failure  # Event_Dtc_Map_Power_Path_117_Over_Temperature_Failure
  diagnostic event to operation cycle mapping EventOperCycleMapPowerPath117OverTemperatureFailure: diagnostic-event=EventPowerPath117OverTemperatureFailure, operation-cycle=DefaultOperationCycle  # Event_Oper_Cycle_Map_Power_Path_117_Over_Temperature_Failure
  diagnostic event to debounce algorithm mapping EventDebounceMapPowerPath117OverTemperatureFailure: debounce-algorithm=time_based, diagnostic-event=EventPowerPath117OverTemperatureFailure  # EventDebounceMap_Power_Path_117_Over_Temperature_Failure
package /ZeC/DTC/DTC/Power_Path_120_Over_Temperature_Failure
  diagnostic trouble code uds Power_Path_120_Over_Temperature_Failure: dtc-props=Dtc_Props_42d35816, uds-dtc-value=0x005778
  diagnostic event EventPowerPath120OverTemperatureFailure: aging-allowed=true, event-kind=SWC, prestorage-freeze-frame=false  # Event_Power_Path_120_Over_Temperature_Failure
  diagnostic event to trouble code uds mapping EventDtcMapPowerPath120OverTemperatureFailure: diagnostic-event=EventPowerPath120OverTemperatureFailure, trouble-code-uds=Power_Path_120_Over_Temperature_Failure  # Event_Dtc_Map_Power_Path_120_Over_Temperature_Failure
  diagnostic event to operation cycle mapping EventOperCycleMapPowerPath120OverTemperatureFailure: diagnostic-event=EventPowerPath120OverTemperatureFailure, operation-cycle=DefaultOperationCycle  # Event_Oper_Cycle_Map_Power_Path_120_Over_Temperature_Failure
  diagnostic event to debounce algorithm mapping EventDebounceMapPowerPath120OverTemperatureFailure: debounce-algorithm=time_based, diagnostic-event=EventPowerPath120OverTemperatureFailure  # EventDebounceMap_Power_Path_120_Over_Temperature_Failure
package /ZeC/DTC/DTC/LIN_21_Slave_12_Defect
  diagnostic trouble code uds LIN_21_Slave_12_Defect: dtc-props=Dtc_Props_358996c7, uds-dtc-value=0x031601  # LIN 21 Slave 12_Defect
  diagnostic event EventLIN21Slave12Defect: aging-allowed=true, event-kind=SWC, prestorage-freeze-frame=false  # Event_LIN 21 Slave 12_Defect
  diagnostic event to trouble code uds mapping EventDtcMapLIN21Slave12Defect: diagnostic-event=EventLIN21Slave12Defect, trouble-code-uds=LIN_21_Slave_12_Defect  # Event_Dtc_Map_LIN 21 Slave 12_Defect
  diagnostic event to operation cycle mapping EventOperCycleMapLIN21Slave12Defect: diagnostic-event=EventLIN21Slave12Defect, operation-cycle=DefaultOperationCycle  # Event_Oper_Cycle_Map_LIN 21 Slave 12_Defect
  diagnostic event to debounce algorithm mapping EventDebounceMapLIN21Slave12Defect: debounce-algorithm=counter_based, diagnostic-event=EventLIN21Slave12Defect  # EventDebounceMap_LIN 21 Slave 12_Defect
package /ZeC/DTC/DTC/Power_Path_119_Over_Temperature_Failure
  diagnostic trouble code uds Power_Path_119_Over_Temperature_Failure: dtc-props=Dtc_Props_16b633e2, uds-dtc-value=0x005777
  diagnostic event EventPowerPath119OverTemperatureFailure: aging-allowed=true, event-kind=SWC, prestorage-freeze-frame=false  # Event_Power_Path_119_Over_Temperature_Failure
  diagnostic event to trouble code uds mapping EventDtcMapPowerPath119OverTemperatureFailure: diagnostic-event=EventPowerPath119OverTemperatureFailure, trouble-code-uds=Power_Path_119_Over_Temperature_Failure  # Event_Dtc_Map_Power_Path_119_Over_Temperature_Failure
  diagnostic event to operation cycle mapping EventOperCycleMapPowerPath119OverTemperatureFailure: diagnostic-event=EventPowerPath119OverTemperatureFailure, operation-cycle=DefaultOperationCycle  # Event_Oper_Cycle_Map_Power_Path_119_Over_Temperature_Failure
  diagnostic event to debounce algorithm mapping EventDebounceMapPowerPath119OverTemperatureFailure: debounce-algorithm=time_based, diagnostic-event=EventPowerPath119OverTemperatureFailure  # EventDebounceMap_Power_Path_119_Over_Temperature_Failure
package /ZeC/DTC/DTC/Power_Path_123_Over_Temperature_Failure
  diagnostic trouble code uds Power_Path_123_Over_Temperature_Failure: dtc-props=Dtc_Props_ae45730c, uds-dtc-value=0x00577b
  diagnostic event EventPowerPath123OverTemperatureFailure: aging-allowed=true, event-kind=SWC, prestorage-freeze-frame=false  # Event_Power_Path_123_Over_Temperature_Failure
  diagnostic event to trouble code uds mapping EventDtcMapPowerPath123OverTemperatureFailure: diagnostic-event=EventPowerPath123OverTemperatureFailure, trouble-code-uds=Power_Path_123_Over_Temperature_Failure  # Event_Dtc_Map_Power_Path_123_Over_Temperature_Failure
  diagnostic event to operation cycle mapping EventOperCycleMapPowerPath123OverTemperatureFailure: diagnostic-event=EventPowerPath123OverTemperatureFailure, operation-cycle=DefaultOperationCycle  # Event_Oper_Cycle_Map_Power_Path_123_Over_Temperature_Failure
  diagnostic event to debounce algorithm mapping EventDebounceMapPowerPath123OverTemperatureFailure: debounce-algorithm=time_based, diagnostic-event=EventPowerPath123OverTemperatureFailure  # EventDebounceMap_Power_Path_123_Over_Temperature_Failure
package /ZeC/DTC/DTC/Power_Path_122_Over_Temperature_Failure
  diagnostic trouble code uds Power_Path_122_Over_Temperature_Failure: dtc-props=Dtc_Props_646e6d42, uds-dtc-value=0x00577a
  diagnostic event EventPowerPath122OverTemperatureFailure: aging-allowed=true, event-kind=SWC, prestorage-freeze-frame=false  # Event_Power_Path_122_Over_Temperature_Failure
  diagnostic event to trouble code uds mapping EventDtcMapPowerPath122OverTemperatureFailure: diagnostic-event=EventPowerPath122OverTemperatureFailure, trouble-code-uds=Power_Path_122_Over_Temperature_Failure  # Event_Dtc_Map_Power_Path_122_Over_Temperature_Failure
  diagnostic event to operation cycle mapping EventOperCycleMapPowerPath122OverTemperatureFailure: diagnostic-event=EventPowerPath122OverTemperatureFailure, operation-cycle=DefaultOperationCycle  # Event_Oper_Cycle_Map_Power_Path_122_Over_Temperature_Failure
  diagnostic event to debounce algorithm mapping EventDebounceMapPowerPath122OverTemperatureFailure: debounce-algorithm=time_based, diagnostic-event=EventPowerPath122OverTemperatureFailure  # EventDebounceMap_Power_Path_122_Over_Temperature_Failure
package /ZeC/DTC/DTC/Power_Path_125_Over_Temperature_Failure
  diagnostic trouble code uds Power_Path_125_Over_Temperature_Failure: dtc-props=Dtc_Props_e16249d1, uds-dtc-value=0x00577d
  diagnostic event EventPowerPath125OverTemperatureFailure: aging-allowed=true, event-kind=SWC, prestorage-freeze-frame=false  # Event_Power_Path_125_Over_Temperature_Failure
  diagnostic event to trouble code uds mapping EventDtcMapPowerPath125OverTemperatureFailure: diagnostic-event=EventPowerPath125OverTemperatureFailure, trouble-code-uds=Power_Path_125_Over_Temperature_Failure  # Event_Dtc_Map_Power_Path_125_Over_Temperature_Failure
  diagnostic event to operation cycle mapping EventOperCycleMapPowerPath125OverTemperatureFailure: diagnostic-event=EventPowerPath125OverTemperatureFailure, operation-cycle=DefaultOperationCycle  # Event_Oper_Cycle_Map_Power_Path_125_Over_Temperature_Failure
  diagnostic event to debounce algorithm mapping EventDebounceMapPowerPath125OverTemperatureFailure: debounce-algorithm=time_based, diagnostic-event=EventPowerPath125OverTemperatureFailure  # EventDebounceMap_Power_Path_125_Over_Temperature_Failure
package /ZeC/DTC/DTC/Power_Path_124_Over_Temperature_Failure
  diagnostic trouble code uds Power_Path_124_Over_Temperature_Failure: dtc-props=Dtc_Props_e85c7936, uds-dtc-value=0x00577c
  diagnostic event EventPowerPath124OverTemperatureFailure: aging-allowed=true, event-kind=SWC, prestorage-freeze-frame=false  # Event_Power_Path_124_Over_Temperature_Failure
  diagnostic event to trouble code uds mapping EventDtcMapPowerPath124OverTemperatureFailure: diagnostic-event=EventPowerPath124OverTemperatureFailure, trouble-code-uds=Power_Path_124_Over_Temperature_Failure  # Event_Dtc_Map_Power_Path_124_Over_Temperature_Failure
  diagnostic event to operation cycle mapping EventOperCycleMapPowerPath124OverTemperatureFailure: diagnostic-event=EventPowerPath124OverTemperatureFailure, operation-cycle=DefaultOperationCycle  # Event_Oper_Cycle_Map_Power_Path_124_Over_Temperature_Failure
  diagnostic event to debounce algorithm mapping EventDebounceMapPowerPath124OverTemperatureFailure: debounce-algorithm=time_based, diagnostic-event=EventPowerPath124OverTemperatureFailure  # EventDebounceMap_Power_Path_124_Over_Temperature_Failure
package /ZeC/DTC/DTC/LIN_21_Slave_5_Defect
  diagnostic trouble code uds LIN_21_Slave_5_Defect: dtc-props=Dtc_Props_358996c7, uds-dtc-value=0x03160f  # LIN 21 Slave 5_Defect
  diagnostic event EventLIN21Slave5Defect: aging-allowed=true, event-kind=SWC, prestorage-freeze-frame=false  # Event_LIN 21 Slave 5_Defect
  diagnostic event to trouble code uds mapping EventDtcMapLIN21Slave5Defect: diagnostic-event=EventLIN21Slave5Defect, trouble-code-uds=LIN_21_Slave_5_Defect  # Event_Dtc_Map_LIN 21 Slave 5_Defect
  diagnostic event to operation cycle mapping EventOperCycleMapLIN21Slave5Defect: diagnostic-event=EventLIN21Slave5Defect, operation-cycle=DefaultOperationCycle  # Event_Oper_Cycle_Map_LIN 21 Slave 5_Defect
  diagnostic event to debounce algorithm mapping EventDebounceMapLIN21Slave5Defect: debounce-algorithm=counter_based, diagnostic-event=EventLIN21Slave5Defect  # EventDebounceMap_LIN 21 Slave 5_Defect
package /ZeC/DTC/DTC/LIN_21_Slave_4_Defect
  diagnostic trouble code uds LIN_21_Slave_4_Defect: dtc-props=Dtc_Props_358996c7, uds-dtc-value=0x03160d  # LIN 21 Slave 4_Defect
  diagnostic event EventLIN21Slave4Defect: aging-allowed=true, event-kind=SWC, prestorage-freeze-frame=false  # Event_LIN 21 Slave 4_Defect
  diagnostic event to trouble code uds mapping EventDtcMapLIN21Slave4Defect: diagnostic-event=EventLIN21Slave4Defect, trouble-code-uds=LIN_21_Slave_4_Defect  # Event_Dtc_Map_LIN 21 Slave 4_Defect
  diagnostic event to operation cycle mapping EventOperCycleMapLIN21Slave4Defect: diagnostic-event=EventLIN21Slave4Defect, operation-cycle=DefaultOperationCycle  # Event_Oper_Cycle_Map_LIN 21 Slave 4_Defect
  diagnostic event to debounce algorithm mapping EventDebounceMapLIN21Slave4Defect: debounce-algorithm=counter_based, diagnostic-event=EventLIN21Slave4Defect  # EventDebounceMap_LIN 21 Slave 4_Defect
package /ZeC/DTC/DTC/LIN_21_Slave_4_NoCommunication
  diagnostic trouble code uds LIN_21_Slave_4_NoCommunication: dtc-props=Dtc_Props_358996c7, uds-dtc-value=0x03160e  # LIN 21 Slave 4_NoCommunication
  diagnostic event EventLIN21Slave4NoCommunication: aging-allowed=true, event-kind=SWC, prestorage-freeze-frame=false  # Event_LIN 21 Slave 4_NoCommunication
  diagnostic event to trouble code uds mapping EventDtcMapLIN21Slave4NoCommunication: diagnostic-event=EventLIN21Slave4NoCommunication, trouble-code-uds=LIN_21_Slave_4_NoCommunication  # Event_Dtc_Map_LIN 21 Slave 4_NoCommunication
  diagnostic event to operation cycle mapping EventOperCycleMapLIN21Slave4NoCommunication: diagnostic-event=EventLIN21Slave4NoCommunication, operation-cycle=DefaultOperationCycle  # Event_Oper_Cycle_Map_LIN 21 Slave 4_NoCommunication
  diagnostic event to debounce algorithm mapping EventDebounceMapLIN21Slave4NoCommunication: debounce-algorithm=counter_based, diagnostic-event=EventLIN21Slave4NoCommunication  # EventDebounceMap_LIN 21 Slave 4_NoCommunication
package /ZeC/DTC/DTC/LIN_21_Slave_3_Defect
  diagnostic trouble code uds LIN_21_Slave_3_Defect: dtc-props=Dtc_Props_358996c7, uds-dtc-value=0x03160b  # LIN 21 Slave 3_Defect
  diagnostic event EventLIN21Slave3Defect: aging-allowed=true, event-kind=SWC, prestorage-freeze-frame=false  # Event_LIN 21 Slave 3_Defect
  diagnostic event to trouble code uds mapping EventDtcMapLIN21Slave3Defect: diagnostic-event=EventLIN21Slave3Defect, trouble-code-uds=LIN_21_Slave_3_Defect  # Event_Dtc_Map_LIN 21 Slave 3_Defect
  diagnostic event to operation cycle mapping EventOperCycleMapLIN21Slave3Defect: diagnostic-event=EventLIN21Slave3Defect, operation-cycle=DefaultOperationCycle  # Event_Oper_Cycle_Map_LIN 21 Slave 3_Defect
  diagnostic event to debounce algorithm mapping EventDebounceMapLIN21Slave3Defect: debounce-algorithm=counter_based, diagnostic-event=EventLIN21Slave3Defect  # EventDebounceMap_LIN 21 Slave 3_Defect
package /ZeC/DTC/DTC/Power_Path_127_Over_Temperature_Failure
  diagnostic trouble code uds Power_Path_127_Over_Temperature_Failure: dtc-props=Dtc_Props_6d505da5, uds-dtc-value=0x00577f
  diagnostic event EventPowerPath127OverTemperatureFailure: aging-allowed=true, event-kind=SWC, prestorage-freeze-frame=false  # Event_Power_Path_127_Over_Temperature_Failure
  diagnostic event to trouble code uds mapping EventDtcMapPowerPath127OverTemperatureFailure: diagnostic-event=EventPowerPath127OverTemperatureFailure, trouble-code-uds=Power_Path_127_Over_Temperature_Failure  # Event_Dtc_Map_Power_Path_127_Over_Temperature_Failure
  diagnostic event to operation cycle mapping EventOperCycleMapPowerPath127OverTemperatureFailure: diagnostic-event=EventPowerPath127OverTemperatureFailure, operation-cycle=DefaultOperationCycle  # Event_Oper_Cycle_Map_Power_Path_127_Over_Temperature_Failure
  diagnostic event to debounce algorithm mapping EventDebounceMapPowerPath127OverTemperatureFailure: debounce-algorithm=time_based, diagnostic-event=EventPowerPath127OverTemperatureFailure  # EventDebounceMap_Power_Path_127_Over_Temperature_Failure
package /ZeC/DTC/DTC/LIN_21_Slave_3_NoCommunication
  diagnostic trouble code uds LIN_21_Slave_3_NoCommunication: dtc-props=Dtc_Props_358996c7, uds-dtc-value=0x03160c  # LIN 21 Slave 3_NoCommunication
  diagnostic event EventLIN21Slave3NoCommunication: aging-allowed=true, event-kind=SWC, prestorage-freeze-frame=false  # Event_LIN 21 Slave 3_NoCommunication
  diagnostic event to trouble code uds mapping EventDtcMapLIN21Slave3NoCommunication: diagnostic-event=EventLIN21Slave3NoCommunication, trouble-code-uds=LIN_21_Slave_3_NoCommunication  # Event_Dtc_Map_LIN 21 Slave 3_NoCommunication
  diagnostic event to operation cycle mapping EventOperCycleMapLIN21Slave3NoCommunication: diagnostic-event=EventLIN21Slave3NoCommunication, operation-cycle=DefaultOperationCycle  # Event_Oper_Cycle_Map_LIN 21 Slave 3_NoCommunication
  diagnostic event to debounce algorithm mapping EventDebounceMapLIN21Slave3NoCommunication: debounce-algorithm=counter_based, diagnostic-event=EventLIN21Slave3NoCommunication  # EventDebounceMap_LIN 21 Slave 3_NoCommunication
package /ZeC/DTC/DTC/Power_Path_126_Over_Temperature_Failure
  diagnostic trouble code uds Power_Path_126_Over_Temperature_Failure: dtc-props=Dtc_Props_a77b43eb, uds-dtc-value=0x00577e
  diagnostic event EventPowerPath126OverTemperatureFailure: aging-allowed=true, event-kind=SWC, prestorage-freeze-frame=false  # Event_Power_Path_126_Over_Temperature_Failure
  diagnostic event to trouble code uds mapping EventDtcMapPowerPath126OverTemperatureFailure: diagnostic-event=EventPowerPath126OverTemperatureFailure, trouble-code-uds=Power_Path_126_Over_Temperature_Failure  # Event_Dtc_Map_Power_Path_126_Over_Temperature_Failure
  diagnostic event to operation cycle mapping EventOperCycleMapPowerPath126OverTemperatureFailure: diagnostic-event=EventPowerPath126OverTemperatureFailure, operation-cycle=DefaultOperationCycle  # Event_Oper_Cycle_Map_Power_Path_126_Over_Temperature_Failure
  diagnostic event to debounce algorithm mapping EventDebounceMapPowerPath126OverTemperatureFailure: debounce-algorithm=time_based, diagnostic-event=EventPowerPath126OverTemperatureFailure  # EventDebounceMap_Power_Path_126_Over_Temperature_Failure
package /ZeC/DTC/DTC/LIN_21_Slave_2_NoCommunication
  diagnostic trouble code uds LIN_21_Slave_2_NoCommunication: dtc-props=Dtc_Props_358996c7, uds-dtc-value=0x03160a  # LIN 21 Slave 2_NoCommunication
  diagnostic event EventLIN21Slave2NoCommunication: aging-allowed=true, event-kind=SWC, prestorage-freeze-frame=false  # Event_LIN 21 Slave 2_NoCommunication
  diagnostic event to trouble code uds mapping EventDtcMapLIN21Slave2NoCommunication: diagnostic-event=EventLIN21Slave2NoCommunication, trouble-code-uds=LIN_21_Slave_2_NoCommunication  # Event_Dtc_Map_LIN 21 Slave 2_NoCommunication
  diagnostic event to operation cycle mapping EventOperCycleMapLIN21Slave2NoCommunication: diagnostic-event=EventLIN21Slave2NoCommunication, operation-cycle=DefaultOperationCycle  # Event_Oper_Cycle_Map_LIN 21 Slave 2_NoCommunication
  diagnostic event to debounce algorithm mapping EventDebounceMapLIN21Slave2NoCommunication: debounce-algorithm=counter_based, diagnostic-event=EventLIN21Slave2NoCommunication  # EventDebounceMap_LIN 21 Slave 2_NoCommunication
package /ZeC/DTC/DTC/Power_Path_131_Over_Temperature_Failure
  diagnostic trouble code uds Power_Path_131_Over_Temperature_Failure: dtc-props=Dtc_Props_6f274e25, uds-dtc-value=0x005783
  diagnostic event EventPowerPath131OverTemperatureFailure: aging-allowed=true, event-kind=SWC, prestorage-freeze-frame=false  # Event_Power_Path_131_Over_Temperature_Failure
  diagnostic event to trouble code uds mapping EventDtcMapPowerPath131OverTemperatureFailure: diagnostic-event=EventPowerPath131OverTemperatureFailure, trouble-code-uds=Power_Path_131_Over_Temperature_Failure  # Event_Dtc_Map_Power_Path_131_Over_Temperature_Failure
  diagnostic event to operation cycle mapping EventOperCycleMapPowerPath131OverTemperatureFailure: diagnostic-event=EventPowerPath131OverTemperatureFailure, operation-cycle=DefaultOperationCycle  # Event_Oper_Cycle_Map_Power_Path_131_Over_Temperature_Failure
  diagnostic event to debounce algorithm mapping EventDebounceMapPowerPath131OverTemperatureFailure: debounce-algorithm=time_based, diagnostic-event=EventPowerPath131OverTemperatureFailure  # EventDebounceMap_Power_Path_131_Over_Temperature_Failure
package /ZeC/DTC/DTC/Power_Path_130_Over_Temperature_Failure
  diagnostic trouble code uds Power_Path_130_Over_Temperature_Failure: dtc-props=Dtc_Props_293e441f, uds-dtc-value=0x005782
  diagnostic event EventPowerPath130OverTemperatureFailure: aging-allowed=true, event-kind=SWC, prestorage-freeze-frame=false  # Event_Power_Path_130_Over_Temperature_Failure
  diagnostic event to trouble code uds mapping EventDtcMapPowerPath130OverTemperatureFailure: diagnostic-event=EventPowerPath130OverTemperatureFailure, trouble-code-uds=Power_Path_130_Over_Temperature_Failure  # Event_Dtc_Map_Power_Path_130_Over_Temperature_Failure
  diagnostic event to operation cycle mapping EventOperCycleMapPowerPath130OverTemperatureFailure: diagnostic-event=EventPowerPath130OverTemperatureFailure, operation-cycle=DefaultOperationCycle  # Event_Oper_Cycle_Map_Power_Path_130_Over_Temperature_Failure
  diagnostic event to debounce algorithm mapping EventDebounceMapPowerPath130OverTemperatureFailure: debounce-algorithm=time_based, diagnostic-event=EventPowerPath130OverTemperatureFailure  # EventDebounceMap_Power_Path_130_Over_Temperature_Failure
package /ZeC/DTC/DTC/Power_Path_001_Open_Load_Failure
  diagnostic trouble code uds Power_Path_001_Open_Load_Failure: dtc-props=Dtc_Props_67f640d4, uds-dtc-value=0x005301
  diagnostic event EventPowerPath001OpenLoadFailure: aging-allowed=true, event-kind=SWC, prestorage-freeze-frame=false  # Event_Power_Path_001_Open_Load_Failure
  diagnostic event to trouble code uds mapping EventDtcMapPowerPath001OpenLoadFailure: diagnostic-event=EventPowerPath001OpenLoadFailure, trouble-code-uds=Power_Path_001_Open_Load_Failure  # Event_Dtc_Map_Power_Path_001_Open_Load_Failure
  diagnostic event to operation cycle mapping EventOperCycleMapPowerPath001OpenLoadFailure: diagnostic-event=EventPowerPath001OpenLoadFailure, operation-cycle=DefaultOperationCycle  # Event_Oper_Cycle_Map_Power_Path_001_Open_Load_Failure
  diagnostic event to debounce algorithm mapping EventDebounceMapPowerPath001OpenLoadFailure: debounce-algorithm=time_based, diagnostic-event=EventPowerPath001OpenLoadFailure  # EventDebounceMap_Power_Path_001_Open_Load_Failure
package /ZeC/DTC/DTC/Power_Path_133_Over_Temperature_Failure
  diagnostic trouble code uds Power_Path_133_Over_Temperature_Failure: dtc-props=Dtc_Props_200074f8, uds-dtc-value=0x005785
  diagnostic event EventPowerPath133OverTemperatureFailure: aging-allowed=true, event-kind=SWC, prestorage-freeze-frame=false  # Event_Power_Path_133_Over_Temperature_Failure
  diagnostic event to trouble code uds mapping EventDtcMapPowerPath133OverTemperatureFailure: diagnostic-event=EventPowerPath133OverTemperatureFailure, trouble-code-uds=Power_Path_133_Over_Temperature_Failure  # Event_Dtc_Map_Power_Path_133_Over_Temperature_Failure
  diagnostic event to operation cycle mapping EventOperCycleMapPowerPath133OverTemperatureFailure: diagnostic-event=EventPowerPath133OverTemperatureFailure, operation-cycle=DefaultOperationCycle  # Event_Oper_Cycle_Map_Power_Path_133_Over_Temperature_Failure
  diagnostic event to debounce algorithm mapping EventDebounceMapPowerPath133OverTemperatureFailure: debounce-algorithm=time_based, diagnostic-event=EventPowerPath133OverTemperatureFailure  # EventDebounceMap_Power_Path_133_Over_Temperature_Failure
package /ZeC/DTC/DTC/Power_Path_132_Over_Temperature_Failure
  diagnostic trouble code uds Power_Path_132_Over_Temperature_Failure: dtc-props=Dtc_Props_66197ec2, uds-dtc-value=0x005784
  diagnostic event EventPowerPath132OverTemperatureFailure: aging-allowed=true, event-kind=SWC, prestorage-freeze-frame=false  # Event_Power_Path_132_Over_Temperature_Failure
  diagnostic event to trouble code uds mapping EventDtcMapPowerPath132OverTemperatureFailure: diagnostic-event=EventPowerPath132OverTemperatureFailure, trouble-code-uds=Power_Path_132_Over_Temperature_Failure  # Event_Dtc_Map_Power_Path_132_Over_Temperature_Failure
  diagnostic event to operation cycle mapping EventOperCycleMapPowerPath132OverTemperatureFailure: diagnostic-event=EventPowerPath132OverTemperatureFailure, operation-cycle=DefaultOperationCycle  # Event_Oper_Cycle_Map_Power_Path_132_Over_Temperature_Failure
  diagnostic event to debounce algorithm mapping EventDebounceMapPowerPath132OverTemperatureFailure: debounce-algorithm=time_based, diagnostic-event=EventPowerPath132OverTemperatureFailure  # EventDebounceMap_Power_Path_132_Over_Temperature_Failure
package /ZeC/DTC/DTC/LIN_21_Slave_15_NoCommunication
  diagnostic trouble code uds LIN_21_Slave_15_NoCommunication: dtc-props=Dtc_Props_358996c7, uds-dtc-value=0x031608  # LIN 21 Slave 15_NoCommunication
  diagnostic event EventLIN21Slave15NoCommunication: aging-allowed=true, event-kind=SWC, prestorage-freeze-frame=false  # Event_LIN 21 Slave 15_NoCommunication
  diagnostic event to trouble code uds mapping EventDtcMapLIN21Slave15NoCommunication: diagnostic-event=EventLIN21Slave15NoCommunication, trouble-code-uds=LIN_21_Slave_15_NoCommunication  # Event_Dtc_Map_LIN 21 Slave 15_NoCommunication
  diagnostic event to operation cycle mapping EventOperCycleMapLIN21Slave15NoCommunication: diagnostic-event=EventLIN21Slave15NoCommunication, operation-cycle=DefaultOperationCycle  # Event_Oper_Cycle_Map_LIN 21 Slave 15_NoCommunication
  diagnostic event to debounce algorithm mapping EventDebounceMapLIN21Slave15NoCommunication: debounce-algorithm=counter_based, diagnostic-event=EventLIN21Slave15NoCommunication  # EventDebounceMap_LIN 21 Slave 15_NoCommunication
package /ZeC/DTC/DTC/Power_Path_129_Over_Temperature_Failure
  diagnostic trouble code uds Power_Path_129_Over_Temperature_Failure: dtc-props=Dtc_Props_e3155a51, uds-dtc-value=0x005781
  diagnostic event EventPowerPath129OverTemperatureFailure: aging-allowed=true, event-kind=SWC, prestorage-freeze-frame=false  # Event_Power_Path_129_Over_Temperature_Failure
  diagnostic event to trouble code uds mapping EventDtcMapPowerPath129OverTemperatureFailure: diagnostic-event=EventPowerPath129OverTemperatureFailure, trouble-code-uds=Power_Path_129_Over_Temperature_Failure  # Event_Dtc_Map_Power_Path_129_Over_Temperature_Failure
  diagnostic event to operation cycle mapping EventOperCycleMapPowerPath129OverTemperatureFailure: diagnostic-event=EventPowerPath129OverTemperatureFailure, operation-cycle=DefaultOperationCycle  # Event_Oper_Cycle_Map_Power_Path_129_Over_Temperature_Failure
  diagnostic event to debounce algorithm mapping EventDebounceMapPowerPath129OverTemperatureFailure: debounce-algorithm=time_based, diagnostic-event=EventPowerPath129OverTemperatureFailure  # EventDebounceMap_Power_Path_129_Over_Temperature_Failure
package /ZeC/DTC/DTC/LIN_21_Slave_2_Defect
  diagnostic trouble code uds LIN_21_Slave_2_Defect: dtc-props=Dtc_Props_358996c7, uds-dtc-value=0x031609  # LIN 21 Slave 2_Defect
  diagnostic event EventLIN21Slave2Defect: aging-allowed=true, event-kind=SWC, prestorage-freeze-frame=false  # Event_LIN 21 Slave 2_Defect
  diagnostic event to trouble code uds mapping EventDtcMapLIN21Slave2Defect: diagnostic-event=EventLIN21Slave2Defect, trouble-code-uds=LIN_21_Slave_2_Defect  # Event_Dtc_Map_LIN 21 Slave 2_Defect
  diagnostic event to operation cycle mapping EventOperCycleMapLIN21Slave2Defect: diagnostic-event=EventLIN21Slave2Defect, operation-cycle=DefaultOperationCycle  # Event_Oper_Cycle_Map_LIN 21 Slave 2_Defect
  diagnostic event to debounce algorithm mapping EventDebounceMapLIN21Slave2Defect: debounce-algorithm=counter_based, diagnostic-event=EventLIN21Slave2Defect  # EventDebounceMap_LIN 21 Slave 2_Defect
package /ZeC/DTC/DTC/Power_Path_128_Over_Temperature_Failure
  diagnostic trouble code uds Power_Path_128_Over_Temperature_Failure: dtc-props=Dtc_Props_a50c506b, uds-dtc-value=0x005780
  diagnostic event EventPowerPath128OverTemperatureFailure: aging-allowed=true, event-kind=SWC, prestorage-freeze-frame=false  # Event_Power_Path_128_Over_Temperature_Failure
  diagnostic event to trouble code uds mapping EventDtcMapPowerPath128OverTemperatureFailure: diagnostic-event=EventPowerPath128OverTemperatureFailure, trouble-code-uds=Power_Path_128_Over_Temperature_Failure  # Event_Dtc_Map_Power_Path_128_Over_Temperature_Failure
  diagnostic event to operation cycle mapping EventOperCycleMapPowerPath128OverTemperatureFailure: diagnostic-event=EventPowerPath128OverTemperatureFailure, operation-cycle=DefaultOperationCycle  # Event_Oper_Cycle_Map_Power_Path_128_Over_Temperature_Failure
  diagnostic event to debounce algorithm mapping EventDebounceMapPowerPath128OverTemperatureFailure: debounce-algorithm=time_based, diagnostic-event=EventPowerPath128OverTemperatureFailure  # EventDebounceMap_Power_Path_128_Over_Temperature_Failure
package /ZeC/DTC/DTC/Power_Path_041_Open_Load_Failure
  diagnostic trouble code uds Power_Path_041_Open_Load_Failure: dtc-props=Dtc_Props_6d499cf6, uds-dtc-value=0x005329
  diagnostic event EventPowerPath041OpenLoadFailure: aging-allowed=true, event-kind=SWC, prestorage-freeze-frame=false  # Event_Power_Path_041_Open_Load_Failure
  diagnostic event to trouble code uds mapping EventDtcMapPowerPath041OpenLoadFailure: diagnostic-event=EventPowerPath041OpenLoadFailure, trouble-code-uds=Power_Path_041_Open_Load_Failure  # Event_Dtc_Map_Power_Path_041_Open_Load_Failure
  diagnostic event to operation cycle mapping EventOperCycleMapPowerPath041OpenLoadFailure: diagnostic-event=EventPowerPath041OpenLoadFailure, operation-cycle=DefaultOperationCycle  # Event_Oper_Cycle_Map_Power_Path_041_Open_Load_Failure
  diagnostic event to debounce algorithm mapping EventDebounceMapPowerPath041OpenLoadFailure: debounce-algorithm=time_based, diagnostic-event=EventPowerPath041OpenLoadFailure  # EventDebounceMap_Power_Path_041_Open_Load_Failure
package /ZeC/DTC/DTC/DB_CANFD_09_Error_Received_Value
  diagnostic trouble code uds DB_CANFD_09_Error_Received_Value: dtc-props=Dtc_Props_b618fb9, uds-dtc-value=0x032904
  diagnostic event EventDBCANFD09ErrorReceivedValue: aging-allowed=true, event-kind=SWC, prestorage-freeze-frame=false  # Event_DB_CANFD_09_Error_Received_Value
  diagnostic event to trouble code uds mapping EventDtcMapDBCANFD09ErrorReceivedValue: diagnostic-event=EventDBCANFD09ErrorReceivedValue, trouble-code-uds=DB_CANFD_09_Error_Received_Value  # Event_Dtc_Map_DB_CANFD_09_Error_Received_Value
  diagnostic event to operation cycle mapping EventOperCycleMapDBCANFD09ErrorReceivedValue: diagnostic-event=EventDBCANFD09ErrorReceivedValue, operation-cycle=DefaultOperationCycle  # Event_Oper_Cycle_Map_DB_CANFD_09_Error_Received_Value
  diagnostic event to debounce algorithm mapping EventDebounceMapDBCANFD09ErrorReceivedValue: debounce-algorithm=counter_based, diagnostic-event=EventDBCANFD09ErrorReceivedValue  # EventDebounceMap_DB_CANFD_09_Error_Received_Value
package /ZeC/DTC/DTC/Power_Path_040_Open_Load_Failure
  diagnostic trouble code uds Power_Path_040_Open_Load_Failure: dtc-props=Dtc_Props_2b5096cc, uds-dtc-value=0x005328
  diagnostic event EventPowerPath040OpenLoadFailure: aging-allowed=true, event-kind=SWC, prestorage-freeze-frame=false  # Event_Power_Path_040_Open_Load_Failure
  diagnostic event to trouble code uds mapping EventDtcMapPowerPath040OpenLoadFailure: diagnostic-event=EventPowerPath040OpenLoadFailure, trouble-code-uds=Power_Path_040_Open_Load_Failure  # Event_Dtc_Map_Power_Path_040_Open_Load_Failure
  diagnostic event to operation cycle mapping EventOperCycleMapPowerPath040OpenLoadFailure: diagnostic-event=EventPowerPath040OpenLoadFailure, operation-cycle=DefaultOperationCycle  # Event_Oper_Cycle_Map_Power_Path_040_Open_Load_Failure
  diagnostic event to debounce algorithm mapping EventDebounceMapPowerPath040OpenLoadFailure: debounce-algorithm=time_based, diagnostic-event=EventPowerPath040OpenLoadFailure  # EventDebounceMap_Power_Path_040_Open_Load_Failure
package /ZeC/DTC/DTC/CAN_09_ECU_1_No_Communication
  diagnostic trouble code uds CAN_09_ECU_1_No_Communication: dtc-props=Dtc_Props_14158306, uds-dtc-value=0x032905
  diagnostic event EventCAN09ECU1NoCommunication: aging-allowed=true, event-kind=SWC, prestorage-freeze-frame=false  # Event_CAN_09_ECU_1_No_Communication
  diagnostic event to trouble code uds mapping EventDtcMapCAN09ECU1NoCommunication: diagnostic-event=EventCAN09ECU1NoCommunication, trouble-code-uds=CAN_09_ECU_1_No_Communication  # Event_Dtc_Map_CAN_09_ECU_1_No_Communication
  diagnostic event to operation cycle mapping EventOperCycleMapCAN09ECU1NoCommunication: diagnostic-event=EventCAN09ECU1NoCommunication, operation-cycle=DefaultOperationCycle  # Event_Oper_Cycle_Map_CAN_09_ECU_1_No_Communication
  diagnostic event to debounce algorithm mapping EventDebounceMapCAN09ECU1NoCommunication: debounce-algorithm=counter_based, diagnostic-event=EventCAN09ECU1NoCommunication  # EventDebounceMap_CAN_09_ECU_1_No_Communication
package /ZeC/DTC/DTC/DB_CANFD_09_No_Communication
  diagnostic trouble code uds DB_CANFD_09_No_Communication: dtc-props=Dtc_Props_14158306, uds-dtc-value=0x032902
  diagnostic event EventDBCANFD09NoCommunication: aging-allowed=true, event-kind=SWC, prestorage-freeze-frame=false  # Event_DB_CANFD_09_No_Communication
  diagnostic event to trouble code uds mapping EventDtcMapDBCANFD09NoCommunication: diagnostic-event=EventDBCANFD09NoCommunication, trouble-code-uds=DB_CANFD_09_No_Communication  # Event_Dtc_Map_DB_CANFD_09_No_Communication
  diagnostic event to operation cycle mapping EventOperCycleMapDBCANFD09NoCommunication: diagnostic-event=EventDBCANFD09NoCommunication, operation-cycle=DefaultOperationCycle  # Event_Oper_Cycle_Map_DB_CANFD_09_No_Communication
  diagnostic event to debounce algorithm mapping EventDebounceMapDBCANFD09NoCommunication: debounce-algorithm=counter_based, diagnostic-event=EventDBCANFD09NoCommunication  # EventDebounceMap_DB_CANFD_09_No_Communication
package /ZeC/DTC/DTC/DB_CANFD_09_Single_Wire_Mode
  diagnostic trouble code uds DB_CANFD_09_Single_Wire_Mode: dtc-props=Dtc_Props_14158306, uds-dtc-value=0x032903
  diagnostic event EventDBCANFD09SingleWireMode: aging-allowed=true, event-kind=SWC, prestorage-freeze-frame=false  # Event_DB_CANFD_09_Single_Wire_Mode
  diagnostic event to trouble code uds mapping EventDtcMapDBCANFD09SingleWireMode: diagnostic-event=EventDBCANFD09SingleWireMode, trouble-code-uds=DB_CANFD_09_Single_Wire_Mode  # Event_Dtc_Map_DB_CANFD_09_Single_Wire_Mode
  diagnostic event to operation cycle mapping EventOperCycleMapDBCANFD09SingleWireMode: diagnostic-event=EventDBCANFD09SingleWireMode, operation-cycle=DefaultOperationCycle  # Event_Oper_Cycle_Map_DB_CANFD_09_Single_Wire_Mode
  diagnostic event to debounce algorithm mapping EventDebounceMapDBCANFD09SingleWireMode: debounce-algorithm=counter_based, diagnostic-event=EventDBCANFD09SingleWireMode  # EventDebounceMap_DB_CANFD_09_Single_Wire_Mode
package /ZeC/DTC/DTC/LIN_7_Local_Databus_Electrical_Failure
  diagnostic trouble code uds LIN_7_Local_Databus_Electrical_Failure: dtc-props=Dtc_Props_358996c7, uds-dtc-value=0x030721  # LIN 7 Local_Databus_Electrical_Failure
  diagnostic event EventLIN7LocalDatabusElectricalFailure: aging-allowed=true, event-kind=SWC, prestorage-freeze-frame=false  # Event_LIN 7 Local_Databus_Electrical_Failure
  diagnostic event to trouble code uds mapping EventDtcMapLIN7LocalDatabusElectricalFailure: diagnostic-event=EventLIN7LocalDatabusElectricalFailure, trouble-code-uds=LIN_7_Local_Databus_Electrical_Failure  # Event_Dtc_Map_LIN 7 Local_Databus_Electrical_Failure
  diagnostic event to operation cycle mapping EventOperCycleMapLIN7LocalDatabusElectricalFailure: diagnostic-event=EventLIN7LocalDatabusElectricalFailure, operation-cycle=DefaultOperationCycle  # Event_Oper_Cycle_Map_LIN 7 Local_Databus_Electrical_Failure
  diagnostic event to debounce algorithm mapping EventDebounceMapLIN7LocalDatabusElectricalFailure: debounce-algorithm=counter_based, diagnostic-event=EventLIN7LocalDatabusElectricalFailure  # EventDebounceMap_LIN 7 Local_Databus_Electrical_Failure
package /ZeC/DTC/DTC/Power_Path_037_Open_Load_Failure
  diagnostic trouble code uds Power_Path_037_Open_Load_Failure: dtc-props=Dtc_Props_f307e94c, uds-dtc-value=0x005325
  diagnostic event EventPowerPath037OpenLoadFailure: aging-allowed=true, event-kind=SWC, prestorage-freeze-frame=false  # Event_Power_Path_037_Open_Load_Failure
  diagnostic event to trouble code uds mapping EventDtcMapPowerPath037OpenLoadFailure: diagnostic-event=EventPowerPath037OpenLoadFailure, trouble-code-uds=Power_Path_037_Open_Load_Failure  # Event_Dtc_Map_Power_Path_037_Open_Load_Failure
  diagnostic event to operation cycle mapping EventOperCycleMapPowerPath037OpenLoadFailure: diagnostic-event=EventPowerPath037OpenLoadFailure, operation-cycle=DefaultOperationCycle  # Event_Oper_Cycle_Map_Power_Path_037_Open_Load_Failure
  diagnostic event to debounce algorithm mapping EventDebounceMapPowerPath037OpenLoadFailure: debounce-algorithm=time_based, diagnostic-event=EventPowerPath037OpenLoadFailure  # EventDebounceMap_Power_Path_037_Open_Load_Failure
package /ZeC/DTC/DTC/LIN_7_Databus_No_Comm
  diagnostic trouble code uds LIN_7_Databus_No_Comm: dtc-props=Dtc_Props_358996c7, uds-dtc-value=0x030720  # LIN 7 Databus_No_Comm
  diagnostic event EventLIN7DatabusNoComm: aging-allowed=true, event-kind=SWC, prestorage-freeze-frame=false  # Event_LIN 7 Databus_No_Comm
  diagnostic event to trouble code uds mapping EventDtcMapLIN7DatabusNoComm: diagnostic-event=EventLIN7DatabusNoComm, trouble-code-uds=LIN_7_Databus_No_Comm  # Event_Dtc_Map_LIN 7 Databus_No_Comm
  diagnostic event to operation cycle mapping EventOperCycleMapLIN7DatabusNoComm: diagnostic-event=EventLIN7DatabusNoComm, operation-cycle=DefaultOperationCycle  # Event_Oper_Cycle_Map_LIN 7 Databus_No_Comm
  diagnostic event to debounce algorithm mapping EventDebounceMapLIN7DatabusNoComm: debounce-algorithm=counter_based, diagnostic-event=EventLIN7DatabusNoComm  # EventDebounceMap_LIN 7 Databus_No_Comm
package /ZeC/DTC/DTC/Power_Path_036_Open_Load_Failure
  diagnostic trouble code uds Power_Path_036_Open_Load_Failure: dtc-props=Dtc_Props_b51ee376, uds-dtc-value=0x005324
  diagnostic event EventPowerPath036OpenLoadFailure: aging-allowed=true, event-kind=SWC, prestorage-freeze-frame=false  # Event_Power_Path_036_Open_Load_Failure
  diagnostic event to trouble code uds mapping EventDtcMapPowerPath036OpenLoadFailure: diagnostic-event=EventPowerPath036OpenLoadFailure, trouble-code-uds=Power_Path_036_Open_Load_Failure  # Event_Dtc_Map_Power_Path_036_Open_Load_Failure
  diagnostic event to operation cycle mapping EventOperCycleMapPowerPath036OpenLoadFailure: diagnostic-event=EventPowerPath036OpenLoadFailure, operation-cycle=DefaultOperationCycle  # Event_Oper_Cycle_Map_Power_Path_036_Open_Load_Failure
  diagnostic event to debounce algorithm mapping EventDebounceMapPowerPath036OpenLoadFailure: debounce-algorithm=time_based, diagnostic-event=EventPowerPath036OpenLoadFailure  # EventDebounceMap_Power_Path_036_Open_Load_Failure
package /ZeC/DTC/DTC/DB_CANFD_09_Defect
  diagnostic trouble code uds DB_CANFD_09_Defect: dtc-props=Dtc_Props_14158306, uds-dtc-value=0x032901
  diagnostic event EventDBCANFD09Defect: aging-allowed=true, event-kind=SWC, prestorage-freeze-frame=false  # Event_DB_CANFD_09_Defect
  diagnostic event to trouble code uds mapping EventDtcMapDBCANFD09Defect: diagnostic-event=EventDBCANFD09Defect, trouble-code-uds=DB_CANFD_09_Defect  # Event_Dtc_Map_DB_CANFD_09_Defect
  diagnostic event to operation cycle mapping EventOperCycleMapDBCANFD09Defect: diagnostic-event=EventDBCANFD09Defect, operation-cycle=DefaultOperationCycle  # Event_Oper_Cycle_Map_DB_CANFD_09_Defect
  diagnostic event to debounce algorithm mapping EventDebounceMapDBCANFD09Defect: debounce-algorithm=counter_based, diagnostic-event=EventDBCANFD09Defect  # EventDebounceMap_DB_CANFD_09_Defect
package /ZeC/DTC/DTC/Power_Path_039_Open_Load_Failure
  diagnostic trouble code uds Power_Path_039_Open_Load_Failure: dtc-props=Dtc_Props_7f35fd38, uds-dtc-value=0x005327
  diagnostic event EventPowerPath039OpenLoadFailure: aging-allowed=true, event-kind=SWC, prestorage-freeze-frame=false  # Event_Power_Path_039_Open_Load_Failure
  diagnostic event to trouble code uds mapping EventDtcMapPowerPath039OpenLoadFailure: diagnostic-event=EventPowerPath039OpenLoadFailure, trouble-code-uds=Power_Path_039_Open_Load_Failure  # Event_Dtc_Map_Power_Path_039_Open_Load_Failure
  diagnostic event to operation cycle mapping EventOperCycleMapPowerPath039OpenLoadFailure: diagnostic-event=EventPowerPath039OpenLoadFailure, operation-cycle=DefaultOperationCycle  # Event_Oper_Cycle_Map_Power_Path_039_Open_Load_Failure
  diagnostic event to debounce algorithm mapping EventDebounceMapPowerPath039OpenLoadFailure: debounce-algorithm=time_based, diagnostic-event=EventPowerPath039OpenLoadFailure  # EventDebounceMap_Power_Path_039_Open_Load_Failure
