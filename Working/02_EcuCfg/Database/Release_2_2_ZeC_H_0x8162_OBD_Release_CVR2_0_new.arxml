[part 6 of 19: packages /ZeC/DTC/ExtendedDataRecords to /ZeC/DTC/DTC/Power_Path_008_Load_Failure]
AUTOSAR XML (schema 00047)
package /ZeC/DTC/ExtendedDataRecords
  5 x diagnostic extended data record, all with trigger=CONFIRMED, update=false:
    StandardDTCInformation: record-number=0x01
      diagnostic-parameter bit-offset=0:
        diagnostic data element Param_DTCPrior: base-type=uint8  # DTC Priority
      diagnostic-parameter bit-offset=8:
        diagnostic data element Param_OccurCount: base-type=uint8  # Occurence Counter
    StandFreezeFrame: record-number=0x02
      diagnostic-parameter bit-offset=0:
        diagnostic data element Param_CentrAgingCount: base-type=uint8  # Central-Aging-Counter
      diagnostic-parameter bit-offset=8:
        diagnostic data element Param_KmMilea: array-size-semantics=FIXED-SIZE, max-number-of-elements=3, base-type=uint8  # km-Mileage
      diagnostic-parameter bit-offset=32:
        diagnostic data element Param_Reser: base-type=uint8  # Reserved
      diagnostic-parameter bit-offset=40:
        diagnostic data element Param_TimeStamp: array-size-semantics=FIXED-SIZE, max-number-of-elements=5, base-type=uint8  # Time Stamp
    Record6: record-number=0x06  # Record_6
      diagnostic-parameter bit-offset=0:
        diagnostic data element EthernetLinkLostCounterParametersVersionNumber: base-type=uint8  # Ethernet_link_lost_counter / Parameters: version_number
      diagnostic-parameter bit-offset=8:
        diagnostic data element EthernetLinkLostCounterParametersEthernetLinkLostCounter: base-type=uint8  # Ethernet_link_lost_counter / Parameters: Ethernet_link_lost_counter
      diagnostic-parameter bit-offset=16:
        diagnostic data element EthernetLinkLostCounterParametersIpEthernetInterfaceEthernetLinkLostCounter: array-size-semantics=VARIABLE-SIZE, max-number-of-elements=10, base-type=uint8  # Ethernet_link_lost_counter / Parameters: Ip_ethernet_interface / Ethernet_link_lost_counter
      diagnostic-parameter bit-offset=96:
        diagnostic data element EthernetCRCErrorCounterParametersVersionNumber: base-type=uint8  # Ethernet_CRC_error_counter / Parameters: version_number
      diagnostic-parameter bit-offset=104:
        diagnostic data element EthernetCRCErrorCounterParametersIpCountOfCRCErrorCounters: base-type=uint8  # Ethernet_CRC_error_counter / Parameters: Ip_count_of_CRC_error_counters
      diagnostic-parameter bit-offset=112:
        diagnostic data element EthernetCRCErrorCounterParametersEthernetInterfaceEthernetCRCErrorCounter: array-size-semantics=VARIABLE-SIZE, max-number-of-elements=10, base-type=uint8  # Ethernet_CRC_error_counter / Parameters: Ethernet_interface / Ethernet_CRC_error_counter
    Record7: record-number=0x07  # Record_7
      diagnostic-parameter bit-offset=0:
        diagnostic data element VkmsMissingKeyHistoryParametersMissingKeysErrorCode: base-type=uint8  # Vkms_missing_key_history / Parameters: Missing_keys_error_code
      diagnostic-parameter bit-offset=8:
        diagnostic data element VkmsMissingKeyHistoryParametersMissingKeysNumber: base-type=uint8  # Vkms_missing_key_history / Parameters: Missing_keys_number
      diagnostic-parameter bit-offset=16:
        diagnostic data element VkmsMissingKeyHistoryParametersMissingKey: array-size-semantics=VARIABLE-SIZE, max-number-of-elements=200, base-type=uint8  # Vkms_missing_key_history / Parameters: Missing_key
    Record8: record-number=0x08  # Record_8
      diagnostic-parameter bit-offset=0:
        diagnostic data element ServiceIdentificationStandardParametersAmountUnauthorizedServiceOffers: base-type=uint8  # Service_identification_standard / Parameters: amount_unauthorized_service_offers
      diagnostic-parameter bit-offset=8:
        diagnostic data element ServiceIdentificationStandardParametersServiceIdApplicationProtocol: array-size-semantics=VARIABLE-SIZE, max-number-of-elements=140, base-type=uint8  # Service_identification_standard / Parameters: service_id / application_protocol
package /ZeC/DTC/FreezeFrames
  160 x diagnostic data identifier set:
    DataIdentifierSet0x7901: data-identifier=PowerPath001PinMapping  # Data_Identifier_Set_0x7901
    DataIdentifierSet0x7902: data-identifier=PowerPath002PinMapping  # Data_Identifier_Set_0x7902
    DataIdentifierSet0x7903: data-identifier=PowerPath003PinMapping  # Data_Identifier_Set_0x7903
    DataIdentifierSet0x7904: data-identifier=PowerPath004PinMapping  # Data_Identifier_Set_0x7904
    DataIdentifierSet0x7905: data-identifier=PowerPath005PinMapping  # Data_Identifier_Set_0x7905
    DataIdentifierSet0x7906: data-identifier=PowerPath006PinMapping  # Data_Identifier_Set_0x7906
    DataIdentifierSet0x7907: data-identifier=PowerPath007PinMapping  # Data_Identifier_Set_0x7907
    DataIdentifierSet0x7908: data-identifier=PowerPath008PinMapping  # Data_Identifier_Set_0x7908
    DataIdentifierSet0x7909: data-identifier=PowerPath009PinMapping  # Data_Identifier_Set_0x7909
    DataIdentifierSet0x790a: data-identifier=PowerPath010PinMapping  # Data_Identifier_Set_0x790a
    DataIdentifierSet0x790b: data-identifier=PowerPath011PinMapping  # Data_Identifier_Set_0x790b
    DataIdentifierSet0x790c: data-identifier=PowerPath012PinMapping  # Data_Identifier_Set_0x790c
    DataIdentifierSet0x790d: data-identifier=PowerPath013PinMapping  # Data_Identifier_Set_0x790d
    DataIdentifierSet0x790e: data-identifier=PowerPath014PinMapping  # Data_Identifier_Set_0x790e
    DataIdentifierSet0x790f: data-identifier=PowerPath015PinMapping  # Data_Identifier_Set_0x790f
    DataIdentifierSet0x7910: data-identifier=PowerPath016PinMapping  # Data_Identifier_Set_0x7910
    DataIdentifierSet0x7911: data-identifier=PowerPath017PinMapping  # Data_Identifier_Set_0x7911
    DataIdentifierSet0x7912: data-identifier=PowerPath018PinMapping  # Data_Identifier_Set_0x7912
    DataIdentifierSet0x7913: data-identifier=PowerPath019PinMapping  # Data_Identifier_Set_0x7913
    DataIdentifierSet0x7914: data-identifier=PowerPath020PinMapping  # Data_Identifier_Set_0x7914
    DataIdentifierSet0x7915: data-identifier=PowerPath021PinMapping  # Data_Identifier_Set_0x7915
    DataIdentifierSet0x7916: data-identifier=PowerPath022PinMapping  # Data_Identifier_Set_0x7916
    DataIdentifierSet0x7917: data-identifier=PowerPath023PinMapping  # Data_Identifier_Set_0x7917
    DataIdentifierSet0x7918: data-identifier=PowerPath024PinMapping  # Data_Identifier_Set_0x7918
    DataIdentifierSet0x7919: data-identifier=PowerPath025PinMapping  # Data_Identifier_Set_0x7919
    DataIdentifierSet0x791a: data-identifier=PowerPath026PinMapping  # Data_Identifier_Set_0x791a
    DataIdentifierSet0x791b: data-identifier=PowerPath027PinMapping  # Data_Identifier_Set_0x791b
    DataIdentifierSet0x791c: data-identifier=PowerPath028PinMapping  # Data_Identifier_Set_0x791c
    DataIdentifierSet0x791d: data-identifier=PowerPath029PinMapping  # Data_Identifier_Set_0x791d
    DataIdentifierSet0x791e: data-identifier=PowerPath030PinMapping  # Data_Identifier_Set_0x791e
    DataIdentifierSet0x791f: data-identifier=PowerPath031PinMapping  # Data_Identifier_Set_0x791f
    DataIdentifierSet0x7920: data-identifier=PowerPath032PinMapping  # Data_Identifier_Set_0x7920
    DataIdentifierSet0x7921: data-identifier=PowerPath033PinMapping  # Data_Identifier_Set_0x7921
    DataIdentifierSet0x7922: data-identifier=PowerPath034PinMapping  # Data_Identifier_Set_0x7922
    DataIdentifierSet0x7923: data-identifier=PowerPath035PinMapping  # Data_Identifier_Set_0x7923
    DataIdentifierSet0x7924: data-identifier=PowerPath036PinMapping  # Data_Identifier_Set_0x7924
    DataIdentifierSet0x7925: data-identifier=PowerPath037PinMapping  # Data_Identifier_Set_0x7925
    DataIdentifierSet0x7926: data-identifier=PowerPath038PinMapping  # Data_Identifier_Set_0x7926
    DataIdentifierSet0x7927: data-identifier=PowerPath039PinMapping  # Data_Identifier_Set_0x7927
    DataIdentifierSet0x7928: data-identifier=PowerPath040PinMapping  # Data_Identifier_Set_0x7928
    DataIdentifierSet0x7929: data-identifier=PowerPath041PinMapping  # Data_Identifier_Set_0x7929
    DataIdentifierSet0x792a: data-identifier=PowerPath042PinMapping  # Data_Identifier_Set_0x792a
    DataIdentifierSet0x792b: data-identifier=PowerPath043PinMapping  # Data_Identifier_Set_0x792b
    DataIdentifierSet0x792c: data-identifier=PowerPath044PinMapping  # Data_Identifier_Set_0x792c
    DataIdentifierSet0x792d: data-identifier=PowerPath045PinMapping  # Data_Identifier_Set_0x792d
    DataIdentifierSet0x792e: data-identifier=PowerPath046PinMapping  # Data_Identifier_Set_0x792e
    DataIdentifierSet0x792f: data-identifier=PowerPath047PinMapping  # Data_Identifier_Set_0x792f
    DataIdentifierSet0x7930: data-identifier=PowerPath048PinMapping  # Data_Identifier_Set_0x7930
    DataIdentifierSet0x7931: data-identifier=PowerPath049PinMapping  # Data_Identifier_Set_0x7931
    DataIdentifierSet0x7932: data-identifier=PowerPath050PinMapping  # Data_Identifier_Set_0x7932
    DataIdentifierSet0x7933: data-identifier=PowerPath051PinMapping  # Data_Identifier_Set_0x7933
    DataIdentifierSet0x7934: data-identifier=PowerPath052PinMapping  # Data_Identifier_Set_0x7934
    DataIdentifierSet0x7935: data-identifier=PowerPath053PinMapping  # Data_Identifier_Set_0x7935
    DataIdentifierSet0x7936: data-identifier=PowerPath054PinMapping  # Data_Identifier_Set_0x7936
    DataIdentifierSet0x7937: data-identifier=PowerPath055PinMapping  # Data_Identifier_Set_0x7937
    DataIdentifierSet0x7938: data-identifier=PowerPath056PinMapping  # Data_Identifier_Set_0x7938
    DataIdentifierSet0x7939: data-identifier=PowerPath057PinMapping  # Data_Identifier_Set_0x7939
    DataIdentifierSet0x793a: data-identifier=PowerPath058PinMapping  # Data_Identifier_Set_0x793a
    DataIdentifierSet0x793b: data-identifier=PowerPath059PinMapping  # Data_Identifier_Set_0x793b
    DataIdentifierSet0x793c: data-identifier=PowerPath060PinMapping  # Data_Identifier_Set_0x793c
    DataIdentifierSet0x793d: data-identifier=PowerPath061PinMapping  # Data_Identifier_Set_0x793d
    DataIdentifierSet0x793e: data-identifier=PowerPath062PinMapping  # Data_Identifier_Set_0x793e
    DataIdentifierSet0x793f: data-identifier=PowerPath063PinMapping  # Data_Identifier_Set_0x793f
    DataIdentifierSet0x7940: data-identifier=PowerPath064PinMapping  # Data_Identifier_Set_0x7940
    DataIdentifierSet0x7941: data-identifier=PowerPath065PinMapping  # Data_Identifier_Set_0x7941
    DataIdentifierSet0x7942: data-identifier=PowerPath066PinMapping  # Data_Identifier_Set_0x7942
    DataIdentifierSet0x7943: data-identifier=PowerPath067PinMapping  # Data_Identifier_Set_0x7943
    DataIdentifierSet0x7944: data-identifier=PowerPath068PinMapping  # Data_Identifier_Set_0x7944
    DataIdentifierSet0x7945: data-identifier=PowerPath069PinMapping  # Data_Identifier_Set_0x7945
    DataIdentifierSet0x7946: data-identifier=PowerPath070PinMapping  # Data_Identifier_Set_0x7946
    DataIdentifierSet0x7947: data-identifier=PowerPath071PinMapping  # Data_Identifier_Set_0x7947
    DataIdentifierSet0x7948: data-identifier=PowerPath072PinMapping  # Data_Identifier_Set_0x7948
    DataIdentifierSet0x7949: data-identifier=PowerPath073PinMapping  # Data_Identifier_Set_0x7949
    DataIdentifierSet0x794a: data-identifier=PowerPath074PinMapping  # Data_Identifier_Set_0x794a
    DataIdentifierSet0x794b: data-identifier=PowerPath075PinMapping  # Data_Identifier_Set_0x794b
    DataIdentifierSet0x794c: data-identifier=PowerPath076PinMapping  # Data_Identifier_Set_0x794c
    DataIdentifierSet0x794d: data-identifier=PowerPath077PinMapping  # Data_Identifier_Set_0x794d
    DataIdentifierSet0x794e: data-identifier=PowerPath078PinMapping  # Data_Identifier_Set_0x794e
    DataIdentifierSet0x794f: data-identifier=PowerPath079PinMapping  # Data_Identifier_Set_0x794f
    DataIdentifierSet0x7950: data-identifier=PowerPath080PinMapping  # Data_Identifier_Set_0x7950
    DataIdentifierSet0x7951: data-identifier=PowerPath081PinMapping  # Data_Identifier_Set_0x7951
    DataIdentifierSet0x7952: data-identifier=PowerPath082PinMapping  # Data_Identifier_Set_0x7952
    DataIdentifierSet0x7953: data-identifier=PowerPath083PinMapping  # Data_Identifier_Set_0x7953
    DataIdentifierSet0x7954: data-identifier=PowerPath084PinMapping  # Data_Identifier_Set_0x7954
    DataIdentifierSet0x7955: data-identifier=PowerPath085PinMapping  # Data_Identifier_Set_0x7955
    DataIdentifierSet0x7956: data-identifier=PowerPath086PinMapping  # Data_Identifier_Set_0x7956
    DataIdentifierSet0x7957: data-identifier=PowerPath087PinMapping  # Data_Identifier_Set_0x7957
    DataIdentifierSet0x7958: data-identifier=PowerPath088PinMapping  # Data_Identifier_Set_0x7958
    DataIdentifierSet0x7959: data-identifier=PowerPath089PinMapping  # Data_Identifier_Set_0x7959
    DataIdentifierSet0x795a: data-identifier=PowerPath090PinMapping  # Data_Identifier_Set_0x795a
    DataIdentifierSet0x795b: data-identifier=PowerPath091PinMapping  # Data_Identifier_Set_0x795b
    DataIdentifierSet0x795c: data-identifier=PowerPath092PinMapping  # Data_Identifier_Set_0x795c
    DataIdentifierSet0x795d: data-identifier=PowerPath093PinMapping  # Data_Identifier_Set_0x795d
    DataIdentifierSet0x795e: data-identifier=PowerPath094PinMapping  # Data_Identifier_Set_0x795e
    DataIdentifierSet0x795f: data-identifier=PowerPath095PinMapping  # Data_Identifier_Set_0x795f
    DataIdentifierSet0x7960: data-identifier=PowerPath096PinMapping  # Data_Identifier_Set_0x7960
    DataIdentifierSet0x7961: data-identifier=PowerPath097PinMapping  # Data_Identifier_Set_0x7961
    DataIdentifierSet0x7962: data-identifier=PowerPath098PinMapping  # Data_Identifier_Set_0x7962
    DataIdentifierSet0x7963: data-identifier=PowerPath099PinMapping  # Data_Identifier_Set_0x7963
    DataIdentifierSet0x7964: data-identifier=PowerPath100PinMapping  # Data_Identifier_Set_0x7964
    DataIdentifierSet0x7965: data-identifier=PowerPath101PinMapping  # Data_Identifier_Set_0x7965
    DataIdentifierSet0x7966: data-identifier=PowerPath102PinMapping  # Data_Identifier_Set_0x7966
    DataIdentifierSet0x7967: data-identifier=PowerPath103PinMapping  # Data_Identifier_Set_0x7967
    DataIdentifierSet0x7968: data-identifier=PowerPath104PinMapping  # Data_Identifier_Set_0x7968
    DataIdentifierSet0x7969: data-identifier=PowerPath105PinMapping  # Data_Identifier_Set_0x7969
    DataIdentifierSet0x796a: data-identifier=PowerPath106PinMapping  # Data_Identifier_Set_0x796a
    DataIdentifierSet0x796b: data-identifier=PowerPath107PinMapping  # Data_Identifier_Set_0x796b
    DataIdentifierSet0x796c: data-identifier=PowerPath108PinMapping  # Data_Identifier_Set_0x796c
    DataIdentifierSet0x796d: data-identifier=PowerPath109PinMapping  # Data_Identifier_Set_0x796d
    DataIdentifierSet0x796e: data-identifier=PowerPath110PinMapping  # Data_Identifier_Set_0x796e
    DataIdentifierSet0x796f: data-identifier=PowerPath111PinMapping  # Data_Identifier_Set_0x796f
    DataIdentifierSet0x7970: data-identifier=PowerPath112PinMapping  # Data_Identifier_Set_0x7970
    DataIdentifierSet0x7971: data-identifier=PowerPath113PinMapping  # Data_Identifier_Set_0x7971
    DataIdentifierSet0x7972: data-identifier=PowerPath114PinMapping  # Data_Identifier_Set_0x7972
    DataIdentifierSet0x7973: data-identifier=PowerPath115PinMapping  # Data_Identifier_Set_0x7973
    DataIdentifierSet0x7974: data-identifier=PowerPath116PinMapping  # Data_Identifier_Set_0x7974
    DataIdentifierSet0x7975: data-identifier=PowerPath117PinMapping  # Data_Identifier_Set_0x7975
    DataIdentifierSet0x7976: data-identifier=PowerPath118PinMapping  # Data_Identifier_Set_0x7976
    DataIdentifierSet0x7977: data-identifier=PowerPath119PinMapping  # Data_Identifier_Set_0x7977
    DataIdentifierSet0x7978: data-identifier=PowerPath120PinMapping  # Data_Identifier_Set_0x7978
    DataIdentifierSet0x7979: data-identifier=PowerPath121PinMapping  # Data_Identifier_Set_0x7979
    DataIdentifierSet0x797a: data-identifier=PowerPath122PinMapping  # Data_Identifier_Set_0x797a
    DataIdentifierSet0x797b: data-identifier=PowerPath123PinMapping  # Data_Identifier_Set_0x797b
    DataIdentifierSet0x797c: data-identifier=PowerPath124PinMapping  # Data_Identifier_Set_0x797c
    DataIdentifierSet0x797d: data-identifier=PowerPath125PinMapping  # Data_Identifier_Set_0x797d
    DataIdentifierSet0x797e: data-identifier=PowerPath126PinMapping  # Data_Identifier_Set_0x797e
    DataIdentifierSet0x797f: data-identifier=PowerPath127PinMapping  # Data_Identifier_Set_0x797f
    DataIdentifierSet0x7980: data-identifier=PowerPath128PinMapping  # Data_Identifier_Set_0x7980
    DataIdentifierSet0x7981: data-identifier=PowerPath129PinMapping  # Data_Identifier_Set_0x7981
    DataIdentifierSet0x7982: data-identifier=PowerPath130PinMapping  # Data_Identifier_Set_0x7982
    DataIdentifierSet0x7983: data-identifier=PowerPath131PinMapping  # Data_Identifier_Set_0x7983
    DataIdentifierSet0x7984: data-identifier=PowerPath132PinMapping  # Data_Identifier_Set_0x7984
    DataIdentifierSet0x7985: data-identifier=PowerPath133PinMapping  # Data_Identifier_Set_0x7985
    DataIdentifierSet0x7986: data-identifier=PowerPath134PinMapping  # Data_Identifier_Set_0x7986
    DataIdentifierSet0x7987: data-identifier=PowerPath135PinMapping  # Data_Identifier_Set_0x7987
    DataIdentifierSet0x7988: data-identifier=PowerPath136PinMapping  # Data_Identifier_Set_0x7988
    DataIdentifierSet0x7989: data-identifier=PowerPath137PinMapping  # Data_Identifier_Set_0x7989
    DataIdentifierSet0x798a: data-identifier=PowerPath138PinMapping  # Data_Identifier_Set_0x798a
    DataIdentifierSet0x798b: data-identifier=PowerPath139PinMapping  # Data_Identifier_Set_0x798b
    DataIdentifierSet0x798c: data-identifier=PowerPath140PinMapping  # Data_Identifier_Set_0x798c
    DataIdentifierSet0x798d: data-identifier=PowerPath141PinMapping  # Data_Identifier_Set_0x798d
    DataIdentifierSet0x798e: data-identifier=PowerPath142PinMapping  # Data_Identifier_Set_0x798e
    DataIdentifierSet0x798f: data-identifier=PowerPath143PinMapping  # Data_Identifier_Set_0x798f
    DataIdentifierSet0x7990: data-identifier=PowerPath144PinMapping  # Data_Identifier_Set_0x7990
    DataIdentifierSet0x7991: data-identifier=PowerPath145PinMapping  # Data_Identifier_Set_0x7991
    DataIdentifierSet0x7992: data-identifier=PowerPath146PinMapping  # Data_Identifier_Set_0x7992
    DataIdentifierSet0x7993: data-identifier=PowerPath147PinMapping  # Data_Identifier_Set_0x7993
    DataIdentifierSet0x7994: data-identifier=PowerPath148PinMapping  # Data_Identifier_Set_0x7994
    DataIdentifierSet0x7995: data-identifier=PowerPath149PinMapping  # Data_Identifier_Set_0x7995
    DataIdentifierSet0x7996: data-identifier=PowerPath150PinMapping  # Data_Identifier_Set_0x7996
    DataIdentifierSet0x7997: data-identifier=PowerPath151PinMapping  # Data_Identifier_Set_0x7997
    DataIdentifierSet0x7998: data-identifier=PowerPath152PinMapping  # Data_Identifier_Set_0x7998
    DataIdentifierSet0x7999: data-identifier=PowerPath153PinMapping  # Data_Identifier_Set_0x7999
    DataIdentifierSet0x799a: data-identifier=PowerPath154PinMapping  # Data_Identifier_Set_0x799a
    DataIdentifierSet0x799b: data-identifier=PowerPath155PinMapping  # Data_Identifier_Set_0x799b
    DataIdentifierSet0x799c: data-identifier=PowerPath156PinMapping  # Data_Identifier_Set_0x799c
    DataIdentifierSet0x799d: data-identifier=PowerPath157PinMapping  # Data_Identifier_Set_0x799d
    DataIdentifierSet0x799e: data-identifier=PowerPath158PinMapping  # Data_Identifier_Set_0x799e
    DataIdentifierSet0x799f: data-identifier=PowerPath159PinMapping  # Data_Identifier_Set_0x799f
    DataIdentifierSet0x79a0: data-identifier=PowerPath160PinMapping  # Data_Identifier_Set_0x79a0
package /ZeC/DTC/DTC/LIN_18_Slave_13_NoCommunication
  diagnostic trouble code uds LIN_18_Slave_13_NoCommunication: dtc-props=Dtc_Props_358996c7, uds-dtc-value=0x031219  # LIN 18 Slave 13_NoCommunication
  diagnostic event EventLIN18Slave13NoCommunication: aging-allowed=true, event-kind=SWC, prestorage-freeze-frame=false  # Event_LIN 18 Slave 13_NoCommunication
  diagnostic event to trouble code uds mapping EventDtcMapLIN18Slave13NoCommunication: diagnostic-event=EventLIN18Slave13NoCommunication, trouble-code-uds=LIN_18_Slave_13_NoCommunication  # Event_Dtc_Map_LIN 18 Slave 13_NoCommunication
  diagnostic event to operation cycle mapping EventOperCycleMapLIN18Slave13NoCommunication: diagnostic-event=EventLIN18Slave13NoCommunication, operation-cycle=DefaultOperationCycle  # Event_Oper_Cycle_Map_LIN 18 Slave 13_NoCommunication
  diagnostic event to debounce algorithm mapping EventDebounceMapLIN18Slave13NoCommunication: debounce-algorithm=counter_based, diagnostic-event=EventLIN18Slave13NoCommunication  # EventDebounceMap_LIN 18 Slave 13_NoCommunication
package /ZeC/DTC/DTC/LIN_18_Slave_12_NoCommunication
  diagnostic trouble code uds LIN_18_Slave_12_NoCommunication: dtc-props=Dtc_Props_358996c7, uds-dtc-value=0x031217  # LIN 18 Slave 12_NoCommunication
  diagnostic event EventLIN18Slave12NoCommunication: aging-allowed=true, event-kind=SWC, prestorage-freeze-frame=false  # Event_LIN 18 Slave 12_NoCommunication
  diagnostic event to trouble code uds mapping EventDtcMapLIN18Slave12NoCommunication: diagnostic-event=EventLIN18Slave12NoCommunication, trouble-code-uds=LIN_18_Slave_12_NoCommunication  # Event_Dtc_Map_LIN 18 Slave 12_NoCommunication
  diagnostic event to operation cycle mapping EventOperCycleMapLIN18Slave12NoCommunication: diagnostic-event=EventLIN18Slave12NoCommunication, operation-cycle=DefaultOperationCycle  # Event_Oper_Cycle_Map_LIN 18 Slave 12_NoCommunication
  diagnostic event to debounce algorithm mapping EventDebounceMapLIN18Slave12NoCommunication: debounce-algorithm=counter_based, diagnostic-event=EventLIN18Slave12NoCommunication  # EventDebounceMap_LIN 18 Slave 12_NoCommunication
package /ZeC/DTC/DTC/LIN_18_Slave_13_Defect
  diagnostic trouble code uds LIN_18_Slave_13_Defect: dtc-props=Dtc_Props_358996c7, uds-dtc-value=0x031218  # LIN 18 Slave 13_Defect
  diagnostic event EventLIN18Slave13Defect: aging-allowed=true, event-kind=SWC, prestorage-freeze-frame=false  # Event_LIN 18 Slave 13_Defect
  diagnostic event to trouble code uds mapping EventDtcMapLIN18Slave13Defect: diagnostic-event=EventLIN18Slave13Defect, trouble-code-uds=LIN_18_Slave_13_Defect  # Event_Dtc_Map_LIN 18 Slave 13_Defect
  diagnostic event to operation cycle mapping EventOperCycleMapLIN18Slave13Defect: diagnostic-event=EventLIN18Slave13Defect, operation-cycle=DefaultOperationCycle  # Event_Oper_Cycle_Map_LIN 18 Slave 13_Defect
  diagnostic event to debounce algorithm mapping EventDebounceMapLIN18Slave13Defect: debounce-algorithm=counter_based, diagnostic-event=EventLIN18Slave13Defect  # EventDebounceMap_LIN 18 Slave 13_Defect
package /ZeC/DTC/DTC/LIN_18_Slave_11_NoCommunication
  diagnostic trouble code uds LIN_18_Slave_11_NoCommunication: dtc-props=Dtc_Props_358996c7, uds-dtc-value=0x031215  # LIN 18 Slave 11_NoCommunication
  diagnostic event EventLIN18Slave11NoCommunication: aging-allowed=true, event-kind=SWC, prestorage-freeze-frame=false  # Event_LIN 18 Slave 11_NoCommunication
  diagnostic event to trouble code uds mapping EventDtcMapLIN18Slave11NoCommunication: diagnostic-event=EventLIN18Slave11NoCommunication, trouble-code-uds=LIN_18_Slave_11_NoCommunication  # Event_Dtc_Map_LIN 18 Slave 11_NoCommunication
  diagnostic event to operation cycle mapping EventOperCycleMapLIN18Slave11NoCommunication: diagnostic-event=EventLIN18Slave11NoCommunication, operation-cycle=DefaultOperationCycle  # Event_Oper_Cycle_Map_LIN 18 Slave 11_NoCommunication
  diagnostic event to debounce algorithm mapping EventDebounceMapLIN18Slave11NoCommunication: debounce-algorithm=counter_based, diagnostic-event=EventLIN18Slave11NoCommunication  # EventDebounceMap_LIN 18 Slave 11_NoCommunication
package /ZeC/DTC/DTC/LIN_18_Slave_12_Defect
  diagnostic trouble code uds LIN_18_Slave_12_Defect: dtc-props=Dtc_Props_358996c7, uds-dtc-value=0x031216  # LIN 18 Slave 12_Defect
  diagnostic event EventLIN18Slave12Defect: aging-allowed=true, event-kind=SWC, prestorage-freeze-frame=false  # Event_LIN 18 Slave 12_Defect
  diagnostic event to trouble code uds mapping EventDtcMapLIN18Slave12Defect: diagnostic-event=EventLIN18Slave12Defect, trouble-code-uds=LIN_18_Slave_12_Defect  # Event_Dtc_Map_LIN 18 Slave 12_Defect
  diagnostic event to operation cycle mapping EventOperCycleMapLIN18Slave12Defect: diagnostic-event=EventLIN18Slave12Defect, operation-cycle=DefaultOperationCycle  # Event_Oper_Cycle_Map_LIN 18 Slave 12_Defect
  diagnostic event to debounce algorithm mapping EventDebounceMapLIN18Slave12Defect: debounce-algorithm=counter_based, diagnostic-event=EventLIN18Slave12Defect  # EventDebounceMap_LIN 18 Slave 12_Defect
package /ZeC/DTC/DTC/LIN_18_Slave_10_NoCommunication
  diagnostic trouble code uds LIN_18_Slave_10_NoCommunication: dtc-props=Dtc_Props_358996c7, uds-dtc-value=0x031213  # LIN 18 Slave 10_NoCommunication
  diagnostic event EventLIN18Slave10NoCommunication: aging-allowed=true, event-kind=SWC, prestorage-freeze-frame=false  # Event_LIN 18 Slave 10_NoCommunication
  diagnostic event to trouble code uds mapping EventDtcMapLIN18Slave10NoCommunication: diagnostic-event=EventLIN18Slave10NoCommunication, trouble-code-uds=LIN_18_Slave_10_NoCommunication  # Event_Dtc_Map_LIN 18 Slave 10_NoCommunication
  diagnostic event to operation cycle mapping EventOperCycleMapLIN18Slave10NoCommunication: diagnostic-event=EventLIN18Slave10NoCommunication, operation-cycle=DefaultOperationCycle  # Event_Oper_Cycle_Map_LIN 18 Slave 10_NoCommunication
  diagnostic event to debounce algorithm mapping EventDebounceMapLIN18Slave10NoCommunication: debounce-algorithm=counter_based, diagnostic-event=EventLIN18Slave10NoCommunication  # EventDebounceMap_LIN 18 Slave 10_NoCommunication
package /ZeC/DTC/DTC/LIN_18_Slave_11_Defect
  diagnostic trouble code uds LIN_18_Slave_11_Defect: dtc-props=Dtc_Props_358996c7, uds-dtc-value=0x031214  # LIN 18 Slave 11_Defect
  diagnostic event EventLIN18Slave11Defect: aging-allowed=true, event-kind=SWC, prestorage-freeze-frame=false  # Event_LIN 18 Slave 11_Defect
  diagnostic event to trouble code uds mapping EventDtcMapLIN18Slave11Defect: diagnostic-event=EventLIN18Slave11Defect, trouble-code-uds=LIN_18_Slave_11_Defect  # Event_Dtc_Map_LIN 18 Slave 11_Defect
  diagnostic event to operation cycle mapping EventOperCycleMapLIN18Slave11Defect: diagnostic-event=EventLIN18Slave11Defect, operation-cycle=DefaultOperationCycle  # Event_Oper_Cycle_Map_LIN 18 Slave 11_Defect
  diagnostic event to debounce algorithm mapping EventDebounceMapLIN18Slave11Defect: debounce-algorithm=counter_based, diagnostic-event=EventLIN18Slave11Defect  # EventDebounceMap_LIN 18 Slave 11_Defect
package /ZeC/DTC/DTC/LIN_18_Slave_1_NoCommunication
  diagnostic trouble code uds LIN_18_Slave_1_NoCommunication: dtc-props=Dtc_Props_358996c7, uds-dtc-value=0x031211  # LIN 18 Slave 1_NoCommunication
  diagnostic event EventLIN18Slave1NoCommunication: aging-allowed=true, event-kind=SWC, prestorage-freeze-frame=false  # Event_LIN 18 Slave 1_NoCommunication
  diagnostic event to trouble code uds mapping EventDtcMapLIN18Slave1NoCommunication: diagnostic-event=EventLIN18Slave1NoCommunication, trouble-code-uds=LIN_18_Slave_1_NoCommunication  # Event_Dtc_Map_LIN 18 Slave 1_NoCommunication
  diagnostic event to operation cycle mapping EventOperCycleMapLIN18Slave1NoCommunication: diagnostic-event=EventLIN18Slave1NoCommunication, operation-cycle=DefaultOperationCycle  # Event_Oper_Cycle_Map_LIN 18 Slave 1_NoCommunication
  diagnostic event to debounce algorithm mapping EventDebounceMapLIN18Slave1NoCommunication: debounce-algorithm=counter_based, diagnostic-event=EventLIN18Slave1NoCommunication  # EventDebounceMap_LIN 18 Slave 1_NoCommunication
package /ZeC/DTC/DTC/LIN_18_Slave_10_Defect
  diagnostic trouble code uds LIN_18_Slave_10_Defect: dtc-props=Dtc_Props_358996c7, uds-dtc-value=0x031212  # LIN 18 Slave 10_Defect
  diagnostic event EventLIN18Slave10Defect: aging-allowed=true, event-kind=SWC, prestorage-freeze-frame=false  # Event_LIN 18 Slave 10_Defect
  diagnostic event to trouble code uds mapping EventDtcMapLIN18Slave10Defect: diagnostic-event=EventLIN18Slave10Defect, trouble-code-uds=LIN_18_Slave_10_Defect  # Event_Dtc_Map_LIN 18 Slave 10_Defect
  diagnostic event to operation cycle mapping EventOperCycleMapLIN18Slave10Defect: diagnostic-event=EventLIN18Slave10Defect, operation-cycle=DefaultOperationCycle  # Event_Oper_Cycle_Map_LIN 18 Slave 10_Defect
  diagnostic event to debounce algorithm mapping EventDebounceMapLIN18Slave10Defect: debounce-algorithm=counter_based, diagnostic-event=EventLIN18Slave10Defect  # EventDebounceMap_LIN 18 Slave 10_Defect
package /ZeC/DTC/DTC/LIN_18_Slave_1_Defect
  diagnostic trouble code uds LIN_18_Slave_1_Defect: dtc-props=Dtc_Props_358996c7, uds-dtc-value=0x031210  # LIN 18 Slave 1_Defect
  diagnostic event EventLIN18Slave1Defect: aging-allowed=true, event-kind=SWC, prestorage-freeze-frame=false  # Event_LIN 18 Slave 1_Defect
  diagnostic event to trouble code uds mapping EventDtcMapLIN18Slave1Defect: diagnostic-event=EventLIN18Slave1Defect, trouble-code-uds=LIN_18_Slave_1_Defect  # Event_Dtc_Map_LIN 18 Slave 1_Defect
  diagnostic event to operation cycle mapping EventOperCycleMapLIN18Slave1Defect: diagnostic-event=EventLIN18Slave1Defect, operation-cycle=DefaultOperationCycle  # Event_Oper_Cycle_Map_LIN 18 Slave 1_Defect
  diagnostic event to debounce algorithm mapping EventDebounceMapLIN18Slave1Defect: debounce-algorithm=counter_based, diagnostic-event=EventLIN18Slave1Defect  # EventDebounceMap_LIN 18 Slave 1_Defect
package /ZeC/DTC/DTC/LIN_18_Slave_2_Defect
  diagnostic trouble code uds LIN_18_Slave_2_Defect: dtc-props=Dtc_Props_358996c7, uds-dtc-value=0x03121e  # LIN 18 Slave 2_Defect
  diagnostic event EventLIN18Slave2Defect: aging-allowed=true, event-kind=SWC, prestorage-freeze-frame=false  # Event_LIN 18 Slave 2_Defect
  diagnostic event to trouble code uds mapping EventDtcMapLIN18Slave2Defect: diagnostic-event=EventLIN18Slave2Defect, trouble-code-uds=LIN_18_Slave_2_Defect  # Event_Dtc_Map_LIN 18 Slave 2_Defect
  diagnostic event to operation cycle mapping EventOperCycleMapLIN18Slave2Defect: diagnostic-event=EventLIN18Slave2Defect, operation-cycle=DefaultOperationCycle  # Event_Oper_Cycle_Map_LIN 18 Slave 2_Defect
  diagnostic event to debounce algorithm mapping EventDebounceMapLIN18Slave2Defect: debounce-algorithm=counter_based, diagnostic-event=EventLIN18Slave2Defect  # EventDebounceMap_LIN 18 Slave 2_Defect
package /ZeC/DTC/DTC/LIN_18_Slave_15_Defect
  diagnostic trouble code uds LIN_18_Slave_15_Defect: dtc-props=Dtc_Props_358996c7, uds-dtc-value=0x03121c  # LIN 18 Slave 15_Defect
  diagnostic event EventLIN18Slave15Defect: aging-allowed=true, event-kind=SWC, prestorage-freeze-frame=false  # Event_LIN 18 Slave 15_Defect
  diagnostic event to trouble code uds mapping EventDtcMapLIN18Slave15Defect: diagnostic-event=EventLIN18Slave15Defect, trouble-code-uds=LIN_18_Slave_15_Defect  # Event_Dtc_Map_LIN 18 Slave 15_Defect
  diagnostic event to operation cycle mapping EventOperCycleMapLIN18Slave15Defect: diagnostic-event=EventLIN18Slave15Defect, operation-cycle=DefaultOperationCycle  # Event_Oper_Cycle_Map_LIN 18 Slave 15_Defect
  diagnostic event to debounce algorithm mapping EventDebounceMapLIN18Slave15Defect: debounce-algorithm=counter_based, diagnostic-event=EventLIN18Slave15Defect  # EventDebounceMap_LIN 18 Slave 15_Defect
package /ZeC/DTC/DTC/LIN_18_Slave_15_NoCommunication
  diagnostic trouble code uds LIN_18_Slave_15_NoCommunication: dtc-props=Dtc_Props_358996c7, uds-dtc-value=0x03121d  # LIN 18 Slave 15_NoCommunication
  diagnostic event EventLIN18Slave15NoCommunication: aging-allowed=true, event-kind=SWC, prestorage-freeze-frame=false  # Event_LIN 18 Slave 15_NoCommunication
  diagnostic event to trouble code uds mapping EventDtcMapLIN18Slave15NoCommunication: diagnostic-event=EventLIN18Slave15NoCommunication, trouble-code-uds=LIN_18_Slave_15_NoCommunication  # Event_Dtc_Map_LIN 18 Slave 15_NoCommunication
  diagnostic event to operation cycle mapping EventOperCycleMapLIN18Slave15NoCommunication: diagnostic-event=EventLIN18Slave15NoCommunication, operation-cycle=DefaultOperationCycle  # Event_Oper_Cycle_Map_LIN 18 Slave 15_NoCommunication
  diagnostic event to debounce algorithm mapping EventDebounceMapLIN18Slave15NoCommunication: debounce-algorithm=counter_based, diagnostic-event=EventLIN18Slave15NoCommunication  # EventDebounceMap_LIN 18 Slave 15_NoCommunication
package /ZeC/DTC/DTC/LIN_18_Slave_14_Defect
  diagnostic trouble code uds LIN_18_Slave_14_Defect: dtc-props=Dtc_Props_358996c7, uds-dtc-value=0x03121a  # LIN 18 Slave 14_Defect
  diagnostic event EventLIN18Slave14Defect: aging-allowed=true, event-kind=SWC, prestorage-freeze-frame=false  # Event_LIN 18 Slave 14_Defect
  diagnostic event to trouble code uds mapping EventDtcMapLIN18Slave14Defect: diagnostic-event=EventLIN18Slave14Defect, trouble-code-uds=LIN_18_Slave_14_Defect  # Event_Dtc_Map_LIN 18 Slave 14_Defect
  diagnostic event to operation cycle mapping EventOperCycleMapLIN18Slave14Defect: diagnostic-event=EventLIN18Slave14Defect, operation-cycle=DefaultOperationCycle  # Event_Oper_Cycle_Map_LIN 18 Slave 14_Defect
  diagnostic event to debounce algorithm mapping EventDebounceMapLIN18Slave14Defect: debounce-algorithm=counter_based, diagnostic-event=EventLIN18Slave14Defect  # EventDebounceMap_LIN 18 Slave 14_Defect
package /ZeC/DTC/DTC/LIN_18_Slave_14_NoCommunication
  diagnostic trouble code uds LIN_18_Slave_14_NoCommunication: dtc-props=Dtc_Props_358996c7, uds-dtc-value=0x03121b  # LIN 18 Slave 14_NoCommunication
  diagnostic event EventLIN18Slave14NoCommunication: aging-allowed=true, event-kind=SWC, prestorage-freeze-frame=false  # Event_LIN 18 Slave 14_NoCommunication
  diagnostic event to trouble code uds mapping EventDtcMapLIN18Slave14NoCommunication: diagnostic-event=EventLIN18Slave14NoCommunication, trouble-code-uds=LIN_18_Slave_14_NoCommunication  # Event_Dtc_Map_LIN 18 Slave 14_NoCommunication
  diagnostic event to operation cycle mapping EventOperCycleMapLIN18Slave14NoCommunication: diagnostic-event=EventLIN18Slave14NoCommunication, operation-cycle=DefaultOperationCycle  # Event_Oper_Cycle_Map_LIN 18 Slave 14_NoCommunication
  diagnostic event to debounce algorithm mapping EventDebounceMapLIN18Slave14NoCommunication: debounce-algorithm=counter_based, diagnostic-event=EventLIN18Slave14NoCommunication  # EventDebounceMap_LIN 18 Slave 14_NoCommunication
package /ZeC/DTC/DTC/local_service_registry_not_available
  diagnostic trouble code uds local_service_registry_not_available: dtc-props=Dtc_Props_76c48c34, uds-dtc-value=0x033401
  diagnostic event EventLocalServiceRegistryNotAvailable: aging-allowed=true, event-kind=SWC, prestorage-freeze-frame=false  # Event_local_service_registry_not_available
  diagnostic event to trouble code uds mapping EventDtcMapLocalServiceRegistryNotAvailable: diagnostic-event=EventLocalServiceRegistryNotAvailable, trouble-code-uds=local_service_registry_not_available  # Event_Dtc_Map_local_service_registry_not_available
  diagnostic event to operation cycle mapping EventOperCycleMapLocalServiceRegistryNotAvailable: diagnostic-event=EventLocalServiceRegistryNotAvailable, operation-cycle=DefaultOperationCycle  # Event_Oper_Cycle_Map_local_service_registry_not_available
  diagnostic event to debounce algorithm mapping EventDebounceMapLocalServiceRegistryNotAvailable: debounce-algorithm=counter_based, diagnostic-event=EventLocalServiceRegistryNotAvailable  # EventDebounceMap_local_service_registry_not_available
package /ZeC/DTC/DTC/LIN_18_Databus_No_Comm
  diagnostic trouble code uds LIN_18_Databus_No_Comm: dtc-props=Dtc_Props_358996c7, uds-dtc-value=0x031220  # LIN 18 Databus_No_Comm
  diagnostic event EventLIN18DatabusNoComm: aging-allowed=true, event-kind=SWC, prestorage-freeze-frame=false  # Event_LIN 18 Databus_No_Comm
  diagnostic event to trouble code uds mapping EventDtcMapLIN18DatabusNoComm: diagnostic-event=EventLIN18DatabusNoComm, trouble-code-uds=LIN_18_Databus_No_Comm  # Event_Dtc_Map_LIN 18 Databus_No_Comm
  diagnostic event to operation cycle mapping EventOperCycleMapLIN18DatabusNoComm: diagnostic-event=EventLIN18DatabusNoComm, operation-cycle=DefaultOperationCycle  # Event_Oper_Cycle_Map_LIN 18 Databus_No_Comm
  diagnostic event to debounce algorithm mapping EventDebounceMapLIN18DatabusNoComm: debounce-algorithm=counter_based, diagnostic-event=EventLIN18DatabusNoComm  # EventDebounceMap_LIN 18 Databus_No_Comm
package /ZeC/DTC/DTC/LIN_18_Local_Databus_Electrical_Failure
  diagnostic trouble code uds LIN_18_Local_Databus_Electrical_Failure: dtc-props=Dtc_Props_358996c7, uds-dtc-value=0x031221  # LIN 18 Local_Databus_Electrical_Failure
  diagnostic event EventLIN18LocalDatabusElectricalFailure: aging-allowed=true, event-kind=SWC, prestorage-freeze-frame=false  # Event_LIN 18 Local_Databus_Electrical_Failure
  diagnostic event to trouble code uds mapping EventDtcMapLIN18LocalDatabusElectricalFailure: diagnostic-event=EventLIN18LocalDatabusElectricalFailure, trouble-code-uds=LIN_18_Local_Databus_Electrical_Failure  # Event_Dtc_Map_LIN 18 Local_Databus_Electrical_Failure
  diagnostic event to operation cycle mapping EventOperCycleMapLIN18LocalDatabusElectricalFailure: diagnostic-event=EventLIN18LocalDatabusElectricalFailure, operation-cycle=DefaultOperationCycle  # Event_Oper_Cycle_Map_LIN 18 Local_Databus_Electrical_Failure
  diagnostic event to debounce algorithm mapping EventDebounceMapLIN18LocalDatabusElectricalFailure: debounce-algorithm=counter_based, diagnostic-event=EventLIN18LocalDatabusElectricalFailure  # EventDebounceMap_LIN 18 Local_Databus_Electrical_Failure
package /ZeC/DTC/DTC/Power_Path_138_Open_Load_Failure
  diagnostic trouble code uds Power_Path_138_Open_Load_Failure: dtc-props=Dtc_Props_deea3e2c, uds-dtc-value=0x00538a
  diagnostic event EventPowerPath138OpenLoadFailure: aging-allowed=true, event-kind=SWC, prestorage-freeze-frame=false  # Event_Power_Path_138_Open_Load_Failure
  diagnostic event to trouble code uds mapping EventDtcMapPowerPath138OpenLoadFailure: diagnostic-event=EventPowerPath138OpenLoadFailure, trouble-code-uds=Power_Path_138_Open_Load_Failure  # Event_Dtc_Map_Power_Path_138_Open_Load_Failure
  diagnostic event to operation cycle mapping EventOperCycleMapPowerPath138OpenLoadFailure: diagnostic-event=EventPowerPath138OpenLoadFailure, operation-cycle=DefaultOperationCycle  # Event_Oper_Cycle_Map_Power_Path_138_Open_Load_Failure
  diagnostic event to debounce algorithm mapping EventDebounceMapPowerPath138OpenLoadFailure: debounce-algorithm=time_based, diagnostic-event=EventPowerPath138OpenLoadFailure  # EventDebounceMap_Power_Path_138_Open_Load_Failure
package /ZeC/DTC/DTC/Power_Path_143_Open_Load_Failure
  diagnostic trouble code uds Power_Path_143_Open_Load_Failure: dtc-props=Dtc_Props_d7d40ecb, uds-dtc-value=0x00538f
  diagnostic event EventPowerPath143OpenLoadFailure: aging-allowed=true, event-kind=SWC, prestorage-freeze-frame=false  # Event_Power_Path_143_Open_Load_Failure
  diagnostic event to trouble code uds mapping EventDtcMapPowerPath143OpenLoadFailure: diagnostic-event=EventPowerPath143OpenLoadFailure, trouble-code-uds=Power_Path_143_Open_Load_Failure  # Event_Dtc_Map_Power_Path_143_Open_Load_Failure
  diagnostic event to operation cycle mapping EventOperCycleMapPowerPath143OpenLoadFailure: diagnostic-event=EventPowerPath143OpenLoadFailure, operation-cycle=DefaultOperationCycle  # Event_Oper_Cycle_Map_Power_Path_143_Open_Load_Failure
  diagnostic event to debounce algorithm mapping EventDebounceMapPowerPath143OpenLoadFailure: debounce-algorithm=time_based, diagnostic-event=EventPowerPath143OpenLoadFailure  # EventDebounceMap_Power_Path_143_Open_Load_Failure
package /ZeC/DTC/DTC/Power_Path_140_Open_Load_Failure
  diagnostic trouble code uds Power_Path_140_Open_Load_Failure: dtc-props=Dtc_Props_52d82a58, uds-dtc-value=0x00538c
  diagnostic event EventPowerPath140OpenLoadFailure: aging-allowed=true, event-kind=SWC, prestorage-freeze-frame=false  # Event_Power_Path_140_Open_Load_Failure
  diagnostic event to trouble code uds mapping EventDtcMapPowerPath140OpenLoadFailure: diagnostic-event=EventPowerPath140OpenLoadFailure, trouble-code-uds=Power_Path_140_Open_Load_Failure  # Event_Dtc_Map_Power_Path_140_Open_Load_Failure
  diagnostic event to operation cycle mapping EventOperCycleMapPowerPath140OpenLoadFailure: diagnostic-event=EventPowerPath140OpenLoadFailure, operation-cycle=DefaultOperationCycle  # Event_Oper_Cycle_Map_Power_Path_140_Open_Load_Failure
  diagnostic event to debounce algorithm mapping EventDebounceMapPowerPath140OpenLoadFailure: debounce-algorithm=time_based, diagnostic-event=EventPowerPath140OpenLoadFailure  # EventDebounceMap_Power_Path_140_Open_Load_Failure
package /ZeC/DTC/DTC/Power_Path_139_Open_Load_Failure
  diagnostic trouble code uds Power_Path_139_Open_Load_Failure: dtc-props=Dtc_Props_14c12062, uds-dtc-value=0x00538b
  diagnostic event EventPowerPath139OpenLoadFailure: aging-allowed=true, event-kind=SWC, prestorage-freeze-frame=false  # Event_Power_Path_139_Open_Load_Failure
  diagnostic event to trouble code uds mapping EventDtcMapPowerPath139OpenLoadFailure: diagnostic-event=EventPowerPath139OpenLoadFailure, trouble-code-uds=Power_Path_139_Open_Load_Failure  # Event_Dtc_Map_Power_Path_139_Open_Load_Failure
  diagnostic event to operation cycle mapping EventOperCycleMapPowerPath139OpenLoadFailure: diagnostic-event=EventPowerPath139OpenLoadFailure, operation-cycle=DefaultOperationCycle  # Event_Oper_Cycle_Map_Power_Path_139_Open_Load_Failure
  diagnostic event to debounce algorithm mapping EventDebounceMapPowerPath139OpenLoadFailure: debounce-algorithm=time_based, diagnostic-event=EventPowerPath139OpenLoadFailure  # EventDebounceMap_Power_Path_139_Open_Load_Failure
package /ZeC/DTC/DTC/Power_Path_142_Open_Load_Failure
  diagnostic trouble code uds Power_Path_142_Open_Load_Failure: dtc-props=Dtc_Props_1dff1085, uds-dtc-value=0x00538e
  diagnostic event EventPowerPath142OpenLoadFailure: aging-allowed=true, event-kind=SWC, prestorage-freeze-frame=false  # Event_Power_Path_142_Open_Load_Failure
  diagnostic event to trouble code uds mapping EventDtcMapPowerPath142OpenLoadFailure: diagnostic-event=EventPowerPath142OpenLoadFailure, trouble-code-uds=Power_Path_142_Open_Load_Failure  # Event_Dtc_Map_Power_Path_142_Open_Load_Failure
  diagnostic event to operation cycle mapping EventOperCycleMapPowerPath142OpenLoadFailure: diagnostic-event=EventPowerPath142OpenLoadFailure, operation-cycle=DefaultOperationCycle  # Event_Oper_Cycle_Map_Power_Path_142_Open_Load_Failure
  diagnostic event to debounce algorithm mapping EventDebounceMapPowerPath142OpenLoadFailure: debounce-algorithm=time_based, diagnostic-event=EventPowerPath142OpenLoadFailure  # EventDebounceMap_Power_Path_142_Open_Load_Failure
package /ZeC/DTC/DTC/Power_Path_141_Open_Load_Failure
  diagnostic trouble code uds Power_Path_141_Open_Load_Failure: dtc-props=Dtc_Props_5be61abf, uds-dtc-value=0x00538d
  diagnostic event EventPowerPath141OpenLoadFailure: aging-allowed=true, event-kind=SWC, prestorage-freeze-frame=false  # Event_Power_Path_141_Open_Load_Failure
  diagnostic event to trouble code uds mapping EventDtcMapPowerPath141OpenLoadFailure: diagnostic-event=EventPowerPath141OpenLoadFailure, trouble-code-uds=Power_Path_141_Open_Load_Failure  # Event_Dtc_Map_Power_Path_141_Open_Load_Failure
  diagnostic event to operation cycle mapping EventOperCycleMapPowerPath141OpenLoadFailure: diagnostic-event=EventPowerPath141OpenLoadFailure, operation-cycle=DefaultOperationCycle  # Event_Oper_Cycle_Map_Power_Path_141_Open_Load_Failure
  diagnostic event to debounce algorithm mapping EventDebounceMapPowerPath141OpenLoadFailure: debounce-algorithm=time_based, diagnostic-event=EventPowerPath141OpenLoadFailure  # EventDebounceMap_Power_Path_141_Open_Load_Failure
package /ZeC/DTC/DTC/Power_Path_144_Open_Load_Failure
  diagnostic trouble code uds Power_Path_144_Open_Load_Failure: dtc-props=Dtc_Props_634690d3, uds-dtc-value=0x005390
  diagnostic event EventPowerPath144OpenLoadFailure: aging-allowed=true, event-kind=SWC, prestorage-freeze-frame=false  # Event_Power_Path_144_Open_Load_Failure
  diagnostic event to trouble code uds mapping EventDtcMapPowerPath144OpenLoadFailure: diagnostic-event=EventPowerPath144OpenLoadFailure, trouble-code-uds=Power_Path_144_Open_Load_Failure  # Event_Dtc_Map_Power_Path_144_Open_Load_Failure
  diagnostic event to operation cycle mapping EventOperCycleMapPowerPath144OpenLoadFailure: diagnostic-event=EventPowerPath144OpenLoadFailure, operation-cycle=DefaultOperationCycle  # Event_Oper_Cycle_Map_Power_Path_144_Open_Load_Failure
  diagnostic event to debounce algorithm mapping EventDebounceMapPowerPath144OpenLoadFailure: debounce-algorithm=time_based, diagnostic-event=EventPowerPath144OpenLoadFailure  # EventDebounceMap_Power_Path_144_Open_Load_Failure
package /ZeC/DTC/DTC/Power_Path_146_Open_Load_Failure
  diagnostic trouble code uds Power_Path_146_Open_Load_Failure: dtc-props=Dtc_Props_ef7484a7, uds-dtc-value=0x005392
  diagnostic event EventPowerPath146OpenLoadFailure: aging-allowed=true, event-kind=SWC, prestorage-freeze-frame=false  # Event_Power_Path_146_Open_Load_Failure
  diagnostic event to trouble code uds mapping EventDtcMapPowerPath146OpenLoadFailure: diagnostic-event=EventPowerPath146OpenLoadFailure, trouble-code-uds=Power_Path_146_Open_Load_Failure  # Event_Dtc_Map_Power_Path_146_Open_Load_Failure
  diagnostic event to operation cycle mapping EventOperCycleMapPowerPath146OpenLoadFailure: diagnostic-event=EventPowerPath146OpenLoadFailure, operation-cycle=DefaultOperationCycle  # Event_Oper_Cycle_Map_Power_Path_146_Open_Load_Failure
  diagnostic event to debounce algorithm mapping EventDebounceMapPowerPath146OpenLoadFailure: debounce-algorithm=time_based, diagnostic-event=EventPowerPath146OpenLoadFailure  # EventDebounceMap_Power_Path_146_Open_Load_Failure
package /ZeC/DTC/DTC/Power_Path_145_Open_Load_Failure
  diagnostic trouble code uds Power_Path_145_Open_Load_Failure: dtc-props=Dtc_Props_255f9ae9, uds-dtc-value=0x005391
  diagnostic event EventPowerPath145OpenLoadFailure: aging-allowed=true, event-kind=SWC, prestorage-freeze-frame=false  # Event_Power_Path_145_Open_Load_Failure
  diagnostic event to trouble code uds mapping EventDtcMapPowerPath145OpenLoadFailure: diagnostic-event=EventPowerPath145OpenLoadFailure, trouble-code-uds=Power_Path_145_Open_Load_Failure  # Event_Dtc_Map_Power_Path_145_Open_Load_Failure
  diagnostic event to operation cycle mapping EventOperCycleMapPowerPath145OpenLoadFailure: diagnostic-event=EventPowerPath145OpenLoadFailure, operation-cycle=DefaultOperationCycle  # Event_Oper_Cycle_Map_Power_Path_145_Open_Load_Failure
  diagnostic event to debounce algorithm mapping EventDebounceMapPowerPath145OpenLoadFailure: debounce-algorithm=time_based, diagnostic-event=EventPowerPath145OpenLoadFailure  # EventDebounceMap_Power_Path_145_Open_Load_Failure
package /ZeC/DTC/DTC/Power_Path_160_Over_Temperature_Failure
  diagnostic trouble code uds Power_Path_160_Over_Temperature_Failure: dtc-props=Dtc_Props_c92c78b3, uds-dtc-value=0x0057a0
  diagnostic event EventPowerPath160OverTemperatureFailure: aging-allowed=true, event-kind=SWC, prestorage-freeze-frame=false  # Event_Power_Path_160_Over_Temperature_Failure
  diagnostic event to trouble code uds mapping EventDtcMapPowerPath160OverTemperatureFailure: diagnostic-event=EventPowerPath160OverTemperatureFailure, trouble-code-uds=Power_Path_160_Over_Temperature_Failure  # Event_Dtc_Map_Power_Path_160_Over_Temperature_Failure
  diagnostic event to operation cycle mapping EventOperCycleMapPowerPath160OverTemperatureFailure: diagnostic-event=EventPowerPath160OverTemperatureFailure, operation-cycle=DefaultOperationCycle  # Event_Oper_Cycle_Map_Power_Path_160_Over_Temperature_Failure
  diagnostic event to debounce algorithm mapping EventDebounceMapPowerPath160OverTemperatureFailure: debounce-algorithm=time_based, diagnostic-event=EventPowerPath160OverTemperatureFailure  # EventDebounceMap_Power_Path_160_Over_Temperature_Failure
package /ZeC/DTC/DTC/Power_Path_152_Open_Load_Failure
  diagnostic trouble code uds Power_Path_152_Open_Load_Failure: dtc-props=Dtc_Props_3e1dcbc0, uds-dtc-value=0x005398
  diagnostic event EventPowerPath152OpenLoadFailure: aging-allowed=true, event-kind=SWC, prestorage-freeze-frame=false  # Event_Power_Path_152_Open_Load_Failure
  diagnostic event to trouble code uds mapping EventDtcMapPowerPath152OpenLoadFailure: diagnostic-event=EventPowerPath152OpenLoadFailure, trouble-code-uds=Power_Path_152_Open_Load_Failure  # Event_Dtc_Map_Power_Path_152_Open_Load_Failure
  diagnostic event to operation cycle mapping EventOperCycleMapPowerPath152OpenLoadFailure: diagnostic-event=EventPowerPath152OpenLoadFailure, operation-cycle=DefaultOperationCycle  # Event_Oper_Cycle_Map_Power_Path_152_Open_Load_Failure
  diagnostic event to debounce algorithm mapping EventDebounceMapPowerPath152OpenLoadFailure: debounce-algorithm=time_based, diagnostic-event=EventPowerPath152OpenLoadFailure  # EventDebounceMap_Power_Path_152_Open_Load_Failure
package /ZeC/DTC/DTC/Power_Path_151_Open_Load_Failure
  diagnostic trouble code uds Power_Path_151_Open_Load_Failure: dtc-props=Dtc_Props_6a78a034, uds-dtc-value=0x005397
  diagnostic event EventPowerPath151OpenLoadFailure: aging-allowed=true, event-kind=SWC, prestorage-freeze-frame=false  # Event_Power_Path_151_Open_Load_Failure
  diagnostic event to trouble code uds mapping EventDtcMapPowerPath151OpenLoadFailure: diagnostic-event=EventPowerPath151OpenLoadFailure, trouble-code-uds=Power_Path_151_Open_Load_Failure  # Event_Dtc_Map_Power_Path_151_Open_Load_Failure
  diagnostic event to operation cycle mapping EventOperCycleMapPowerPath151OpenLoadFailure: diagnostic-event=EventPowerPath151OpenLoadFailure, operation-cycle=DefaultOperationCycle  # Event_Oper_Cycle_Map_Power_Path_151_Open_Load_Failure
  diagnostic event to debounce algorithm mapping EventDebounceMapPowerPath151OpenLoadFailure: debounce-algorithm=time_based, diagnostic-event=EventPowerPath151OpenLoadFailure  # EventDebounceMap_Power_Path_151_Open_Load_Failure
package /ZeC/DTC/DTC/Power_Path_153_Open_Load_Failure
  diagnostic trouble code uds Power_Path_153_Open_Load_Failure: dtc-props=Dtc_Props_7804c1fa, uds-dtc-value=0x005399
  diagnostic event EventPowerPath153OpenLoadFailure: aging-allowed=true, event-kind=SWC, prestorage-freeze-frame=false  # Event_Power_Path_153_Open_Load_Failure
  diagnostic event to trouble code uds mapping EventDtcMapPowerPath153OpenLoadFailure: diagnostic-event=EventPowerPath153OpenLoadFailure, trouble-code-uds=Power_Path_153_Open_Load_Failure  # Event_Dtc_Map_Power_Path_153_Open_Load_Failure
  diagnostic event to operation cycle mapping EventOperCycleMapPowerPath153OpenLoadFailure: diagnostic-event=EventPowerPath153OpenLoadFailure, operation-cycle=DefaultOperationCycle  # Event_Oper_Cycle_Map_Power_Path_153_Open_Load_Failure
  diagnostic event to debounce algorithm mapping EventDebounceMapPowerPath153OpenLoadFailure: debounce-algorithm=time_based, diagnostic-event=EventPowerPath153OpenLoadFailure  # EventDebounceMap_Power_Path_153_Open_Load_Failure
package /ZeC/DTC/DTC/Power_Path_148_Open_Load_Failure
  diagnostic trouble code uds Power_Path_148_Open_Load_Failure: dtc-props=Dtc_Props_a053be7a, uds-dtc-value=0x005394
  diagnostic event EventPowerPath148OpenLoadFailure: aging-allowed=true, event-kind=SWC, prestorage-freeze-frame=false  # Event_Power_Path_148_Open_Load_Failure
  diagnostic event to trouble code uds mapping EventDtcMapPowerPath148OpenLoadFailure: diagnostic-event=EventPowerPath148OpenLoadFailure, trouble-code-uds=Power_Path_148_Open_Load_Failure  # Event_Dtc_Map_Power_Path_148_Open_Load_Failure
  diagnostic event to operation cycle mapping EventOperCycleMapPowerPath148OpenLoadFailure: diagnostic-event=EventPowerPath148OpenLoadFailure, operation-cycle=DefaultOperationCycle  # Event_Oper_Cycle_Map_Power_Path_148_Open_Load_Failure
  diagnostic event to debounce algorithm mapping EventDebounceMapPowerPath148OpenLoadFailure: debounce-algorithm=time_based, diagnostic-event=EventPowerPath148OpenLoadFailure  # EventDebounceMap_Power_Path_148_Open_Load_Failure
package /ZeC/DTC/DTC/Power_Path_147_Open_Load_Failure
  diagnostic trouble code uds Power_Path_147_Open_Load_Failure: dtc-props=Dtc_Props_a96d8e9d, uds-dtc-value=0x005393
  diagnostic event EventPowerPath147OpenLoadFailure: aging-allowed=true, event-kind=SWC, prestorage-freeze-frame=false  # Event_Power_Path_147_Open_Load_Failure
  diagnostic event to trouble code uds mapping EventDtcMapPowerPath147OpenLoadFailure: diagnostic-event=EventPowerPath147OpenLoadFailure, trouble-code-uds=Power_Path_147_Open_Load_Failure  # Event_Dtc_Map_Power_Path_147_Open_Load_Failure
  diagnostic event to operation cycle mapping EventOperCycleMapPowerPath147OpenLoadFailure: diagnostic-event=EventPowerPath147OpenLoadFailure, operation-cycle=DefaultOperationCycle  # Event_Oper_Cycle_Map_Power_Path_147_Open_Load_Failure
  diagnostic event to debounce algorithm mapping EventDebounceMapPowerPath147OpenLoadFailure: debounce-algorithm=time_based, diagnostic-event=EventPowerPath147OpenLoadFailure  # EventDebounceMap_Power_Path_147_Open_Load_Failure
package /ZeC/DTC/DTC/Power_Path_150_Open_Load_Failure
  diagnostic trouble code uds Power_Path_150_Open_Load_Failure: dtc-props=Dtc_Props_2c61aa0e, uds-dtc-value=0x005396
  diagnostic event EventPowerPath150OpenLoadFailure: aging-allowed=true, event-kind=SWC, prestorage-freeze-frame=false  # Event_Power_Path_150_Open_Load_Failure
  diagnostic event to trouble code uds mapping EventDtcMapPowerPath150OpenLoadFailure: diagnostic-event=EventPowerPath150OpenLoadFailure, trouble-code-uds=Power_Path_150_Open_Load_Failure  # Event_Dtc_Map_Power_Path_150_Open_Load_Failure
  diagnostic event to operation cycle mapping EventOperCycleMapPowerPath150OpenLoadFailure: diagnostic-event=EventPowerPath150OpenLoadFailure, operation-cycle=DefaultOperationCycle  # Event_Oper_Cycle_Map_Power_Path_150_Open_Load_Failure
  diagnostic event to debounce algorithm mapping EventDebounceMapPowerPath150OpenLoadFailure: debounce-algorithm=time_based, diagnostic-event=EventPowerPath150OpenLoadFailure  # EventDebounceMap_Power_Path_150_Open_Load_Failure
package /ZeC/DTC/DTC/Power_Path_149_Open_Load_Failure
  diagnostic trouble code uds Power_Path_149_Open_Load_Failure: dtc-props=Dtc_Props_e64ab440, uds-dtc-value=0x005395
  diagnostic event EventPowerPath149OpenLoadFailure: aging-allowed=true, event-kind=SWC, prestorage-freeze-frame=false  # Event_Power_Path_149_Open_Load_Failure
  diagnostic event to trouble code uds mapping EventDtcMapPowerPath149OpenLoadFailure: diagnostic-event=EventPowerPath149OpenLoadFailure, trouble-code-uds=Power_Path_149_Open_Load_Failure  # Event_Dtc_Map_Power_Path_149_Open_Load_Failure
  diagnostic event to operation cycle mapping EventOperCycleMapPowerPath149OpenLoadFailure: diagnostic-event=EventPowerPath149OpenLoadFailure, operation-cycle=DefaultOperationCycle  # Event_Oper_Cycle_Map_Power_Path_149_Open_Load_Failure
  diagnostic event to debounce algorithm mapping EventDebounceMapPowerPath149OpenLoadFailure: debounce-algorithm=time_based, diagnostic-event=EventPowerPath149OpenLoadFailure  # EventDebounceMap_Power_Path_149_Open_Load_Failure
package /ZeC/DTC/DTC/LIN_18_Slave_6_Defect
  diagnostic trouble code uds LIN_18_Slave_6_Defect: dtc-props=Dtc_Props_358996c7, uds-dtc-value=0x031208  # LIN 18 Slave 6_Defect
  diagnostic event EventLIN18Slave6Defect: aging-allowed=true, event-kind=SWC, prestorage-freeze-frame=false  # Event_LIN 18 Slave 6_Defect
  diagnostic event to trouble code uds mapping EventDtcMapLIN18Slave6Defect: diagnostic-event=EventLIN18Slave6Defect, trouble-code-uds=LIN_18_Slave_6_Defect  # Event_Dtc_Map_LIN 18 Slave 6_Defect
  diagnostic event to operation cycle mapping EventOperCycleMapLIN18Slave6Defect: diagnostic-event=EventLIN18Slave6Defect, operation-cycle=DefaultOperationCycle  # Event_Oper_Cycle_Map_LIN 18 Slave 6_Defect
  diagnostic event to debounce algorithm mapping EventDebounceMapLIN18Slave6Defect: debounce-algorithm=counter_based, diagnostic-event=EventLIN18Slave6Defect  # EventDebounceMap_LIN 18 Slave 6_Defect
package /ZeC/DTC/DTC/LIN_18_Slave_6_NoCommunication
  diagnostic trouble code uds LIN_18_Slave_6_NoCommunication: dtc-props=Dtc_Props_358996c7, uds-dtc-value=0x031209  # LIN 18 Slave 6_NoCommunication
  diagnostic event EventLIN18Slave6NoCommunication: aging-allowed=true, event-kind=SWC, prestorage-freeze-frame=false  # Event_LIN 18 Slave 6_NoCommunication
  diagnostic event to trouble code uds mapping EventDtcMapLIN18Slave6NoCommunication: diagnostic-event=EventLIN18Slave6NoCommunication, trouble-code-uds=LIN_18_Slave_6_NoCommunication  # Event_Dtc_Map_LIN 18 Slave 6_NoCommunication
  diagnostic event to operation cycle mapping EventOperCycleMapLIN18Slave6NoCommunication: diagnostic-event=EventLIN18Slave6NoCommunication, operation-cycle=DefaultOperationCycle  # Event_Oper_Cycle_Map_LIN 18 Slave 6_NoCommunication
  diagnostic event to debounce algorithm mapping EventDebounceMapLIN18Slave6NoCommunication: debounce-algorithm=counter_based, diagnostic-event=EventLIN18Slave6NoCommunication  # EventDebounceMap_LIN 18 Slave 6_NoCommunication
package /ZeC/DTC/DTC/LIN_18_Slave_5_Defect
  diagnostic trouble code uds LIN_18_Slave_5_Defect: dtc-props=Dtc_Props_358996c7, uds-dtc-value=0x031206  # LIN 18 Slave 5_Defect
  diagnostic event EventLIN18Slave5Defect: aging-allowed=true, event-kind=SWC, prestorage-freeze-frame=false  # Event_LIN 18 Slave 5_Defect
  diagnostic event to trouble code uds mapping EventDtcMapLIN18Slave5Defect: diagnostic-event=EventLIN18Slave5Defect, trouble-code-uds=LIN_18_Slave_5_Defect  # Event_Dtc_Map_LIN 18 Slave 5_Defect
  diagnostic event to operation cycle mapping EventOperCycleMapLIN18Slave5Defect: diagnostic-event=EventLIN18Slave5Defect, operation-cycle=DefaultOperationCycle  # Event_Oper_Cycle_Map_LIN 18 Slave 5_Defect
  diagnostic event to debounce algorithm mapping EventDebounceMapLIN18Slave5Defect: debounce-algorithm=counter_based, diagnostic-event=EventLIN18Slave5Defect  # EventDebounceMap_LIN 18 Slave 5_Defect
package /ZeC/DTC/DTC/LIN_18_Slave_5_NoCommunication
  diagnostic trouble code uds LIN_18_Slave_5_NoCommunication: dtc-props=Dtc_Props_358996c7, uds-dtc-value=0x031207  # LIN 18 Slave 5_NoCommunication
  diagnostic event EventLIN18Slave5NoCommunication: aging-allowed=true, event-kind=SWC, prestorage-freeze-frame=false  # Event_LIN 18 Slave 5_NoCommunication
  diagnostic event to trouble code uds mapping EventDtcMapLIN18Slave5NoCommunication: diagnostic-event=EventLIN18Slave5NoCommunication, trouble-code-uds=LIN_18_Slave_5_NoCommunication  # Event_Dtc_Map_LIN 18 Slave 5_NoCommunication
  diagnostic event to operation cycle mapping EventOperCycleMapLIN18Slave5NoCommunication: diagnostic-event=EventLIN18Slave5NoCommunication, operation-cycle=DefaultOperationCycle  # Event_Oper_Cycle_Map_LIN 18 Slave 5_NoCommunication
  diagnostic event to debounce algorithm mapping EventDebounceMapLIN18Slave5NoCommunication: debounce-algorithm=counter_based, diagnostic-event=EventLIN18Slave5NoCommunication  # EventDebounceMap_LIN 18 Slave 5_NoCommunication
package /ZeC/DTC/DTC/Power_Path_121_Open_Load_Failure
  diagnostic trouble code uds Power_Path_121_Open_Load_Failure: dtc-props=Dtc_Props_4ca522c, uds-dtc-value=0x005379
  diagnostic event EventPowerPath121OpenLoadFailure: aging-allowed=true, event-kind=SWC, prestorage-freeze-frame=false  # Event_Power_Path_121_Open_Load_Failure
  diagnostic event to trouble code uds mapping EventDtcMapPowerPath121OpenLoadFailure: diagnostic-event=EventPowerPath121OpenLoadFailure, trouble-code-uds=Power_Path_121_Open_Load_Failure  # Event_Dtc_Map_Power_Path_121_Open_Load_Failure
  diagnostic event to operation cycle mapping EventOperCycleMapPowerPath121OpenLoadFailure: diagnostic-event=EventPowerPath121OpenLoadFailure, operation-cycle=DefaultOperationCycle  # Event_Oper_Cycle_Map_Power_Path_121_Open_Load_Failure
  diagnostic event to debounce algorithm mapping EventDebounceMapPowerPath121OpenLoadFailure: debounce-algorithm=time_based, diagnostic-event=EventPowerPath121OpenLoadFailure  # EventDebounceMap_Power_Path_121_Open_Load_Failure
package /ZeC/DTC/DTC/LIN_18_Slave_4_Defect
  diagnostic trouble code uds LIN_18_Slave_4_Defect: dtc-props=Dtc_Props_358996c7, uds-dtc-value=0x031204  # LIN 18 Slave 4_Defect
  diagnostic event EventLIN18Slave4Defect: aging-allowed=true, event-kind=SWC, prestorage-freeze-frame=false  # Event_LIN 18 Slave 4_Defect
  diagnostic event to trouble code uds mapping EventDtcMapLIN18Slave4Defect: diagnostic-event=EventLIN18Slave4Defect, trouble-code-uds=LIN_18_Slave_4_Defect  # Event_Dtc_Map_LIN 18 Slave 4_Defect
  diagnostic event to operation cycle mapping EventOperCycleMapLIN18Slave4Defect: diagnostic-event=EventLIN18Slave4Defect, operation-cycle=DefaultOperationCycle  # Event_Oper_Cycle_Map_LIN 18 Slave 4_Defect
  diagnostic event to debounce algorithm mapping EventDebounceMapLIN18Slave4Defect: debounce-algorithm=counter_based, diagnostic-event=EventLIN18Slave4Defect  # EventDebounceMap_LIN 18 Slave 4_Defect
package /ZeC/DTC/DTC/LIN_18_Slave_4_NoCommunication
  diagnostic trouble code uds LIN_18_Slave_4_NoCommunication: dtc-props=Dtc_Props_358996c7, uds-dtc-value=0x031205  # LIN 18 Slave 4_NoCommunication
  diagnostic event EventLIN18Slave4NoCommunication: aging-allowed=true, event-kind=SWC, prestorage-freeze-frame=false  # Event_LIN 18 Slave 4_NoCommunication
  diagnostic event to trouble code uds mapping EventDtcMapLIN18Slave4NoCommunication: diagnostic-event=EventLIN18Slave4NoCommunication, trouble-code-uds=LIN_18_Slave_4_NoCommunication  # Event_Dtc_Map_LIN 18 Slave 4_NoCommunication
  diagnostic event to operation cycle mapping EventOperCycleMapLIN18Slave4NoCommunication: diagnostic-event=EventLIN18Slave4NoCommunication, operation-cycle=DefaultOperationCycle  # Event_Oper_Cycle_Map_LIN 18 Slave 4_NoCommunication
  diagnostic event to debounce algorithm mapping EventDebounceMapLIN18Slave4NoCommunication: debounce-algorithm=counter_based, diagnostic-event=EventLIN18Slave4NoCommunication  # EventDebounceMap_LIN 18 Slave 4_NoCommunication
package /ZeC/DTC/DTC/LIN_18_Slave_3_Defect
  diagnostic trouble code uds LIN_18_Slave_3_Defect: dtc-props=Dtc_Props_358996c7, uds-dtc-value=0x031202  # LIN 18 Slave 3_Defect
  diagnostic event EventLIN18Slave3Defect: aging-allowed=true, event-kind=SWC, prestorage-freeze-frame=false  # Event_LIN 18 Slave 3_Defect
  diagnostic event to trouble code uds mapping EventDtcMapLIN18Slave3Defect: diagnostic-event=EventLIN18Slave3Defect, trouble-code-uds=LIN_18_Slave_3_Defect  # Event_Dtc_Map_LIN 18 Slave 3_Defect
  diagnostic event to operation cycle mapping EventOperCycleMapLIN18Slave3Defect: diagnostic-event=EventLIN18Slave3Defect, operation-cycle=DefaultOperationCycle  # Event_Oper_Cycle_Map_LIN 18 Slave 3_Defect
  diagnostic event to debounce algorithm mapping EventDebounceMapLIN18Slave3Defect: debounce-algorithm=counter_based, diagnostic-event=EventLIN18Slave3Defect  # EventDebounceMap_LIN 18 Slave 3_Defect
package /ZeC/DTC/DTC/Power_Path_127_Open_Load_Failure
  diagnostic trouble code uds Power_Path_127_Open_Load_Failure: dtc-props=Dtc_Props_6d505da5, uds-dtc-value=0x00537f
  diagnostic event EventPowerPath127OpenLoadFailure: aging-allowed=true, event-kind=SWC, prestorage-freeze-frame=false  # Event_Power_Path_127_Open_Load_Failure
  diagnostic event to trouble code uds mapping EventDtcMapPowerPath127OpenLoadFailure: diagnostic-event=EventPowerPath127OpenLoadFailure, trouble-code-uds=Power_Path_127_Open_Load_Failure  # Event_Dtc_Map_Power_Path_127_Open_Load_Failure
  diagnostic event to operation cycle mapping EventOperCycleMapPowerPath127OpenLoadFailure: diagnostic-event=EventPowerPath127OpenLoadFailure, operation-cycle=DefaultOperationCycle  # Event_Oper_Cycle_Map_Power_Path_127_Open_Load_Failure
  diagnostic event to debounce algorithm mapping EventDebounceMapPowerPath127OpenLoadFailure: debounce-algorithm=time_based, diagnostic-event=EventPowerPath127OpenLoadFailure  # EventDebounceMap_Power_Path_127_Open_Load_Failure
package /ZeC/DTC/DTC/LIN_18_Slave_3_NoCommunication
  diagnostic trouble code uds LIN_18_Slave_3_NoCommunication: dtc-props=Dtc_Props_358996c7, uds-dtc-value=0x031203  # LIN 18 Slave 3_NoCommunication
  diagnostic event EventLIN18Slave3NoCommunication: aging-allowed=true, event-kind=SWC, prestorage-freeze-frame=false  # Event_LIN 18 Slave 3_NoCommunication
  diagnostic event to trouble code uds mapping EventDtcMapLIN18Slave3NoCommunication: diagnostic-event=EventLIN18Slave3NoCommunication, trouble-code-uds=LIN_18_Slave_3_NoCommunication  # Event_Dtc_Map_LIN 18 Slave 3_NoCommunication
  diagnostic event to operation cycle mapping EventOperCycleMapLIN18Slave3NoCommunication: diagnostic-event=EventLIN18Slave3NoCommunication, operation-cycle=DefaultOperationCycle  # Event_Oper_Cycle_Map_LIN 18 Slave 3_NoCommunication
  diagnostic event to debounce algorithm mapping EventDebounceMapLIN18Slave3NoCommunication: debounce-algorithm=counter_based, diagnostic-event=EventLIN18Slave3NoCommunication  # EventDebounceMap_LIN 18 Slave 3_NoCommunication
package /ZeC/DTC/DTC/Power_Path_126_Open_Load_Failure
  diagnostic trouble code uds Power_Path_126_Open_Load_Failure: dtc-props=Dtc_Props_a77b43eb, uds-dtc-value=0x00537e
  diagnostic event EventPowerPath126OpenLoadFailure: aging-allowed=true, event-kind=SWC, prestorage-freeze-frame=false  # Event_Power_Path_126_Open_Load_Failure
  diagnostic event to trouble code uds mapping EventDtcMapPowerPath126OpenLoadFailure: diagnostic-event=EventPowerPath126OpenLoadFailure, trouble-code-uds=Power_Path_126_Open_Load_Failure  # Event_Dtc_Map_Power_Path_126_Open_Load_Failure
  diagnostic event to operation cycle mapping EventOperCycleMapPowerPath126OpenLoadFailure: diagnostic-event=EventPowerPath126OpenLoadFailure, operation-cycle=DefaultOperationCycle  # Event_Oper_Cycle_Map_Power_Path_126_Open_Load_Failure
  diagnostic event to debounce algorithm mapping EventDebounceMapPowerPath126OpenLoadFailure: debounce-algorithm=time_based, diagnostic-event=EventPowerPath126OpenLoadFailure  # EventDebounceMap_Power_Path_126_Open_Load_Failure
package /ZeC/DTC/DTC/LIN_18_Slave_2_NoCommunication
  diagnostic trouble code uds LIN_18_Slave_2_NoCommunication: dtc-props=Dtc_Props_358996c7, uds-dtc-value=0x031201  # LIN 18 Slave 2_NoCommunication
  diagnostic event EventLIN18Slave2NoCommunication: aging-allowed=true, event-kind=SWC, prestorage-freeze-frame=false  # Event_LIN 18 Slave 2_NoCommunication
  diagnostic event to trouble code uds mapping EventDtcMapLIN18Slave2NoCommunication: diagnostic-event=EventLIN18Slave2NoCommunication, trouble-code-uds=LIN_18_Slave_2_NoCommunication  # Event_Dtc_Map_LIN 18 Slave 2_NoCommunication
  diagnostic event to operation cycle mapping EventOperCycleMapLIN18Slave2NoCommunication: diagnostic-event=EventLIN18Slave2NoCommunication, operation-cycle=DefaultOperationCycle  # Event_Oper_Cycle_Map_LIN 18 Slave 2_NoCommunication
  diagnostic event to debounce algorithm mapping EventDebounceMapLIN18Slave2NoCommunication: debounce-algorithm=counter_based, diagnostic-event=EventLIN18Slave2NoCommunication  # EventDebounceMap_LIN 18 Slave 2_NoCommunication
package /ZeC/DTC/DTC/Power_Path_123_Open_Load_Failure
  diagnostic trouble code uds Power_Path_123_Open_Load_Failure: dtc-props=Dtc_Props_ae45730c, uds-dtc-value=0x00537b
  diagnostic event EventPowerPath123OpenLoadFailure: aging-allowed=true, event-kind=SWC, prestorage-freeze-frame=false  # Event_Power_Path_123_Open_Load_Failure
  diagnostic event to trouble code uds mapping EventDtcMapPowerPath123OpenLoadFailure: diagnostic-event=EventPowerPath123OpenLoadFailure, trouble-code-uds=Power_Path_123_Open_Load_Failure  # Event_Dtc_Map_Power_Path_123_Open_Load_Failure
  diagnostic event to operation cycle mapping EventOperCycleMapPowerPath123OpenLoadFailure: diagnostic-event=EventPowerPath123OpenLoadFailure, operation-cycle=DefaultOperationCycle  # Event_Oper_Cycle_Map_Power_Path_123_Open_Load_Failure
  diagnostic event to debounce algorithm mapping EventDebounceMapPowerPath123OpenLoadFailure: debounce-algorithm=time_based, diagnostic-event=EventPowerPath123OpenLoadFailure  # EventDebounceMap_Power_Path_123_Open_Load_Failure
package /ZeC/DTC/DTC/Power_Path_122_Open_Load_Failure
  diagnostic trouble code uds Power_Path_122_Open_Load_Failure: dtc-props=Dtc_Props_646e6d42, uds-dtc-value=0x00537a
  diagnostic event EventPowerPath122OpenLoadFailure: aging-allowed=true, event-kind=SWC, prestorage-freeze-frame=false  # Event_Power_Path_122_Open_Load_Failure
  diagnostic event to trouble code uds mapping EventDtcMapPowerPath122OpenLoadFailure: diagnostic-event=EventPowerPath122OpenLoadFailure, trouble-code-uds=Power_Path_122_Open_Load_Failure  # Event_Dtc_Map_Power_Path_122_Open_Load_Failure
  diagnostic event to operation cycle mapping EventOperCycleMapPowerPath122OpenLoadFailure: diagnostic-event=EventPowerPath122OpenLoadFailure, operation-cycle=DefaultOperationCycle  # Event_Oper_Cycle_Map_Power_Path_122_Open_Load_Failure
  diagnostic event to debounce algorithm mapping EventDebounceMapPowerPath122OpenLoadFailure: debounce-algorithm=time_based, diagnostic-event=EventPowerPath122OpenLoadFailure  # EventDebounceMap_Power_Path_122_Open_Load_Failure
package /ZeC/DTC/DTC/Power_Path_125_Open_Load_Failure
  diagnostic trouble code uds Power_Path_125_Open_Load_Failure: dtc-props=Dtc_Props_e16249d1, uds-dtc-value=0x00537d
  diagnostic event EventPowerPath125OpenLoadFailure: aging-allowed=true, event-kind=SWC, prestorage-freeze-frame=false  # Event_Power_Path_125_Open_Load_Failure
  diagnostic event to trouble code uds mapping EventDtcMapPowerPath125OpenLoadFailure: diagnostic-event=EventPowerPath125OpenLoadFailure, trouble-code-uds=Power_Path_125_Open_Load_Failure  # Event_Dtc_Map_Power_Path_125_Open_Load_Failure
  diagnostic event to operation cycle mapping EventOperCycleMapPowerPath125OpenLoadFailure: diagnostic-event=EventPowerPath125OpenLoadFailure, operation-cycle=DefaultOperationCycle  # Event_Oper_Cycle_Map_Power_Path_125_Open_Load_Failure
  diagnostic event to debounce algorithm mapping EventDebounceMapPowerPath125OpenLoadFailure: debounce-algorithm=time_based, diagnostic-event=EventPowerPath125OpenLoadFailure  # EventDebounceMap_Power_Path_125_Open_Load_Failure
package /ZeC/DTC/DTC/Power_Path_124_Open_Load_Failure
  diagnostic trouble code uds Power_Path_124_Open_Load_Failure: dtc-props=Dtc_Props_e85c7936, uds-dtc-value=0x00537c
  diagnostic event EventPowerPath124OpenLoadFailure: aging-allowed=true, event-kind=SWC, prestorage-freeze-frame=false  # Event_Power_Path_124_Open_Load_Failure
  diagnostic event to trouble code uds mapping EventDtcMapPowerPath124OpenLoadFailure: diagnostic-event=EventPowerPath124OpenLoadFailure, trouble-code-uds=Power_Path_124_Open_Load_Failure  # Event_Dtc_Map_Power_Path_124_Open_Load_Failure
  diagnostic event to operation cycle mapping EventOperCycleMapPowerPath124OpenLoadFailure: diagnostic-event=EventPowerPath124OpenLoadFailure, operation-cycle=DefaultOperationCycle  # Event_Oper_Cycle_Map_Power_Path_124_Open_Load_Failure
  diagnostic event to debounce algorithm mapping EventDebounceMapPowerPath124OpenLoadFailure: debounce-algorithm=time_based, diagnostic-event=EventPowerPath124OpenLoadFailure  # EventDebounceMap_Power_Path_124_Open_Load_Failure
package /ZeC/DTC/DTC/Power_Path_129_Open_Load_Failure
  diagnostic trouble code uds Power_Path_129_Open_Load_Failure: dtc-props=Dtc_Props_e3155a51, uds-dtc-value=0x005381
  diagnostic event EventPowerPath129OpenLoadFailure: aging-allowed=true, event-kind=SWC, prestorage-freeze-frame=false  # Event_Power_Path_129_Open_Load_Failure
  diagnostic event to trouble code uds mapping EventDtcMapPowerPath129OpenLoadFailure: diagnostic-event=EventPowerPath129OpenLoadFailure, trouble-code-uds=Power_Path_129_Open_Load_Failure  # Event_Dtc_Map_Power_Path_129_Open_Load_Failure
  diagnostic event to operation cycle mapping EventOperCycleMapPowerPath129OpenLoadFailure: diagnostic-event=EventPowerPath129OpenLoadFailure, operation-cycle=DefaultOperationCycle  # Event_Oper_Cycle_Map_Power_Path_129_Open_Load_Failure
  diagnostic event to debounce algorithm mapping EventDebounceMapPowerPath129OpenLoadFailure: debounce-algorithm=time_based, diagnostic-event=EventPowerPath129OpenLoadFailure  # EventDebounceMap_Power_Path_129_Open_Load_Failure
package /ZeC/DTC/DTC/Power_Path_128_Open_Load_Failure
  diagnostic trouble code uds Power_Path_128_Open_Load_Failure: dtc-props=Dtc_Props_a50c506b, uds-dtc-value=0x005380
  diagnostic event EventPowerPath128OpenLoadFailure: aging-allowed=true, event-kind=SWC, prestorage-freeze-frame=false  # Event_Power_Path_128_Open_Load_Failure
  diagnostic event to trouble code uds mapping EventDtcMapPowerPath128OpenLoadFailure: diagnostic-event=EventPowerPath128OpenLoadFailure, trouble-code-uds=Power_Path_128_Open_Load_Failure  # Event_Dtc_Map_Power_Path_128_Open_Load_Failure
  diagnostic event to operation cycle mapping EventOperCycleMapPowerPath128OpenLoadFailure: diagnostic-event=EventPowerPath128OpenLoadFailure, operation-cycle=DefaultOperationCycle  # Event_Oper_Cycle_Map_Power_Path_128_Open_Load_Failure
  diagnostic event to debounce algorithm mapping EventDebounceMapPowerPath128OpenLoadFailure: debounce-algorithm=time_based, diagnostic-event=EventPowerPath128OpenLoadFailure  # EventDebounceMap_Power_Path_128_Open_Load_Failure
package /ZeC/DTC/DTC/LIN_18_Slave_9_NoCommunication
  diagnostic trouble code uds LIN_18_Slave_9_NoCommunication: dtc-props=Dtc_Props_358996c7, uds-dtc-value=0x03120f  # LIN 18 Slave 9_NoCommunication
  diagnostic event EventLIN18Slave9NoCommunication: aging-allowed=true, event-kind=SWC, prestorage-freeze-frame=false  # Event_LIN 18 Slave 9_NoCommunication
  diagnostic event to trouble code uds mapping EventDtcMapLIN18Slave9NoCommunication: diagnostic-event=EventLIN18Slave9NoCommunication, trouble-code-uds=LIN_18_Slave_9_NoCommunication  # Event_Dtc_Map_LIN 18 Slave 9_NoCommunication
  diagnostic event to operation cycle mapping EventOperCycleMapLIN18Slave9NoCommunication: diagnostic-event=EventLIN18Slave9NoCommunication, operation-cycle=DefaultOperationCycle  # Event_Oper_Cycle_Map_LIN 18 Slave 9_NoCommunication
  diagnostic event to debounce algorithm mapping EventDebounceMapLIN18Slave9NoCommunication: debounce-algorithm=counter_based, diagnostic-event=EventLIN18Slave9NoCommunication  # EventDebounceMap_LIN 18 Slave 9_NoCommunication
package /ZeC/DTC/DTC/LIN_18_Slave_8_NoCommunication
  diagnostic trouble code uds LIN_18_Slave_8_NoCommunication: dtc-props=Dtc_Props_358996c7, uds-dtc-value=0x03120d  # LIN 18 Slave 8_NoCommunication
  diagnostic event EventLIN18Slave8NoCommunication: aging-allowed=true, event-kind=SWC, prestorage-freeze-frame=false  # Event_LIN 18 Slave 8_NoCommunication
  diagnostic event to trouble code uds mapping EventDtcMapLIN18Slave8NoCommunication: diagnostic-event=EventLIN18Slave8NoCommunication, trouble-code-uds=LIN_18_Slave_8_NoCommunication  # Event_Dtc_Map_LIN 18 Slave 8_NoCommunication
  diagnostic event to operation cycle mapping EventOperCycleMapLIN18Slave8NoCommunication: diagnostic-event=EventLIN18Slave8NoCommunication, operation-cycle=DefaultOperationCycle  # Event_Oper_Cycle_Map_LIN 18 Slave 8_NoCommunication
  diagnostic event to debounce algorithm mapping EventDebounceMapLIN18Slave8NoCommunication: debounce-algorithm=counter_based, diagnostic-event=EventLIN18Slave8NoCommunication  # EventDebounceMap_LIN 18 Slave 8_NoCommunication
package /ZeC/DTC/DTC/LIN_18_Slave_9_Defect
  diagnostic trouble code uds LIN_18_Slave_9_Defect: dtc-props=Dtc_Props_358996c7, uds-dtc-value=0x03120e  # LIN 18 Slave 9_Defect
  diagnostic event EventLIN18Slave9Defect: aging-allowed=true, event-kind=SWC, prestorage-freeze-frame=false  # Event_LIN 18 Slave 9_Defect
  diagnostic event to trouble code uds mapping EventDtcMapLIN18Slave9Defect: diagnostic-event=EventLIN18Slave9Defect, trouble-code-uds=LIN_18_Slave_9_Defect  # Event_Dtc_Map_LIN 18 Slave 9_Defect
  diagnostic event to operation cycle mapping EventOperCycleMapLIN18Slave9Defect: diagnostic-event=EventLIN18Slave9Defect, operation-cycle=DefaultOperationCycle  # Event_Oper_Cycle_Map_LIN 18 Slave 9_Defect
  diagnostic event to debounce algorithm mapping EventDebounceMapLIN18Slave9Defect: debounce-algorithm=counter_based, diagnostic-event=EventLIN18Slave9Defect  # EventDebounceMap_LIN 18 Slave 9_Defect
package /ZeC/DTC/DTC/LIN_18_Slave_7_NoCommunication
  diagnostic trouble code uds LIN_18_Slave_7_NoCommunication: dtc-props=Dtc_Props_358996c7, uds-dtc-value=0x03120b  # LIN 18 Slave 7_NoCommunication
  diagnostic event EventLIN18Slave7NoCommunication: aging-allowed=true, event-kind=SWC, prestorage-freeze-frame=false  # Event_LIN 18 Slave 7_NoCommunication
  diagnostic event to trouble code uds mapping EventDtcMapLIN18Slave7NoCommunication: diagnostic-event=EventLIN18Slave7NoCommunication, trouble-code-uds=LIN_18_Slave_7_NoCommunication  # Event_Dtc_Map_LIN 18 Slave 7_NoCommunication
  diagnostic event to operation cycle mapping EventOperCycleMapLIN18Slave7NoCommunication: diagnostic-event=EventLIN18Slave7NoCommunication, operation-cycle=DefaultOperationCycle  # Event_Oper_Cycle_Map_LIN 18 Slave 7_NoCommunication
  diagnostic event to debounce algorithm mapping EventDebounceMapLIN18Slave7NoCommunication: debounce-algorithm=counter_based, diagnostic-event=EventLIN18Slave7NoCommunication  # EventDebounceMap_LIN 18 Slave 7_NoCommunication
package /ZeC/DTC/DTC/Power_Path_135_Open_Load_Failure
  diagnostic trouble code uds Power_Path_135_Open_Load_Failure: dtc-props=Dtc_Props_ac32608c, uds-dtc-value=0x005387
  diagnostic event EventPowerPath135OpenLoadFailure: aging-allowed=true, event-kind=SWC, prestorage-freeze-frame=false  # Event_Power_Path_135_Open_Load_Failure
  diagnostic event to trouble code uds mapping EventDtcMapPowerPath135OpenLoadFailure: diagnostic-event=EventPowerPath135OpenLoadFailure, trouble-code-uds=Power_Path_135_Open_Load_Failure  # Event_Dtc_Map_Power_Path_135_Open_Load_Failure
  diagnostic event to operation cycle mapping EventOperCycleMapPowerPath135OpenLoadFailure: diagnostic-event=EventPowerPath135OpenLoadFailure, operation-cycle=DefaultOperationCycle  # Event_Oper_Cycle_Map_Power_Path_135_Open_Load_Failure
  diagnostic event to debounce algorithm mapping EventDebounceMapPowerPath135OpenLoadFailure: debounce-algorithm=time_based, diagnostic-event=EventPowerPath135OpenLoadFailure  # EventDebounceMap_Power_Path_135_Open_Load_Failure
package /ZeC/DTC/DTC/LIN_18_Slave_8_Defect
  diagnostic trouble code uds LIN_18_Slave_8_Defect: dtc-props=Dtc_Props_358996c7, uds-dtc-value=0x03120c  # LIN 18 Slave 8_Defect
  diagnostic event EventLIN18Slave8Defect: aging-allowed=true, event-kind=SWC, prestorage-freeze-frame=false  # Event_LIN 18 Slave 8_Defect
  diagnostic event to trouble code uds mapping EventDtcMapLIN18Slave8Defect: diagnostic-event=EventLIN18Slave8Defect, trouble-code-uds=LIN_18_Slave_8_Defect  # Event_Dtc_Map_LIN 18 Slave 8_Defect
  diagnostic event to operation cycle mapping EventOperCycleMapLIN18Slave8Defect: diagnostic-event=EventLIN18Slave8Defect, operation-cycle=DefaultOperationCycle  # Event_Oper_Cycle_Map_LIN 18 Slave 8_Defect
  diagnostic event to debounce algorithm mapping EventDebounceMapLIN18Slave8Defect: debounce-algorithm=counter_based, diagnostic-event=EventLIN18Slave8Defect  # EventDebounceMap_LIN 18 Slave 8_Defect
package /ZeC/DTC/DTC/Power_Path_134_Open_Load_Failure
  diagnostic trouble code uds Power_Path_134_Open_Load_Failure: dtc-props=Dtc_Props_ea2b6ab6, uds-dtc-value=0x005386
  diagnostic event EventPowerPath134OpenLoadFailure: aging-allowed=true, event-kind=SWC, prestorage-freeze-frame=false  # Event_Power_Path_134_Open_Load_Failure
  diagnostic event to trouble code uds mapping EventDtcMapPowerPath134OpenLoadFailure: diagnostic-event=EventPowerPath134OpenLoadFailure, trouble-code-uds=Power_Path_134_Open_Load_Failure  # Event_Dtc_Map_Power_Path_134_Open_Load_Failure
  diagnostic event to operation cycle mapping EventOperCycleMapPowerPath134OpenLoadFailure: diagnostic-event=EventPowerPath134OpenLoadFailure, operation-cycle=DefaultOperationCycle  # Event_Oper_Cycle_Map_Power_Path_134_Open_Load_Failure
  diagnostic event to debounce algorithm mapping EventDebounceMapPowerPath134OpenLoadFailure: debounce-algorithm=time_based, diagnostic-event=EventPowerPath134OpenLoadFailure  # EventDebounceMap_Power_Path_134_Open_Load_Failure
package /ZeC/DTC/DTC/Power_Path_137_Open_Load_Failure
  diagnostic trouble code uds Power_Path_137_Open_Load_Failure: dtc-props=Dtc_Props_be4e0142, uds-dtc-value=0x005389
  diagnostic event EventPowerPath137OpenLoadFailure: aging-allowed=true, event-kind=SWC, prestorage-freeze-frame=false  # Event_Power_Path_137_Open_Load_Failure
  diagnostic event to trouble code uds mapping EventDtcMapPowerPath137OpenLoadFailure: diagnostic-event=EventPowerPath137OpenLoadFailure, trouble-code-uds=Power_Path_137_Open_Load_Failure  # Event_Dtc_Map_Power_Path_137_Open_Load_Failure
  diagnostic event to operation cycle mapping EventOperCycleMapPowerPath137OpenLoadFailure: diagnostic-event=EventPowerPath137OpenLoadFailure, operation-cycle=DefaultOperationCycle  # Event_Oper_Cycle_Map_Power_Path_137_Open_Load_Failure
  diagnostic event to debounce algorithm mapping EventDebounceMapPowerPath137OpenLoadFailure: debounce-algorithm=time_based, diagnostic-event=EventPowerPath137OpenLoadFailure  # EventDebounceMap_Power_Path_137_Open_Load_Failure
package /ZeC/DTC/DTC/LIN_18_Slave_7_Defect
  diagnostic trouble code uds LIN_18_Slave_7_Defect: dtc-props=Dtc_Props_358996c7, uds-dtc-value=0x03120a  # LIN 18 Slave 7_Defect
  diagnostic event EventLIN18Slave7Defect: aging-allowed=true, event-kind=SWC, prestorage-freeze-frame=false  # Event_LIN 18 Slave 7_Defect
  diagnostic event to trouble code uds mapping EventDtcMapLIN18Slave7Defect: diagnostic-event=EventLIN18Slave7Defect, trouble-code-uds=LIN_18_Slave_7_Defect  # Event_Dtc_Map_LIN 18 Slave 7_Defect
  diagnostic event to operation cycle mapping EventOperCycleMapLIN18Slave7Defect: diagnostic-event=EventLIN18Slave7Defect, operation-cycle=DefaultOperationCycle  # Event_Oper_Cycle_Map_LIN 18 Slave 7_Defect
  diagnostic event to debounce algorithm mapping EventDebounceMapLIN18Slave7Defect: debounce-algorithm=counter_based, diagnostic-event=EventLIN18Slave7Defect  # EventDebounceMap_LIN 18 Slave 7_Defect
package /ZeC/DTC/DTC/Power_Path_136_Open_Load_Failure
  diagnostic trouble code uds Power_Path_136_Open_Load_Failure: dtc-props=Dtc_Props_f8570b78, uds-dtc-value=0x005388
  diagnostic event EventPowerPath136OpenLoadFailure: aging-allowed=true, event-kind=SWC, prestorage-freeze-frame=false  # Event_Power_Path_136_Open_Load_Failure
  diagnostic event to trouble code uds mapping EventDtcMapPowerPath136OpenLoadFailure: diagnostic-event=EventPowerPath136OpenLoadFailure, trouble-code-uds=Power_Path_136_Open_Load_Failure  # Event_Dtc_Map_Power_Path_136_Open_Load_Failure
  diagnostic event to operation cycle mapping EventOperCycleMapPowerPath136OpenLoadFailure: diagnostic-event=EventPowerPath136OpenLoadFailure, operation-cycle=DefaultOperationCycle  # Event_Oper_Cycle_Map_Power_Path_136_Open_Load_Failure
  diagnostic event to debounce algorithm mapping EventDebounceMapPowerPath136OpenLoadFailure: debounce-algorithm=time_based, diagnostic-event=EventPowerPath136OpenLoadFailure  # EventDebounceMap_Power_Path_136_Open_Load_Failure
package /ZeC/DTC/DTC/Power_Path_131_Open_Load_Failure
  diagnostic trouble code uds Power_Path_131_Open_Load_Failure: dtc-props=Dtc_Props_6f274e25, uds-dtc-value=0x005383
  diagnostic event EventPowerPath131OpenLoadFailure: aging-allowed=true, event-kind=SWC, prestorage-freeze-frame=false  # Event_Power_Path_131_Open_Load_Failure
  diagnostic event to trouble code uds mapping EventDtcMapPowerPath131OpenLoadFailure: diagnostic-event=EventPowerPath131OpenLoadFailure, trouble-code-uds=Power_Path_131_Open_Load_Failure  # Event_Dtc_Map_Power_Path_131_Open_Load_Failure
  diagnostic event to operation cycle mapping EventOperCycleMapPowerPath131OpenLoadFailure: diagnostic-event=EventPowerPath131OpenLoadFailure, operation-cycle=DefaultOperationCycle  # Event_Oper_Cycle_Map_Power_Path_131_Open_Load_Failure
  diagnostic event to debounce algorithm mapping EventDebounceMapPowerPath131OpenLoadFailure: debounce-algorithm=time_based, diagnostic-event=EventPowerPath131OpenLoadFailure  # EventDebounceMap_Power_Path_131_Open_Load_Failure
package /ZeC/DTC/DTC/Power_Path_130_Open_Load_Failure
  diagnostic trouble code uds Power_Path_130_Open_Load_Failure: dtc-props=Dtc_Props_293e441f, uds-dtc-value=0x005382
  diagnostic event EventPowerPath130OpenLoadFailure: aging-allowed=true, event-kind=SWC, prestorage-freeze-frame=false  # Event_Power_Path_130_Open_Load_Failure
  diagnostic event to trouble code uds mapping EventDtcMapPowerPath130OpenLoadFailure: diagnostic-event=EventPowerPath130OpenLoadFailure, trouble-code-uds=Power_Path_130_Open_Load_Failure  # Event_Dtc_Map_Power_Path_130_Open_Load_Failure
  diagnostic event to operation cycle mapping EventOperCycleMapPowerPath130OpenLoadFailure: diagnostic-event=EventPowerPath130OpenLoadFailure, operation-cycle=DefaultOperationCycle  # Event_Oper_Cycle_Map_Power_Path_130_Open_Load_Failure
  diagnostic event to debounce algorithm mapping EventDebounceMapPowerPath130OpenLoadFailure: debounce-algorithm=time_based, diagnostic-event=EventPowerPath130OpenLoadFailure  # EventDebounceMap_Power_Path_130_Open_Load_Failure
package /ZeC/DTC/DTC/Power_Path_133_Open_Load_Failure
  diagnostic trouble code uds Power_Path_133_Open_Load_Failure: dtc-props=Dtc_Props_200074f8, uds-dtc-value=0x005385
  diagnostic event EventPowerPath133OpenLoadFailure: aging-allowed=true, event-kind=SWC, prestorage-freeze-frame=false  # Event_Power_Path_133_Open_Load_Failure
  diagnostic event to trouble code uds mapping EventDtcMapPowerPath133OpenLoadFailure: diagnostic-event=EventPowerPath133OpenLoadFailure, trouble-code-uds=Power_Path_133_Open_Load_Failure  # Event_Dtc_Map_Power_Path_133_Open_Load_Failure
  diagnostic event to operation cycle mapping EventOperCycleMapPowerPath133OpenLoadFailure: diagnostic-event=EventPowerPath133OpenLoadFailure, operation-cycle=DefaultOperationCycle  # Event_Oper_Cycle_Map_Power_Path_133_Open_Load_Failure
  diagnostic event to debounce algorithm mapping EventDebounceMapPowerPath133OpenLoadFailure: debounce-algorithm=time_based, diagnostic-event=EventPowerPath133OpenLoadFailure  # EventDebounceMap_Power_Path_133_Open_Load_Failure
package /ZeC/DTC/DTC/Power_Path_132_Open_Load_Failure
  diagnostic trouble code uds Power_Path_132_Open_Load_Failure: dtc-props=Dtc_Props_66197ec2, uds-dtc-value=0x005384
  diagnostic event EventPowerPath132OpenLoadFailure: aging-allowed=true, event-kind=SWC, prestorage-freeze-frame=false  # Event_Power_Path_132_Open_Load_Failure
  diagnostic event to trouble code uds mapping EventDtcMapPowerPath132OpenLoadFailure: diagnostic-event=EventPowerPath132OpenLoadFailure, trouble-code-uds=Power_Path_132_Open_Load_Failure  # Event_Dtc_Map_Power_Path_132_Open_Load_Failure
  diagnostic event to operation cycle mapping EventOperCycleMapPowerPath132OpenLoadFailure: diagnostic-event=EventPowerPath132OpenLoadFailure, operation-cycle=DefaultOperationCycle  # Event_Oper_Cycle_Map_Power_Path_132_Open_Load_Failure
  diagnostic event to debounce algorithm mapping EventDebounceMapPowerPath132OpenLoadFailure: debounce-algorithm=time_based, diagnostic-event=EventPowerPath132OpenLoadFailure  # EventDebounceMap_Power_Path_132_Open_Load_Failure
package /ZeC/DTC/DTC/CAN_05_ECU_4_No_Communication
  diagnostic trouble code uds CAN_05_ECU_4_No_Communication: dtc-props=Dtc_Props_14158306, uds-dtc-value=0x032508
  diagnostic event EventCAN05ECU4NoCommunication: aging-allowed=true, event-kind=SWC, prestorage-freeze-frame=false  # Event_CAN_05_ECU_4_No_Communication
  diagnostic event to trouble code uds mapping EventDtcMapCAN05ECU4NoCommunication: diagnostic-event=EventCAN05ECU4NoCommunication, trouble-code-uds=CAN_05_ECU_4_No_Communication  # Event_Dtc_Map_CAN_05_ECU_4_No_Communication
  diagnostic event to operation cycle mapping EventOperCycleMapCAN05ECU4NoCommunication: diagnostic-event=EventCAN05ECU4NoCommunication, operation-cycle=DefaultOperationCycle  # Event_Oper_Cycle_Map_CAN_05_ECU_4_No_Communication
  diagnostic event to debounce algorithm mapping EventDebounceMapCAN05ECU4NoCommunication: debounce-algorithm=counter_based, diagnostic-event=EventCAN05ECU4NoCommunication  # EventDebounceMap_CAN_05_ECU_4_No_Communication
package /ZeC/DTC/DTC/CAN_05_ECU_5_No_Communication
  diagnostic trouble code uds CAN_05_ECU_5_No_Communication: dtc-props=Dtc_Props_14158306, uds-dtc-value=0x032509
  diagnostic event EventCAN05ECU5NoCommunication: aging-allowed=true, event-kind=SWC, prestorage-freeze-frame=false  # Event_CAN_05_ECU_5_No_Communication
  diagnostic event to trouble code uds mapping EventDtcMapCAN05ECU5NoCommunication: diagnostic-event=EventCAN05ECU5NoCommunication, trouble-code-uds=CAN_05_ECU_5_No_Communication  # Event_Dtc_Map_CAN_05_ECU_5_No_Communication
  diagnostic event to operation cycle mapping EventOperCycleMapCAN05ECU5NoCommunication: diagnostic-event=EventCAN05ECU5NoCommunication, operation-cycle=DefaultOperationCycle  # Event_Oper_Cycle_Map_CAN_05_ECU_5_No_Communication
  diagnostic event to debounce algorithm mapping EventDebounceMapCAN05ECU5NoCommunication: debounce-algorithm=counter_based, diagnostic-event=EventCAN05ECU5NoCommunication  # EventDebounceMap_CAN_05_ECU_5_No_Communication
package /ZeC/DTC/DTC/CAN_05_ECU_2_No_Communication
  diagnostic trouble code uds CAN_05_ECU_2_No_Communication: dtc-props=Dtc_Props_14158306, uds-dtc-value=0x032506
  diagnostic event EventCAN05ECU2NoCommunication: aging-allowed=true, event-kind=SWC, prestorage-freeze-frame=false  # Event_CAN_05_ECU_2_No_Communication
  diagnostic event to trouble code uds mapping EventDtcMapCAN05ECU2NoCommunication: diagnostic-event=EventCAN05ECU2NoCommunication, trouble-code-uds=CAN_05_ECU_2_No_Communication  # Event_Dtc_Map_CAN_05_ECU_2_No_Communication
  diagnostic event to operation cycle mapping EventOperCycleMapCAN05ECU2NoCommunication: diagnostic-event=EventCAN05ECU2NoCommunication, operation-cycle=DefaultOperationCycle  # Event_Oper_Cycle_Map_CAN_05_ECU_2_No_Communication
  diagnostic event to debounce algorithm mapping EventDebounceMapCAN05ECU2NoCommunication: debounce-algorithm=counter_based, diagnostic-event=EventCAN05ECU2NoCommunication  # EventDebounceMap_CAN_05_ECU_2_No_Communication
package /ZeC/DTC/DTC/CAN_05_ECU_3_No_Communication
  diagnostic trouble code uds CAN_05_ECU_3_No_Communication: dtc-props=Dtc_Props_14158306, uds-dtc-value=0x032507
  diagnostic event EventCAN05ECU3NoCommunication: aging-allowed=true, event-kind=SWC, prestorage-freeze-frame=false  # Event_CAN_05_ECU_3_No_Communication
  diagnostic event to trouble code uds mapping EventDtcMapCAN05ECU3NoCommunication: diagnostic-event=EventCAN05ECU3NoCommunication, trouble-code-uds=CAN_05_ECU_3_No_Communication  # Event_Dtc_Map_CAN_05_ECU_3_No_Communication
  diagnostic event to operation cycle mapping EventOperCycleMapCAN05ECU3NoCommunication: diagnostic-event=EventCAN05ECU3NoCommunication, operation-cycle=DefaultOperationCycle  # Event_Oper_Cycle_Map_CAN_05_ECU_3_No_Communication
  diagnostic event to debounce algorithm mapping EventDebounceMapCAN05ECU3NoCommunication: debounce-algorithm=counter_based, diagnostic-event=EventCAN05ECU3NoCommunication  # EventDebounceMap_CAN_05_ECU_3_No_Communication
package /ZeC/DTC/DTC/DB_CANFD_05_Error_Received_Value
  diagnostic trouble code uds DB_CANFD_05_Error_Received_Value: dtc-props=Dtc_Props_b618fb9, uds-dtc-value=0x032504
  diagnostic event EventDBCANFD05ErrorReceivedValue: aging-allowed=true, event-kind=SWC, prestorage-freeze-frame=false  # Event_DB_CANFD_05_Error_Received_Value
  diagnostic event to trouble code uds mapping EventDtcMapDBCANFD05ErrorReceivedValue: diagnostic-event=EventDBCANFD05ErrorReceivedValue, trouble-code-uds=DB_CANFD_05_Error_Received_Value  # Event_Dtc_Map_DB_CANFD_05_Error_Received_Value
  diagnostic event to operation cycle mapping EventOperCycleMapDBCANFD05ErrorReceivedValue: diagnostic-event=EventDBCANFD05ErrorReceivedValue, operation-cycle=DefaultOperationCycle  # Event_Oper_Cycle_Map_DB_CANFD_05_Error_Received_Value
  diagnostic event to debounce algorithm mapping EventDebounceMapDBCANFD05ErrorReceivedValue: debounce-algorithm=counter_based, diagnostic-event=EventDBCANFD05ErrorReceivedValue  # EventDebounceMap_DB_CANFD_05_Error_Received_Value
package /ZeC/DTC/DTC/CAN_05_ECU_1_No_Communication
  diagnostic trouble code uds CAN_05_ECU_1_No_Communication: dtc-props=Dtc_Props_14158306, uds-dtc-value=0x032505
  diagnostic event EventCAN05ECU1NoCommunication: aging-allowed=true, event-kind=SWC, prestorage-freeze-frame=false  # Event_CAN_05_ECU_1_No_Communication
  diagnostic event to trouble code uds mapping EventDtcMapCAN05ECU1NoCommunication: diagnostic-event=EventCAN05ECU1NoCommunication, trouble-code-uds=CAN_05_ECU_1_No_Communication  # Event_Dtc_Map_CAN_05_ECU_1_No_Communication
  diagnostic event to operation cycle mapping EventOperCycleMapCAN05ECU1NoCommunication: diagnostic-event=EventCAN05ECU1NoCommunication, operation-cycle=DefaultOperationCycle  # Event_Oper_Cycle_Map_CAN_05_ECU_1_No_Communication
  diagnostic event to debounce algorithm mapping EventDebounceMapCAN05ECU1NoCommunication: debounce-algorithm=counter_based, diagnostic-event=EventCAN05ECU1NoCommunication  # EventDebounceMap_CAN_05_ECU_1_No_Communication
package /ZeC/DTC/DTC/DB_CANFD_05_No_Communication
  diagnostic trouble code uds DB_CANFD_05_No_Communication: dtc-props=Dtc_Props_14158306, uds-dtc-value=0x032502
  diagnostic event EventDBCANFD05NoCommunication: aging-allowed=true, event-kind=SWC, prestorage-freeze-frame=false  # Event_DB_CANFD_05_No_Communication
  diagnostic event to trouble code uds mapping EventDtcMapDBCANFD05NoCommunication: diagnostic-event=EventDBCANFD05NoCommunication, trouble-code-uds=DB_CANFD_05_No_Communication  # Event_Dtc_Map_DB_CANFD_05_No_Communication
  diagnostic event to operation cycle mapping EventOperCycleMapDBCANFD05NoCommunication: diagnostic-event=EventDBCANFD05NoCommunication, operation-cycle=DefaultOperationCycle  # Event_Oper_Cycle_Map_DB_CANFD_05_No_Communication
  diagnostic event to debounce algorithm mapping EventDebounceMapDBCANFD05NoCommunication: debounce-algorithm=counter_based, diagnostic-event=EventDBCANFD05NoCommunication  # EventDebounceMap_DB_CANFD_05_No_Communication
package /ZeC/DTC/DTC/DB_CANFD_05_Single_Wire_Mode
  diagnostic trouble code uds DB_CANFD_05_Single_Wire_Mode: dtc-props=Dtc_Props_14158306, uds-dtc-value=0x032503
  diagnostic event EventDBCANFD05SingleWireMode: aging-allowed=true, event-kind=SWC, prestorage-freeze-frame=false  # Event_DB_CANFD_05_Single_Wire_Mode
  diagnostic event to trouble code uds mapping EventDtcMapDBCANFD05SingleWireMode: diagnostic-event=EventDBCANFD05SingleWireMode, trouble-code-uds=DB_CANFD_05_Single_Wire_Mode  # Event_Dtc_Map_DB_CANFD_05_Single_Wire_Mode
  diagnostic event to operation cycle mapping EventOperCycleMapDBCANFD05SingleWireMode: diagnostic-event=EventDBCANFD05SingleWireMode, operation-cycle=DefaultOperationCycle  # Event_Oper_Cycle_Map_DB_CANFD_05_Single_Wire_Mode
  diagnostic event to debounce algorithm mapping EventDebounceMapDBCANFD05SingleWireMode: debounce-algorithm=counter_based, diagnostic-event=EventDBCANFD05SingleWireMode  # EventDebounceMap_DB_CANFD_05_Single_Wire_Mode
package /ZeC/DTC/DTC/LIN_3_Local_Databus_Electrical_Failure
  diagnostic trouble code uds LIN_3_Local_Databus_Electrical_Failure: dtc-props=Dtc_Props_358996c7, uds-dtc-value=0x030321  # LIN 3 Local_Databus_Electrical_Failure
  diagnostic event EventLIN3LocalDatabusElectricalFailure: aging-allowed=true, event-kind=SWC, prestorage-freeze-frame=false  # Event_LIN 3 Local_Databus_Electrical_Failure
  diagnostic event to trouble code uds mapping EventDtcMapLIN3LocalDatabusElectricalFailure: diagnostic-event=EventLIN3LocalDatabusElectricalFailure, trouble-code-uds=LIN_3_Local_Databus_Electrical_Failure  # Event_Dtc_Map_LIN 3 Local_Databus_Electrical_Failure
  diagnostic event to operation cycle mapping EventOperCycleMapLIN3LocalDatabusElectricalFailure: diagnostic-event=EventLIN3LocalDatabusElectricalFailure, operation-cycle=DefaultOperationCycle  # Event_Oper_Cycle_Map_LIN 3 Local_Databus_Electrical_Failure
  diagnostic event to debounce algorithm mapping EventDebounceMapLIN3LocalDatabusElectricalFailure: debounce-algorithm=counter_based, diagnostic-event=EventLIN3LocalDatabusElectricalFailure  # EventDebounceMap_LIN 3 Local_Databus_Electrical_Failure
package /ZeC/DTC/DTC/LIN_3_Databus_No_Comm
  diagnostic trouble code uds LIN_3_Databus_No_Comm: dtc-props=Dtc_Props_358996c7, uds-dtc-value=0x030320  # LIN 3 Databus_No_Comm
  diagnostic event EventLIN3DatabusNoComm: aging-allowed=true, event-kind=SWC, prestorage-freeze-frame=false  # Event_LIN 3 Databus_No_Comm
  diagnostic event to trouble code uds mapping EventDtcMapLIN3DatabusNoComm: diagnostic-event=EventLIN3DatabusNoComm, trouble-code-uds=LIN_3_Databus_No_Comm  # Event_Dtc_Map_LIN 3 Databus_No_Comm
  diagnostic event to operation cycle mapping EventOperCycleMapLIN3DatabusNoComm: diagnostic-event=EventLIN3DatabusNoComm, operation-cycle=DefaultOperationCycle  # Event_Oper_Cycle_Map_LIN 3 Databus_No_Comm
  diagnostic event to debounce algorithm mapping EventDebounceMapLIN3DatabusNoComm: debounce-algorithm=counter_based, diagnostic-event=EventLIN3DatabusNoComm  # EventDebounceMap_LIN 3 Databus_No_Comm
package /ZeC/DTC/DTC/DB_CANFD_05_Defect
  diagnostic trouble code uds DB_CANFD_05_Defect: dtc-props=Dtc_Props_14158306, uds-dtc-value=0x032501
  diagnostic event EventDBCANFD05Defect: aging-allowed=true, event-kind=SWC, prestorage-freeze-frame=false  # Event_DB_CANFD_05_Defect
  diagnostic event to trouble code uds mapping EventDtcMapDBCANFD05Defect: diagnostic-event=EventDBCANFD05Defect, trouble-code-uds=DB_CANFD_05_Defect  # Event_Dtc_Map_DB_CANFD_05_Defect
  diagnostic event to operation cycle mapping EventOperCycleMapDBCANFD05Defect: diagnostic-event=EventDBCANFD05Defect, operation-cycle=DefaultOperationCycle  # Event_Oper_Cycle_Map_DB_CANFD_05_Defect
  diagnostic event to debounce algorithm mapping EventDebounceMapDBCANFD05Defect: debounce-algorithm=counter_based, diagnostic-event=EventDBCANFD05Defect  # EventDebounceMap_DB_CANFD_05_Defect
package /ZeC/DTC/DTC/Power_Path_155_Open_Load_Failure
  diagnostic trouble code uds Power_Path_155_Open_Load_Failure: dtc-props=Dtc_Props_d28be0da, uds-dtc-value=0x00539b
  diagnostic event EventPowerPath155OpenLoadFailure: aging-allowed=true, event-kind=SWC, prestorage-freeze-frame=false  # Event_Power_Path_155_Open_Load_Failure
  diagnostic event to trouble code uds mapping EventDtcMapPowerPath155OpenLoadFailure: diagnostic-event=EventPowerPath155OpenLoadFailure, trouble-code-uds=Power_Path_155_Open_Load_Failure  # Event_Dtc_Map_Power_Path_155_Open_Load_Failure
  diagnostic event to operation cycle mapping EventOperCycleMapPowerPath155OpenLoadFailure: diagnostic-event=EventPowerPath155OpenLoadFailure, operation-cycle=DefaultOperationCycle  # Event_Oper_Cycle_Map_Power_Path_155_Open_Load_Failure
  diagnostic event to debounce algorithm mapping EventDebounceMapPowerPath155OpenLoadFailure: debounce-algorithm=time_based, diagnostic-event=EventPowerPath155OpenLoadFailure  # EventDebounceMap_Power_Path_155_Open_Load_Failure
package /ZeC/DTC/DTC/Power_Path_154_Open_Load_Failure
  diagnostic trouble code uds Power_Path_154_Open_Load_Failure: dtc-props=Dtc_Props_18a0fe94, uds-dtc-value=0x00539a
  diagnostic event EventPowerPath154OpenLoadFailure: aging-allowed=true, event-kind=SWC, prestorage-freeze-frame=false  # Event_Power_Path_154_Open_Load_Failure
  diagnostic event to trouble code uds mapping EventDtcMapPowerPath154OpenLoadFailure: diagnostic-event=EventPowerPath154OpenLoadFailure, trouble-code-uds=Power_Path_154_Open_Load_Failure  # Event_Dtc_Map_Power_Path_154_Open_Load_Failure
  diagnostic event to operation cycle mapping EventOperCycleMapPowerPath154OpenLoadFailure: diagnostic-event=EventPowerPath154OpenLoadFailure, operation-cycle=DefaultOperationCycle  # Event_Oper_Cycle_Map_Power_Path_154_Open_Load_Failure
  diagnostic event to debounce algorithm mapping EventDebounceMapPowerPath154OpenLoadFailure: debounce-algorithm=time_based, diagnostic-event=EventPowerPath154OpenLoadFailure  # EventDebounceMap_Power_Path_154_Open_Load_Failure
package /ZeC/DTC/DTC/CAN_05_ECU_6_No_Communication
  diagnostic trouble code uds CAN_05_ECU_6_No_Communication: dtc-props=Dtc_Props_14158306, uds-dtc-value=0x032510
  diagnostic event EventCAN05ECU6NoCommunication: aging-allowed=true, event-kind=SWC, prestorage-freeze-frame=false  # Event_CAN_05_ECU_6_No_Communication
  diagnostic event to trouble code uds mapping EventDtcMapCAN05ECU6NoCommunication: diagnostic-event=EventCAN05ECU6NoCommunication, trouble-code-uds=CAN_05_ECU_6_No_Communication  # Event_Dtc_Map_CAN_05_ECU_6_No_Communication
  diagnostic event to operation cycle mapping EventOperCycleMapCAN05ECU6NoCommunication: diagnostic-event=EventCAN05ECU6NoCommunication, operation-cycle=DefaultOperationCycle  # Event_Oper_Cycle_Map_CAN_05_ECU_6_No_Communication
  diagnostic event to debounce algorithm mapping EventDebounceMapCAN05ECU6NoCommunication: debounce-algorithm=counter_based, diagnostic-event=EventCAN05ECU6NoCommunication  # EventDebounceMap_CAN_05_ECU_6_No_Communication
package /ZeC/DTC/DTC/Power_Path_157_Open_Load_Failure
  diagnostic trouble code uds Power_Path_157_Open_Load_Failure: dtc-props=Dtc_Props_9dacda07, uds-dtc-value=0x00539d
  diagnostic event EventPowerPath157OpenLoadFailure: aging-allowed=true, event-kind=SWC, prestorage-freeze-frame=false  # Event_Power_Path_157_Open_Load_Failure
  diagnostic event to trouble code uds mapping EventDtcMapPowerPath157OpenLoadFailure: diagnostic-event=EventPowerPath157OpenLoadFailure, trouble-code-uds=Power_Path_157_Open_Load_Failure  # Event_Dtc_Map_Power_Path_157_Open_Load_Failure
  diagnostic event to operation cycle mapping EventOperCycleMapPowerPath157OpenLoadFailure: diagnostic-event=EventPowerPath157OpenLoadFailure, operation-cycle=DefaultOperationCycle  # Event_Oper_Cycle_Map_Power_Path_157_Open_Load_Failure
  diagnostic event to debounce algorithm mapping EventDebounceMapPowerPath157OpenLoadFailure: debounce-algorithm=time_based, diagnostic-event=EventPowerPath157OpenLoadFailure  # EventDebounceMap_Power_Path_157_Open_Load_Failure
package /ZeC/DTC/DTC/Power_Path_156_Open_Load_Failure
  diagnostic trouble code uds Power_Path_156_Open_Load_Failure: dtc-props=Dtc_Props_9492eae0, uds-dtc-value=0x00539c
  diagnostic event EventPowerPath156OpenLoadFailure: aging-allowed=true, event-kind=SWC, prestorage-freeze-frame=false  # Event_Power_Path_156_Open_Load_Failure
  diagnostic event to trouble code uds mapping EventDtcMapPowerPath156OpenLoadFailure: diagnostic-event=EventPowerPath156OpenLoadFailure, trouble-code-uds=Power_Path_156_Open_Load_Failure  # Event_Dtc_Map_Power_Path_156_Open_Load_Failure
  diagnostic event to operation cycle mapping EventOperCycleMapPowerPath156OpenLoadFailure: diagnostic-event=EventPowerPath156OpenLoadFailure, operation-cycle=DefaultOperationCycle  # Event_Oper_Cycle_Map_Power_Path_156_Open_Load_Failure
  diagnostic event to debounce algorithm mapping EventDebounceMapPowerPath156OpenLoadFailure: debounce-algorithm=time_based, diagnostic-event=EventPowerPath156OpenLoadFailure  # EventDebounceMap_Power_Path_156_Open_Load_Failure
package /ZeC/DTC/DTC/Power_Path_159_Open_Load_Failure
  diagnostic trouble code uds Power_Path_159_Open_Load_Failure: dtc-props=Dtc_Props_119ece73, uds-dtc-value=0x00539f
  diagnostic event EventPowerPath159OpenLoadFailure: aging-allowed=true, event-kind=SWC, prestorage-freeze-frame=false  # Event_Power_Path_159_Open_Load_Failure
  diagnostic event to trouble code uds mapping EventDtcMapPowerPath159OpenLoadFailure: diagnostic-event=EventPowerPath159OpenLoadFailure, trouble-code-uds=Power_Path_159_Open_Load_Failure  # Event_Dtc_Map_Power_Path_159_Open_Load_Failure
  diagnostic event to operation cycle mapping EventOperCycleMapPowerPath159OpenLoadFailure: diagnostic-event=EventPowerPath159OpenLoadFailure, operation-cycle=DefaultOperationCycle  # Event_Oper_Cycle_Map_Power_Path_159_Open_Load_Failure
  diagnostic event to debounce algorithm mapping EventDebounceMapPowerPath159OpenLoadFailure: debounce-algorithm=time_based, diagnostic-event=EventPowerPath159OpenLoadFailure  # EventDebounceMap_Power_Path_159_Open_Load_Failure
package /ZeC/DTC/DTC/Power_Path_158_Open_Load_Failure
  diagnostic trouble code uds Power_Path_158_Open_Load_Failure: dtc-props=Dtc_Props_dbb5d03d, uds-dtc-value=0x00539e
  diagnostic event EventPowerPath158OpenLoadFailure: aging-allowed=true, event-kind=SWC, prestorage-freeze-frame=false  # Event_Power_Path_158_Open_Load_Failure
  diagnostic event to trouble code uds mapping EventDtcMapPowerPath158OpenLoadFailure: diagnostic-event=EventPowerPath158OpenLoadFailure, trouble-code-uds=Power_Path_158_Open_Load_Failure  # Event_Dtc_Map_Power_Path_158_Open_Load_Failure
  diagnostic event to operation cycle mapping EventOperCycleMapPowerPath158OpenLoadFailure: diagnostic-event=EventPowerPath158OpenLoadFailure, operation-cycle=DefaultOperationCycle  # Event_Oper_Cycle_Map_Power_Path_158_Open_Load_Failure
  diagnostic event to debounce algorithm mapping EventDebounceMapPowerPath158OpenLoadFailure: debounce-algorithm=time_based, diagnostic-event=EventPowerPath158OpenLoadFailure  # EventDebounceMap_Power_Path_158_Open_Load_Failure
package /ZeC/DTC/DTC/Power_Path_002_Cable_Protection_Failure
  diagnostic trouble code uds Power_Path_002_Cable_Protection_Failure: dtc-props=Dtc_Props_addd5e9a, uds-dtc-value=0x005802
  diagnostic event EventPowerPath002CableProtectionFailure: aging-allowed=true, event-kind=SWC, prestorage-freeze-frame=false  # Event_Power_Path_002_Cable_Protection_Failure
  diagnostic event to trouble code uds mapping EventDtcMapPowerPath002CableProtectionFailure: diagnostic-event=EventPowerPath002CableProtectionFailure, trouble-code-uds=Power_Path_002_Cable_Protection_Failure  # Event_Dtc_Map_Power_Path_002_Cable_Protection_Failure
  diagnostic event to operation cycle mapping EventOperCycleMapPowerPath002CableProtectionFailure: diagnostic-event=EventPowerPath002CableProtectionFailure, operation-cycle=DefaultOperationCycle  # Event_Oper_Cycle_Map_Power_Path_002_Cable_Protection_Failure
  diagnostic event to debounce algorithm mapping EventDebounceMapPowerPath002CableProtectionFailure: debounce-algorithm=time_based, diagnostic-event=EventPowerPath002CableProtectionFailure  # EventDebounceMap_Power_Path_002_Cable_Protection_Failure
package /ZeC/DTC/DTC/Power_Path_001_Cable_Protection_Failure
  diagnostic trouble code uds Power_Path_001_Cable_Protection_Failure: dtc-props=Dtc_Props_67f640d4, uds-dtc-value=0x005801
  diagnostic event EventPowerPath001CableProtectionFailure: aging-allowed=true, event-kind=SWC, prestorage-freeze-frame=false  # Event_Power_Path_001_Cable_Protection_Failure
  diagnostic event to trouble code uds mapping EventDtcMapPowerPath001CableProtectionFailure: diagnostic-event=EventPowerPath001CableProtectionFailure, trouble-code-uds=Power_Path_001_Cable_Protection_Failure  # Event_Dtc_Map_Power_Path_001_Cable_Protection_Failure
  diagnostic event to operation cycle mapping EventOperCycleMapPowerPath001CableProtectionFailure: diagnostic-event=EventPowerPath001CableProtectionFailure, operation-cycle=DefaultOperationCycle  # Event_Oper_Cycle_Map_Power_Path_001_Cable_Protection_Failure
  diagnostic event to debounce algorithm mapping EventDebounceMapPowerPath001CableProtectionFailure: debounce-algorithm=time_based, diagnostic-event=EventPowerPath001CableProtectionFailure  # EventDebounceMap_Power_Path_001_Cable_Protection_Failure
package /ZeC/DTC/DTC/Power_Path_004_Cable_Protection_Failure
  diagnostic trouble code uds Power_Path_004_Cable_Protection_Failure: dtc-props=Dtc_Props_e2fa6447, uds-dtc-value=0x005804
  diagnostic event EventPowerPath004CableProtectionFailure: aging-allowed=true, event-kind=SWC, prestorage-freeze-frame=false  # Event_Power_Path_004_Cable_Protection_Failure
  diagnostic event to trouble code uds mapping EventDtcMapPowerPath004CableProtectionFailure: diagnostic-event=EventPowerPath004CableProtectionFailure, trouble-code-uds=Power_Path_004_Cable_Protection_Failure  # Event_Dtc_Map_Power_Path_004_Cable_Protection_Failure
  diagnostic event to operation cycle mapping EventOperCycleMapPowerPath004CableProtectionFailure: diagnostic-event=EventPowerPath004CableProtectionFailure, operation-cycle=DefaultOperationCycle  # Event_Oper_Cycle_Map_Power_Path_004_Cable_Protection_Failure
  diagnostic event to debounce algorithm mapping EventDebounceMapPowerPath004CableProtectionFailure: debounce-algorithm=time_based, diagnostic-event=EventPowerPath004CableProtectionFailure  # EventDebounceMap_Power_Path_004_Cable_Protection_Failure
package /ZeC/DTC/DTC/Power_Path_003_Cable_Protection_Failure
  diagnostic trouble code uds Power_Path_003_Cable_Protection_Failure: dtc-props=Dtc_Props_ebc454a0, uds-dtc-value=0x005803
  diagnostic event EventPowerPath003CableProtectionFailure: aging-allowed=true, event-kind=SWC, prestorage-freeze-frame=false  # Event_Power_Path_003_Cable_Protection_Failure
  diagnostic event to trouble code uds mapping EventDtcMapPowerPath003CableProtectionFailure: diagnostic-event=EventPowerPath003CableProtectionFailure, trouble-code-uds=Power_Path_003_Cable_Protection_Failure  # Event_Dtc_Map_Power_Path_003_Cable_Protection_Failure
  diagnostic event to operation cycle mapping EventOperCycleMapPowerPath003CableProtectionFailure: diagnostic-event=EventPowerPath003CableProtectionFailure, operation-cycle=DefaultOperationCycle  # Event_Oper_Cycle_Map_Power_Path_003_Cable_Protection_Failure
  diagnostic event to debounce algorithm mapping EventDebounceMapPowerPath003CableProtectionFailure: debounce-algorithm=time_based, diagnostic-event=EventPowerPath003CableProtectionFailure  # EventDebounceMap_Power_Path_003_Cable_Protection_Failure
package /ZeC/DTC/DTC/Power_Path_009_Cable_Protection_Failure
  diagnostic trouble code uds Power_Path_009_Cable_Protection_Failure: dtc-props=Dtc_Props_3aad1bc7, uds-dtc-value=0x005809
  diagnostic event EventPowerPath009CableProtectionFailure: aging-allowed=true, event-kind=SWC, prestorage-freeze-frame=false  # Event_Power_Path_009_Cable_Protection_Failure
  diagnostic event to trouble code uds mapping EventDtcMapPowerPath009CableProtectionFailure: diagnostic-event=EventPowerPath009CableProtectionFailure, trouble-code-uds=Power_Path_009_Cable_Protection_Failure  # Event_Dtc_Map_Power_Path_009_Cable_Protection_Failure
  diagnostic event to operation cycle mapping EventOperCycleMapPowerPath009CableProtectionFailure: diagnostic-event=EventPowerPath009CableProtectionFailure, operation-cycle=DefaultOperationCycle  # Event_Oper_Cycle_Map_Power_Path_009_Cable_Protection_Failure
  diagnostic event to debounce algorithm mapping EventDebounceMapPowerPath009CableProtectionFailure: debounce-algorithm=time_based, diagnostic-event=EventPowerPath009CableProtectionFailure  # EventDebounceMap_Power_Path_009_Cable_Protection_Failure
package /ZeC/DTC/DTC/Power_Path_006_Cable_Protection_Failure
  diagnostic trouble code uds Power_Path_006_Cable_Protection_Failure: dtc-props=Dtc_Props_6ec87033, uds-dtc-value=0x005806
  diagnostic event EventPowerPath006CableProtectionFailure: aging-allowed=true, event-kind=SWC, prestorage-freeze-frame=false  # Event_Power_Path_006_Cable_Protection_Failure
  diagnostic event to trouble code uds mapping EventDtcMapPowerPath006CableProtectionFailure: diagnostic-event=EventPowerPath006CableProtectionFailure, trouble-code-uds=Power_Path_006_Cable_Protection_Failure  # Event_Dtc_Map_Power_Path_006_Cable_Protection_Failure
  diagnostic event to operation cycle mapping EventOperCycleMapPowerPath006CableProtectionFailure: diagnostic-event=EventPowerPath006CableProtectionFailure, operation-cycle=DefaultOperationCycle  # Event_Oper_Cycle_Map_Power_Path_006_Cable_Protection_Failure
  diagnostic event to debounce algorithm mapping EventDebounceMapPowerPath006CableProtectionFailure: debounce-algorithm=time_based, diagnostic-event=EventPowerPath006CableProtectionFailure  # EventDebounceMap_Power_Path_006_Cable_Protection_Failure
package /ZeC/DTC/DTC/Power_Path_005_Cable_Protection_Failure
  diagnostic trouble code uds Power_Path_005_Cable_Protection_Failure: dtc-props=Dtc_Props_67f640d4, uds-dtc-value=0x005805
  diagnostic event EventPowerPath005CableProtectionFailure: aging-allowed=true, event-kind=SWC, prestorage-freeze-frame=false  # Event_Power_Path_005_Cable_Protection_Failure
  diagnostic event to trouble code uds mapping EventDtcMapPowerPath005CableProtectionFailure: diagnostic-event=EventPowerPath005CableProtectionFailure, trouble-code-uds=Power_Path_005_Cable_Protection_Failure  # Event_Dtc_Map_Power_Path_005_Cable_Protection_Failure
  diagnostic event to operation cycle mapping EventOperCycleMapPowerPath005CableProtectionFailure: diagnostic-event=EventPowerPath005CableProtectionFailure, operation-cycle=DefaultOperationCycle  # Event_Oper_Cycle_Map_Power_Path_005_Cable_Protection_Failure
  diagnostic event to debounce algorithm mapping EventDebounceMapPowerPath005CableProtectionFailure: debounce-algorithm=time_based, diagnostic-event=EventPowerPath005CableProtectionFailure  # EventDebounceMap_Power_Path_005_Cable_Protection_Failure
package /ZeC/DTC/DTC/Power_Path_008_Cable_Protection_Failure
  diagnostic trouble code uds Power_Path_008_Cable_Protection_Failure: dtc-props=Dtc_Props_7cb411fd, uds-dtc-value=0x005808
  diagnostic event EventPowerPath008CableProtectionFailure: aging-allowed=true, event-kind=SWC, prestorage-freeze-frame=false  # Event_Power_Path_008_Cable_Protection_Failure
  diagnostic event to trouble code uds mapping EventDtcMapPowerPath008CableProtectionFailure: diagnostic-event=EventPowerPath008CableProtectionFailure, trouble-code-uds=Power_Path_008_Cable_Protection_Failure  # Event_Dtc_Map_Power_Path_008_Cable_Protection_Failure
  diagnostic event to operation cycle mapping EventOperCycleMapPowerPath008CableProtectionFailure: diagnostic-event=EventPowerPath008CableProtectionFailure, operation-cycle=DefaultOperationCycle  # Event_Oper_Cycle_Map_Power_Path_008_Cable_Protection_Failure
  diagnostic event to debounce algorithm mapping EventDebounceMapPowerPath008CableProtectionFailure: debounce-algorithm=time_based, diagnostic-event=EventPowerPath008CableProtectionFailure  # EventDebounceMap_Power_Path_008_Cable_Protection_Failure
package /ZeC/DTC/DTC/Power_Path_007_Cable_Protection_Failure
  diagnostic trouble code uds Power_Path_007_Cable_Protection_Failure: dtc-props=Dtc_Props_28d17a09, uds-dtc-value=0x005807
  diagnostic event EventPowerPath007CableProtectionFailure: aging-allowed=true, event-kind=SWC, prestorage-freeze-frame=false  # Event_Power_Path_007_Cable_Protection_Failure
  diagnostic event to trouble code uds mapping EventDtcMapPowerPath007CableProtectionFailure: diagnostic-event=EventPowerPath007CableProtectionFailure, trouble-code-uds=Power_Path_007_Cable_Protection_Failure  # Event_Dtc_Map_Power_Path_007_Cable_Protection_Failure
  diagnostic event to operation cycle mapping EventOperCycleMapPowerPath007CableProtectionFailure: diagnostic-event=EventPowerPath007CableProtectionFailure, operation-cycle=DefaultOperationCycle  # Event_Oper_Cycle_Map_Power_Path_007_Cable_Protection_Failure
  diagnostic event to debounce algorithm mapping EventDebounceMapPowerPath007CableProtectionFailure: debounce-algorithm=time_based, diagnostic-event=EventPowerPath007CableProtectionFailure  # EventDebounceMap_Power_Path_007_Cable_Protection_Failure
package /ZeC/DTC/DTC/Power_Path_011_Cable_Protection_Failure
  diagnostic trouble code uds Power_Path_011_Cable_Protection_Failure: dtc-props=Dtc_Props_90223ae7, uds-dtc-value=0x00580b
  diagnostic event EventPowerPath011CableProtectionFailure: aging-allowed=true, event-kind=SWC, prestorage-freeze-frame=false  # Event_Power_Path_011_Cable_Protection_Failure
  diagnostic event to trouble code uds mapping EventDtcMapPowerPath011CableProtectionFailure: diagnostic-event=EventPowerPath011CableProtectionFailure, trouble-code-uds=Power_Path_011_Cable_Protection_Failure  # Event_Dtc_Map_Power_Path_011_Cable_Protection_Failure
  diagnostic event to operation cycle mapping EventOperCycleMapPowerPath011CableProtectionFailure: diagnostic-event=EventPowerPath011CableProtectionFailure, operation-cycle=DefaultOperationCycle  # Event_Oper_Cycle_Map_Power_Path_011_Cable_Protection_Failure
  diagnostic event to debounce algorithm mapping EventDebounceMapPowerPath011CableProtectionFailure: debounce-algorithm=time_based, diagnostic-event=EventPowerPath011CableProtectionFailure  # EventDebounceMap_Power_Path_011_Cable_Protection_Failure
package /ZeC/DTC/DTC/Power_Path_010_Cable_Protection_Failure
  diagnostic trouble code uds Power_Path_010_Cable_Protection_Failure: dtc-props=Dtc_Props_5a0924a9, uds-dtc-value=0x00580a
  diagnostic event EventPowerPath010CableProtectionFailure: aging-allowed=true, event-kind=SWC, prestorage-freeze-frame=false  # Event_Power_Path_010_Cable_Protection_Failure
  diagnostic event to trouble code uds mapping EventDtcMapPowerPath010CableProtectionFailure: diagnostic-event=EventPowerPath010CableProtectionFailure, trouble-code-uds=Power_Path_010_Cable_Protection_Failure  # Event_Dtc_Map_Power_Path_010_Cable_Protection_Failure
  diagnostic event to operation cycle mapping EventOperCycleMapPowerPath010CableProtectionFailure: diagnostic-event=EventPowerPath010CableProtectionFailure, operation-cycle=DefaultOperationCycle  # Event_Oper_Cycle_Map_Power_Path_010_Cable_Protection_Failure
  diagnostic event to debounce algorithm mapping EventDebounceMapPowerPath010CableProtectionFailure: debounce-algorithm=time_based, diagnostic-event=EventPowerPath010CableProtectionFailure  # EventDebounceMap_Power_Path_010_Cable_Protection_Failure
package /ZeC/DTC/DTC/Power_Path_013_Cable_Protection_Failure
  diagnostic trouble code uds Power_Path_013_Cable_Protection_Failure: dtc-props=Dtc_Props_df05003a, uds-dtc-value=0x00580d
  diagnostic event EventPowerPath013CableProtectionFailure: aging-allowed=true, event-kind=SWC, prestorage-freeze-frame=false  # Event_Power_Path_013_Cable_Protection_Failure
  diagnostic event to trouble code uds mapping EventDtcMapPowerPath013CableProtectionFailure: diagnostic-event=EventPowerPath013CableProtectionFailure, trouble-code-uds=Power_Path_013_Cable_Protection_Failure  # Event_Dtc_Map_Power_Path_013_Cable_Protection_Failure
  diagnostic event to operation cycle mapping EventOperCycleMapPowerPath013CableProtectionFailure: diagnostic-event=EventPowerPath013CableProtectionFailure, operation-cycle=DefaultOperationCycle  # Event_Oper_Cycle_Map_Power_Path_013_Cable_Protection_Failure
  diagnostic event to debounce algorithm mapping EventDebounceMapPowerPath013CableProtectionFailure: debounce-algorithm=time_based, diagnostic-event=EventPowerPath013CableProtectionFailure  # EventDebounceMap_Power_Path_013_Cable_Protection_Failure
package /ZeC/DTC/DTC/Power_Path_012_Cable_Protection_Failure
  diagnostic trouble code uds Power_Path_012_Cable_Protection_Failure: dtc-props=Dtc_Props_d63b30dd, uds-dtc-value=0x00580c
  diagnostic event EventPowerPath012CableProtectionFailure: aging-allowed=true, event-kind=SWC, prestorage-freeze-frame=false  # Event_Power_Path_012_Cable_Protection_Failure
  diagnostic event to trouble code uds mapping EventDtcMapPowerPath012CableProtectionFailure: diagnostic-event=EventPowerPath012CableProtectionFailure, trouble-code-uds=Power_Path_012_Cable_Protection_Failure  # Event_Dtc_Map_Power_Path_012_Cable_Protection_Failure
  diagnostic event to operation cycle mapping EventOperCycleMapPowerPath012CableProtectionFailure: diagnostic-event=EventPowerPath012CableProtectionFailure, operation-cycle=DefaultOperationCycle  # Event_Oper_Cycle_Map_Power_Path_012_Cable_Protection_Failure
  diagnostic event to debounce algorithm mapping EventDebounceMapPowerPath012CableProtectionFailure: debounce-algorithm=time_based, diagnostic-event=EventPowerPath012CableProtectionFailure  # EventDebounceMap_Power_Path_012_Cable_Protection_Failure
package /ZeC/DTC/DTC/Power_Path_015_Cable_Protection_Failure
  diagnostic trouble code uds Power_Path_015_Cable_Protection_Failure: dtc-props=Dtc_Props_5337144e, uds-dtc-value=0x00580f
  diagnostic event EventPowerPath015CableProtectionFailure: aging-allowed=true, event-kind=SWC, prestorage-freeze-frame=false  # Event_Power_Path_015_Cable_Protection_Failure
  diagnostic event to trouble code uds mapping EventDtcMapPowerPath015CableProtectionFailure: diagnostic-event=EventPowerPath015CableProtectionFailure, trouble-code-uds=Power_Path_015_Cable_Protection_Failure  # Event_Dtc_Map_Power_Path_015_Cable_Protection_Failure
  diagnostic event to operation cycle mapping EventOperCycleMapPowerPath015CableProtectionFailure: diagnostic-event=EventPowerPath015CableProtectionFailure, operation-cycle=DefaultOperationCycle  # Event_Oper_Cycle_Map_Power_Path_015_Cable_Protection_Failure
  diagnostic event to debounce algorithm mapping EventDebounceMapPowerPath015CableProtectionFailure: debounce-algorithm=time_based, diagnostic-event=EventPowerPath015CableProtectionFailure  # EventDebounceMap_Power_Path_015_Cable_Protection_Failure
package /ZeC/DTC/DTC/Power_Path_014_Cable_Protection_Failure
  diagnostic trouble code uds Power_Path_014_Cable_Protection_Failure: dtc-props=Dtc_Props_991c0a00, uds-dtc-value=0x00580e
  diagnostic event EventPowerPath014CableProtectionFailure: aging-allowed=true, event-kind=SWC, prestorage-freeze-frame=false  # Event_Power_Path_014_Cable_Protection_Failure
  diagnostic event to trouble code uds mapping EventDtcMapPowerPath014CableProtectionFailure: diagnostic-event=EventPowerPath014CableProtectionFailure, trouble-code-uds=Power_Path_014_Cable_Protection_Failure  # Event_Dtc_Map_Power_Path_014_Cable_Protection_Failure
  diagnostic event to operation cycle mapping EventOperCycleMapPowerPath014CableProtectionFailure: diagnostic-event=EventPowerPath014CableProtectionFailure, operation-cycle=DefaultOperationCycle  # Event_Oper_Cycle_Map_Power_Path_014_Cable_Protection_Failure
  diagnostic event to debounce algorithm mapping EventDebounceMapPowerPath014CableProtectionFailure: debounce-algorithm=time_based, diagnostic-event=EventPowerPath014CableProtectionFailure  # EventDebounceMap_Power_Path_014_Cable_Protection_Failure
package /ZeC/DTC/DTC/Power_Path_160_Open_Load_Failure
  diagnostic trouble code uds Power_Path_160_Open_Load_Failure: dtc-props=Dtc_Props_c92c78b3, uds-dtc-value=0x0053a0
  diagnostic event EventPowerPath160OpenLoadFailure: aging-allowed=true, event-kind=SWC, prestorage-freeze-frame=false  # Event_Power_Path_160_Open_Load_Failure
  diagnostic event to trouble code uds mapping EventDtcMapPowerPath160OpenLoadFailure: diagnostic-event=EventPowerPath160OpenLoadFailure, trouble-code-uds=Power_Path_160_Open_Load_Failure  # Event_Dtc_Map_Power_Path_160_Open_Load_Failure
  diagnostic event to operation cycle mapping EventOperCycleMapPowerPath160OpenLoadFailure: diagnostic-event=EventPowerPath160OpenLoadFailure, operation-cycle=DefaultOperationCycle  # Event_Oper_Cycle_Map_Power_Path_160_Open_Load_Failure
  diagnostic event to debounce algorithm mapping EventDebounceMapPowerPath160OpenLoadFailure: debounce-algorithm=time_based, diagnostic-event=EventPowerPath160OpenLoadFailure  # EventDebounceMap_Power_Path_160_Open_Load_Failure
package /ZeC/DTC/DTC/CAN_01_ECU_4_No_Communication
  diagnostic trouble code uds CAN_01_ECU_4_No_Communication: dtc-props=Dtc_Props_14158306, uds-dtc-value=0x032108
  diagnostic event EventCAN01ECU4NoCommunication: aging-allowed=true, event-kind=SWC, prestorage-freeze-frame=false  # Event_CAN_01_ECU_4_No_Communication
  diagnostic event to trouble code uds mapping EventDtcMapCAN01ECU4NoCommunication: diagnostic-event=EventCAN01ECU4NoCommunication, trouble-code-uds=CAN_01_ECU_4_No_Communication  # Event_Dtc_Map_CAN_01_ECU_4_No_Communication
  diagnostic event to operation cycle mapping EventOperCycleMapCAN01ECU4NoCommunication: diagnostic-event=EventCAN01ECU4NoCommunication, operation-cycle=DefaultOperationCycle  # Event_Oper_Cycle_Map_CAN_01_ECU_4_No_Communication
  diagnostic event to debounce algorithm mapping EventDebounceMapCAN01ECU4NoCommunication: debounce-algorithm=counter_based, diagnostic-event=EventCAN01ECU4NoCommunication  # EventDebounceMap_CAN_01_ECU_4_No_Communication
package /ZeC/DTC/DTC/CAN_01_ECU_5_No_Communication
  diagnostic trouble code uds CAN_01_ECU_5_No_Communication: dtc-props=Dtc_Props_14158306, uds-dtc-value=0x032109
  diagnostic event EventCAN01ECU5NoCommunication: aging-allowed=true, event-kind=SWC, prestorage-freeze-frame=false  # Event_CAN_01_ECU_5_No_Communication
  diagnostic event to trouble code uds mapping EventDtcMapCAN01ECU5NoCommunication: diagnostic-event=EventCAN01ECU5NoCommunication, trouble-code-uds=CAN_01_ECU_5_No_Communication  # Event_Dtc_Map_CAN_01_ECU_5_No_Communication
  diagnostic event to operation cycle mapping EventOperCycleMapCAN01ECU5NoCommunication: diagnostic-event=EventCAN01ECU5NoCommunication, operation-cycle=DefaultOperationCycle  # Event_Oper_Cycle_Map_CAN_01_ECU_5_No_Communication
  diagnostic event to debounce algorithm mapping EventDebounceMapCAN01ECU5NoCommunication: debounce-algorithm=counter_based, diagnostic-event=EventCAN01ECU5NoCommunication  # EventDebounceMap_CAN_01_ECU_5_No_Communication
package /ZeC/DTC/DTC/CAN_01_ECU_2_No_Communication
  diagnostic trouble code uds CAN_01_ECU_2_No_Communication: dtc-props=Dtc_Props_14158306, uds-dtc-value=0x032106
  diagnostic event EventCAN01ECU2NoCommunication: aging-allowed=true, event-kind=SWC, prestorage-freeze-frame=false  # Event_CAN_01_ECU_2_No_Communication
  diagnostic event to trouble code uds mapping EventDtcMapCAN01ECU2NoCommunication: diagnostic-event=EventCAN01ECU2NoCommunication, trouble-code-uds=CAN_01_ECU_2_No_Communication  # Event_Dtc_Map_CAN_01_ECU_2_No_Communication
  diagnostic event to operation cycle mapping EventOperCycleMapCAN01ECU2NoCommunication: diagnostic-event=EventCAN01ECU2NoCommunication, operation-cycle=DefaultOperationCycle  # Event_Oper_Cycle_Map_CAN_01_ECU_2_No_Communication
  diagnostic event to debounce algorithm mapping EventDebounceMapCAN01ECU2NoCommunication: debounce-algorithm=counter_based, diagnostic-event=EventCAN01ECU2NoCommunication  # EventDebounceMap_CAN_01_ECU_2_No_Communication
package /ZeC/DTC/DTC/CAN_01_ECU_3_No_Communication
  diagnostic trouble code uds CAN_01_ECU_3_No_Communication: dtc-props=Dtc_Props_14158306, uds-dtc-value=0x032107
  diagnostic event EventCAN01ECU3NoCommunication: aging-allowed=true, event-kind=SWC, prestorage-freeze-frame=false  # Event_CAN_01_ECU_3_No_Communication
  diagnostic event to trouble code uds mapping EventDtcMapCAN01ECU3NoCommunication: diagnostic-event=EventCAN01ECU3NoCommunication, trouble-code-uds=CAN_01_ECU_3_No_Communication  # Event_Dtc_Map_CAN_01_ECU_3_No_Communication
  diagnostic event to operation cycle mapping EventOperCycleMapCAN01ECU3NoCommunication: diagnostic-event=EventCAN01ECU3NoCommunication, operation-cycle=DefaultOperationCycle  # Event_Oper_Cycle_Map_CAN_01_ECU_3_No_Communication
  diagnostic event to debounce algorithm mapping EventDebounceMapCAN01ECU3NoCommunication: debounce-algorithm=counter_based, diagnostic-event=EventCAN01ECU3NoCommunication  # EventDebounceMap_CAN_01_ECU_3_No_Communication
package /ZeC/DTC/DTC/DB_CANFD_01_Error_Received_Value
  diagnostic trouble code uds DB_CANFD_01_Error_Received_Value: dtc-props=Dtc_Props_b618fb9, uds-dtc-value=0x032104
  diagnostic event EventDBCANFD01ErrorReceivedValue: aging-allowed=true, event-kind=SWC, prestorage-freeze-frame=false  # Event_DB_CANFD_01_Error_Received_Value
  diagnostic event to trouble code uds mapping EventDtcMapDBCANFD01ErrorReceivedValue: diagnostic-event=EventDBCANFD01ErrorReceivedValue, trouble-code-uds=DB_CANFD_01_Error_Received_Value  # Event_Dtc_Map_DB_CANFD_01_Error_Received_Value
  diagnostic event to operation cycle mapping EventOperCycleMapDBCANFD01ErrorReceivedValue: diagnostic-event=EventDBCANFD01ErrorReceivedValue, operation-cycle=DefaultOperationCycle  # Event_Oper_Cycle_Map_DB_CANFD_01_Error_Received_Value
  diagnostic event to debounce algorithm mapping EventDebounceMapDBCANFD01ErrorReceivedValue: debounce-algorithm=counter_based, diagnostic-event=EventDBCANFD01ErrorReceivedValue  # EventDebounceMap_DB_CANFD_01_Error_Received_Value
package /ZeC/DTC/DTC/CAN_01_ECU_1_No_Communication
  diagnostic trouble code uds CAN_01_ECU_1_No_Communication: dtc-props=Dtc_Props_14158306, uds-dtc-value=0x032105
  diagnostic event EventCAN01ECU1NoCommunication: aging-allowed=true, event-kind=SWC, prestorage-freeze-frame=false  # Event_CAN_01_ECU_1_No_Communication
  diagnostic event to trouble code uds mapping EventDtcMapCAN01ECU1NoCommunication: diagnostic-event=EventCAN01ECU1NoCommunication, trouble-code-uds=CAN_01_ECU_1_No_Communication  # Event_Dtc_Map_CAN_01_ECU_1_No_Communication
  diagnostic event to operation cycle mapping EventOperCycleMapCAN01ECU1NoCommunication: diagnostic-event=EventCAN01ECU1NoCommunication, operation-cycle=DefaultOperationCycle  # Event_Oper_Cycle_Map_CAN_01_ECU_1_No_Communication
  diagnostic event to debounce algorithm mapping EventDebounceMapCAN01ECU1NoCommunication: debounce-algorithm=counter_based, diagnostic-event=EventCAN01ECU1NoCommunication  # EventDebounceMap_CAN_01_ECU_1_No_Communication
package /ZeC/DTC/DTC/DB_CANFD_01_No_Communication
  diagnostic trouble code uds DB_CANFD_01_No_Communication: dtc-props=Dtc_Props_14158306, uds-dtc-value=0x032102
  diagnostic event EventDBCANFD01NoCommunication: aging-allowed=true, event-kind=SWC, prestorage-freeze-frame=false  # Event_DB_CANFD_01_No_Communication
  diagnostic event to trouble code uds mapping EventDtcMapDBCANFD01NoCommunication: diagnostic-event=EventDBCANFD01NoCommunication, trouble-code-uds=DB_CANFD_01_No_Communication  # Event_Dtc_Map_DB_CANFD_01_No_Communication
  diagnostic event to operation cycle mapping EventOperCycleMapDBCANFD01NoCommunication: diagnostic-event=EventDBCANFD01NoCommunication, operation-cycle=DefaultOperationCycle  # Event_Oper_Cycle_Map_DB_CANFD_01_No_Communication
  diagnostic event to debounce algorithm mapping EventDebounceMapDBCANFD01NoCommunication: debounce-algorithm=counter_based, diagnostic-event=EventDBCANFD01NoCommunication  # EventDebounceMap_DB_CANFD_01_No_Communication
package /ZeC/DTC/DTC/DB_CANFD_01_Single_Wire_Mode
  diagnostic trouble code uds DB_CANFD_01_Single_Wire_Mode: dtc-props=Dtc_Props_14158306, uds-dtc-value=0x032103
  diagnostic event EventDBCANFD01SingleWireMode: aging-allowed=true, event-kind=SWC, prestorage-freeze-frame=false  # Event_DB_CANFD_01_Single_Wire_Mode
  diagnostic event to trouble code uds mapping EventDtcMapDBCANFD01SingleWireMode: diagnostic-event=EventDBCANFD01SingleWireMode, trouble-code-uds=DB_CANFD_01_Single_Wire_Mode  # Event_Dtc_Map_DB_CANFD_01_Single_Wire_Mode
  diagnostic event to operation cycle mapping EventOperCycleMapDBCANFD01SingleWireMode: diagnostic-event=EventDBCANFD01SingleWireMode, operation-cycle=DefaultOperationCycle  # Event_Oper_Cycle_Map_DB_CANFD_01_Single_Wire_Mode
  diagnostic event to debounce algorithm mapping EventDebounceMapDBCANFD01SingleWireMode: debounce-algorithm=counter_based, diagnostic-event=EventDBCANFD01SingleWireMode  # EventDebounceMap_DB_CANFD_01_Single_Wire_Mode
package /ZeC/DTC/DTC/DB_CANFD_01_Defect
  diagnostic trouble code uds DB_CANFD_01_Defect: dtc-props=Dtc_Props_14158306, uds-dtc-value=0x032101
  diagnostic event EventDBCANFD01Defect: aging-allowed=true, event-kind=SWC, prestorage-freeze-frame=false  # Event_DB_CANFD_01_Defect
  diagnostic event to trouble code uds mapping EventDtcMapDBCANFD01Defect: diagnostic-event=EventDBCANFD01Defect, trouble-code-uds=DB_CANFD_01_Defect  # Event_Dtc_Map_DB_CANFD_01_Defect
  diagnostic event to operation cycle mapping EventOperCycleMapDBCANFD01Defect: diagnostic-event=EventDBCANFD01Defect, operation-cycle=DefaultOperationCycle  # Event_Oper_Cycle_Map_DB_CANFD_01_Defect
  diagnostic event to debounce algorithm mapping EventDebounceMapDBCANFD01Defect: debounce-algorithm=counter_based, diagnostic-event=EventDBCANFD01Defect  # EventDebounceMap_DB_CANFD_01_Defect
package /ZeC/DTC/DTC/CAN_01_ECU_6_No_Communication
  diagnostic trouble code uds CAN_01_ECU_6_No_Communication: dtc-props=Dtc_Props_14158306, uds-dtc-value=0x032110
  diagnostic event EventCAN01ECU6NoCommunication: aging-allowed=true, event-kind=SWC, prestorage-freeze-frame=false  # Event_CAN_01_ECU_6_No_Communication
  diagnostic event to trouble code uds mapping EventDtcMapCAN01ECU6NoCommunication: diagnostic-event=EventCAN01ECU6NoCommunication, trouble-code-uds=CAN_01_ECU_6_No_Communication  # Event_Dtc_Map_CAN_01_ECU_6_No_Communication
  diagnostic event to operation cycle mapping EventOperCycleMapCAN01ECU6NoCommunication: diagnostic-event=EventCAN01ECU6NoCommunication, operation-cycle=DefaultOperationCycle  # Event_Oper_Cycle_Map_CAN_01_ECU_6_No_Communication
  diagnostic event to debounce algorithm mapping EventDebounceMapCAN01ECU6NoCommunication: debounce-algorithm=counter_based, diagnostic-event=EventCAN01ECU6NoCommunication  # EventDebounceMap_CAN_01_ECU_6_No_Communication
package /ZeC/DTC/DTC/Power_Path_104_Cable_Protection_Failure
  diagnostic trouble code uds Power_Path_104_Cable_Protection_Failure: dtc-props=Dtc_Props_849998ae, uds-dtc-value=0x005868
  diagnostic event EventPowerPath104CableProtectionFailure: aging-allowed=true, event-kind=SWC, prestorage-freeze-frame=false  # Event_Power_Path_104_Cable_Protection_Failure
  diagnostic event to trouble code uds mapping EventDtcMapPowerPath104CableProtectionFailure: diagnostic-event=EventPowerPath104CableProtectionFailure, trouble-code-uds=Power_Path_104_Cable_Protection_Failure  # Event_Dtc_Map_Power_Path_104_Cable_Protection_Failure
  diagnostic event to operation cycle mapping EventOperCycleMapPowerPath104CableProtectionFailure: diagnostic-event=EventPowerPath104CableProtectionFailure, operation-cycle=DefaultOperationCycle  # Event_Oper_Cycle_Map_Power_Path_104_Cable_Protection_Failure
  diagnostic event to debounce algorithm mapping EventDebounceMapPowerPath104CableProtectionFailure: debounce-algorithm=time_based, diagnostic-event=EventPowerPath104CableProtectionFailure  # EventDebounceMap_Power_Path_104_Cable_Protection_Failure
package /ZeC/DTC/DTC/Power_Path_103_Cable_Protection_Failure
  diagnostic trouble code uds Power_Path_103_Cable_Protection_Failure: dtc-props=Dtc_Props_d0fcf35a, uds-dtc-value=0x005867
  diagnostic event EventPowerPath103CableProtectionFailure: aging-allowed=true, event-kind=SWC, prestorage-freeze-frame=false  # Event_Power_Path_103_Cable_Protection_Failure
  diagnostic event to trouble code uds mapping EventDtcMapPowerPath103CableProtectionFailure: diagnostic-event=EventPowerPath103CableProtectionFailure, trouble-code-uds=Power_Path_103_Cable_Protection_Failure  # Event_Dtc_Map_Power_Path_103_Cable_Protection_Failure
  diagnostic event to operation cycle mapping EventOperCycleMapPowerPath103CableProtectionFailure: diagnostic-event=EventPowerPath103CableProtectionFailure, operation-cycle=DefaultOperationCycle  # Event_Oper_Cycle_Map_Power_Path_103_Cable_Protection_Failure
  diagnostic event to debounce algorithm mapping EventDebounceMapPowerPath103CableProtectionFailure: debounce-algorithm=time_based, diagnostic-event=EventPowerPath103CableProtectionFailure  # EventDebounceMap_Power_Path_103_Cable_Protection_Failure
package /ZeC/DTC/DTC/Power_Path_105_Cable_Protection_Failure
  diagnostic trouble code uds Power_Path_105_Cable_Protection_Failure: dtc-props=Dtc_Props_c2809294, uds-dtc-value=0x005869
  diagnostic event EventPowerPath105CableProtectionFailure: aging-allowed=true, event-kind=SWC, prestorage-freeze-frame=false  # Event_Power_Path_105_Cable_Protection_Failure
  diagnostic event to trouble code uds mapping EventDtcMapPowerPath105CableProtectionFailure: diagnostic-event=EventPowerPath105CableProtectionFailure, trouble-code-uds=Power_Path_105_Cable_Protection_Failure  # Event_Dtc_Map_Power_Path_105_Cable_Protection_Failure
  diagnostic event to operation cycle mapping EventOperCycleMapPowerPath105CableProtectionFailure: diagnostic-event=EventPowerPath105CableProtectionFailure, operation-cycle=DefaultOperationCycle  # Event_Oper_Cycle_Map_Power_Path_105_Cable_Protection_Failure
  diagnostic event to debounce algorithm mapping EventDebounceMapPowerPath105CableProtectionFailure: debounce-algorithm=time_based, diagnostic-event=EventPowerPath105CableProtectionFailure  # EventDebounceMap_Power_Path_105_Cable_Protection_Failure
package /ZeC/DTC/DTC/LIN_8_Databus_No_Comm
  diagnostic trouble code uds LIN_8_Databus_No_Comm: dtc-props=Dtc_Props_358996c7, uds-dtc-value=0x030820  # LIN 8 Databus_No_Comm
  diagnostic event EventLIN8DatabusNoComm: aging-allowed=true, event-kind=SWC, prestorage-freeze-frame=false  # Event_LIN 8 Databus_No_Comm
  diagnostic event to trouble code uds mapping EventDtcMapLIN8DatabusNoComm: diagnostic-event=EventLIN8DatabusNoComm, trouble-code-uds=LIN_8_Databus_No_Comm  # Event_Dtc_Map_LIN 8 Databus_No_Comm
  diagnostic event to operation cycle mapping EventOperCycleMapLIN8DatabusNoComm: diagnostic-event=EventLIN8DatabusNoComm, operation-cycle=DefaultOperationCycle  # Event_Oper_Cycle_Map_LIN 8 Databus_No_Comm
  diagnostic event to debounce algorithm mapping EventDebounceMapLIN8DatabusNoComm: debounce-algorithm=counter_based, diagnostic-event=EventLIN8DatabusNoComm  # EventDebounceMap_LIN 8 Databus_No_Comm
package /ZeC/DTC/DTC/Power_Path_100_Cable_Protection_Failure
  diagnostic trouble code uds Power_Path_100_Cable_Protection_Failure: dtc-props=Dtc_Props_1ad7ed14, uds-dtc-value=0x005864
  diagnostic event EventPowerPath100CableProtectionFailure: aging-allowed=true, event-kind=SWC, prestorage-freeze-frame=false  # Event_Power_Path_100_Cable_Protection_Failure
  diagnostic event to trouble code uds mapping EventDtcMapPowerPath100CableProtectionFailure: diagnostic-event=EventPowerPath100CableProtectionFailure, trouble-code-uds=Power_Path_100_Cable_Protection_Failure  # Event_Dtc_Map_Power_Path_100_Cable_Protection_Failure
  diagnostic event to operation cycle mapping EventOperCycleMapPowerPath100CableProtectionFailure: diagnostic-event=EventPowerPath100CableProtectionFailure, operation-cycle=DefaultOperationCycle  # Event_Oper_Cycle_Map_Power_Path_100_Cable_Protection_Failure
  diagnostic event to debounce algorithm mapping EventDebounceMapPowerPath100CableProtectionFailure: debounce-algorithm=time_based, diagnostic-event=EventPowerPath100CableProtectionFailure  # EventDebounceMap_Power_Path_100_Cable_Protection_Failure
package /ZeC/DTC/DTC/Power_Path_099_Cable_Protection_Failure
  diagnostic trouble code uds Power_Path_099_Cable_Protection_Failure: dtc-props=Dtc_Props_13e9ddf3, uds-dtc-value=0x005863
  diagnostic event EventPowerPath099CableProtectionFailure: aging-allowed=true, event-kind=SWC, prestorage-freeze-frame=false  # Event_Power_Path_099_Cable_Protection_Failure
  diagnostic event to trouble code uds mapping EventDtcMapPowerPath099CableProtectionFailure: diagnostic-event=EventPowerPath099CableProtectionFailure, trouble-code-uds=Power_Path_099_Cable_Protection_Failure  # Event_Dtc_Map_Power_Path_099_Cable_Protection_Failure
  diagnostic event to operation cycle mapping EventOperCycleMapPowerPath099CableProtectionFailure: diagnostic-event=EventPowerPath099CableProtectionFailure, operation-cycle=DefaultOperationCycle  # Event_Oper_Cycle_Map_Power_Path_099_Cable_Protection_Failure
  diagnostic event to debounce algorithm mapping EventDebounceMapPowerPath099CableProtectionFailure: debounce-algorithm=time_based, diagnostic-event=EventPowerPath099CableProtectionFailure  # EventDebounceMap_Power_Path_099_Cable_Protection_Failure
package /ZeC/DTC/DTC/Power_Path_102_Cable_Protection_Failure
  diagnostic trouble code uds Power_Path_102_Cable_Protection_Failure: dtc-props=Dtc_Props_96e5f960, uds-dtc-value=0x005866
  diagnostic event EventPowerPath102CableProtectionFailure: aging-allowed=true, event-kind=SWC, prestorage-freeze-frame=false  # Event_Power_Path_102_Cable_Protection_Failure
  diagnostic event to trouble code uds mapping EventDtcMapPowerPath102CableProtectionFailure: diagnostic-event=EventPowerPath102CableProtectionFailure, trouble-code-uds=Power_Path_102_Cable_Protection_Failure  # Event_Dtc_Map_Power_Path_102_Cable_Protection_Failure
  diagnostic event to operation cycle mapping EventOperCycleMapPowerPath102CableProtectionFailure: diagnostic-event=EventPowerPath102CableProtectionFailure, operation-cycle=DefaultOperationCycle  # Event_Oper_Cycle_Map_Power_Path_102_Cable_Protection_Failure
  diagnostic event to debounce algorithm mapping EventDebounceMapPowerPath102CableProtectionFailure: debounce-algorithm=time_based, diagnostic-event=EventPowerPath102CableProtectionFailure  # EventDebounceMap_Power_Path_102_Cable_Protection_Failure
package /ZeC/DTC/DTC/LIN_8_Local_Databus_Electrical_Failure
  diagnostic trouble code uds LIN_8_Local_Databus_Electrical_Failure: dtc-props=Dtc_Props_358996c7, uds-dtc-value=0x030821  # LIN 8 Local_Databus_Electrical_Failure
  diagnostic event EventLIN8LocalDatabusElectricalFailure: aging-allowed=true, event-kind=SWC, prestorage-freeze-frame=false  # Event_LIN 8 Local_Databus_Electrical_Failure
  diagnostic event to trouble code uds mapping EventDtcMapLIN8LocalDatabusElectricalFailure: diagnostic-event=EventLIN8LocalDatabusElectricalFailure, trouble-code-uds=LIN_8_Local_Databus_Electrical_Failure  # Event_Dtc_Map_LIN 8 Local_Databus_Electrical_Failure
  diagnostic event to operation cycle mapping EventOperCycleMapLIN8LocalDatabusElectricalFailure: diagnostic-event=EventLIN8LocalDatabusElectricalFailure, operation-cycle=DefaultOperationCycle  # Event_Oper_Cycle_Map_LIN 8 Local_Databus_Electrical_Failure
  diagnostic event to debounce algorithm mapping EventDebounceMapLIN8LocalDatabusElectricalFailure: debounce-algorithm=counter_based, diagnostic-event=EventLIN8LocalDatabusElectricalFailure  # EventDebounceMap_LIN 8 Local_Databus_Electrical_Failure
package /ZeC/DTC/DTC/Power_Path_101_Cable_Protection_Failure
  diagnostic trouble code uds Power_Path_101_Cable_Protection_Failure: dtc-props=Dtc_Props_5ccee72e, uds-dtc-value=0x005865
  diagnostic event EventPowerPath101CableProtectionFailure: aging-allowed=true, event-kind=SWC, prestorage-freeze-frame=false  # Event_Power_Path_101_Cable_Protection_Failure
  diagnostic event to trouble code uds mapping EventDtcMapPowerPath101CableProtectionFailure: diagnostic-event=EventPowerPath101CableProtectionFailure, trouble-code-uds=Power_Path_101_Cable_Protection_Failure  # Event_Dtc_Map_Power_Path_101_Cable_Protection_Failure
  diagnostic event to operation cycle mapping EventOperCycleMapPowerPath101CableProtectionFailure: diagnostic-event=EventPowerPath101CableProtectionFailure, operation-cycle=DefaultOperationCycle  # Event_Oper_Cycle_Map_Power_Path_101_Cable_Protection_Failure
  diagnostic event to debounce algorithm mapping EventDebounceMapPowerPath101CableProtectionFailure: debounce-algorithm=time_based, diagnostic-event=EventPowerPath101CableProtectionFailure  # EventDebounceMap_Power_Path_101_Cable_Protection_Failure
package /ZeC/DTC/DTC/Power_Path_107_Cable_Protection_Failure
  diagnostic trouble code uds Power_Path_107_Cable_Protection_Failure: dtc-props=Dtc_Props_680fb3b4, uds-dtc-value=0x00586b
  diagnostic event EventPowerPath107CableProtectionFailure: aging-allowed=true, event-kind=SWC, prestorage-freeze-frame=false  # Event_Power_Path_107_Cable_Protection_Failure
  diagnostic event to trouble code uds mapping EventDtcMapPowerPath107CableProtectionFailure: diagnostic-event=EventPowerPath107CableProtectionFailure, trouble-code-uds=Power_Path_107_Cable_Protection_Failure  # Event_Dtc_Map_Power_Path_107_Cable_Protection_Failure
  diagnostic event to operation cycle mapping EventOperCycleMapPowerPath107CableProtectionFailure: diagnostic-event=EventPowerPath107CableProtectionFailure, operation-cycle=DefaultOperationCycle  # Event_Oper_Cycle_Map_Power_Path_107_Cable_Protection_Failure
  diagnostic event to debounce algorithm mapping EventDebounceMapPowerPath107CableProtectionFailure: debounce-algorithm=time_based, diagnostic-event=EventPowerPath107CableProtectionFailure  # EventDebounceMap_Power_Path_107_Cable_Protection_Failure
package /ZeC/DTC/DTC/Power_Path_106_Cable_Protection_Failure
  diagnostic trouble code uds Power_Path_106_Cable_Protection_Failure: dtc-props=Dtc_Props_a224adfa, uds-dtc-value=0x00586a
  diagnostic event EventPowerPath106CableProtectionFailure: aging-allowed=true, event-kind=SWC, prestorage-freeze-frame=false  # Event_Power_Path_106_Cable_Protection_Failure
  diagnostic event to trouble code uds mapping EventDtcMapPowerPath106CableProtectionFailure: diagnostic-event=EventPowerPath106CableProtectionFailure, trouble-code-uds=Power_Path_106_Cable_Protection_Failure  # Event_Dtc_Map_Power_Path_106_Cable_Protection_Failure
  diagnostic event to operation cycle mapping EventOperCycleMapPowerPath106CableProtectionFailure: diagnostic-event=EventPowerPath106CableProtectionFailure, operation-cycle=DefaultOperationCycle  # Event_Oper_Cycle_Map_Power_Path_106_Cable_Protection_Failure
  diagnostic event to debounce algorithm mapping EventDebounceMapPowerPath106CableProtectionFailure: debounce-algorithm=time_based, diagnostic-event=EventPowerPath106CableProtectionFailure  # EventDebounceMap_Power_Path_106_Cable_Protection_Failure
package /ZeC/DTC/DTC/Power_Path_109_Cable_Protection_Failure
  diagnostic trouble code uds Power_Path_109_Cable_Protection_Failure: dtc-props=Dtc_Props_27288969, uds-dtc-value=0x00586d
  diagnostic event EventPowerPath109CableProtectionFailure: aging-allowed=true, event-kind=SWC, prestorage-freeze-frame=false  # Event_Power_Path_109_Cable_Protection_Failure
  diagnostic event to trouble code uds mapping EventDtcMapPowerPath109CableProtectionFailure: diagnostic-event=EventPowerPath109CableProtectionFailure, trouble-code-uds=Power_Path_109_Cable_Protection_Failure  # Event_Dtc_Map_Power_Path_109_Cable_Protection_Failure
  diagnostic event to operation cycle mapping EventOperCycleMapPowerPath109CableProtectionFailure: diagnostic-event=EventPowerPath109CableProtectionFailure, operation-cycle=DefaultOperationCycle  # Event_Oper_Cycle_Map_Power_Path_109_Cable_Protection_Failure
  diagnostic event to debounce algorithm mapping EventDebounceMapPowerPath109CableProtectionFailure: debounce-algorithm=time_based, diagnostic-event=EventPowerPath109CableProtectionFailure  # EventDebounceMap_Power_Path_109_Cable_Protection_Failure
package /ZeC/DTC/DTC/Power_Path_108_Cable_Protection_Failure
  diagnostic trouble code uds Power_Path_108_Cable_Protection_Failure: dtc-props=Dtc_Props_2e16b98e, uds-dtc-value=0x00586c
  diagnostic event EventPowerPath108CableProtectionFailure: aging-allowed=true, event-kind=SWC, prestorage-freeze-frame=false  # Event_Power_Path_108_Cable_Protection_Failure
  diagnostic event to trouble code uds mapping EventDtcMapPowerPath108CableProtectionFailure: diagnostic-event=EventPowerPath108CableProtectionFailure, trouble-code-uds=Power_Path_108_Cable_Protection_Failure  # Event_Dtc_Map_Power_Path_108_Cable_Protection_Failure
  diagnostic event to operation cycle mapping EventOperCycleMapPowerPath108CableProtectionFailure: diagnostic-event=EventPowerPath108CableProtectionFailure, operation-cycle=DefaultOperationCycle  # Event_Oper_Cycle_Map_Power_Path_108_Cable_Protection_Failure
  diagnostic event to debounce algorithm mapping EventDebounceMapPowerPath108CableProtectionFailure: debounce-algorithm=time_based, diagnostic-event=EventPowerPath108CableProtectionFailure  # EventDebounceMap_Power_Path_108_Cable_Protection_Failure
package /ZeC/DTC/DTC/Power_Path_111_Cable_Protection_Failure
  diagnostic trouble code uds Power_Path_111_Cable_Protection_Failure: dtc-props=Dtc_Props_ab1a9d1d, uds-dtc-value=0x00586f
  diagnostic event EventPowerPath111CableProtectionFailure: aging-allowed=true, event-kind=SWC, prestorage-freeze-frame=false  # Event_Power_Path_111_Cable_Protection_Failure
  diagnostic event to trouble code uds mapping EventDtcMapPowerPath111CableProtectionFailure: diagnostic-event=EventPowerPath111CableProtectionFailure, trouble-code-uds=Power_Path_111_Cable_Protection_Failure  # Event_Dtc_Map_Power_Path_111_Cable_Protection_Failure
  diagnostic event to operation cycle mapping EventOperCycleMapPowerPath111CableProtectionFailure: diagnostic-event=EventPowerPath111CableProtectionFailure, operation-cycle=DefaultOperationCycle  # Event_Oper_Cycle_Map_Power_Path_111_Cable_Protection_Failure
  diagnostic event to debounce algorithm mapping EventDebounceMapPowerPath111CableProtectionFailure: debounce-algorithm=time_based, diagnostic-event=EventPowerPath111CableProtectionFailure  # EventDebounceMap_Power_Path_111_Cable_Protection_Failure
package /ZeC/DTC/DTC/Power_Path_110_Cable_Protection_Failure
  diagnostic trouble code uds Power_Path_110_Cable_Protection_Failure: dtc-props=Dtc_Props_61318353, uds-dtc-value=0x00586e
  diagnostic event EventPowerPath110CableProtectionFailure: aging-allowed=true, event-kind=SWC, prestorage-freeze-frame=false  # Event_Power_Path_110_Cable_Protection_Failure
  diagnostic event to trouble code uds mapping EventDtcMapPowerPath110CableProtectionFailure: diagnostic-event=EventPowerPath110CableProtectionFailure, trouble-code-uds=Power_Path_110_Cable_Protection_Failure  # Event_Dtc_Map_Power_Path_110_Cable_Protection_Failure
  diagnostic event to operation cycle mapping EventOperCycleMapPowerPath110CableProtectionFailure: diagnostic-event=EventPowerPath110CableProtectionFailure, operation-cycle=DefaultOperationCycle  # Event_Oper_Cycle_Map_Power_Path_110_Cable_Protection_Failure
  diagnostic event to debounce algorithm mapping EventDebounceMapPowerPath110CableProtectionFailure: debounce-algorithm=time_based, diagnostic-event=EventPowerPath110CableProtectionFailure  # EventDebounceMap_Power_Path_110_Cable_Protection_Failure
package /ZeC/DTC/DTC/Power_Path_113_Cable_Protection_Failure
  diagnostic trouble code uds Power_Path_113_Cable_Protection_Failure: dtc-props=Dtc_Props_5991093f, uds-dtc-value=0x005871
  diagnostic event EventPowerPath113CableProtectionFailure: aging-allowed=true, event-kind=SWC, prestorage-freeze-frame=false  # Event_Power_Path_113_Cable_Protection_Failure
  diagnostic event to trouble code uds mapping EventDtcMapPowerPath113CableProtectionFailure: diagnostic-event=EventPowerPath113CableProtectionFailure, trouble-code-uds=Power_Path_113_Cable_Protection_Failure  # Event_Dtc_Map_Power_Path_113_Cable_Protection_Failure
  diagnostic event to operation cycle mapping EventOperCycleMapPowerPath113CableProtectionFailure: diagnostic-event=EventPowerPath113CableProtectionFailure, operation-cycle=DefaultOperationCycle  # Event_Oper_Cycle_Map_Power_Path_113_Cable_Protection_Failure
  diagnostic event to debounce algorithm mapping EventDebounceMapPowerPath113CableProtectionFailure: debounce-algorithm=time_based, diagnostic-event=EventPowerPath113CableProtectionFailure  # EventDebounceMap_Power_Path_113_Cable_Protection_Failure
package /ZeC/DTC/DTC/Supply_voltage_below_lower_limit_input_1
  diagnostic trouble code uds Supply_voltage_below_lower_limit_input_1: dtc-props=Dtc_Props_d78b13b8, uds-dtc-value=0x001031
  diagnostic event EventSupplyVoltageBelowLowerLimitInput1: aging-allowed=true, event-kind=SWC, prestorage-freeze-frame=false  # Event_Supply_voltage_below_lower_limit_input_1
  diagnostic event to trouble code uds mapping EventDtcMapSupplyVoltageBelowLowerLimitInput1: diagnostic-event=EventSupplyVoltageBelowLowerLimitInput1, trouble-code-uds=Supply_voltage_below_lower_limit_input_1  # Event_Dtc_Map_Supply_voltage_below_lower_limit_input_1
  diagnostic event to operation cycle mapping EventOperCycleMapSupplyVoltageBelowLowerLimitInput1: diagnostic-event=EventSupplyVoltageBelowLowerLimitInput1, operation-cycle=DefaultOperationCycle  # Event_Oper_Cycle_Map_Supply_voltage_below_lower_limit_input_1
  diagnostic event to debounce algorithm mapping EventDebounceMapSupplyVoltageBelowLowerLimitInput1: debounce-algorithm=time_based, diagnostic-event=EventSupplyVoltageBelowLowerLimitInput1  # EventDebounceMap_Supply_voltage_below_lower_limit_input_1
package /ZeC/DTC/DTC/Power_Path_112_Cable_Protection_Failure
  diagnostic trouble code uds Power_Path_112_Cable_Protection_Failure: dtc-props=Dtc_Props_1f880305, uds-dtc-value=0x005870
  diagnostic event EventPowerPath112CableProtectionFailure: aging-allowed=true, event-kind=SWC, prestorage-freeze-frame=false  # Event_Power_Path_112_Cable_Protection_Failure
  diagnostic event to trouble code uds mapping EventDtcMapPowerPath112CableProtectionFailure: diagnostic-event=EventPowerPath112CableProtectionFailure, trouble-code-uds=Power_Path_112_Cable_Protection_Failure  # Event_Dtc_Map_Power_Path_112_Cable_Protection_Failure
  diagnostic event to operation cycle mapping EventOperCycleMapPowerPath112CableProtectionFailure: diagnostic-event=EventPowerPath112CableProtectionFailure, operation-cycle=DefaultOperationCycle  # Event_Oper_Cycle_Map_Power_Path_112_Cable_Protection_Failure
  diagnostic event to debounce algorithm mapping EventDebounceMapPowerPath112CableProtectionFailure: debounce-algorithm=time_based, diagnostic-event=EventPowerPath112CableProtectionFailure  # EventDebounceMap_Power_Path_112_Cable_Protection_Failure
package /ZeC/DTC/DTC/Supply_voltage_below_lower_limit_input_2
  diagnostic trouble code uds Supply_voltage_below_lower_limit_input_2: dtc-props=Dtc_Props_d78b13b8, uds-dtc-value=0x001032
  diagnostic event EventSupplyVoltageBelowLowerLimitInput2: aging-allowed=true, event-kind=SWC, prestorage-freeze-frame=false  # Event_Supply_voltage_below_lower_limit_input_2
  diagnostic event to trouble code uds mapping EventDtcMapSupplyVoltageBelowLowerLimitInput2: diagnostic-event=EventSupplyVoltageBelowLowerLimitInput2, trouble-code-uds=Supply_voltage_below_lower_limit_input_2  # Event_Dtc_Map_Supply_voltage_below_lower_limit_input_2
  diagnostic event to operation cycle mapping EventOperCycleMapSupplyVoltageBelowLowerLimitInput2: diagnostic-event=EventSupplyVoltageBelowLowerLimitInput2, operation-cycle=DefaultOperationCycle  # Event_Oper_Cycle_Map_Supply_voltage_below_lower_limit_input_2
  diagnostic event to debounce algorithm mapping EventDebounceMapSupplyVoltageBelowLowerLimitInput2: debounce-algorithm=time_based, diagnostic-event=EventSupplyVoltageBelowLowerLimitInput2  # EventDebounceMap_Supply_voltage_below_lower_limit_input_2
package /ZeC/DTC/DTC/Power_Path_115_Cable_Protection_Failure
  diagnostic trouble code uds Power_Path_115_Cable_Protection_Failure: dtc-props=Dtc_Props_d5a31d4b, uds-dtc-value=0x005873
  diagnostic event EventPowerPath115CableProtectionFailure: aging-allowed=true, event-kind=SWC, prestorage-freeze-frame=false  # Event_Power_Path_115_Cable_Protection_Failure
  diagnostic event to trouble code uds mapping EventDtcMapPowerPath115CableProtectionFailure: diagnostic-event=EventPowerPath115CableProtectionFailure, trouble-code-uds=Power_Path_115_Cable_Protection_Failure  # Event_Dtc_Map_Power_Path_115_Cable_Protection_Failure
  diagnostic event to operation cycle mapping EventOperCycleMapPowerPath115CableProtectionFailure: diagnostic-event=EventPowerPath115CableProtectionFailure, operation-cycle=DefaultOperationCycle  # Event_Oper_Cycle_Map_Power_Path_115_Cable_Protection_Failure
  diagnostic event to debounce algorithm mapping EventDebounceMapPowerPath115CableProtectionFailure: debounce-algorithm=time_based, diagnostic-event=EventPowerPath115CableProtectionFailure  # EventDebounceMap_Power_Path_115_Cable_Protection_Failure
package /ZeC/DTC/DTC/Supply_voltage_exceeded_upper_limit_input_1
  diagnostic trouble code uds Supply_voltage_exceeded_upper_limit_input_1: dtc-props=Dtc_Props_d78b13b8, uds-dtc-value=0x001033
  diagnostic event EventSupplyVoltageExceededUpperLimitInput1: aging-allowed=true, event-kind=SWC, prestorage-freeze-frame=false  # Event_Supply_voltage_exceeded_upper_limit_input_1
  diagnostic event to trouble code uds mapping EventDtcMapSupplyVoltageExceededUpperLimitInput1: diagnostic-event=EventSupplyVoltageExceededUpperLimitInput1, trouble-code-uds=Supply_voltage_exceeded_upper_limit_input_1  # Event_Dtc_Map_Supply_voltage_exceeded_upper_limit_input_1
  diagnostic event to operation cycle mapping EventOperCycleMapSupplyVoltageExceededUpperLimitInput1: diagnostic-event=EventSupplyVoltageExceededUpperLimitInput1, operation-cycle=DefaultOperationCycle  # Event_Oper_Cycle_Map_Supply_voltage_exceeded_upper_limit_input_1
  diagnostic event to debounce algorithm mapping EventDebounceMapSupplyVoltageExceededUpperLimitInput1: debounce-algorithm=time_based, diagnostic-event=EventSupplyVoltageExceededUpperLimitInput1  # EventDebounceMap_Supply_voltage_exceeded_upper_limit_input_1
package /ZeC/DTC/DTC/Power_Path_114_Cable_Protection_Failure
  diagnostic trouble code uds Power_Path_114_Cable_Protection_Failure: dtc-props=Dtc_Props_93ba1771, uds-dtc-value=0x005872
  diagnostic event EventPowerPath114CableProtectionFailure: aging-allowed=true, event-kind=SWC, prestorage-freeze-frame=false  # Event_Power_Path_114_Cable_Protection_Failure
  diagnostic event to trouble code uds mapping EventDtcMapPowerPath114CableProtectionFailure: diagnostic-event=EventPowerPath114CableProtectionFailure, trouble-code-uds=Power_Path_114_Cable_Protection_Failure  # Event_Dtc_Map_Power_Path_114_Cable_Protection_Failure
  diagnostic event to operation cycle mapping EventOperCycleMapPowerPath114CableProtectionFailure: diagnostic-event=EventPowerPath114CableProtectionFailure, operation-cycle=DefaultOperationCycle  # Event_Oper_Cycle_Map_Power_Path_114_Cable_Protection_Failure
  diagnostic event to debounce algorithm mapping EventDebounceMapPowerPath114CableProtectionFailure: debounce-algorithm=time_based, diagnostic-event=EventPowerPath114CableProtectionFailure  # EventDebounceMap_Power_Path_114_Cable_Protection_Failure
package /ZeC/DTC/DTC/Memory_protection_compromised
  diagnostic trouble code uds Memory_protection_compromised: dtc-props=Dtc_Props_c8ff1f07, uds-dtc-value=0x001016
  diagnostic event EventMemoryProtectionCompromised: aging-allowed=true, event-kind=SWC, prestorage-freeze-frame=false  # Event_Memory_protection_compromised
  diagnostic event to trouble code uds mapping EventDtcMapMemoryProtectionCompromised: diagnostic-event=EventMemoryProtectionCompromised, trouble-code-uds=Memory_protection_compromised  # Event_Dtc_Map_Memory_protection_compromised
  diagnostic event to operation cycle mapping EventOperCycleMapMemoryProtectionCompromised: diagnostic-event=EventMemoryProtectionCompromised, operation-cycle=DefaultOperationCycle  # Event_Oper_Cycle_Map_Memory_protection_compromised
  diagnostic event to debounce algorithm mapping EventDebounceMapMemoryProtectionCompromised: debounce-algorithm=counter_based, diagnostic-event=EventMemoryProtectionCompromised  # EventDebounceMap_Memory_protection_compromised
package /ZeC/DTC/DTC/Power_Path_087_Cable_Protection_Failure
  diagnostic trouble code uds Power_Path_087_Cable_Protection_Failure: dtc-props=Dtc_Props_4152b4d3, uds-dtc-value=0x005857
  diagnostic event EventPowerPath087CableProtectionFailure: aging-allowed=true, event-kind=SWC, prestorage-freeze-frame=false  # Event_Power_Path_087_Cable_Protection_Failure
  diagnostic event to trouble code uds mapping EventDtcMapPowerPath087CableProtectionFailure: diagnostic-event=EventPowerPath087CableProtectionFailure, trouble-code-uds=Power_Path_087_Cable_Protection_Failure  # Event_Dtc_Map_Power_Path_087_Cable_Protection_Failure
  diagnostic event to operation cycle mapping EventOperCycleMapPowerPath087CableProtectionFailure: diagnostic-event=EventPowerPath087CableProtectionFailure, operation-cycle=DefaultOperationCycle  # Event_Oper_Cycle_Map_Power_Path_087_Cable_Protection_Failure
  diagnostic event to debounce algorithm mapping EventDebounceMapPowerPath087CableProtectionFailure: debounce-algorithm=time_based, diagnostic-event=EventPowerPath087CableProtectionFailure  # EventDebounceMap_Power_Path_087_Cable_Protection_Failure
package /ZeC/DTC/DTC/Model_monitoring
  diagnostic trouble code uds Model_monitoring: dtc-props=Dtc_Props_c8ff1f07, uds-dtc-value=0x001017
  diagnostic event EventModelMonitoring: aging-allowed=true, event-kind=SWC, prestorage-freeze-frame=false  # Event_Model_monitoring
  diagnostic event to trouble code uds mapping EventDtcMapModelMonitoring: diagnostic-event=EventModelMonitoring, trouble-code-uds=Model_monitoring  # Event_Dtc_Map_Model_monitoring
  diagnostic event to operation cycle mapping EventOperCycleMapModelMonitoring: diagnostic-event=EventModelMonitoring, operation-cycle=DefaultOperationCycle  # Event_Oper_Cycle_Map_Model_monitoring
  diagnostic event to debounce algorithm mapping EventDebounceMapModelMonitoring: debounce-algorithm=counter_based, diagnostic-event=EventModelMonitoring  # EventDebounceMap_Model_monitoring
package /ZeC/DTC/DTC/Power_Path_086_Cable_Protection_Failure
  diagnostic trouble code uds Power_Path_086_Cable_Protection_Failure: dtc-props=Dtc_Props_74bbee9, uds-dtc-value=0x005856
  diagnostic event EventPowerPath086CableProtectionFailure: aging-allowed=true, event-kind=SWC, prestorage-freeze-frame=false  # Event_Power_Path_086_Cable_Protection_Failure
  diagnostic event to trouble code uds mapping EventDtcMapPowerPath086CableProtectionFailure: diagnostic-event=EventPowerPath086CableProtectionFailure, trouble-code-uds=Power_Path_086_Cable_Protection_Failure  # Event_Dtc_Map_Power_Path_086_Cable_Protection_Failure
  diagnostic event to operation cycle mapping EventOperCycleMapPowerPath086CableProtectionFailure: diagnostic-event=EventPowerPath086CableProtectionFailure, operation-cycle=DefaultOperationCycle  # Event_Oper_Cycle_Map_Power_Path_086_Cable_Protection_Failure
  diagnostic event to debounce algorithm mapping EventDebounceMapPowerPath086CableProtectionFailure: debounce-algorithm=time_based, diagnostic-event=EventPowerPath086CableProtectionFailure  # EventDebounceMap_Power_Path_086_Cable_Protection_Failure
package /ZeC/DTC/DTC/Program_sequence_error
  diagnostic trouble code uds Program_sequence_error: dtc-props=Dtc_Props_c8ff1f07, uds-dtc-value=0x001018
  diagnostic event EventProgramSequenceError: aging-allowed=true, event-kind=SWC, prestorage-freeze-frame=false  # Event_Program_sequence_error
  diagnostic event to trouble code uds mapping EventDtcMapProgramSequenceError: diagnostic-event=EventProgramSequenceError, trouble-code-uds=Program_sequence_error  # Event_Dtc_Map_Program_sequence_error
  diagnostic event to operation cycle mapping EventOperCycleMapProgramSequenceError: diagnostic-event=EventProgramSequenceError, operation-cycle=DefaultOperationCycle  # Event_Oper_Cycle_Map_Program_sequence_error
  diagnostic event to debounce algorithm mapping EventDebounceMapProgramSequenceError: debounce-algorithm=counter_based, diagnostic-event=EventProgramSequenceError  # EventDebounceMap_Program_sequence_error
package /ZeC/DTC/DTC/Power_Path_089_Cable_Protection_Failure
  diagnostic trouble code uds Power_Path_089_Cable_Protection_Failure: dtc-props=Dtc_Props_532ed51d, uds-dtc-value=0x005859
  diagnostic event EventPowerPath089CableProtectionFailure: aging-allowed=true, event-kind=SWC, prestorage-freeze-frame=false  # Event_Power_Path_089_Cable_Protection_Failure
  diagnostic event to trouble code uds mapping EventDtcMapPowerPath089CableProtectionFailure: diagnostic-event=EventPowerPath089CableProtectionFailure, trouble-code-uds=Power_Path_089_Cable_Protection_Failure  # Event_Dtc_Map_Power_Path_089_Cable_Protection_Failure
  diagnostic event to operation cycle mapping EventOperCycleMapPowerPath089CableProtectionFailure: diagnostic-event=EventPowerPath089CableProtectionFailure, operation-cycle=DefaultOperationCycle  # Event_Oper_Cycle_Map_Power_Path_089_Cable_Protection_Failure
  diagnostic event to debounce algorithm mapping EventDebounceMapPowerPath089CableProtectionFailure: debounce-algorithm=time_based, diagnostic-event=EventPowerPath089CableProtectionFailure  # EventDebounceMap_Power_Path_089_Cable_Protection_Failure
package /ZeC/DTC/DTC/RAM_defective
  diagnostic trouble code uds RAM_defective: dtc-props=Dtc_Props_c8ff1f07, uds-dtc-value=0x001019
  diagnostic event EventRAMDefective: aging-allowed=true, event-kind=SWC, prestorage-freeze-frame=false  # Event_RAM_defective
  diagnostic event to trouble code uds mapping EventDtcMapRAMDefective: diagnostic-event=EventRAMDefective, trouble-code-uds=RAM_defective  # Event_Dtc_Map_RAM_defective
  diagnostic event to operation cycle mapping EventOperCycleMapRAMDefective: diagnostic-event=EventRAMDefective, operation-cycle=DefaultOperationCycle  # Event_Oper_Cycle_Map_RAM_defective
  diagnostic event to debounce algorithm mapping EventDebounceMapRAMDefective: debounce-algorithm=counter_based, diagnostic-event=EventRAMDefective  # EventDebounceMap_RAM_defective
package /ZeC/DTC/DTC/Power_Path_088_Cable_Protection_Failure
  diagnostic trouble code uds Power_Path_088_Cable_Protection_Failure: dtc-props=Dtc_Props_1537df27, uds-dtc-value=0x005858
  diagnostic event EventPowerPath088CableProtectionFailure: aging-allowed=true, event-kind=SWC, prestorage-freeze-frame=false  # Event_Power_Path_088_Cable_Protection_Failure
  diagnostic event to trouble code uds mapping EventDtcMapPowerPath088CableProtectionFailure: diagnostic-event=EventPowerPath088CableProtectionFailure, trouble-code-uds=Power_Path_088_Cable_Protection_Failure  # Event_Dtc_Map_Power_Path_088_Cable_Protection_Failure
  diagnostic event to operation cycle mapping EventOperCycleMapPowerPath088CableProtectionFailure: diagnostic-event=EventPowerPath088CableProtectionFailure, operation-cycle=DefaultOperationCycle  # Event_Oper_Cycle_Map_Power_Path_088_Cable_Protection_Failure
  diagnostic event to debounce algorithm mapping EventDebounceMapPowerPath088CableProtectionFailure: debounce-algorithm=time_based, diagnostic-event=EventPowerPath088CableProtectionFailure  # EventDebounceMap_Power_Path_088_Cable_Protection_Failure
package /ZeC/DTC/DTC/Control_Module_Missing_Calibration
  diagnostic trouble code uds Control_Module_Missing_Calibration: dtc-props=Dtc_Props_c8ff1f07, uds-dtc-value=0x001012  # Control Module Missing Calibration
  diagnostic event EventControlModuleMissingCalibration: aging-allowed=true, event-kind=SWC, prestorage-freeze-frame=false  # Event_Control Module Missing Calibration
  diagnostic event to trouble code uds mapping EventDtcMapControlModuleMissingCalibration: diagnostic-event=EventControlModuleMissingCalibration, trouble-code-uds=Control_Module_Missing_Calibration  # Event_Dtc_Map_Control Module Missing Calibration
  diagnostic event to operation cycle mapping EventOperCycleMapControlModuleMissingCalibration: diagnostic-event=EventControlModuleMissingCalibration, operation-cycle=DefaultOperationCycle  # Event_Oper_Cycle_Map_Control Module Missing Calibration
  diagnostic event to debounce algorithm mapping EventDebounceMapControlModuleMissingCalibration: debounce-algorithm=counter_based, diagnostic-event=EventControlModuleMissingCalibration  # EventDebounceMap_Control Module Missing Calibration
package /ZeC/DTC/DTC/Power_Path_083_Cable_Protection_Failure
  diagnostic trouble code uds Power_Path_083_Cable_Protection_Failure: dtc-props=Dtc_Props_82479a7a, uds-dtc-value=0x005853
  diagnostic event EventPowerPath083CableProtectionFailure: aging-allowed=true, event-kind=SWC, prestorage-freeze-frame=false  # Event_Power_Path_083_Cable_Protection_Failure
  diagnostic event to trouble code uds mapping EventDtcMapPowerPath083CableProtectionFailure: diagnostic-event=EventPowerPath083CableProtectionFailure, trouble-code-uds=Power_Path_083_Cable_Protection_Failure  # Event_Dtc_Map_Power_Path_083_Cable_Protection_Failure
  diagnostic event to operation cycle mapping EventOperCycleMapPowerPath083CableProtectionFailure: diagnostic-event=EventPowerPath083CableProtectionFailure, operation-cycle=DefaultOperationCycle  # Event_Oper_Cycle_Map_Power_Path_083_Cable_Protection_Failure
  diagnostic event to debounce algorithm mapping EventDebounceMapPowerPath083CableProtectionFailure: debounce-algorithm=time_based, diagnostic-event=EventPowerPath083CableProtectionFailure  # EventDebounceMap_Power_Path_083_Cable_Protection_Failure
package /ZeC/DTC/DTC/Control_Module_Vehicle_Options_Error
  diagnostic trouble code uds Control_Module_Vehicle_Options_Error: dtc-props=Dtc_Props_c8ff1f07, uds-dtc-value=0x001013  # Control Module Vehicle Options Error
  diagnostic event EventControlModuleVehicleOptionsError: aging-allowed=true, event-kind=SWC, prestorage-freeze-frame=false  # Event_Control Module Vehicle Options Error
  diagnostic event to trouble code uds mapping EventDtcMapControlModuleVehicleOptionsError: diagnostic-event=EventControlModuleVehicleOptionsError, trouble-code-uds=Control_Module_Vehicle_Options_Error  # Event_Dtc_Map_Control Module Vehicle Options Error
  diagnostic event to operation cycle mapping EventOperCycleMapControlModuleVehicleOptionsError: diagnostic-event=EventControlModuleVehicleOptionsError, operation-cycle=DefaultOperationCycle  # Event_Oper_Cycle_Map_Control Module Vehicle Options Error
  diagnostic event to debounce algorithm mapping EventDebounceMapControlModuleVehicleOptionsError: debounce-algorithm=counter_based, diagnostic-event=EventControlModuleVehicleOptionsError  # EventDebounceMap_Control Module Vehicle Options Error
package /ZeC/DTC/DTC/Power_Path_082_Cable_Protection_Failure
  diagnostic trouble code uds Power_Path_082_Cable_Protection_Failure: dtc-props=Dtc_Props_c45e9040, uds-dtc-value=0x005852
  diagnostic event EventPowerPath082CableProtectionFailure: aging-allowed=true, event-kind=SWC, prestorage-freeze-frame=false  # Event_Power_Path_082_Cable_Protection_Failure
  diagnostic event to trouble code uds mapping EventDtcMapPowerPath082CableProtectionFailure: diagnostic-event=EventPowerPath082CableProtectionFailure, trouble-code-uds=Power_Path_082_Cable_Protection_Failure  # Event_Dtc_Map_Power_Path_082_Cable_Protection_Failure
  diagnostic event to operation cycle mapping EventOperCycleMapPowerPath082CableProtectionFailure: diagnostic-event=EventPowerPath082CableProtectionFailure, operation-cycle=DefaultOperationCycle  # Event_Oper_Cycle_Map_Power_Path_082_Cable_Protection_Failure
  diagnostic event to debounce algorithm mapping EventDebounceMapPowerPath082CableProtectionFailure: debounce-algorithm=time_based, diagnostic-event=EventPowerPath082CableProtectionFailure  # EventDebounceMap_Power_Path_082_Cable_Protection_Failure
package /ZeC/DTC/DTC/EEPROM_defective
  diagnostic trouble code uds EEPROM_defective: dtc-props=Dtc_Props_c8ff1f07, uds-dtc-value=0x001014
  diagnostic event EventEEPROMDefective: aging-allowed=true, event-kind=SWC, prestorage-freeze-frame=false  # Event_EEPROM_defective
  diagnostic event to trouble code uds mapping EventDtcMapEEPROMDefective: diagnostic-event=EventEEPROMDefective, trouble-code-uds=EEPROM_defective  # Event_Dtc_Map_EEPROM_defective
  diagnostic event to operation cycle mapping EventOperCycleMapEEPROMDefective: diagnostic-event=EventEEPROMDefective, operation-cycle=DefaultOperationCycle  # Event_Oper_Cycle_Map_EEPROM_defective
  diagnostic event to debounce algorithm mapping EventDebounceMapEEPROMDefective: debounce-algorithm=counter_based, diagnostic-event=EventEEPROMDefective  # EventDebounceMap_EEPROM_defective
package /ZeC/DTC/DTC/Power_Path_085_Cable_Protection_Failure
  diagnostic trouble code uds Power_Path_085_Cable_Protection_Failure: dtc-props=Dtc_Props_cd60a0a7, uds-dtc-value=0x005855
  diagnostic event EventPowerPath085CableProtectionFailure: aging-allowed=true, event-kind=SWC, prestorage-freeze-frame=false  # Event_Power_Path_085_Cable_Protection_Failure
  diagnostic event to trouble code uds mapping EventDtcMapPowerPath085CableProtectionFailure: diagnostic-event=EventPowerPath085CableProtectionFailure, trouble-code-uds=Power_Path_085_Cable_Protection_Failure  # Event_Dtc_Map_Power_Path_085_Cable_Protection_Failure
  diagnostic event to operation cycle mapping EventOperCycleMapPowerPath085CableProtectionFailure: diagnostic-event=EventPowerPath085CableProtectionFailure, operation-cycle=DefaultOperationCycle  # Event_Oper_Cycle_Map_Power_Path_085_Cable_Protection_Failure
  diagnostic event to debounce algorithm mapping EventDebounceMapPowerPath085CableProtectionFailure: debounce-algorithm=time_based, diagnostic-event=EventPowerPath085CableProtectionFailure  # EventDebounceMap_Power_Path_085_Cable_Protection_Failure
package /ZeC/DTC/DTC/Interface_defective
  diagnostic trouble code uds Interface_defective: dtc-props=Dtc_Props_c8ff1f07, uds-dtc-value=0x001015
  diagnostic event EventInterfaceDefective: aging-allowed=true, event-kind=SWC, prestorage-freeze-frame=false  # Event_Interface_defective
  diagnostic event to trouble code uds mapping EventDtcMapInterfaceDefective: diagnostic-event=EventInterfaceDefective, trouble-code-uds=Interface_defective  # Event_Dtc_Map_Interface_defective
  diagnostic event to operation cycle mapping EventOperCycleMapInterfaceDefective: diagnostic-event=EventInterfaceDefective, operation-cycle=DefaultOperationCycle  # Event_Oper_Cycle_Map_Interface_defective
  diagnostic event to debounce algorithm mapping EventDebounceMapInterfaceDefective: debounce-algorithm=counter_based, diagnostic-event=EventInterfaceDefective  # EventDebounceMap_Interface_defective
package /ZeC/DTC/DTC/Power_Path_084_Cable_Protection_Failure
  diagnostic trouble code uds Power_Path_084_Cable_Protection_Failure: dtc-props=Dtc_Props_8b79aa9d, uds-dtc-value=0x005854
  diagnostic event EventPowerPath084CableProtectionFailure: aging-allowed=true, event-kind=SWC, prestorage-freeze-frame=false  # Event_Power_Path_084_Cable_Protection_Failure
  diagnostic event to trouble code uds mapping EventDtcMapPowerPath084CableProtectionFailure: diagnostic-event=EventPowerPath084CableProtectionFailure, trouble-code-uds=Power_Path_084_Cable_Protection_Failure  # Event_Dtc_Map_Power_Path_084_Cable_Protection_Failure
  diagnostic event to operation cycle mapping EventOperCycleMapPowerPath084CableProtectionFailure: diagnostic-event=EventPowerPath084CableProtectionFailure, operation-cycle=DefaultOperationCycle  # Event_Oper_Cycle_Map_Power_Path_084_Cable_Protection_Failure
  diagnostic event to debounce algorithm mapping EventDebounceMapPowerPath084CableProtectionFailure: debounce-algorithm=time_based, diagnostic-event=EventPowerPath084CableProtectionFailure  # EventDebounceMap_Power_Path_084_Cable_Protection_Failure
package /ZeC/DTC/DTC/Power_Path_090_Cable_Protection_Failure
  diagnostic trouble code uds Power_Path_090_Cable_Protection_Failure: dtc-props=Dtc_Props_338aea73, uds-dtc-value=0x00585a
  diagnostic event EventPowerPath090CableProtectionFailure: aging-allowed=true, event-kind=SWC, prestorage-freeze-frame=false  # Event_Power_Path_090_Cable_Protection_Failure
  diagnostic event to trouble code uds mapping EventDtcMapPowerPath090CableProtectionFailure: diagnostic-event=EventPowerPath090CableProtectionFailure, trouble-code-uds=Power_Path_090_Cable_Protection_Failure  # Event_Dtc_Map_Power_Path_090_Cable_Protection_Failure
  diagnostic event to operation cycle mapping EventOperCycleMapPowerPath090CableProtectionFailure: diagnostic-event=EventPowerPath090CableProtectionFailure, operation-cycle=DefaultOperationCycle  # Event_Oper_Cycle_Map_Power_Path_090_Cable_Protection_Failure
  diagnostic event to debounce algorithm mapping EventDebounceMapPowerPath090CableProtectionFailure: debounce-algorithm=time_based, diagnostic-event=EventPowerPath090CableProtectionFailure  # EventDebounceMap_Power_Path_090_Cable_Protection_Failure
package /ZeC/DTC/DTC/Watchdog_defective
  diagnostic trouble code uds Watchdog_defective: dtc-props=Dtc_Props_c8ff1f07, uds-dtc-value=0x00101f
  diagnostic event EventWatchdogDefective: aging-allowed=true, event-kind=SWC, prestorage-freeze-frame=false  # Event_Watchdog_defective
  diagnostic event to trouble code uds mapping EventDtcMapWatchdogDefective: diagnostic-event=EventWatchdogDefective, trouble-code-uds=Watchdog_defective  # Event_Dtc_Map_Watchdog_defective
  diagnostic event to operation cycle mapping EventOperCycleMapWatchdogDefective: diagnostic-event=EventWatchdogDefective, operation-cycle=DefaultOperationCycle  # Event_Oper_Cycle_Map_Watchdog_defective
  diagnostic event to debounce algorithm mapping EventDebounceMapWatchdogDefective: debounce-algorithm=counter_based, diagnostic-event=EventWatchdogDefective  # EventDebounceMap_Watchdog_defective
package /ZeC/DTC/DTC/Power_Path_095_Cable_Protection_Failure
  diagnostic trouble code uds Power_Path_095_Cable_Protection_Failure: dtc-props=Dtc_Props_3ab4da94, uds-dtc-value=0x00585f
  diagnostic event EventPowerPath095CableProtectionFailure: aging-allowed=true, event-kind=SWC, prestorage-freeze-frame=false  # Event_Power_Path_095_Cable_Protection_Failure
  diagnostic event to trouble code uds mapping EventDtcMapPowerPath095CableProtectionFailure: diagnostic-event=EventPowerPath095CableProtectionFailure, trouble-code-uds=Power_Path_095_Cable_Protection_Failure  # Event_Dtc_Map_Power_Path_095_Cable_Protection_Failure
  diagnostic event to operation cycle mapping EventOperCycleMapPowerPath095CableProtectionFailure: diagnostic-event=EventPowerPath095CableProtectionFailure, operation-cycle=DefaultOperationCycle  # Event_Oper_Cycle_Map_Power_Path_095_Cable_Protection_Failure
  diagnostic event to debounce algorithm mapping EventDebounceMapPowerPath095CableProtectionFailure: debounce-algorithm=time_based, diagnostic-event=EventPowerPath095CableProtectionFailure  # EventDebounceMap_Power_Path_095_Cable_Protection_Failure
package /ZeC/DTC/DTC/ROM_defective
  diagnostic trouble code uds ROM_defective: dtc-props=Dtc_Props_c8ff1f07, uds-dtc-value=0x00101b
  diagnostic event EventROMDefective: aging-allowed=true, event-kind=SWC, prestorage-freeze-frame=false  # Event_ROM_defective
  diagnostic event to trouble code uds mapping EventDtcMapROMDefective: diagnostic-event=EventROMDefective, trouble-code-uds=ROM_defective  # Event_Dtc_Map_ROM_defective
  diagnostic event to operation cycle mapping EventOperCycleMapROMDefective: diagnostic-event=EventROMDefective, operation-cycle=DefaultOperationCycle  # Event_Oper_Cycle_Map_ROM_defective
  diagnostic event to debounce algorithm mapping EventDebounceMapROMDefective: debounce-algorithm=counter_based, diagnostic-event=EventROMDefective  # EventDebounceMap_ROM_defective
package /ZeC/DTC/DTC/Power_Path_092_Cable_Protection_Failure
  diagnostic trouble code uds Power_Path_092_Cable_Protection_Failure: dtc-props=Dtc_Props_bfb8fe07, uds-dtc-value=0x00585c
  diagnostic event EventPowerPath092CableProtectionFailure: aging-allowed=true, event-kind=SWC, prestorage-freeze-frame=false  # Event_Power_Path_092_Cable_Protection_Failure
  diagnostic event to trouble code uds mapping EventDtcMapPowerPath092CableProtectionFailure: diagnostic-event=EventPowerPath092CableProtectionFailure, trouble-code-uds=Power_Path_092_Cable_Protection_Failure  # Event_Dtc_Map_Power_Path_092_Cable_Protection_Failure
  diagnostic event to operation cycle mapping EventOperCycleMapPowerPath092CableProtectionFailure: diagnostic-event=EventPowerPath092CableProtectionFailure, operation-cycle=DefaultOperationCycle  # Event_Oper_Cycle_Map_Power_Path_092_Cable_Protection_Failure
  diagnostic event to debounce algorithm mapping EventDebounceMapPowerPath092CableProtectionFailure: debounce-algorithm=time_based, diagnostic-event=EventPowerPath092CableProtectionFailure  # EventDebounceMap_Power_Path_092_Cable_Protection_Failure
package /ZeC/DTC/DTC/Runtime_error
  diagnostic trouble code uds Runtime_error: dtc-props=Dtc_Props_c8ff1f07, uds-dtc-value=0x00101c
  diagnostic event EventRuntimeError: aging-allowed=true, event-kind=SWC, prestorage-freeze-frame=false  # Event_Runtime_error
  diagnostic event to trouble code uds mapping EventDtcMapRuntimeError: diagnostic-event=EventRuntimeError, trouble-code-uds=Runtime_error  # Event_Dtc_Map_Runtime_error
  diagnostic event to operation cycle mapping EventOperCycleMapRuntimeError: diagnostic-event=EventRuntimeError, operation-cycle=DefaultOperationCycle  # Event_Oper_Cycle_Map_Runtime_error
  diagnostic event to debounce algorithm mapping EventDebounceMapRuntimeError: debounce-algorithm=counter_based, diagnostic-event=EventRuntimeError  # EventDebounceMap_Runtime_error
package /ZeC/DTC/DTC/Power_Path_091_Cable_Protection_Failure
  diagnostic trouble code uds Power_Path_091_Cable_Protection_Failure: dtc-props=Dtc_Props_f9a1f43d, uds-dtc-value=0x00585b
  diagnostic event EventPowerPath091CableProtectionFailure: aging-allowed=true, event-kind=SWC, prestorage-freeze-frame=false  # Event_Power_Path_091_Cable_Protection_Failure
  diagnostic event to trouble code uds mapping EventDtcMapPowerPath091CableProtectionFailure: diagnostic-event=EventPowerPath091CableProtectionFailure, trouble-code-uds=Power_Path_091_Cable_Protection_Failure  # Event_Dtc_Map_Power_Path_091_Cable_Protection_Failure
  diagnostic event to operation cycle mapping EventOperCycleMapPowerPath091CableProtectionFailure: diagnostic-event=EventPowerPath091CableProtectionFailure, operation-cycle=DefaultOperationCycle  # Event_Oper_Cycle_Map_Power_Path_091_Cable_Protection_Failure
  diagnostic event to debounce algorithm mapping EventDebounceMapPowerPath091CableProtectionFailure: debounce-algorithm=time_based, diagnostic-event=EventPowerPath091CableProtectionFailure  # EventDebounceMap_Power_Path_091_Cable_Protection_Failure
package /ZeC/DTC/DTC/Unauthorized_Software_Calibration_Detected
  diagnostic trouble code uds Unauthorized_Software_Calibration_Detected: dtc-props=Dtc_Props_c8ff1f07, uds-dtc-value=0x00101d  # Unauthorized Software/Calibration Detected
  diagnostic event EventUnauthorizedSoftwareCalibrationDetected: aging-allowed=true, event-kind=SWC, prestorage-freeze-frame=false  # Event_Unauthorized Software/Calibration Detected
  diagnostic event to trouble code uds mapping EventDtcMapUnauthorizedSoftwareCalibrationDetected: diagnostic-event=EventUnauthorizedSoftwareCalibrationDetected, trouble-code-uds=Unauthorized_Software_Calibration_Detected  # Event_Dtc_Map_Unauthorized Software/Calibration Detected
  diagnostic event to operation cycle mapping EventOperCycleMapUnauthorizedSoftwareCalibrationDetected: diagnostic-event=EventUnauthorizedSoftwareCalibrationDetected, operation-cycle=DefaultOperationCycle  # Event_Oper_Cycle_Map_Unauthorized Software/Calibration Detected
  diagnostic event to debounce algorithm mapping EventDebounceMapUnauthorizedSoftwareCalibrationDetected: debounce-algorithm=counter_based, diagnostic-event=EventUnauthorizedSoftwareCalibrationDetected  # EventDebounceMap_Unauthorized Software/Calibration Detected
package /ZeC/DTC/DTC/Power_Path_094_Cable_Protection_Failure
  diagnostic trouble code uds Power_Path_094_Cable_Protection_Failure: dtc-props=Dtc_Props_f09fc4da, uds-dtc-value=0x00585e
  diagnostic event EventPowerPath094CableProtectionFailure: aging-allowed=true, event-kind=SWC, prestorage-freeze-frame=false  # Event_Power_Path_094_Cable_Protection_Failure
  diagnostic event to trouble code uds mapping EventDtcMapPowerPath094CableProtectionFailure: diagnostic-event=EventPowerPath094CableProtectionFailure, trouble-code-uds=Power_Path_094_Cable_Protection_Failure  # Event_Dtc_Map_Power_Path_094_Cable_Protection_Failure
  diagnostic event to operation cycle mapping EventOperCycleMapPowerPath094CableProtectionFailure: diagnostic-event=EventPowerPath094CableProtectionFailure, operation-cycle=DefaultOperationCycle  # Event_Oper_Cycle_Map_Power_Path_094_Cable_Protection_Failure
  diagnostic event to debounce algorithm mapping EventDebounceMapPowerPath094CableProtectionFailure: debounce-algorithm=time_based, diagnostic-event=EventPowerPath094CableProtectionFailure  # EventDebounceMap_Power_Path_094_Cable_Protection_Failure
package /ZeC/DTC/DTC/Voltage_regulator_defective
  diagnostic trouble code uds Voltage_regulator_defective: dtc-props=Dtc_Props_c8ff1f07, uds-dtc-value=0x00101e
  diagnostic event EventVoltageRegulatorDefective: aging-allowed=true, event-kind=SWC, prestorage-freeze-frame=false  # Event_Voltage_regulator_defective
  diagnostic event to trouble code uds mapping EventDtcMapVoltageRegulatorDefective: diagnostic-event=EventVoltageRegulatorDefective, trouble-code-uds=Voltage_regulator_defective  # Event_Dtc_Map_Voltage_regulator_defective
  diagnostic event to operation cycle mapping EventOperCycleMapVoltageRegulatorDefective: diagnostic-event=EventVoltageRegulatorDefective, operation-cycle=DefaultOperationCycle  # Event_Oper_Cycle_Map_Voltage_regulator_defective
  diagnostic event to debounce algorithm mapping EventDebounceMapVoltageRegulatorDefective: debounce-algorithm=counter_based, diagnostic-event=EventVoltageRegulatorDefective  # EventDebounceMap_Voltage_regulator_defective
package /ZeC/DTC/DTC/Power_Path_093_Cable_Protection_Failure
  diagnostic trouble code uds Power_Path_093_Cable_Protection_Failure: dtc-props=Dtc_Props_b686cee0, uds-dtc-value=0x00585d
  diagnostic event EventPowerPath093CableProtectionFailure: aging-allowed=true, event-kind=SWC, prestorage-freeze-frame=false  # Event_Power_Path_093_Cable_Protection_Failure
  diagnostic event to trouble code uds mapping EventDtcMapPowerPath093CableProtectionFailure: diagnostic-event=EventPowerPath093CableProtectionFailure, trouble-code-uds=Power_Path_093_Cable_Protection_Failure  # Event_Dtc_Map_Power_Path_093_Cable_Protection_Failure
  diagnostic event to operation cycle mapping EventOperCycleMapPowerPath093CableProtectionFailure: diagnostic-event=EventPowerPath093CableProtectionFailure, operation-cycle=DefaultOperationCycle  # Event_Oper_Cycle_Map_Power_Path_093_Cable_Protection_Failure
  diagnostic event to debounce algorithm mapping EventDebounceMapPowerPath093CableProtectionFailure: debounce-algorithm=time_based, diagnostic-event=EventPowerPath093CableProtectionFailure  # EventDebounceMap_Power_Path_093_Cable_Protection_Failure
package /ZeC/DTC/DTC/Power_Path_096_Cable_Protection_Failure
  diagnostic trouble code uds Power_Path_096_Cable_Protection_Failure: dtc-props=Dtc_Props_d9c2c3bd, uds-dtc-value=0x005860
  diagnostic event EventPowerPath096CableProtectionFailure: aging-allowed=true, event-kind=SWC, prestorage-freeze-frame=false  # Event_Power_Path_096_Cable_Protection_Failure
  diagnostic event to trouble code uds mapping EventDtcMapPowerPath096CableProtectionFailure: diagnostic-event=EventPowerPath096CableProtectionFailure, trouble-code-uds=Power_Path_096_Cable_Protection_Failure  # Event_Dtc_Map_Power_Path_096_Cable_Protection_Failure
  diagnostic event to operation cycle mapping EventOperCycleMapPowerPath096CableProtectionFailure: diagnostic-event=EventPowerPath096CableProtectionFailure, operation-cycle=DefaultOperationCycle  # Event_Oper_Cycle_Map_Power_Path_096_Cable_Protection_Failure
  diagnostic event to debounce algorithm mapping EventDebounceMapPowerPath096CableProtectionFailure: debounce-algorithm=time_based, diagnostic-event=EventPowerPath096CableProtectionFailure  # EventDebounceMap_Power_Path_096_Cable_Protection_Failure
package /ZeC/DTC/DTC/Power_Path_098_Cable_Protection_Failure
  diagnostic trouble code uds Power_Path_098_Cable_Protection_Failure: dtc-props=Dtc_Props_55f0d7c9, uds-dtc-value=0x005862
  diagnostic event EventPowerPath098CableProtectionFailure: aging-allowed=true, event-kind=SWC, prestorage-freeze-frame=false  # Event_Power_Path_098_Cable_Protection_Failure
  diagnostic event to trouble code uds mapping EventDtcMapPowerPath098CableProtectionFailure: diagnostic-event=EventPowerPath098CableProtectionFailure, trouble-code-uds=Power_Path_098_Cable_Protection_Failure  # Event_Dtc_Map_Power_Path_098_Cable_Protection_Failure
  diagnostic event to operation cycle mapping EventOperCycleMapPowerPath098CableProtectionFailure: diagnostic-event=EventPowerPath098CableProtectionFailure, operation-cycle=DefaultOperationCycle  # Event_Oper_Cycle_Map_Power_Path_098_Cable_Protection_Failure
  diagnostic event to debounce algorithm mapping EventDebounceMapPowerPath098CableProtectionFailure: debounce-algorithm=time_based, diagnostic-event=EventPowerPath098CableProtectionFailure  # EventDebounceMap_Power_Path_098_Cable_Protection_Failure
package /ZeC/DTC/DTC/Power_Path_097_Cable_Protection_Failure
  diagnostic trouble code uds Power_Path_097_Cable_Protection_Failure: dtc-props=Dtc_Props_9fdbc987, uds-dtc-value=0x005861
  diagnostic event EventPowerPath097CableProtectionFailure: aging-allowed=true, event-kind=SWC, prestorage-freeze-frame=false  # Event_Power_Path_097_Cable_Protection_Failure
  diagnostic event to trouble code uds mapping EventDtcMapPowerPath097CableProtectionFailure: diagnostic-event=EventPowerPath097CableProtectionFailure, trouble-code-uds=Power_Path_097_Cable_Protection_Failure  # Event_Dtc_Map_Power_Path_097_Cable_Protection_Failure
  diagnostic event to operation cycle mapping EventOperCycleMapPowerPath097CableProtectionFailure: diagnostic-event=EventPowerPath097CableProtectionFailure, operation-cycle=DefaultOperationCycle  # Event_Oper_Cycle_Map_Power_Path_097_Cable_Protection_Failure
  diagnostic event to debounce algorithm mapping EventDebounceMapPowerPath097CableProtectionFailure: debounce-algorithm=time_based, diagnostic-event=EventPowerPath097CableProtectionFailure  # EventDebounceMap_Power_Path_097_Cable_Protection_Failure
package /ZeC/DTC/DTC/LIN_8_Slave_3_Defect
  diagnostic trouble code uds LIN_8_Slave_3_Defect: dtc-props=Dtc_Props_358996c7, uds-dtc-value=0x030802  # LIN 8 Slave 3_Defect
  diagnostic event EventLIN8Slave3Defect: aging-allowed=true, event-kind=SWC, prestorage-freeze-frame=false  # Event_LIN 8 Slave 3_Defect
  diagnostic event to trouble code uds mapping EventDtcMapLIN8Slave3Defect: diagnostic-event=EventLIN8Slave3Defect, trouble-code-uds=LIN_8_Slave_3_Defect  # Event_Dtc_Map_LIN 8 Slave 3_Defect
  diagnostic event to operation cycle mapping EventOperCycleMapLIN8Slave3Defect: diagnostic-event=EventLIN8Slave3Defect, operation-cycle=DefaultOperationCycle  # Event_Oper_Cycle_Map_LIN 8 Slave 3_Defect
  diagnostic event to debounce algorithm mapping EventDebounceMapLIN8Slave3Defect: debounce-algorithm=counter_based, diagnostic-event=EventLIN8Slave3Defect  # EventDebounceMap_LIN 8 Slave 3_Defect
package /ZeC/DTC/DTC/Power_Path_006_Load_Failure
  diagnostic trouble code uds Power_Path_006_Load_Failure: dtc-props=Dtc_Props_6ec87033, uds-dtc-value=0x005406
  diagnostic event EventPowerPath006LoadFailure: aging-allowed=true, event-kind=SWC, prestorage-freeze-frame=false  # Event_Power_Path_006_Load_Failure
  diagnostic event to trouble code uds mapping EventDtcMapPowerPath006LoadFailure: diagnostic-event=EventPowerPath006LoadFailure, trouble-code-uds=Power_Path_006_Load_Failure  # Event_Dtc_Map_Power_Path_006_Load_Failure
  diagnostic event to operation cycle mapping EventOperCycleMapPowerPath006LoadFailure: diagnostic-event=EventPowerPath006LoadFailure, operation-cycle=DefaultOperationCycle  # Event_Oper_Cycle_Map_Power_Path_006_Load_Failure
  diagnostic event to debounce algorithm mapping EventDebounceMapPowerPath006LoadFailure: debounce-algorithm=time_based, diagnostic-event=EventPowerPath006LoadFailure  # EventDebounceMap_Power_Path_006_Load_Failure
package /ZeC/DTC/DTC/LIN_8_Slave_2_NoCommunication
  diagnostic trouble code uds LIN_8_Slave_2_NoCommunication: dtc-props=Dtc_Props_358996c7, uds-dtc-value=0x030801  # LIN 8 Slave 2_NoCommunication
  diagnostic event EventLIN8Slave2NoCommunication: aging-allowed=true, event-kind=SWC, prestorage-freeze-frame=false  # Event_LIN 8 Slave 2_NoCommunication
  diagnostic event to trouble code uds mapping EventDtcMapLIN8Slave2NoCommunication: diagnostic-event=EventLIN8Slave2NoCommunication, trouble-code-uds=LIN_8_Slave_2_NoCommunication  # Event_Dtc_Map_LIN 8 Slave 2_NoCommunication
  diagnostic event to operation cycle mapping EventOperCycleMapLIN8Slave2NoCommunication: diagnostic-event=EventLIN8Slave2NoCommunication, operation-cycle=DefaultOperationCycle  # Event_Oper_Cycle_Map_LIN 8 Slave 2_NoCommunication
  diagnostic event to debounce algorithm mapping EventDebounceMapLIN8Slave2NoCommunication: debounce-algorithm=counter_based, diagnostic-event=EventLIN8Slave2NoCommunication  # EventDebounceMap_LIN 8 Slave 2_NoCommunication
package /ZeC/DTC/DTC/Power_Path_005_Load_Failure
  diagnostic trouble code uds Power_Path_005_Load_Failure: dtc-props=Dtc_Props_a4e36e7d, uds-dtc-value=0x005405
  diagnostic event EventPowerPath005LoadFailure: aging-allowed=true, event-kind=SWC, prestorage-freeze-frame=false  # Event_Power_Path_005_Load_Failure
  diagnostic event to trouble code uds mapping EventDtcMapPowerPath005LoadFailure: diagnostic-event=EventPowerPath005LoadFailure, trouble-code-uds=Power_Path_005_Load_Failure  # Event_Dtc_Map_Power_Path_005_Load_Failure
  diagnostic event to operation cycle mapping EventOperCycleMapPowerPath005LoadFailure: diagnostic-event=EventPowerPath005LoadFailure, operation-cycle=DefaultOperationCycle  # Event_Oper_Cycle_Map_Power_Path_005_Load_Failure
  diagnostic event to debounce algorithm mapping EventDebounceMapPowerPath005LoadFailure: debounce-algorithm=time_based, diagnostic-event=EventPowerPath005LoadFailure  # EventDebounceMap_Power_Path_005_Load_Failure
package /ZeC/DTC/DTC/Power_Path_137_Cable_Protection_Failure
  diagnostic trouble code uds Power_Path_137_Cable_Protection_Failure: dtc-props=Dtc_Props_be4e0142, uds-dtc-value=0x005889
  diagnostic event EventPowerPath137CableProtectionFailure: aging-allowed=true, event-kind=SWC, prestorage-freeze-frame=false  # Event_Power_Path_137_Cable_Protection_Failure
  diagnostic event to trouble code uds mapping EventDtcMapPowerPath137CableProtectionFailure: diagnostic-event=EventPowerPath137CableProtectionFailure, trouble-code-uds=Power_Path_137_Cable_Protection_Failure  # Event_Dtc_Map_Power_Path_137_Cable_Protection_Failure
  diagnostic event to operation cycle mapping EventOperCycleMapPowerPath137CableProtectionFailure: diagnostic-event=EventPowerPath137CableProtectionFailure, operation-cycle=DefaultOperationCycle  # Event_Oper_Cycle_Map_Power_Path_137_Cable_Protection_Failure
  diagnostic event to debounce algorithm mapping EventDebounceMapPowerPath137CableProtectionFailure: debounce-algorithm=time_based, diagnostic-event=EventPowerPath137CableProtectionFailure  # EventDebounceMap_Power_Path_137_Cable_Protection_Failure
package /ZeC/DTC/DTC/LIN_8_Slave_4_Defect
  diagnostic trouble code uds LIN_8_Slave_4_Defect: dtc-props=Dtc_Props_358996c7, uds-dtc-value=0x030804  # LIN 8 Slave 4_Defect
  diagnostic event EventLIN8Slave4Defect: aging-allowed=true, event-kind=SWC, prestorage-freeze-frame=false  # Event_LIN 8 Slave 4_Defect
  diagnostic event to trouble code uds mapping EventDtcMapLIN8Slave4Defect: diagnostic-event=EventLIN8Slave4Defect, trouble-code-uds=LIN_8_Slave_4_Defect  # Event_Dtc_Map_LIN 8 Slave 4_Defect
  diagnostic event to operation cycle mapping EventOperCycleMapLIN8Slave4Defect: diagnostic-event=EventLIN8Slave4Defect, operation-cycle=DefaultOperationCycle  # Event_Oper_Cycle_Map_LIN 8 Slave 4_Defect
  diagnostic event to debounce algorithm mapping EventDebounceMapLIN8Slave4Defect: debounce-algorithm=counter_based, diagnostic-event=EventLIN8Slave4Defect  # EventDebounceMap_LIN 8 Slave 4_Defect
package /ZeC/DTC/DTC/Power_Path_008_Load_Failure
  diagnostic trouble code uds Power_Path_008_Load_Failure: dtc-props=Dtc_Props_7cb411fd, uds-dtc-value=0x005408
  diagnostic event EventPowerPath008LoadFailure: aging-allowed=true, event-kind=SWC, prestorage-freeze-frame=false  # Event_Power_Path_008_Load_Failure
  diagnostic event to trouble code uds mapping EventDtcMapPowerPath008LoadFailure: diagnostic-event=EventPowerPath008LoadFailure, trouble-code-uds=Power_Path_008_Load_Failure  # Event_Dtc_Map_Power_Path_008_Load_Failure
  diagnostic event to operation cycle mapping EventOperCycleMapPowerPath008LoadFailure: diagnostic-event=EventPowerPath008LoadFailure, operation-cycle=DefaultOperationCycle  # Event_Oper_Cycle_Map_Power_Path_008_Load_Failure
  diagnostic event to debounce algorithm mapping EventDebounceMapPowerPath008LoadFailure: debounce-algorithm=time_based, diagnostic-event=EventPowerPath008LoadFailure  # EventDebounceMap_Power_Path_008_Load_Failure
