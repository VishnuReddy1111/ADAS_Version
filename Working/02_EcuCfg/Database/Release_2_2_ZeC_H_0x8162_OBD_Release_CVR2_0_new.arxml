[part 19 of 19: packages /ZeC/Routine/Prepare_upload_data to /ZeC/services]
AUTOSAR XML (schema 00047)
package /ZeC/Routine/Prepare_upload_data
  diagnostic routine PrepareUploadData: id=0xc006  # Prepare_upload_data
    request result Result_Subfunction  # Result Subfunction
    start Start_Subfunction  # Start Subfunction
      diagnostic-parameter bit-offset=0:
        diagnostic data element Routine_Start_Routine_Request_Prepare_upload_data_Data_Block_ID: base-type=uint16, compu {30208=Data Block ID: Data_block_1 (TTR446812)}  # Parameters: Data Block ID
      diagnostic-parameter bit-offset=16:
        diagnostic data element Routine_Start_Routine_Request_Prepare_upload_data_Encryption_Method_Compression_Method: base-type=uint8, compu {0=Encryption Method: Unencrypted; Compression Method: Uncompressed (TTR234712TTR236312)}  # Parameters: Encryption Method / Compression Method
      diagnostic-parameter bit-offset=0:
        diagnostic data element Routine_Start_Routine_Response_Prepare_upload_data_Routine_Status_Routine_Result: base-type=uint8, compu-method=Prepare_upload_data/TEXTTABLE_RoutineStatusRoutineResult  # Parameters: Routine Status / Routine Result
    stop Stop_Subfunction  # Stop Subfunction
      diagnostic-parameter bit-offset=0:
        diagnostic data element Routine_Stop_Routine_Response_Prepare_upload_data_Routine_Status_Routine_Result: base-type=uint8, compu-method=Prepare_upload_data/TEXTTABLE_RoutineStatusRoutineResult  # Parameters: Routine Status / Routine Result
  compu method TEXTTABLE_RoutineStatusRoutineResult: 2=Routine Status: Routine Aborted (TTR615), 4=Routine Status: Routine Finished Correctly (TTR815), 3=Routine Status: Routine Execution Stuck (TTR715), 1=Routine Status: Routine Active (TTR515), 0=Routine Status: Routine Inactive; Routine Result: No Results Available (TTR415TTR117), 16=Routine Result: Incorrect Results (TTR216), 32=Routine Result: Correct Results (TTR316)
  diagnostic routine control RoutineControlPrepareUploadData: access-permission=READWRITE0x03ExtendedSession, routine-control-class=Diagnostic_Routine_Control_Class, routine=PrepareUploadData  # RoutineControl_Prepare_upload_data
package /ZeC/Routine/Reset_someip_service_identification
  diagnostic routine ResetSomeipServiceIdentification: id=0x0f05  # Reset_someip_service_identification
    request result Result_Subfunction  # Result Subfunction
      diagnostic-parameter bit-offset=0:
        diagnostic data element Routine_Request_Routine_Results_Response_Reset_someip_service_identification_Routine_Status_Routine_Result: base-type=uint8, compu-method=Reset_someip_service_identification/TEXTTABLE_RoutineStatusRoutineResult  # Parameters: Routine Status / Routine Result
    start Start_Subfunction  # Start Subfunction
      diagnostic-parameter bit-offset=0:
        diagnostic data element Routine_Start_Routine_Response_Reset_someip_service_identification_Routine_Status_Routine_Result: base-type=uint8, compu-method=Reset_someip_service_identification/TEXTTABLE_RoutineStatusRoutineResult  # Parameters: Routine Status / Routine Result
    stop Stop_Subfunction  # Stop Subfunction
      diagnostic-parameter bit-offset=0:
        diagnostic data element Routine_Stop_Routine_Response_Reset_someip_service_identification_Routine_Status_Routine_Result: base-type=uint8, compu-method=Reset_someip_service_identification/TEXTTABLE_RoutineStatusRoutineResult  # Parameters: Routine Status / Routine Result
  compu method TEXTTABLE_RoutineStatusRoutineResult: 2=Routine Status: Routine Aborted (TTR615), 4=Routine Status: Routine Finished Correctly (TTR815), 3=Routine Status: Routine Execution Stuck (TTR715), 1=Routine Status: Routine Active (TTR515), 0=Routine Status: Routine Inactive; Routine Result: No Results Available (TTR415TTR117), 16=Routine Result: Incorrect Results (TTR216), 32=Routine Result: Correct Results (TTR316)
  diagnostic routine control RoutineControlResetSomeipServiceIdentification: access-permission=READWRITEBasicSFDRole0x01DefaultSession0x03ExtendedSession, routine-control-class=Diagnostic_Routine_Control_Class, routine=ResetSomeipServiceIdentification  # RoutineControl_Reset_someip_service_identification
package /ZeC/Routine/Lock_protection_of_vehicle_diagnosis
  diagnostic routine LockProtectionOfVehicleDiagnosis: id=0xc005  # Lock_protection_of_vehicle_diagnosis
    start Start_Subfunction  # Start Subfunction
      diagnostic-parameter bit-offset=0:
        diagnostic data element Routine_Start_Routine_Response_Lock_protection_of_vehicle_diagnosis_Routine_Status_Routine_Result: base-type=uint8, compu {2=Routine Status: Routine Aborted (TTR615), 4=Routine Status: Routine Finished Correctly (TTR815), 3=Routine Status: Routine Execution Stuck (TTR715), 1=Routine Status: Routine Active (TTR515), 0=Routine Status: Routine Inactive; Routine Result: No Results Available (TTR415TTR117), 16=Routine Result: Incorrect Results (TTR216), 32=Routine Result: Correct Results (TTR316)}  # Parameters: Routine Status / Routine Result
      diagnostic-parameter bit-offset=8:
        diagnostic data element Routine_Start_Routine_Response_Lock_protection_of_vehicle_diagnosis_RoutineStatusRecord: base-type=uint8, compu {0=RoutineStatusRecord: Lock_successful (TTR223412), 1=RoutineStatusRecord: Lock_not_successful (TTR223512)}  # Parameters: RoutineStatusRecord
  diagnostic routine control RoutineControlLockProtectionOfVehicleDiagnosis: access-permission=READWRITE0x03ExtendedSession, routine-control-class=Diagnostic_Routine_Control_Class, routine=LockProtectionOfVehicleDiagnosis  # RoutineControl_Lock_protection_of_vehicle_diagnosis
package /ZeC/Routine/Unlock_protection_of_vehicle_diagnosis
  diagnostic routine UnlockProtectionOfVehicleDiagnosis: id=0xc004  # Unlock_protection_of_vehicle_diagnosis
    start Start_Subfunction  # Start Subfunction
      diagnostic-parameter bit-offset=0:
        diagnostic data element Routine_Start_Routine_Request_Unlock_protection_of_vehicle_diagnosis_Unlock_Token: base-type=uint8  # Parameters: Unlock Token
      diagnostic-parameter bit-offset=0:
        diagnostic data element Routine_Start_Routine_Response_Unlock_protection_of_vehicle_diagnosis_Routine_Status_Routine_Result: base-type=uint8, compu {2=Routine Status: Routine Aborted (TTR615), 4=Routine Status: Routine Finished Correctly (TTR815), 3=Routine Status: Routine Execution Stuck (TTR715), 1=Routine Status: Routine Active (TTR515), 0=Routine Status: Routine Inactive; Routine Result: No Results Available (TTR415TTR117), 16=Routine Result: Incorrect Results (TTR216), 32=Routine Result: Correct Results (TTR316)}  # Parameters: Routine Status / Routine Result
      diagnostic-parameter bit-offset=8:
        diagnostic data element Routine_Start_Routine_Response_Unlock_protection_of_vehicle_diagnosis_RoutineStatusRecord: base-type=uint8, compu {6=RoutineStatusRecord: Token_Type_not_supported (TTR222213), 10=RoutineStatusRecord: Duration_not_setable (TTR222612), 9=RoutineStatusRecord: Role_not_supported (TTR222512), 7=RoutineStatusRecord: Replay_protection_invalid (TTR222313), 8=RoutineStatusRecord: Token_is_corrupt (TTR222413), 3=RoutineStatusRecord: Projekt_ID_is_wrong (TTR221913), 1=RoutineStatusRecord: Signature_validation_error (TTR221713), 0=RoutineStatusRecord: Unlock_successful (TTR221612), 12=RoutineStatusRecord: ECU_not_individualized (TTR222812), 5=RoutineStatusRecord: Token_Version_not_supported (TTR222113), 2=RoutineStatusRecord: Token_is_not_for_this_ecu (TTR221813), 4=RoutineStatusRecord: SFD_OID_not_supported (TTR222013), 11=RoutineStatusRecord: ECU_already_individualized (TTR222712)}  # Parameters: RoutineStatusRecord
  diagnostic routine control RoutineControlUnlockProtectionOfVehicleDiagnosis: access-permission=READWRITE0x03ExtendedSession, routine-control-class=Diagnostic_Routine_Control_Class, routine=UnlockProtectionOfVehicleDiagnosis  # RoutineControl_Unlock_protection_of_vehicle_diagnosis
package /ZeC/Routine/Calculate_configuration_state_fingerprint_of_protection_of_vehicle_diagnosis
  diagnostic routine CalculateConfigurationStateFingerprintOfProtectionOfVehicleDiagnosis: id=0x0f02  # Calculate_configuration_state_fingerprint_of_protection_of_vehicle_diagnosis
    start Start_Subfunction  # Start Subfunction
      diagnostic-parameter bit-offset=0:
        diagnostic data element Routine_Start_Routine_Request_Calculate_configuration_state_fingerprint_of_protection_of_vehicle_diagnosis_Type_9C7748E: base-type=uint8  # Parameters: Type_of_calculation
      diagnostic-parameter bit-offset=8:
        diagnostic data element Routine_Start_Routine_Request_Calculate_configuration_state_fingerprint_of_protection_of_vehicle_diagnosis_Numbe91CAC15: base-type=uint16  # Parameters: Number_of_dataidentifier
      diagnostic-parameter bit-offset=24:
        diagnostic data element Routine_Start_Routine_Request_Calculate_configuration_state_fingerprint_of_protection_of_vehicle_diagnosis_DataIC8A6FAC: base-type=uint16  # Parameters: DataIdentifier
      diagnostic-parameter bit-offset=0:
        diagnostic data element Routine_Start_Routine_Response_Calculate_configuration_state_fingerprint_of_protection_of_vehicle_diagnosis_Rout2F6EBE7: base-type=uint8, compu {2=Routine Status: Routine Aborted (TTR615), 4=Routine Status: Routine Finished Correctly (TTR815), 3=Routine Status: Routine Execution Stuck (TTR715), 1=Routine Status: Routine Active (TTR515), 0=Routine Status: Routine Inactive; Routine Result: No Results Available (TTR415TTR117), 16=Routine Result: Incorrect Results (TTR216), 32=Routine Result: Correct Results (TTR316)}  # Parameters: Routine Status / Routine Result
      diagnostic-parameter bit-offset=8:
        diagnostic data element Routine_Start_Routine_Response_Calculate_configuration_state_fingerprint_of_protection_of_vehicle_diagnosis_Resu72B49FB: base-type=uint8, compu {2=Result_of_calculation: Calculation_invalid_list_of_dataidentifier (TTR221312), 0=Result_of_calculation: Calculation_successful (TTR221112), 3=Result_of_calculation: Calculation_dataidentifier_not_found (TTR221412), 4=Result_of_calculation: Calculation_dataidentifier_not_end_to_end_secured (TTR221512), 1=Result_of_calculation: Calculation_failed (TTR221213)}  # Parameters: Result_of_calculation
      diagnostic-parameter bit-offset=24:
        diagnostic data element Routine_Start_Routine_Response_Calculate_configuration_state_fingerprint_of_protection_of_vehicle_diagnosis_BasiF57B2A0: array-size-semantics=VARIABLE-SIZE, max-number-of-elements=32, base-type=uint8  # Parameters: Basic_Hashvalue
  diagnostic routine control RoutineControlCalculateConfigurationStateFingerprintOfProtectionOfVehicleDiagnosis: access-permission=READWRITE0x01DefaultSession0x03ExtendedSession, routine-control-class=Diagnostic_Routine_Control_Class, routine=CalculateConfigurationStateFingerprintOfProtectionOfVehicleDiagnosis  # RoutineControl_Calculate_configuration_state_fingerprint_of_protection_of_vehicle_diagnosis
package /ZeC/Routine/Sec_reset_counter_firewall_and_ethernet_port_statistics
  diagnostic routine SecResetCounterFirewallAndEthernetPortStatistics: id=0x0f03  # Sec_reset_counter_firewall_and_ethernet-port_statistics
    request result Result_Subfunction  # Result Subfunction
      diagnostic-parameter bit-offset=0:
        diagnostic data element Routine_Request_Routine_Results_Response_Sec_reset_counter_firewall_and_ethernet_port_statistics_Routine_Status_8217FE6: base-type=uint8, compu-method=Sec_reset_counter_firewall_and_ethernet_port_statistics/TEXTTABLE_RoutineStatusRoutineResult  # Parameters: Routine Status / Routine Result
    start Start_Subfunction  # Start Subfunction
      diagnostic-parameter bit-offset=0:
        diagnostic data element Routine_Start_Routine_Response_Sec_reset_counter_firewall_and_ethernet_port_statistics_Routine_Status_Routine_Result: base-type=uint8, compu-method=Sec_reset_counter_firewall_and_ethernet_port_statistics/TEXTTABLE_RoutineStatusRoutineResult  # Parameters: Routine Status / Routine Result
    stop Stop_Subfunction  # Stop Subfunction
      diagnostic-parameter bit-offset=0:
        diagnostic data element Routine_Stop_Routine_Response_Sec_reset_counter_firewall_and_ethernet_port_statistics_Routine_Status_Routine_Result: base-type=uint8, compu-method=Sec_reset_counter_firewall_and_ethernet_port_statistics/TEXTTABLE_RoutineStatusRoutineResult  # Parameters: Routine Status / Routine Result
  compu method TEXTTABLE_RoutineStatusRoutineResult: 2=Routine Status: Routine Aborted (TTR615), 4=Routine Status: Routine Finished Correctly (TTR815), 3=Routine Status: Routine Execution Stuck (TTR715), 1=Routine Status: Routine Active (TTR515), 0=Routine Status: Routine Inactive; Routine Result: No Results Available (TTR415TTR117), 16=Routine Result: Incorrect Results (TTR216), 32=Routine Result: Correct Results (TTR316)
  diagnostic routine control RoutineControlSecResetCounterFirewallAndEthernetPortStatistics: access-permission=READWRITEBasicSFDRole0x03ExtendedSession, routine-control-class=Diagnostic_Routine_Control_Class, routine=SecResetCounterFirewallAndEthernetPortStatistics  # RoutineControl_Sec_reset_counter_firewall_and_ethernet-port_statistics
package /ZeC/Routine/Check_Memory
  diagnostic routine CheckMemory: id=0x0202  # Check Memory
    start Start_Subfunction  # Start Subfunction
      diagnostic-parameter bit-offset=0:
        diagnostic data element Routine_Start_Routine_Request_Check_Memory_Value: array-size-semantics=VARIABLE-SIZE, max-number-of-elements=1, base-type=uint8  # Parameters: Value
      diagnostic-parameter bit-offset=0:
        diagnostic data element Routine_Start_Routine_Response_Check_Memory_Routine_status: base-type=uint8, compu {0=Routine status: Correct Result (TTR207613), 1=Routine status: Incorrect Result (TTR207713), 128=Routine status: Downgrade Protection: Missing Or Invalid Driver (TTR286912), 129=Routine status: Downgrade Protection: Invalid Block-ID Or Invalid Version Number (TTR287012)}  # Parameters: Routine status
  diagnostic routine control RoutineControlCheckMemory: access-permission=READWRITESA11120x02ProgrammingSession, routine-control-class=Diagnostic_Routine_Control_Class, routine=CheckMemory  # RoutineControl_Check Memory
package /ZeC/Routine/Check_Programming_Preconditions
  diagnostic routine CheckProgrammingPreconditions: id=0x0203  # Check Programming Preconditions
    start Start_Subfunction  # Start Subfunction
      diagnostic-parameter bit-offset=0:
        diagnostic data element Routine_Start_Routine_Response_Check_Programming_Preconditions_Programming_Precondition: array-size-semantics=VARIABLE-SIZE, max-number-of-elements=8, base-type=uint8  # Parameters: Programming Precondition
  diagnostic routine control RoutineControlCheckProgrammingPreconditions: access-permission=READWRITE0x01DefaultSession0x03ExtendedSession, routine-control-class=Diagnostic_Routine_Control_Class, routine=CheckProgrammingPreconditions  # RoutineControl_Check Programming Preconditions
package /ZeC/Routine/Reset_of_all_adaptions
  diagnostic routine ResetOfAllAdaptions: id=0x0366  # Reset of all adaptions
    request result Result_Subfunction  # Result Subfunction
      diagnostic-parameter bit-offset=0:
        diagnostic data element Routine_Request_Routine_Results_Response_Reset_of_all_adaptions_Routine_Status_Routine_Result: base-type=uint8, compu-method=Reset_of_all_adaptions/TEXTTABLE_RoutineStatusRoutineResult  # Parameters: Routine Status / Routine Result
    start Start_Subfunction  # Start Subfunction
      diagnostic-parameter bit-offset=0:
        diagnostic data element Routine_Start_Routine_Request_Reset_of_all_adaptions_Adaption_indication: array-size-semantics=FIXED-SIZE, max-number-of-elements=3, base-type=uint8, compu {0=Adaption_indication: All_adaptions (TTR219213), 1=Adaption_indication: Unknown (TTR219315)}  # Parameters: Adaption_indication
      diagnostic-parameter bit-offset=0:
        diagnostic data element Routine_Start_Routine_Response_Reset_of_all_adaptions_Routine_Status_Routine_Result: base-type=uint8, compu-method=Reset_of_all_adaptions/TEXTTABLE_RoutineStatusRoutineResult  # Parameters: Routine Status / Routine Result
    stop Stop_Subfunction  # Stop Subfunction
      diagnostic-parameter bit-offset=0:
        diagnostic data element Routine_Stop_Routine_Response_Reset_of_all_adaptions_Routine_Status_Routine_Result: base-type=uint8, compu-method=Reset_of_all_adaptions/TEXTTABLE_RoutineStatusRoutineResult  # Parameters: Routine Status / Routine Result
  compu method TEXTTABLE_RoutineStatusRoutineResult: 2=Routine Status: Routine Aborted (TTR615), 4=Routine Status: Routine Finished Correctly (TTR815), 3=Routine Status: Routine Execution Stuck (TTR715), 1=Routine Status: Routine Active (TTR515), 0=Routine Status: Routine Inactive; Routine Result: No Results Available (TTR415TTR117), 16=Routine Result: Incorrect Results (TTR216), 32=Routine Result: Correct Results (TTR316)
  diagnostic routine control RoutineControlResetOfAllAdaptions: access-permission=READWRITEBasicSFDRole0x03ExtendedSession, routine-control-class=Diagnostic_Routine_Control_Class, routine=ResetOfAllAdaptions  # RoutineControl_Reset of all adaptions
package /ZeC/Routine/Vkms_debug
  diagnostic routine VkmsDebug: id=0x0648  # Vkms_debug
    request result Result_Subfunction  # Result Subfunction
      diagnostic-parameter bit-offset=0:
        diagnostic data element Routine_Request_Routine_Results_Response_Vkms_debug_Routine_Status_Routine_Result: base-type=uint8, compu {0=Routine Status: Routine Inactive; Routine Result: No Results available (TTR414TTR114), 3=Routine Status: Routine Execution Stuck (TTR714), 1=Routine Status: Routine Active (TTR514), 2=Routine Status: Routine Aborted (TTR614), 4=Routine Status: Routine Finished Correctly (TTR814), 32=Routine Result: Correct Results (TTR314), 16=Routine Result: Incorrect Results (TTR214)}  # Parameters: Routine Status / Routine Result
      diagnostic-parameter bit-offset=8:
        diagnostic data element Routine_Request_Routine_Results_Response_Vkms_debug_ErrorCode: base-type=uint8  # Parameters: ErrorCode
      diagnostic-parameter bit-offset=16:
        diagnostic data element Routine_Request_Routine_Results_Response_Vkms_debug_Debug_data_out: array-size-semantics=VARIABLE-SIZE, max-number-of-elements=1, base-type=uint8  # Parameters: Debug_data_out
    start Start_Subfunction  # Start Subfunction
      diagnostic-parameter bit-offset=0:
        diagnostic data element Routine_Start_Routine_Request_Vkms_debug_Reserved: base-type=uint8  # Parameters: Reserved
      diagnostic-parameter bit-offset=8:
        diagnostic data element Routine_Start_Routine_Request_Vkms_debug_Debug_data_in: base-type=uint8  # Parameters: Debug_data_in
  diagnostic routine control RoutineControlVkmsDebug: access-permission=READWRITE0x03ExtendedSession, routine-control-class=Diagnostic_Routine_Control_Class, routine=VkmsDebug  # RoutineControl_Vkms_debug
package /ZeC/Routine/Clear_downgrade_protection_data
  diagnostic routine ClearDowngradeProtectionData: id=0x065e  # Clear_downgrade_protection_data
    request result Result_Subfunction  # Result Subfunction
      diagnostic-parameter bit-offset=0:
        diagnostic data element Routine_Request_Routine_Results_Response_Clear_downgrade_protection_data_Routine_Status_Routine_Result: base-type=uint8, compu-method=Clear_downgrade_protection_data/TEXTTABLE_RoutineStatusRoutineResult  # Parameters: Routine Status / Routine Result
    start Start_Subfunction  # Start Subfunction
      diagnostic-parameter bit-offset=0:
        diagnostic data element Routine_Start_Routine_Response_Clear_downgrade_protection_data_Routine_Status_Routine_Result: base-type=uint8, compu-method=Clear_downgrade_protection_data/TEXTTABLE_RoutineStatusRoutineResult  # Parameters: Routine Status / Routine Result
    stop Stop_Subfunction  # Stop Subfunction
      diagnostic-parameter bit-offset=0:
        diagnostic data element Routine_Stop_Routine_Response_Clear_downgrade_protection_data_Routine_Status_Routine_Result: base-type=uint8, compu-method=Clear_downgrade_protection_data/TEXTTABLE_RoutineStatusRoutineResult  # Parameters: Routine Status / Routine Result
  compu method TEXTTABLE_RoutineStatusRoutineResult: 2=Routine Status: Routine Aborted (TTR615), 4=Routine Status: Routine Finished Correctly (TTR815), 3=Routine Status: Routine Execution Stuck (TTR715), 1=Routine Status: Routine Active (TTR515), 0=Routine Status: Routine Inactive; Routine Result: No Results Available (TTR415TTR117), 16=Routine Result: Incorrect Results (TTR216), 32=Routine Result: Correct Results (TTR316)
  diagnostic routine control RoutineControlClearDowngradeProtectionData: access-permission=READWRITEExtendedSFDRole0x01DefaultSession0x03ExtendedSession, routine-control-class=Diagnostic_Routine_Control_Class, routine=ClearDowngradeProtectionData  # RoutineControl_Clear_downgrade_protection_data
package /ZeC/Routine/Ethernet_testability_deactivate
  diagnostic routine EthernetTestabilityDeactivate: id=0x057f  # Ethernet_testability_deactivate
    request result Result_Subfunction  # Result Subfunction
      diagnostic-parameter bit-offset=0:
        diagnostic data element Routine_Request_Routine_Results_Response_Ethernet_testability_deactivate_Routine_Status: base-type=uint8, compu {1=Routine Status: Routine Active (TTR298712), 3=Routine Status: Routine Aborted (TTR298912), 2=Routine Status: Routine not active or finished correctly (TTR298812)}  # Parameters: Routine Status
      diagnostic-parameter bit-offset=8:
        diagnostic data element Routine_Request_Routine_Results_Response_Ethernet_testability_deactivate_Routine_Results: base-type=uint16, compu {65535=Routine Results: Correct Results (TTR342912), 1=Routine Results: No Results Available (TTR299112), 0=Routine Results: Incorrect Results (TTR343012)}  # Parameters: Routine Results
    start Start_Subfunction  # Start Subfunction
      diagnostic-parameter bit-offset=0:
        diagnostic data element Routine_Start_Routine_Request_Ethernet_testability_deactivate_Routine_Control_Option: array-size-semantics=FIXED-SIZE, max-number-of-elements=3, base-type=uint8, compu {262144=Routine Control Option: Grundeinstellung (TTR284312)}  # Parameters: Routine Control Option
      diagnostic-parameter bit-offset=0:
        diagnostic data element Routine_Start_Routine_Response_Ethernet_testability_deactivate_Routine_Status_Routine_Result: base-type=uint8, compu-method=Ethernet_testability_deactivate/TEXTTABLE_RoutineStatusRoutineResult  # Parameters: Routine Status / Routine Result
    stop Stop_Subfunction  # Stop Subfunction
      diagnostic-parameter bit-offset=0:
        diagnostic data element Routine_Stop_Routine_Response_Ethernet_testability_deactivate_Routine_Status_Routine_Result: base-type=uint8, compu-method=Ethernet_testability_deactivate/TEXTTABLE_RoutineStatusRoutineResult  # Parameters: Routine Status / Routine Result
  compu method TEXTTABLE_RoutineStatusRoutineResult: 2=Routine Status: Routine Aborted (TTR615), 4=Routine Status: Routine Finished Correctly (TTR815), 3=Routine Status: Routine Execution Stuck (TTR715), 1=Routine Status: Routine Active (TTR515), 0=Routine Status: Routine Inactive; Routine Result: No Results Available (TTR415TTR117), 16=Routine Result: Incorrect Results (TTR216), 32=Routine Result: Correct Results (TTR316)
  diagnostic routine control RoutineControlEthernetTestabilityDeactivate: access-permission=READWRITE0x01DefaultSession0x03ExtendedSession, routine-control-class=Diagnostic_Routine_Control_Class, routine=EthernetTestabilityDeactivate  # RoutineControl_Ethernet_testability_deactivate
package /ZeC/Routine/Ethernet_testability_activate
  diagnostic routine EthernetTestabilityActivate: id=0x057e  # Ethernet_testability_activate
    request result Result_Subfunction  # Result Subfunction
      diagnostic-parameter bit-offset=0:
        diagnostic data element Routine_Request_Routine_Results_Response_Ethernet_testability_activate_Routine_Status: base-type=uint8, compu {1=Routine Status: Routine Active (TTR298712), 3=Routine Status: Routine Aborted (TTR298912), 2=Routine Status: Routine not active or finished correctly (TTR298812)}  # Parameters: Routine Status
      diagnostic-parameter bit-offset=8:
        diagnostic data element Routine_Request_Routine_Results_Response_Ethernet_testability_activate_Routine_Results: base-type=uint16, compu {1=Routine Results: No Results Available (TTR299112), 65535=Routine Results: Correct Results (TTR342912), 0=Routine Results: Incorrect Results (TTR343012)}  # Parameters: Routine Results
    start Start_Subfunction  # Start Subfunction
      diagnostic-parameter bit-offset=0:
        diagnostic data element Routine_Start_Routine_Request_Ethernet_testability_activate_Routine_Control_Option: array-size-semantics=FIXED-SIZE, max-number-of-elements=3, base-type=uint8, compu {262144=Routine Control Option: Grundeinstellung (TTR284312)}  # Parameters: Routine Control Option
      diagnostic-parameter bit-offset=0:
        diagnostic data element Routine_Start_Routine_Response_Ethernet_testability_activate_Routine_Status_Routine_Result: base-type=uint8, compu-method=Ethernet_testability_activate/TEXTTABLE_RoutineStatusRoutineResult  # Parameters: Routine Status / Routine Result
    stop Stop_Subfunction  # Stop Subfunction
      diagnostic-parameter bit-offset=0:
        diagnostic data element Routine_Stop_Routine_Response_Ethernet_testability_activate_Routine_Status_Routine_Result: base-type=uint8, compu-method=Ethernet_testability_activate/TEXTTABLE_RoutineStatusRoutineResult  # Parameters: Routine Status / Routine Result
  compu method TEXTTABLE_RoutineStatusRoutineResult: 2=Routine Status: Routine Aborted (TTR615), 4=Routine Status: Routine Finished Correctly (TTR815), 3=Routine Status: Routine Execution Stuck (TTR715), 1=Routine Status: Routine Active (TTR515), 0=Routine Status: Routine Inactive; Routine Result: No Results Available (TTR415TTR117), 16=Routine Result: Incorrect Results (TTR216), 32=Routine Result: Correct Results (TTR316)
  diagnostic routine control RoutineControlEthernetTestabilityActivate: access-permission=READWRITEExtendedSFDRole0x03ExtendedSession, routine-control-class=Diagnostic_Routine_Control_Class, routine=EthernetTestabilityActivate  # RoutineControl_Ethernet_testability_activate
package /ZeC/Routine/Communication_connection_adaption
  diagnostic routine CommunicationConnectionAdaption: id=0x057c  # Communication_connection_adaption
    request result Result_Subfunction  # Result Subfunction
      diagnostic-parameter bit-offset=0:
        diagnostic data element Routine_Request_Routine_Results_Response_Communication_connection_adaption_Routine_Status: base-type=uint8, compu {1=Routine Status: Routine Active (TTR298712), 3=Routine Status: Routine Aborted (TTR298912), 2=Routine Status: Routine not active or finished correctly (TTR298812)}  # Parameters: Routine Status
      diagnostic-parameter bit-offset=8:
        diagnostic data element Routine_Request_Routine_Results_Response_Communication_connection_adaption_Routine_Results: base-type=uint16, compu {65535=Routine Results: Correct Results (TTR342912), 1=Routine Results: No Results Available (TTR299112), 0=Routine Results: Incorrect Results (TTR343012)}  # Parameters: Routine Results
    start Start_Subfunction  # Start Subfunction
      diagnostic-parameter bit-offset=0:
        diagnostic data element Routine_Start_Routine_Request_Communication_connection_adaption_Routine_Control_Option: array-size-semantics=FIXED-SIZE, max-number-of-elements=3, base-type=uint8, compu {262144=Routine Control Option: Grundeinstellung (TTR284312)}  # Parameters: Routine Control Option
      diagnostic-parameter bit-offset=0:
        diagnostic data element Routine_Start_Routine_Response_Communication_connection_adaption_Routine_Status_Routine_Result: base-type=uint8, compu-method=Communication_connection_adaption/TEXTTABLE_RoutineStatusRoutineResult  # Parameters: Routine Status / Routine Result
    stop Stop_Subfunction  # Stop Subfunction
      diagnostic-parameter bit-offset=0:
        diagnostic data element Routine_Stop_Routine_Response_Communication_connection_adaption_Routine_Status_Routine_Result: base-type=uint8, compu-method=Communication_connection_adaption/TEXTTABLE_RoutineStatusRoutineResult  # Parameters: Routine Status / Routine Result
  compu method TEXTTABLE_RoutineStatusRoutineResult: 2=Routine Status: Routine Aborted (TTR615), 4=Routine Status: Routine Finished Correctly (TTR815), 3=Routine Status: Routine Execution Stuck (TTR715), 1=Routine Status: Routine Active (TTR515), 0=Routine Status: Routine Inactive; Routine Result: No Results Available (TTR415TTR117), 16=Routine Result: Incorrect Results (TTR216), 32=Routine Result: Correct Results (TTR316)
  diagnostic routine control RoutineControlCommunicationConnectionAdaption: access-permission=READWRITE0x01DefaultSession0x03ExtendedSession, routine-control-class=Diagnostic_Routine_Control_Class, routine=CommunicationConnectionAdaption  # RoutineControl_Communication_connection_adaption
package /ZeC/Routine/Check_calibration_pre_conditions
  diagnostic routine CheckCalibrationPreConditions: id=0xc013  # Check_calibration_pre_conditions
    start Start_Subfunction  # Start Subfunction
      diagnostic-parameter bit-offset=0:
        diagnostic data element Routine_Start_Routine_Request_Check_calibration_pre_conditions_Configuration_type: base-type=uint8, compu-method=TEXTTABLE_ConfigurationType  # Parameters: Configuration_type
      diagnostic-parameter bit-offset=8:
        diagnostic data element Routine_Start_Routine_Request_Check_calibration_pre_conditions_Parameter_ID: base-type=uint16  # Parameters: Parameter_ID
      diagnostic-parameter bit-offset=0:
        diagnostic data element Routine_Start_Routine_Response_Check_calibration_pre_conditions_Configuration_type: base-type=uint8, compu-method=TEXTTABLE_ConfigurationType  # Parameters: Configuration_type
      diagnostic-parameter bit-offset=8:
        diagnostic data element Routine_Start_Routine_Response_Check_calibration_pre_conditions_Parameter_ID: base-type=uint16  # Parameters: Parameter_ID
      diagnostic-parameter bit-offset=24:
        diagnostic data element Routine_Start_Routine_Response_Check_calibration_pre_conditions_Number_of_preconditions: base-type=uint8  # Parameters: Number_of_preconditions
      diagnostic-parameter bit-offset=32:
        diagnostic data element Routine_Start_Routine_Response_Check_calibration_pre_conditions_Configuration_preconditions: base-type=uint8, compu {148=Configuration_preconditions: Electric_drive_motor_engine_speed_too_high (TTR205913), 2=Configuration_preconditions: Immobiliser not unlocked (TTR202713), 160=Configuration_preconditions: Voltage_not_off_DC_Connector (TTR207113), 155=Configuration_preconditions: Control_module_in_emergency_mode (TTR206613), 163=Configuration_preconditions: Internal_update_programming_is_active (TTR207413), 1=Configuration_preconditions: Engine speed non-zero (TTR202613), 140=Configuration_preconditions: Drive_motor_engine_not_free_of_voltage (TTR205113), 152=Configuration_preconditions: Rotational_speed_is_not_zero (TTR206313), 9=Configuration_preconditions: Ignition is switched off (TTR203413), 131=Configuration_preconditions: Maximum number of programming attempts exceeded (TTR204213), 154=Configuration_preconditions: Overvoltage (TTR206513), 145=Configuration_preconditions: Active_function_not_finished (TTR205613), 137=Configuration_preconditions: Engine_stop_during_start_stop_operation_active (TTR204813), 129=Configuration_preconditions: Required time delay after failed security access not expired (TTR204013), 156=Configuration_preconditions: Safety_test_active (TTR206714), 128=Configuration_preconditions: Selector lever is not in P or N (TTR203913), 149=Configuration_preconditions: Readiness_for_electric_drive_is_not_off (TTR206013), 4=Configuration_preconditions: Transmission output speed non-zero (TTR202913), 5=Configuration_preconditions: Vehicle speed non-zero (TTR203013), 11=Configuration_preconditions: Temperature too high (TTR203613), 13=Configuration_preconditions: Secure_state (TTR203813), 7=Configuration_preconditions: Key-off/on cycle required (TTR203213), 132=Configuration_preconditions: Slave ECU not present (TTR204313), 142=Configuration_preconditions: Critical_DTC_error_entry (TTR205313), 158=Configuration_preconditions: Emergency_call_service_is_active (TTR206913), 147=Configuration_preconditions: Charging_plug_status_connected (TTR205813), 157=Configuration_preconditions: Vehicle_identification_number_not_received (TTR206813), 146=Configuration_preconditions: Manual_steering_torque_out_of_range (TTR205713), 130=Configuration_preconditions: ECU in overshoot time (TTR204113), 161=Configuration_preconditions: Not_logged_in_in_FAZIT (TTR207213), 159=Configuration_preconditions: Vehicle_tracking_system_has_active_alarm (TTR207013), 135=Configuration_preconditions: Selector_lever_in_position_P (TTR204613), 133=Configuration_preconditions: Crash counter has non-zero value (TTR204413), 150=Configuration_preconditions: First_engine_start_active_terminal_75_off (TTR206113), 153=Configuration_preconditions: Steering_column_switch_not_in_position_off (TTR206413), 10=Configuration_preconditions: Supply voltage too low (TTR203513), 136=Configuration_preconditions: Invalid_data_received (TTR204713), 8=Configuration_preconditions: Programming voltage required (TTR203313), 164=Configuration_preconditions: Ignition_is_switched_on (TTR207513), 141=Configuration_preconditions: Readiness_code_not_resetted (TTR205213), 162=Configuration_preconditions: Vehicle_is_above_floor_panel_for_contactless_charging (TTR207313), 151=Configuration_preconditions: High_voltage_battery_charging_is_active (TTR206213), 138=Configuration_preconditions: Light_is_not_switched_off (TTR204913), 3=Configuration_preconditions: Transmission input speed non-zero (TTR202814), 6=Configuration_preconditions: Automatic control active (TTR203113), 139=Configuration_preconditions: Control_module_defective_set_in_fault_memory (TTR205013), 144=Configuration_preconditions: Brake_pad_change_mode_not_finished (TTR205513), 143=Configuration_preconditions: HV_battery_current_too_high (TTR205413), 134=Configuration_preconditions: Subsystem in diagnosis (TTR204513), 12=Configuration_preconditions: Temperature too low (TTR203713)}  # Parameters: Configuration_preconditions
  compu method TEXTTABLE_ConfigurationType: 2=Configuration_type: Routine Control (31hex) (TTR219713), 1=Configuration_type: Write Data By Identifier (2Ehex) (TTR219613)
  diagnostic routine control RoutineControlCheckCalibrationPreConditions: access-permission=READWRITE0x03ExtendedSession, routine-control-class=Diagnostic_Routine_Control_Class, routine=CheckCalibrationPreConditions  # RoutineControl_Check_calibration_pre_conditions
package /ZeC/Routine/End_of_writing_secured_data_of_protection_of_vehicle_diagnosis
  diagnostic routine EndOfWritingSecuredDataOfProtectionOfVehicleDiagnosis: id=0xc012  # End_of_writing_secured_data_of_protection_of_vehicle_diagnosis
    start Start_Subfunction  # Start Subfunction
      diagnostic-parameter bit-offset=0:
        diagnostic data element Routine_Start_Routine_Request_End_of_writing_secured_data_of_protection_of_vehicle_diagnosis_Type_of_termination: base-type=uint8, compu {2=Type_of_termination: Cancel_writing_of_secured_data (TTR225612), 1=Type_of_termination: Finish_writing_of_secured_data (TTR225512)}  # Parameters: Type_of_termination
      diagnostic-parameter bit-offset=0:
        diagnostic data element Routine_Start_Routine_Response_End_of_writing_secured_data_of_protection_of_vehicle_diagnosis_Routine_Status_Rou9D6BC59: base-type=uint8, compu {2=Routine Status: Routine Aborted (TTR615), 4=Routine Status: Routine Finished Correctly (TTR815), 3=Routine Status: Routine Execution Stuck (TTR715), 1=Routine Status: Routine Active (TTR515), 0=Routine Status: Routine Inactive; Routine Result: No Results Available (TTR415TTR117), 16=Routine Result: Incorrect Results (TTR216), 32=Routine Result: Correct Results (TTR316)}  # Parameters: Routine Status / Routine Result
      diagnostic-parameter bit-offset=8:
        diagnostic data element Routine_Start_Routine_Response_End_of_writing_secured_data_of_protection_of_vehicle_diagnosis_Result_of_termination: base-type=uint8, compu {1=Result_of_termination: End_of_writing_of_secured_data_canceled_successful (TTR225813), 2=Result_of_termination: End_of_writing_of_secured_data_not_successful (TTR225913), 0=Result_of_termination: End_of_writing_of_secured_data_finished_successful (TTR225713)}  # Parameters: Result_of_termination
  diagnostic routine control RoutineControlEndOfWritingSecuredDataOfProtectionOfVehicleDiagnosis: access-permission=READWRITE0x03ExtendedSession, routine-control-class=Diagnostic_Routine_Control_Class, routine=EndOfWritingSecuredDataOfProtectionOfVehicleDiagnosis  # RoutineControl_End_of_writing_secured_data_of_protection_of_vehicle_diagnosis
package /ZeC/Routine/Begin_of_writing_of_secured_data_of_protection_of_vehicle_diagnosis
  diagnostic routine BeginOfWritingOfSecuredDataOfProtectionOfVehicleDiagnosis: id=0xc011  # Begin_of_writing_of_secured_data_of_protection_of_vehicle_diagnosis
    start Start_Subfunction  # Start Subfunction
      diagnostic-parameter bit-offset=0:
        diagnostic data element Routine_Start_Routine_Request_Begin_of_writing_of_secured_data_of_protection_of_vehicle_diagnosis_Safeguard_token: base-type=uint8  # Parameters: Safeguard_token
      diagnostic-parameter bit-offset=0:
        diagnostic data element Routine_Start_Routine_Response_Begin_of_writing_of_secured_data_of_protection_of_vehicle_diagnosis_Routine_Statu3349E15: base-type=uint8, compu {2=Routine Status: Routine Aborted (TTR615), 4=Routine Status: Routine Finished Correctly (TTR815), 3=Routine Status: Routine Execution Stuck (TTR715), 1=Routine Status: Routine Active (TTR515), 0=Routine Status: Routine Inactive; Routine Result: No Results Available (TTR415TTR117), 16=Routine Result: Incorrect Results (TTR216), 32=Routine Result: Correct Results (TTR316)}  # Parameters: Routine Status / Routine Result
      diagnostic-parameter bit-offset=8:
        diagnostic data element Routine_Start_Routine_Response_Begin_of_writing_of_secured_data_of_protection_of_vehicle_diagnosis_Result_of_wri67296D0: base-type=uint8, compu {6=Result_of_writing_of_secured_data: TokenType_not_supported (TTR226413), 5=Result_of_writing_of_secured_data: TokenVersion_not_supported (TTR226115), 2=Result_of_writing_of_secured_data: Token_is_not_for_this_server (TTR226314), 7=Result_of_writing_of_secured_data: Replay_protection_invalid (TTR222313), 12=Result_of_writing_of_secured_data: Server_not_individualized (TTR226213), 4=Result_of_writing_of_secured_data: SFD_OID_not_supported (TTR222013), 8=Result_of_writing_of_secured_data: Token_is_corrupt (TTR222413), 3=Result_of_writing_of_secured_data: Projekt_ID_is_wrong (TTR221913), 1=Result_of_writing_of_secured_data: Signature_validation_error (TTR221713), 0=Result_of_writing_of_secured_data: Begin_of_writing_of_secured_data_successful (TTR226013)}  # Parameters: Result_of_writing_of_secured_data
  diagnostic routine control RoutineControlBeginOfWritingOfSecuredDataOfProtectionOfVehicleDiagnosis: access-permission=READWRITE0x03ExtendedSession, routine-control-class=Diagnostic_Routine_Control_Class, routine=BeginOfWritingOfSecuredDataOfProtectionOfVehicleDiagnosis  # RoutineControl_Begin_of_writing_of_secured_data_of_protection_of_vehicle_diagnosis
package /ZeC/Routine/Calculate_integrity_validation_data
  diagnostic routine CalculateIntegrityValidationData: id=0x0253  # Calculate_integrity_validation_data
    start Start_Subfunction  # Start Subfunction
      diagnostic-parameter bit-offset=0:
        diagnostic data element Routine_Start_Routine_Request_Calculate_integrity_validation_data_Type_of_calculation: base-type=uint8, compu {0=Type_of_calculation: Calculate_hash_value_for_configuration_data (TTR283814), 1=Type_of_calculation: Calculate_hash_value_for_programming_data (TTR283914)}  # Parameters: Type_of_calculation
      diagnostic-parameter bit-offset=8:
        diagnostic data element Routine_Start_Routine_Request_Calculate_integrity_validation_data_Type_of_hash_value: base-type=uint8, compu {1=Type_of_hash_value: SHA-256 (TTR231013)}  # Parameters: Type_of_hash_value
      diagnostic-parameter bit-offset=0:
        diagnostic data element Routine_Start_Routine_Response_Calculate_integrity_validation_data_Result_of_calculation: base-type=uint8, compu {0=Result_of_calculation: Calculation_successful (TTR230613), 1=Result_of_calculation: Calculation_failed (TTR230712), 2=Result_of_calculation: Calculation_identifier_not_found (TTR230812)}  # Parameters: Result_of_calculation
      diagnostic-parameter bit-offset=8:
        diagnostic data element Routine_Start_Routine_Response_Calculate_integrity_validation_data_Type_of_hash_value: base-type=uint8, compu {1=Type_of_hash_value: SHA-256 (TTR231013)}  # Parameters: Type_of_hash_value
      diagnostic-parameter bit-offset=16:
        diagnostic data element Routine_Start_Routine_Response_Calculate_integrity_validation_data_Hash_value: array-size-semantics=VARIABLE-SIZE, max-number-of-elements=32, base-type=uint8  # Parameters: Hash_value
  diagnostic routine control RoutineControlCalculateIntegrityValidationData: access-permission=READWRITE0x01DefaultSession0x03ExtendedSession, routine-control-class=Diagnostic_Routine_Control_Class, routine=CalculateIntegrityValidationData  # RoutineControl_Calculate_integrity_validation_data
package /ZeC/Routine/Calculate_individual_hash_value
  diagnostic routine CalculateIndividualHashValue: id=0x0254  # Calculate_individual_hash_value
    start Start_Subfunction  # Start Subfunction
      diagnostic-parameter bit-offset=0:
        diagnostic data element Routine_Start_Routine_Request_Calculate_individual_hash_value_Type_of_hash_value: base-type=uint8, compu {1=Type_of_hash_value: SHA-256 (TTR231013)}  # Parameters: Type_of_hash_value
      diagnostic-parameter bit-offset=8:
        diagnostic data element Routine_Start_Routine_Request_Calculate_individual_hash_value_Type_of_hash: base-type=uint8, compu-method=TEXTTABLE_TypeOfHash  # Parameters: Type_of_hash
      diagnostic-parameter bit-offset=16:
        diagnostic data element Routine_Start_Routine_Request_Calculate_individual_hash_value_Individual_hash_value_id: base-type=uint16  # Parameters: Individual_hash_value_id
      diagnostic-parameter bit-offset=0:
        diagnostic data element Routine_Start_Routine_Response_Calculate_individual_hash_value_State_of_hash_value: base-type=uint8, compu {0=State_of_hash_value: Calculation_hash_value_valid (TTR232414), 1=State_of_hash_value: Calculation_hash_value_invalid (TTR232514), 2=State_of_hash_value: Calculation_hash_value_not_found (TTR232614)}  # Parameters: State_of_hash_value
      diagnostic-parameter bit-offset=8:
        diagnostic data element Routine_Start_Routine_Response_Calculate_individual_hash_value_Type_of_hash_value: base-type=uint8, compu {1=Type_of_hash_value: SHA-256 (TTR231013)}  # Parameters: Type_of_hash_value
      diagnostic-parameter bit-offset=16:
        diagnostic data element Routine_Start_Routine_Response_Calculate_individual_hash_value_Type_of_hash: base-type=uint8, compu-method=TEXTTABLE_TypeOfHash  # Parameters: Type_of_hash
      diagnostic-parameter bit-offset=24:
        diagnostic data element Routine_Start_Routine_Response_Calculate_individual_hash_value_Individual_hash_value_id: base-type=uint16  # Parameters: Individual_hash_value_id
      diagnostic-parameter bit-offset=40:
        diagnostic data element Routine_Start_Routine_Response_Calculate_individual_hash_value_Hash_value: array-size-semantics=VARIABLE-SIZE, max-number-of-elements=4064, base-type=uint8  # Parameters: Hash_value
  compu method TEXTTABLE_TypeOfHash: 2=Type_of_hash: Individual Hash Value For Application Data Set (Corresponds To Application Data Set Number Of Data Set Download Gen. 2) (TTR232113), 0=Type_of_hash: Individual Hash Value For Data Set (For Data Set Download Gen. 1) (TTR231913), 3=Type_of_hash: Individual Hash Value For All Adaptations / Codings As Per DataIdentifier 0x0250 (TTR232213), 1=Type_of_hash: Individual Hash Value For Boot Loader Data Set (For Data Set Download Gen. 2) (TTR232013), 255=Type_of_hash: All Individual Hash Values As Per DataIdentifier 0x0250 (TTR232312)
  diagnostic routine control RoutineControlCalculateIndividualHashValue: access-permission=READWRITE0x01DefaultSession0x03ExtendedSession, routine-control-class=Diagnostic_Routine_Control_Class, routine=CalculateIndividualHashValue  # RoutineControl_Calculate_individual_hash_value
package /ZeC/Routine/Reset_counter_invalid_someip_messages_interface_version
  diagnostic routine ResetCounterInvalidSomeipMessagesInterfaceVersion: id=0xb11d  # Reset_counter_invalid_someip_messages_interface_version
    request result Result_Subfunction  # Result Subfunction
      diagnostic-parameter bit-offset=0:
        diagnostic data element Routine_Request_Routine_Results_Response_Reset_counter_invalid_someip_messages_interface_version_Routine_Status_B5877F1: base-type=uint8, compu-method=Reset_counter_invalid_someip_messages_interface_version/TEXTTABLE_RoutineStatusRoutineResult  # Parameters: Routine Status / Routine Result
    start Start_Subfunction  # Start Subfunction
      diagnostic-parameter bit-offset=0:
        diagnostic data element Routine_Start_Routine_Response_Reset_counter_invalid_someip_messages_interface_version_Routine_Status_Routine_Result: base-type=uint8, compu-method=Reset_counter_invalid_someip_messages_interface_version/TEXTTABLE_RoutineStatusRoutineResult  # Parameters: Routine Status / Routine Result
    stop Stop_Subfunction  # Stop Subfunction
      diagnostic-parameter bit-offset=0:
        diagnostic data element Routine_Stop_Routine_Response_Reset_counter_invalid_someip_messages_interface_version_Routine_Status_Routine_Result: base-type=uint8, compu-method=Reset_counter_invalid_someip_messages_interface_version/TEXTTABLE_RoutineStatusRoutineResult  # Parameters: Routine Status / Routine Result
  compu method TEXTTABLE_RoutineStatusRoutineResult: 2=Routine Status: Routine Aborted (TTR615), 4=Routine Status: Routine Finished Correctly (TTR815), 3=Routine Status: Routine Execution Stuck (TTR715), 1=Routine Status: Routine Active (TTR515), 0=Routine Status: Routine Inactive; Routine Result: No Results Available (TTR415TTR117), 16=Routine Result: Incorrect Results (TTR216), 32=Routine Result: Correct Results (TTR316)
  diagnostic routine control RoutineControlResetCounterInvalidSomeipMessagesInterfaceVersion: access-permission=READWRITEBasicSFDRole0x01DefaultSession0x03ExtendedSession, routine-control-class=Diagnostic_Routine_Control_Class, routine=ResetCounterInvalidSomeipMessagesInterfaceVersion  # RoutineControl_Reset_counter_invalid_someip_messages_interface_version
package /ZeC/Routine/Calculate_module_hash_value
  diagnostic routine CalculateModuleHashValue: id=0x029a  # Calculate_module_hash_value
    request result Result_Subfunction  # Result Subfunction
      diagnostic-parameter bit-offset=0:
        diagnostic data element Routine_Request_Routine_Results_Response_Calculate_module_hash_value_Routine_Status_Routine_Result: base-type=uint8, compu-method=Calculate_module_hash_value/TEXTTABLE_RoutineStatusRoutineResult  # Parameters: Routine Status / Routine Result
      diagnostic-parameter bit-offset=8:
        diagnostic data element Routine_Request_Routine_Results_Response_Calculate_module_hash_value_Progress_of_calculation: base-type=uint8  # Parameters: Progress_of_calculation
      diagnostic-parameter bit-offset=16:
        diagnostic data element Routine_Request_Routine_Results_Response_Calculate_module_hash_value_Type_of_hash_value: base-type=uint8, compu {1=Type_of_hash_value: SHA-256 (TTR231013)}  # Parameters: Type_of_hash_value
      diagnostic-parameter bit-offset=24:
        diagnostic data element Routine_Request_Routine_Results_Response_Calculate_module_hash_value_Type_of_calculation: base-type=uint8, compu-method=Calculate_module_hash_value/TEXTTABLE_TypeOfCalculation  # Parameters: Type_of_calculation
      diagnostic-parameter bit-offset=32:
        diagnostic data element Routine_Request_Routine_Results_Response_Calculate_module_hash_value_Result_of_calculation: base-type=uint8, compu {0=Result_of_calculation: Calculation_successful (TTR230614), 1=Result_of_calculation: Calculation_failed (TTR230713), 4=Result_of_calculation: Calculation_incomplete (TTR231814)}  # Parameters: Result_of_calculation
      diagnostic-parameter bit-offset=40:
        diagnostic data element Routine_Request_Routine_Results_Response_Calculate_module_hash_value_Hash_value: array-size-semantics=VARIABLE-SIZE, max-number-of-elements=32, base-type=uint8  # Parameters: Hash_value
    start Start_Subfunction  # Start Subfunction
      diagnostic-parameter bit-offset=0:
        diagnostic data element Routine_Start_Routine_Request_Calculate_module_hash_value_Type_of_hash_value: base-type=uint8, compu {1=Type_of_hash_value: SHA-256 (TTR231013)}  # Parameters: Type_of_hash_value
      diagnostic-parameter bit-offset=8:
        diagnostic data element Routine_Start_Routine_Request_Calculate_module_hash_value_Type_of_calculation: base-type=uint8, compu-method=Calculate_module_hash_value/TEXTTABLE_TypeOfCalculation  # Parameters: Type_of_calculation
      diagnostic-parameter bit-offset=0:
        diagnostic data element Routine_Start_Routine_Response_Calculate_module_hash_value_Routine_Status_Routine_Result: base-type=uint8, compu-method=Calculate_module_hash_value/TEXTTABLE_RoutineStatusRoutineResult  # Parameters: Routine Status / Routine Result
      diagnostic-parameter bit-offset=8:
        diagnostic data element Routine_Start_Routine_Response_Calculate_module_hash_value_Type_of_hash_value: base-type=uint8, compu {1=Type_of_hash_value: SHA-256 (TTR231013)}  # Parameters: Type_of_hash_value
      diagnostic-parameter bit-offset=16:
        diagnostic data element Routine_Start_Routine_Response_Calculate_module_hash_value_Type_of_calculation: base-type=uint8, compu-method=Calculate_module_hash_value/TEXTTABLE_TypeOfCalculation  # Parameters: Type_of_calculation
    stop Stop_Subfunction  # Stop Subfunction
  compu method TEXTTABLE_TypeOfCalculation: 0=Type_of_calculation: Calculate_hash_value_for_configuration_data (TTR283814), 1=Type_of_calculation: Calculate_hash_value_for_programming_data (TTR283914)
  compu method TEXTTABLE_RoutineStatusRoutineResult: 2=Routine Status: Routine Aborted (TTR615), 4=Routine Status: Routine Finished Correctly (TTR815), 3=Routine Status: Routine Execution Stuck (TTR715), 1=Routine Status: Routine Active (TTR515), 0=Routine Status: Routine Inactive; Routine Result: No Results Available (TTR415TTR117), 16=Routine Result: Incorrect Results (TTR216), 32=Routine Result: Correct Results (TTR316)
  diagnostic routine control RoutineControlCalculateModuleHashValue: access-permission=READWRITE0x01DefaultSession0x02ProgrammingSession0x03ExtendedSession, routine-control-class=Diagnostic_Routine_Control_Class, routine=CalculateModuleHashValue  # RoutineControl_Calculate_module_hash_value
package /ZeC/Routine/Vkms_get_state
  diagnostic routine VkmsGetState: id=0xc00f  # Vkms_get_state
    request result Result_Subfunction  # Result Subfunction
      diagnostic-parameter bit-offset=0:
        diagnostic data element Routine_Request_Routine_Results_Response_Vkms_get_state_Routine_Status_Routine_Result: base-type=uint8, compu {2=Routine Status: Routine Aborted (TTR615), 4=Routine Status: Routine Finished Correctly (TTR815), 3=Routine Status: Routine Execution Stuck (TTR715), 1=Routine Status: Routine Active (TTR515), 0=Routine Status: Routine Inactive; Routine Result: No Results Available (TTR415TTR117), 16=Routine Result: Incorrect Results (TTR216), 32=Routine Result: Correct Results (TTR316)}  # Parameters: Routine Status / Routine Result
      diagnostic-parameter bit-offset=8:
        diagnostic data element Routine_Request_Routine_Results_Response_Vkms_get_state_ErrorCode: base-type=uint8  # Parameters: ErrorCode
      diagnostic-parameter bit-offset=16:
        diagnostic data element Routine_Request_Routine_Results_Response_Vkms_get_state_Major_Version: base-type=uint8  # Parameters: Major Version
      diagnostic-parameter bit-offset=24:
        diagnostic data element Routine_Request_Routine_Results_Response_Vkms_get_state_Minor_Version: base-type=uint8  # Parameters: Minor Version
      diagnostic-parameter bit-offset=32:
        diagnostic data element Routine_Request_Routine_Results_Response_Vkms_get_state_Bugfix_Version: base-type=uint8  # Parameters: Bugfix Version
      diagnostic-parameter bit-offset=40:
        diagnostic data element Routine_Request_Routine_Results_Response_Vkms_get_state_Master_Key_1: base-type=uint8  # Parameters: Master Key 1
      diagnostic-parameter bit-offset=48:
        diagnostic data element Routine_Request_Routine_Results_Response_Vkms_get_state_Master_Key_2: base-type=uint8  # Parameters: Master Key 2
      diagnostic-parameter bit-offset=56:
        diagnostic data element Routine_Request_Routine_Results_Response_Vkms_get_state_Master_Key_3: base-type=uint8  # Parameters: Master Key 3
      diagnostic-parameter bit-offset=64:
        diagnostic data element Routine_Request_Routine_Results_Response_Vkms_get_state_Identitycounter: base-type=uint16  # Parameters: Identitycounter
      diagnostic-parameter bit-offset=80:
        diagnostic data element Routine_Request_Routine_Results_Response_Vkms_get_state_Statusflag_7_Statusflag_6_Statusflag_5_Statusflag_4_StatC5D4114: base-type=uint8  # Parameters: Statusflag 7 / Statusflag 6 / Statusflag 5 / Statusflag 4 / Statusflag 3 / Statusflag 2 / Statusflag 1 / Statusflag 0
      diagnostic-parameter bit-offset=88:
        diagnostic data element Routine_Request_Routine_Results_Response_Vkms_get_state_Statusflag_15_Statusflag_14_Statusflag_13_Statusflag_12_A745BA1: base-type=uint8  # Parameters: Statusflag 15 / Statusflag 14 / Statusflag 13 / Statusflag 12 / Statusflag 11 / Statusflag 10 / Statusflag 9 / Statusflag 8
    start Start_Subfunction  # Start Subfunction
  diagnostic routine control RoutineControlVkmsGetState: access-permission=READWRITE0x03ExtendedSession, routine-control-class=Diagnostic_Routine_Control_Class, routine=VkmsGetState  # RoutineControl_Vkms_get_state
package /ZeC/Routine/Reset_counter_invalid_someip_messages_protocol_version
  diagnostic routine ResetCounterInvalidSomeipMessagesProtocolVersion: id=0xb11e  # Reset_counter_invalid_someip_messages_protocol_version
    request result Result_Subfunction  # Result Subfunction
      diagnostic-parameter bit-offset=0:
        diagnostic data element Routine_Request_Routine_Results_Response_Reset_counter_invalid_someip_messages_protocol_version_Routine_Status_R07B8636: base-type=uint8, compu-method=Reset_counter_invalid_someip_messages_protocol_version/TEXTTABLE_RoutineStatusRoutineResult  # Parameters: Routine Status / Routine Result
    start Start_Subfunction  # Start Subfunction
      diagnostic-parameter bit-offset=0:
        diagnostic data element Routine_Start_Routine_Response_Reset_counter_invalid_someip_messages_protocol_version_Routine_Status_Routine_Result: base-type=uint8, compu-method=Reset_counter_invalid_someip_messages_protocol_version/TEXTTABLE_RoutineStatusRoutineResult  # Parameters: Routine Status / Routine Result
    stop Stop_Subfunction  # Stop Subfunction
      diagnostic-parameter bit-offset=0:
        diagnostic data element Routine_Stop_Routine_Response_Reset_counter_invalid_someip_messages_protocol_version_Routine_Status_Routine_Result: base-type=uint8, compu-method=Reset_counter_invalid_someip_messages_protocol_version/TEXTTABLE_RoutineStatusRoutineResult  # Parameters: Routine Status / Routine Result
  compu method TEXTTABLE_RoutineStatusRoutineResult: 2=Routine Status: Routine Aborted (TTR615), 4=Routine Status: Routine Finished Correctly (TTR815), 3=Routine Status: Routine Execution Stuck (TTR715), 1=Routine Status: Routine Active (TTR515), 0=Routine Status: Routine Inactive; Routine Result: No Results Available (TTR415TTR117), 16=Routine Result: Incorrect Results (TTR216), 32=Routine Result: Correct Results (TTR316)
  diagnostic routine control RoutineControlResetCounterInvalidSomeipMessagesProtocolVersion: access-permission=READWRITEBasicSFDRole0x01DefaultSession0x03ExtendedSession, routine-control-class=Diagnostic_Routine_Control_Class, routine=ResetCounterInvalidSomeipMessagesProtocolVersion  # RoutineControl_Reset_counter_invalid_someip_messages_protocol_version
package /ZeC/Routine/Reset_counter_invalid_someip_messages_method_id
  diagnostic routine ResetCounterInvalidSomeipMessagesMethodId: id=0xb11b  # Reset_counter_invalid_someip_messages_method_id
    request result Result_Subfunction  # Result Subfunction
      diagnostic-parameter bit-offset=0:
        diagnostic data element Routine_Request_Routine_Results_Response_Reset_counter_invalid_someip_messages_method_id_Routine_Status_Routine_Result: base-type=uint8, compu-method=Reset_counter_invalid_someip_messages_method_id/TEXTTABLE_RoutineStatusRoutineResult  # Parameters: Routine Status / Routine Result
    start Start_Subfunction  # Start Subfunction
      diagnostic-parameter bit-offset=0:
        diagnostic data element Routine_Start_Routine_Response_Reset_counter_invalid_someip_messages_method_id_Routine_Status_Routine_Result: base-type=uint8, compu-method=Reset_counter_invalid_someip_messages_method_id/TEXTTABLE_RoutineStatusRoutineResult  # Parameters: Routine Status / Routine Result
    stop Stop_Subfunction  # Stop Subfunction
      diagnostic-parameter bit-offset=0:
        diagnostic data element Routine_Stop_Routine_Response_Reset_counter_invalid_someip_messages_method_id_Routine_Status_Routine_Result: base-type=uint8, compu-method=Reset_counter_invalid_someip_messages_method_id/TEXTTABLE_RoutineStatusRoutineResult  # Parameters: Routine Status / Routine Result
  compu method TEXTTABLE_RoutineStatusRoutineResult: 2=Routine Status: Routine Aborted (TTR615), 4=Routine Status: Routine Finished Correctly (TTR815), 3=Routine Status: Routine Execution Stuck (TTR715), 1=Routine Status: Routine Active (TTR515), 0=Routine Status: Routine Inactive; Routine Result: No Results Available (TTR415TTR117), 16=Routine Result: Incorrect Results (TTR216), 32=Routine Result: Correct Results (TTR316)
  diagnostic routine control RoutineControlResetCounterInvalidSomeipMessagesMethodId: access-permission=READWRITEBasicSFDRole0x01DefaultSession0x03ExtendedSession, routine-control-class=Diagnostic_Routine_Control_Class, routine=ResetCounterInvalidSomeipMessagesMethodId  # RoutineControl_Reset_counter_invalid_someip_messages_method_id
package /ZeC/Routine/Vkms_get_pss_hash
  diagnostic routine VkmsGetPssHash: id=0xc00d  # Vkms_get_pss_hash
    request result Result_Subfunction  # Result Subfunction
      diagnostic-parameter bit-offset=0:
        diagnostic data element Routine_Request_Routine_Results_Response_Vkms_get_pss_hash_Routine_Status_Routine_Result: base-type=uint8, compu {2=Routine Status: Routine Aborted (TTR615), 4=Routine Status: Routine Finished Correctly (TTR815), 3=Routine Status: Routine Execution Stuck (TTR715), 1=Routine Status: Routine Active (TTR515), 0=Routine Status: Routine Inactive; Routine Result: No Results Available (TTR415TTR117), 16=Routine Result: Incorrect Results (TTR216), 32=Routine Result: Correct Results (TTR316)}  # Parameters: Routine Status / Routine Result
      diagnostic-parameter bit-offset=8:
        diagnostic data element Routine_Request_Routine_Results_Response_Vkms_get_pss_hash_PHASH_ErrorCode: array-size-semantics=FIXED-SIZE, max-number-of-elements=16, base-type=uint8  # Parameters: PHASH / ErrorCode
    start Start_Subfunction  # Start Subfunction
  diagnostic routine control RoutineControlVkmsGetPssHash: access-permission=READWRITE0x03ExtendedSession, routine-control-class=Diagnostic_Routine_Control_Class, routine=VkmsGetPssHash  # RoutineControl_Vkms_get_pss_hash
package /ZeC/Routine/Clear_data_block
  diagnostic routine ClearDataBlock: id=0x0657  # Clear_data_block
    request result Result_Subfunction  # Result Subfunction
      diagnostic-parameter bit-offset=0:
        diagnostic data element Routine_Request_Routine_Results_Response_Clear_data_block_Routine_Status_Routine_Result: base-type=uint8, compu-method=Clear_data_block/TEXTTABLE_RoutineStatusRoutineResult  # Parameters: Routine Status / Routine Result
    start Start_Subfunction  # Start Subfunction
      diagnostic-parameter bit-offset=0:
        diagnostic data element Routine_Start_Routine_Request_Clear_data_block_Data_Block_ID: base-type=uint16, compu {30208=Data Block ID: Data_block_1 (TTR446812)}  # Parameters: Data Block ID
      diagnostic-parameter bit-offset=0:
        diagnostic data element Routine_Start_Routine_Response_Clear_data_block_Routine_Status_Routine_Result: base-type=uint8, compu-method=Clear_data_block/TEXTTABLE_RoutineStatusRoutineResult  # Parameters: Routine Status / Routine Result
    stop Stop_Subfunction  # Stop Subfunction
      diagnostic-parameter bit-offset=0:
        diagnostic data element Routine_Stop_Routine_Response_Clear_data_block_Routine_Status_Routine_Result: base-type=uint8, compu-method=Clear_data_block/TEXTTABLE_RoutineStatusRoutineResult  # Parameters: Routine Status / Routine Result
  compu method TEXTTABLE_RoutineStatusRoutineResult: 2=Routine Status: Routine Aborted (TTR615), 4=Routine Status: Routine Finished Correctly (TTR815), 3=Routine Status: Routine Execution Stuck (TTR715), 1=Routine Status: Routine Active (TTR515), 0=Routine Status: Routine Inactive; Routine Result: No Results Available (TTR415TTR117), 16=Routine Result: Incorrect Results (TTR216), 32=Routine Result: Correct Results (TTR316)
  diagnostic routine control RoutineControlClearDataBlock: access-permission=READWRITE0x03ExtendedSession, routine-control-class=Diagnostic_Routine_Control_Class, routine=ClearDataBlock  # RoutineControl_Clear_data_block
package /ZeC/Routine/Reset_counter_invalid_someip_messages_service_id
  diagnostic routine ResetCounterInvalidSomeipMessagesServiceId: id=0xb11c  # Reset_counter_invalid_someip_messages_service_id
    request result Result_Subfunction  # Result Subfunction
      diagnostic-parameter bit-offset=0:
        diagnostic data element Routine_Request_Routine_Results_Response_Reset_counter_invalid_someip_messages_service_id_Routine_Status_Routine_Result: base-type=uint8, compu-method=Reset_counter_invalid_someip_messages_service_id/TEXTTABLE_RoutineStatusRoutineResult  # Parameters: Routine Status / Routine Result
    start Start_Subfunction  # Start Subfunction
      diagnostic-parameter bit-offset=0:
        diagnostic data element Routine_Start_Routine_Response_Reset_counter_invalid_someip_messages_service_id_Routine_Status_Routine_Result: base-type=uint8, compu-method=Reset_counter_invalid_someip_messages_service_id/TEXTTABLE_RoutineStatusRoutineResult  # Parameters: Routine Status / Routine Result
    stop Stop_Subfunction  # Stop Subfunction
      diagnostic-parameter bit-offset=0:
        diagnostic data element Routine_Stop_Routine_Response_Reset_counter_invalid_someip_messages_service_id_Routine_Status_Routine_Result: base-type=uint8, compu-method=Reset_counter_invalid_someip_messages_service_id/TEXTTABLE_RoutineStatusRoutineResult  # Parameters: Routine Status / Routine Result
  compu method TEXTTABLE_RoutineStatusRoutineResult: 2=Routine Status: Routine Aborted (TTR615), 4=Routine Status: Routine Finished Correctly (TTR815), 3=Routine Status: Routine Execution Stuck (TTR715), 1=Routine Status: Routine Active (TTR515), 0=Routine Status: Routine Inactive; Routine Result: No Results Available (TTR415TTR117), 16=Routine Result: Incorrect Results (TTR216), 32=Routine Result: Correct Results (TTR316)
  diagnostic routine control RoutineControlResetCounterInvalidSomeipMessagesServiceId: access-permission=READWRITEBasicSFDRole0x01DefaultSession0x03ExtendedSession, routine-control-class=Diagnostic_Routine_Control_Class, routine=ResetCounterInvalidSomeipMessagesServiceId  # RoutineControl_Reset_counter_invalid_someip_messages_service_id
package /ZeC/Routine/Vkms_get_identity_hash
  diagnostic routine VkmsGetIdentityHash: id=0xc00c  # Vkms_get_identity_hash
    request result Result_Subfunction  # Result Subfunction
      diagnostic-parameter bit-offset=0:
        diagnostic data element Routine_Request_Routine_Results_Response_Vkms_get_identity_hash_Routine_Status_Routine_Result: base-type=uint8, compu {2=Routine Status: Routine Aborted (TTR615), 4=Routine Status: Routine Finished Correctly (TTR815), 3=Routine Status: Routine Execution Stuck (TTR715), 1=Routine Status: Routine Active (TTR515), 0=Routine Status: Routine Inactive; Routine Result: No Results Available (TTR415TTR117), 16=Routine Result: Incorrect Results (TTR216), 32=Routine Result: Correct Results (TTR316)}  # Parameters: Routine Status / Routine Result
      diagnostic-parameter bit-offset=8:
        diagnostic data element Routine_Request_Routine_Results_Response_Vkms_get_identity_hash_IHASH_ErrorCode: array-size-semantics=FIXED-SIZE, max-number-of-elements=16, base-type=uint8  # Parameters: IHASH / ErrorCode
    start Start_Subfunction  # Start Subfunction
      diagnostic-parameter bit-offset=0:
        diagnostic data element Routine_Start_Routine_Request_Vkms_get_identity_hash_Reserved: base-type=uint8  # Parameters: Reserved
      diagnostic-parameter bit-offset=8:
        diagnostic data element Routine_Start_Routine_Request_Vkms_get_identity_hash_Challenge: array-size-semantics=FIXED-SIZE, max-number-of-elements=16, base-type=uint8  # Parameters: Challenge
  diagnostic routine control RoutineControlVkmsGetIdentityHash: access-permission=READWRITE0x03ExtendedSession, routine-control-class=Diagnostic_Routine_Control_Class, routine=VkmsGetIdentityHash  # RoutineControl_Vkms_get_identity_hash
package /ZeC/Routine/Reset_ip_counter_wrong_ipv6_addresses
  diagnostic routine ResetIpCounterWrongIpv6Addresses: id=0x05e4  # Reset_ip_counter_wrong_ipv6_addresses
    request result Result_Subfunction  # Result Subfunction
      diagnostic-parameter bit-offset=0:
        diagnostic data element Routine_Request_Routine_Results_Response_Reset_ip_counter_wrong_ipv6_addresses_Routine_Status: base-type=uint8, compu {1=Routine Status: Routine Active (TTR298712), 3=Routine Status: Routine Aborted (TTR298912), 2=Routine Status: Routine not active or finished correctly (TTR298812)}  # Parameters: Routine Status
      diagnostic-parameter bit-offset=8:
        diagnostic data element Routine_Request_Routine_Results_Response_Reset_ip_counter_wrong_ipv6_addresses_Routine_Results: base-type=uint16, compu {1=Routine Results: No Results Available (TTR299112), 65535=Routine Results: Correct Results (TTR342912), 0=Routine Results: Incorrect Results (TTR343012)}  # Parameters: Routine Results
    start Start_Subfunction  # Start Subfunction
      diagnostic-parameter bit-offset=0:
        diagnostic data element Routine_Start_Routine_Request_Reset_ip_counter_wrong_ipv6_addresses_Routine_Control_Option: array-size-semantics=FIXED-SIZE, max-number-of-elements=3, base-type=uint8, compu {262144=Routine Control Option: Grundeinstellung (TTR284312)}  # Parameters: Routine Control Option
      diagnostic-parameter bit-offset=0:
        diagnostic data element Routine_Start_Routine_Response_Reset_ip_counter_wrong_ipv6_addresses_Routine_Status_Routine_Result: base-type=uint8, compu-method=Reset_ip_counter_wrong_ipv6_addresses/TEXTTABLE_RoutineStatusRoutineResult  # Parameters: Routine Status / Routine Result
    stop Stop_Subfunction  # Stop Subfunction
      diagnostic-parameter bit-offset=0:
        diagnostic data element Routine_Stop_Routine_Response_Reset_ip_counter_wrong_ipv6_addresses_Routine_Status_Routine_Result: base-type=uint8, compu-method=Reset_ip_counter_wrong_ipv6_addresses/TEXTTABLE_RoutineStatusRoutineResult  # Parameters: Routine Status / Routine Result
  compu method TEXTTABLE_RoutineStatusRoutineResult: 2=Routine Status: Routine Aborted (TTR615), 4=Routine Status: Routine Finished Correctly (TTR815), 3=Routine Status: Routine Execution Stuck (TTR715), 1=Routine Status: Routine Active (TTR515), 0=Routine Status: Routine Inactive; Routine Result: No Results Available (TTR415TTR117), 16=Routine Result: Incorrect Results (TTR216), 32=Routine Result: Correct Results (TTR316)
  diagnostic routine control RoutineControlResetIpCounterWrongIpv6Addresses: access-permission=READWRITE0x01DefaultSession0x03ExtendedSession, routine-control-class=Diagnostic_Routine_Control_Class, routine=ResetIpCounterWrongIpv6Addresses  # RoutineControl_Reset_ip_counter_wrong_ipv6_addresses
package /ZeC/Routine/Reset_to_factory_setting
  diagnostic routine ResetToFactorySetting: id=0x03e7  # Reset_to_factory_setting
    request result Result_Subfunction  # Result Subfunction
      diagnostic-parameter bit-offset=0:
        diagnostic data element Routine_Request_Routine_Results_Response_Reset_to_factory_setting_Routine_Status_Routine_Result: base-type=uint8, compu-method=Reset_to_factory_setting/TEXTTABLE_RoutineStatusRoutineResult  # Parameters: Routine Status / Routine Result
    start Start_Subfunction  # Start Subfunction
      diagnostic-parameter bit-offset=0:
        diagnostic data element Routine_Start_Routine_Request_Reset_to_factory_setting_Reset_indication: array-size-semantics=FIXED-SIZE, max-number-of-elements=3, base-type=uint8, compu {0=Reset_indication: All_settings (TTR219412)}  # Parameters: Reset_indication
      diagnostic-parameter bit-offset=0:
        diagnostic data element Routine_Start_Routine_Response_Reset_to_factory_setting_Routine_Status_Routine_Result: base-type=uint8, compu-method=Reset_to_factory_setting/TEXTTABLE_RoutineStatusRoutineResult  # Parameters: Routine Status / Routine Result
    stop Stop_Subfunction  # Stop Subfunction
      diagnostic-parameter bit-offset=0:
        diagnostic data element Routine_Stop_Routine_Response_Reset_to_factory_setting_Routine_Status_Routine_Result: base-type=uint8, compu-method=Reset_to_factory_setting/TEXTTABLE_RoutineStatusRoutineResult  # Parameters: Routine Status / Routine Result
  compu method TEXTTABLE_RoutineStatusRoutineResult: 2=Routine Status: Routine Aborted (TTR615), 4=Routine Status: Routine Finished Correctly (TTR815), 3=Routine Status: Routine Execution Stuck (TTR715), 1=Routine Status: Routine Active (TTR515), 0=Routine Status: Routine Inactive; Routine Result: No Results Available (TTR415TTR117), 16=Routine Result: Incorrect Results (TTR216), 32=Routine Result: Correct Results (TTR316)
  diagnostic routine control RoutineControlResetToFactorySetting: access-permission=READWRITEBasicSFDRole0x03ExtendedSession, routine-control-class=Diagnostic_Routine_Control_Class, routine=ResetToFactorySetting  # RoutineControl_Reset_to_factory_setting
package /ZeC/Routine/Reset_ip_counter_wrong_tcp_ports
  diagnostic routine ResetIpCounterWrongTcpPorts: id=0x05e5  # Reset_ip_counter_wrong_tcp_ports
    request result Result_Subfunction  # Result Subfunction
      diagnostic-parameter bit-offset=0:
        diagnostic data element Routine_Request_Routine_Results_Response_Reset_ip_counter_wrong_tcp_ports_Routine_Status: base-type=uint8, compu {1=Routine Status: Routine Active (TTR298712), 3=Routine Status: Routine Aborted (TTR298912), 2=Routine Status: Routine not active or finished correctly (TTR298812)}  # Parameters: Routine Status
      diagnostic-parameter bit-offset=8:
        diagnostic data element Routine_Request_Routine_Results_Response_Reset_ip_counter_wrong_tcp_ports_Routine_Results: base-type=uint16, compu {65535=Routine Results: Correct Results (TTR342912), 1=Routine Results: No Results Available (TTR299112), 0=Routine Results: Incorrect Results (TTR343012)}  # Parameters: Routine Results
    start Start_Subfunction  # Start Subfunction
      diagnostic-parameter bit-offset=0:
        diagnostic data element Routine_Start_Routine_Request_Reset_ip_counter_wrong_tcp_ports_Routine_Control_Option: array-size-semantics=FIXED-SIZE, max-number-of-elements=3, base-type=uint8, compu {262144=Routine Control Option: Grundeinstellung (TTR284312)}  # Parameters: Routine Control Option
      diagnostic-parameter bit-offset=0:
        diagnostic data element Routine_Start_Routine_Response_Reset_ip_counter_wrong_tcp_ports_Routine_Status_Routine_Result: base-type=uint8, compu-method=Reset_ip_counter_wrong_tcp_ports/TEXTTABLE_RoutineStatusRoutineResult  # Parameters: Routine Status / Routine Result
    stop Stop_Subfunction  # Stop Subfunction
      diagnostic-parameter bit-offset=0:
        diagnostic data element Routine_Stop_Routine_Response_Reset_ip_counter_wrong_tcp_ports_Routine_Status_Routine_Result: base-type=uint8, compu-method=Reset_ip_counter_wrong_tcp_ports/TEXTTABLE_RoutineStatusRoutineResult  # Parameters: Routine Status / Routine Result
  compu method TEXTTABLE_RoutineStatusRoutineResult: 2=Routine Status: Routine Aborted (TTR615), 4=Routine Status: Routine Finished Correctly (TTR815), 3=Routine Status: Routine Execution Stuck (TTR715), 1=Routine Status: Routine Active (TTR515), 0=Routine Status: Routine Inactive; Routine Result: No Results Available (TTR415TTR117), 16=Routine Result: Incorrect Results (TTR216), 32=Routine Result: Correct Results (TTR316)
  diagnostic routine control RoutineControlResetIpCounterWrongTcpPorts: access-permission=READWRITE0x01DefaultSession0x03ExtendedSession, routine-control-class=Diagnostic_Routine_Control_Class, routine=ResetIpCounterWrongTcpPorts  # RoutineControl_Reset_ip_counter_wrong_tcp_ports
package /ZeC/Routine/SOK_function_deactivation
  diagnostic routine SOKFunctionDeactivation: id=0xc102  # SOK_function_deactivation
    request result Result_Subfunction  # Result Subfunction
      diagnostic-parameter bit-offset=0:
        diagnostic data element Routine_Request_Routine_Results_Response_SOK_function_deactivation_Routine_Status_Routine_Result: base-type=uint8, compu-method=SOK_function_deactivation/TEXTTABLE_RoutineStatusRoutineResult  # Parameters: Routine Status / Routine Result
      diagnostic-parameter bit-offset=8:
        diagnostic data element Routine_Request_Routine_Results_Response_SOK_function_deactivation_SOK_function_requested: base-type=uint8, compu {1=SOK_function_requested: requested_deactivate_sok_function (TTR926811), 0=SOK_function_requested: requested_activate_sok_function (TTR926711)}  # Parameters: SOK_function_requested
      diagnostic-parameter bit-offset=16:
        diagnostic data element Routine_Request_Routine_Results_Response_SOK_function_deactivation_SOK_deactivation_result: base-type=uint8  # Parameters: SOK_deactivation_result
    start Start_Subfunction  # Start Subfunction
      diagnostic-parameter bit-offset=0:
        diagnostic data element Routine_Start_Routine_Request_SOK_function_deactivation_SOK_function: base-type=uint8, compu {1=SOK_function: deactivate_sok_function (TTR926611), 0=SOK_function: activate_sok_function (TTR926511)}  # Parameters: SOK_function
      diagnostic-parameter bit-offset=0:
        diagnostic data element Routine_Start_Routine_Response_SOK_function_deactivation_Routine_Status_Routine_Result: base-type=uint8, compu-method=SOK_function_deactivation/TEXTTABLE_RoutineStatusRoutineResult  # Parameters: Routine Status / Routine Result
  compu method TEXTTABLE_RoutineStatusRoutineResult: 2=Routine Status: Routine Aborted (TTR615), 4=Routine Status: Routine Finished Correctly (TTR815), 3=Routine Status: Routine Execution Stuck (TTR715), 1=Routine Status: Routine Active (TTR515), 0=Routine Status: Routine Inactive; Routine Result: No Results Available (TTR415TTR117), 16=Routine Result: Incorrect Results (TTR216), 32=Routine Result: Correct Results (TTR316)
  diagnostic routine control RoutineControlSOKFunctionDeactivation: access-permission=READWRITEProductionSFDRole0x03ExtendedSession, routine-control-class=Diagnostic_Routine_Control_Class, routine=SOKFunctionDeactivation  # RoutineControl_SOK_function_deactivation
package /ZeC/Routine/Clear_downgrade_protection_data_dk2f
  diagnostic routine ClearDowngradeProtectionDataDk2f: id=0xc100  # Clear_downgrade_protection_data_dk2f
    request result Result_Subfunction  # Result Subfunction
      diagnostic-parameter bit-offset=0:
        diagnostic data element Routine_Request_Routine_Results_Response_Clear_downgrade_protection_data_dk2f_Routine_Status_Routine_Result: base-type=uint8, compu-method=Clear_downgrade_protection_data_dk2f/TEXTTABLE_RoutineStatusRoutineResult  # Parameters: Routine Status / Routine Result
    start Start_Subfunction  # Start Subfunction
    stop Stop_Subfunction  # Stop Subfunction
      diagnostic-parameter bit-offset=0:
        diagnostic data element Routine_Stop_Routine_Response_Clear_downgrade_protection_data_dk2f_Routine_Status_Routine_Result: base-type=uint8, compu-method=Clear_downgrade_protection_data_dk2f/TEXTTABLE_RoutineStatusRoutineResult  # Parameters: Routine Status / Routine Result
  compu method TEXTTABLE_RoutineStatusRoutineResult: 2=Routine Status: Routine Aborted (TTR615), 4=Routine Status: Routine Finished Correctly (TTR815), 3=Routine Status: Routine Execution Stuck (TTR715), 1=Routine Status: Routine Active (TTR515), 0=Routine Status: Routine Inactive; Routine Result: No Results Available (TTR415TTR117), 16=Routine Result: Incorrect Results (TTR216), 32=Routine Result: Correct Results (TTR316)
  diagnostic routine control RoutineControlClearDowngradeProtectionDataDk2f: access-permission=READWRITEExtendedSFDRole0x01DefaultSession0x03ExtendedSession, routine-control-class=Diagnostic_Routine_Control_Class, routine=ClearDowngradeProtectionDataDk2f  # RoutineControl_Clear_downgrade_protection_data_dk2f
package /ZeC/Routine/Verify_partial_software_checksum
  diagnostic routine VerifyPartialSoftwareChecksum: id=0x0544  # Verify_partial_software_checksum
    start Start_Subfunction  # Start Subfunction
      diagnostic-parameter bit-offset=0:
        diagnostic data element Routine_Start_Routine_Request_Verify_partial_software_checksum_Length_Identifier_Checksum_Signature_Length_Ident47D6A48: array-size-semantics=FIXED-SIZE, max-number-of-elements=2, base-type=uint8  # Parameters: Length Identifier - Checksum/Signature / Length Identifier - Memory Address
      diagnostic-parameter bit-offset=16:
        diagnostic data element Routine_Start_Routine_Request_Verify_partial_software_checksum_Memory_Address_Checksum_Signature: array-size-semantics=VARIABLE-SIZE, max-number-of-elements=240, base-type=uint8  # Parameters: Memory Address / Checksum/Signature
      diagnostic-parameter bit-offset=0:
        diagnostic data element Routine_Start_Routine_Response_Verify_partial_software_checksum_Routine_Status: base-type=uint8, compu {0=Routine Status: Correct Result (TTR207613), 1=Routine Status: Incorrect Result (TTR207713)}  # Parameters: Routine Status
  diagnostic routine control RoutineControlVerifyPartialSoftwareChecksum: access-permission=READWRITE0x01DefaultSession0x02ProgrammingSession0x03ExtendedSession, routine-control-class=Diagnostic_Routine_Control_Class, routine=VerifyPartialSoftwareChecksum  # RoutineControl_Verify_partial_software_checksum
package /ZeC/Routine/Erase_Memory
  diagnostic routine EraseMemory: id=0xff00  # Erase Memory
    start Start_Subfunction  # Start Subfunction
      diagnostic-parameter bit-offset=0:
        diagnostic data element Routine_Start_Routine_Request_Erase_Memory_Address_Format_Identifier_Length_Format_Identifier: base-type=uint8  # Parameters: Address Format Identifier / Length Format Identifier
      diagnostic-parameter bit-offset=8:
        diagnostic data element Routine_Start_Routine_Request_Erase_Memory_Memory_Address: array-size-semantics=VARIABLE-SIZE, max-number-of-elements=4, base-type=uint8  # Parameters: Memory Address
      diagnostic-parameter bit-offset=0:
        diagnostic data element Routine_Start_Routine_Response_Erase_Memory_Routine_status: base-type=uint8, compu {0=Routine status: Correct Result (TTR207613), 1=Routine status: Incorrect Result (TTR207713), 129=Routine status: Downgrade Protection: Invalid Block-ID Or Invalid Version Number (TTR287012), 128=Routine status: Downgrade Protection: Missing Or Invalid Driver (TTR286912)}  # Parameters: Routine status
  diagnostic routine control RoutineControlEraseMemory: access-permission=READWRITESA11120x02ProgrammingSession, routine-control-class=Diagnostic_Routine_Control_Class, routine=EraseMemory  # RoutineControl_Erase Memory
package /ZeC/Routine/Check_Programming_Dependencies
  diagnostic routine CheckProgrammingDependencies: id=0xff01  # Check Programming Dependencies
    start Start_Subfunction  # Start Subfunction
      diagnostic-parameter bit-offset=0:
        diagnostic data element Routine_Start_Routine_Response_Check_Programming_Dependencies_Routine_Status: base-type=uint8, compu {2=Routine Status: Incorrect Result error SW - HW (TTR226712), 0=Routine Status: Correct Result (TTR207613), 3=Routine Status: Incorrect Result error SW - SW (TTR226812), 1=Routine Status: Incorrect Result (TTR207713), 4=Routine Status: Incorrect Result: One or more data blocks not programmed or programmed incorrectly (TTR226912)}  # Parameters: Routine Status
  diagnostic routine control RoutineControlCheckProgrammingDependencies: access-permission=READWRITESA11120x02ProgrammingSession, routine-control-class=Diagnostic_Routine_Control_Class, routine=CheckProgrammingDependencies  # RoutineControl_Check Programming Dependencies
package /ZeC/Routine/Ethernet_1_gbit_phy_testmode
  diagnostic routine Ethernet1GbitPhyTestmode: id=0xb100  # Ethernet_1_gbit_phy_testmode
    request result Result_Subfunction  # Result Subfunction
      diagnostic-parameter bit-offset=0:
        diagnostic data element Routine_Request_Routine_Results_Response_Ethernet_1_gbit_phy_testmode_Routine_Status: base-type=uint8, compu {1=Routine Status: Routine Active (TTR298712), 3=Routine Status: Routine Aborted (TTR298912), 2=Routine Status: Routine not active or finished correctly (TTR298812)}  # Parameters: Routine Status
      diagnostic-parameter bit-offset=8:
        diagnostic data element Routine_Request_Routine_Results_Response_Ethernet_1_gbit_phy_testmode_Routine_Results: base-type=uint16, compu {1=Routine Results: No Results Available (TTR299112), 65535=Routine Results: Correct Results (TTR342912), 0=Routine Results: Incorrect Results (TTR343012)}  # Parameters: Routine Results
    start Start_Subfunction  # Start Subfunction
      diagnostic-parameter bit-offset=0:
        diagnostic data element Routine_Start_Routine_Request_Ethernet_1_gbit_phy_testmode_Ethernet_1_gbit_phy_testmode:  # Parameters: Ethernet_1_gbit_phy_testmode
          array-size-semantics=FIXED-SIZE
          max-number-of-elements=3
          base-type=uint8
          compu {262151=Ethernet_1_gbit_phy_testmode: Test_Mode_normal_operation_zero_data_pattern (TTR825211), 262146=Ethernet_1_gbit_phy_testmode: Test_Mode_transmit_jitter_master (TTR753211), 262147=Ethernet_1_gbit_phy_testmode: reserved (TTR825311), 262148=Ethernet_1_gbit_phy_testmode: Test_Mode_transmitter_distortion_test (TTR753411), 262150=Ethernet_1_gbit_phy_testmode: Test_mode_transmitter_droop_test (TTR825111), 262144=Ethernet_1_gbit_phy_testmode: Test_Mode_normal_operation (TTR753011), 262149=Ethernet_1_gbit_phy_testmode: Test_Mode_normal_operation_idle_mode (TTR825011), 262145=Ethernet_1_gbit_phy_testmode: Test_Mode_clock_jitter_test (TTR824912)}
      diagnostic-parameter bit-offset=0:
        diagnostic data element Routine_Start_Routine_Response_Ethernet_1_gbit_phy_testmode_Routine_Status_Routine_Result: base-type=uint8, compu-method=Ethernet_1_gbit_phy_testmode/TEXTTABLE_RoutineStatusRoutineResult  # Parameters: Routine Status / Routine Result
    stop Stop_Subfunction  # Stop Subfunction
      diagnostic-parameter bit-offset=0:
        diagnostic data element Routine_Stop_Routine_Response_Ethernet_1_gbit_phy_testmode_Routine_Status_Routine_Result: base-type=uint8, compu-method=Ethernet_1_gbit_phy_testmode/TEXTTABLE_RoutineStatusRoutineResult  # Parameters: Routine Status / Routine Result
  compu method TEXTTABLE_RoutineStatusRoutineResult: 2=Routine Status: Routine Aborted (TTR615), 4=Routine Status: Routine Finished Correctly (TTR815), 3=Routine Status: Routine Execution Stuck (TTR715), 1=Routine Status: Routine Active (TTR515), 0=Routine Status: Routine Inactive; Routine Result: No Results Available (TTR415TTR117), 16=Routine Result: Incorrect Results (TTR216), 32=Routine Result: Correct Results (TTR316)
  diagnostic routine control RoutineControlEthernet1GbitPhyTestmode: access-permission=READWRITE0x03ExtendedSession0x4FDevelopmentSession, routine-control-class=Diagnostic_Routine_Control_Class, routine=Ethernet1GbitPhyTestmode  # RoutineControl_Ethernet_1_gbit_phy_testmode
package /ZeC/Routine/Powerpath_IO_Control
  diagnostic routine PowerpathIOControl: id=0x7a00  # Powerpath IO Control
    request result Result_Subfunction  # Result Subfunction
      diagnostic-parameter bit-offset=0:
        diagnostic data element Routine_Request_Routine_Results_Response_Powerpath_IO_Control_Routine_Status_Routine_Result: base-type=uint8, compu-method=Powerpath_IO_Control/TEXTTABLE_RoutineStatusRoutineResult  # Parameters: Routine Status / Routine Result
      diagnostic-parameter bit-offset=8:
        diagnostic data element Routine_Request_Routine_Results_Response_Powerpath_IO_Control_Routine_Control_Timer_Response: base-type=uint8, compu {49=Routine Control Timer Response: 49 s (TTR412311), 107=Routine Control Timer Response: 107 s (TTR418111), 193=Routine Control Timer Response: 193 s (TTR426711), 219=Routine Control Timer Response: 219 s (TTR429311), 147=Routine Control Timer Response: 147 s (TTR422111), 146=Routine Control Timer Response: 146 s (TTR422011), 149=Routine Control Timer Response: 149 s (TTR422311), 236=Routine Control Timer Response: 236 s (TTR431011), 56=Routine Control Timer Response: 56 s (TTR413011), 40=Routine Control Timer Response: 40 s (TTR411411), 216=Routine Control Timer Response: 216 s (TTR429011), 11=Routine Control Timer Response: 11 s (TTR408511), 97=Routine Control Timer Response: 97 s (TTR417111), 239=Routine Control Timer Response: 239 s (TTR431311), 238=Routine Control Timer Response: 238 s (TTR431211), 223=Routine Control Timer Response: 223 s (TTR429711), 131=Routine Control Timer Response: 131 s (TTR420511), 142=Routine Control Timer Response: 142 s (TTR421611), 16=Routine Control Timer Response: 16 s (TTR409011), 1=Routine Control Timer Response: 1 s (TTR407511), 61=Routine Control Timer Response: 61 s (TTR413511), 249=Routine Control Timer Response: 249 s (TTR432311), 213=Routine Control Timer Response: 213 s (TTR428711), 35=Routine Control Timer Response: 35 s (TTR410911), 196=Routine Control Timer Response: 196 s (TTR427011), 133=Routine Control Timer Response: 133 s (TTR420711), 224=Routine Control Timer Response: 224 s (TTR429811), 98=Routine Control Timer Response: 98 s (TTR417211), 43=Routine Control Timer Response: 43 s (TTR411711), 20=Routine Control Timer Response: 20 s (TTR409411), 200=Routine Control Timer Response: 200 s (TTR427411), 112=Routine Control Timer Response: 112 s (TTR418611), 59=Routine Control Timer Response: 59 s (TTR413311), 2=Routine Control Timer Response: 2 s (TTR407611), 96=Routine Control Timer Response: 96 s (TTR417011), 105=Routine Control Timer Response: 105 s (TTR417911), 166=Routine Control Timer Response: 166 s (TTR424011), 124=Routine Control Timer Response: 124 s (TTR419811), 38=Routine Control Timer Response: 38 s (TTR411211), 221=Routine Control Timer Response: 221 s (TTR429511), 75=Routine Control Timer Response: 75 s (TTR414911), 58=Routine Control Timer Response: 58 s (TTR413211), 108=Routine Control Timer Response: 108 s (TTR418211), 154=Routine Control Timer Response: 154 s (TTR422811), 54=Routine Control Timer Response: 54 s (TTR412811), 177=Routine Control Timer Response: 177 s (TTR425111), 167=Routine Control Timer Response: 167 s (TTR424111), 13=Routine Control Timer Response: 13 s (TTR408711), 90=Routine Control Timer Response: 90 s (TTR416411), 42=Routine Control Timer Response: 42 s (TTR411611), 60=Routine Control Timer Response: 60 s (TTR413411), 110=Routine Control Timer Response: 110 s (TTR418411), 77=Routine Control Timer Response: 77 s (TTR415111), 246=Routine Control Timer Response: 246 s (TTR432011), 10=Routine Control Timer Response: 10 s (TTR408411), 47=Routine Control Timer Response: 47 s (TTR412111), 85=Routine Control Timer Response: 85 s (TTR415911), 24=Routine Control Timer Response: 24 s (TTR409811), 29=Routine Control Timer Response: 29 s (TTR410311), 152=Routine Control Timer Response: 152 s (TTR422611), 168=Routine Control Timer Response: 168 s (TTR424211), 186=Routine Control Timer Response: 186 s (TTR426011), 191=Routine Control Timer Response: 191 s (TTR426511), 171=Routine Control Timer Response: 171 s (TTR424511), 91=Routine Control Timer Response: 91 s (TTR416511), 203=Routine Control Timer Response: 203 s (TTR427711), 104=Routine Control Timer Response: 104 s (TTR417811), 164=Routine Control Timer Response: 164 s (TTR423811), 189=Routine Control Timer Response: 189 s (TTR426311), 109=Routine Control Timer Response: 109 s (TTR418311), 102=Routine Control Timer Response: 102 s (TTR417611), 37=Routine Control Timer Response: 37 s (TTR411111), 95=Routine Control Timer Response: 95 s (TTR416911), 220=Routine Control Timer Response: 220 s (TTR429411), 140=Routine Control Timer Response: 140 s (TTR421411), 68=Routine Control Timer Response: 68 s (TTR414211), 5=Routine Control Timer Response: 5 s (TTR407911), 27=Routine Control Timer Response: 27 s (TTR410111), 89=Routine Control Timer Response: 89 s (TTR416311), 117=Routine Control Timer Response: 117 s (TTR419111), 62=Routine Control Timer Response: 62 s (TTR413611), 128=Routine Control Timer Response: 128 s (TTR420211), 80=Routine Control Timer Response: 80 s (TTR415411), 136=Routine Control Timer Response: 136 s (TTR421011), 8=Routine Control Timer Response: 8 s (TTR408211), 156=Routine Control Timer Response: 156 s (TTR423011), 209=Routine Control Timer Response: 209 s (TTR428311), 184=Routine Control Timer Response: 184 s (TTR425811), 123=Routine Control Timer Response: 123 s (TTR419711), 229=Routine Control Timer Response: 229 s (TTR430311), 28=Routine Control Timer Response: 28 s (TTR410211), 32=Routine Control Timer Response: 32 s (TTR410611), 129=Routine Control Timer Response: 129 s (TTR420311), 18=Routine Control Timer Response: 18 s (TTR409211), 241=Routine Control Timer Response: 241 s (TTR431511), 137=Routine Control Timer Response: 137 s (TTR421111), 179=Routine Control Timer Response: 179 s (TTR425311), 195=Routine Control Timer Response: 195 s (TTR426911), 143=Routine Control Timer Response: 143 s (TTR421711), 53=Routine Control Timer Response: 53 s (TTR412711), 135=Routine Control Timer Response: 135 s (TTR420911), 6=Routine Control Timer Response: 6 s (TTR408011), 103=Routine Control Timer Response: 103 s (TTR417711), 51=Routine Control Timer Response: 51 s (TTR412511), 157=Routine Control Timer Response: 157 s (TTR423111), 17=Routine Control Timer Response: 17 s (TTR409111), 113=Routine Control Timer Response: 113 s (TTR418711), 214=Routine Control Timer Response: 214 s (TTR428811), 19=Routine Control Timer Response: 19 s (TTR409311), 230=Routine Control Timer Response: 230 s (TTR430411), 79=Routine Control Timer Response: 79 s (TTR415311), 232=Routine Control Timer Response: 232 s (TTR430611), 41=Routine Control Timer Response: 41 s (TTR411511), 132=Routine Control Timer Response: 132 s (TTR420611), 245=Routine Control Timer Response: 245 s (TTR431911), 73=Routine Control Timer Response: 73 s (TTR414711), 170=Routine Control Timer Response: 170 s (TTR424411), 66=Routine Control Timer Response: 66 s (TTR414011), 192=Routine Control Timer Response: 192 s (TTR426611), 228=Routine Control Timer Response: 228 s (TTR430211), 153=Routine Control Timer Response: 153 s (TTR422711), 88=Routine Control Timer Response: 88 s (TTR416211), 65=Routine Control Timer Response: 65 s (TTR413911), 45=Routine Control Timer Response: 45 s (TTR411911), 187=Routine Control Timer Response: 187 s (TTR426111), 118=Routine Control Timer Response: 118 s (TTR419211), 206=Routine Control Timer Response: 206 s (TTR428011), 125=Routine Control Timer Response: 125 s (TTR419911), 3=Routine Control Timer Response: 3 s (TTR407711), 163=Routine Control Timer Response: 163 s (TTR423711), 218=Routine Control Timer Response: 218 s (TTR429211), 111=Routine Control Timer Response: 111 s (TTR418511), 173=Routine Control Timer Response: 173 s (TTR424711), 144=Routine Control Timer Response: 144 s (TTR421811), 36=Routine Control Timer Response: 36 s (TTR411011), 242=Routine Control Timer Response: 242 s (TTR431611), 12=Routine Control Timer Response: 12 s (TTR408611), 201=Routine Control Timer Response: 201 s (TTR427511), 204=Routine Control Timer Response: 204 s (TTR427811), 116=Routine Control Timer Response: 116 s (TTR419011), 165=Routine Control Timer Response: 165 s (TTR423911), 84=Routine Control Timer Response: 84 s (TTR415811), 9=Routine Control Timer Response: 9 s (TTR408311), 71=Routine Control Timer Response: 71 s (TTR414511), 22=Routine Control Timer Response: 22 s (TTR409611), 211=Routine Control Timer Response: 211 s (TTR428511), 198=Routine Control Timer Response: 198 s (TTR427211), 33=Routine Control Timer Response: 33 s (TTR410711), 188=Routine Control Timer Response: 188 s (TTR426211), 82=Routine Control Timer Response: 82 s (TTR415611), 130=Routine Control Timer Response: 130 s (TTR420411), 57=Routine Control Timer Response: 57 s (TTR413111), 31=Routine Control Timer Response: 31 s (TTR410511), 202=Routine Control Timer Response: 202 s (TTR427611), 160=Routine Control Timer Response: 160 s (TTR423411), 215=Routine Control Timer Response: 215 s (TTR428911), 93=Routine Control Timer Response: 93 s (TTR416711), 174=Routine Control Timer Response: 174 s (TTR424811), 183=Routine Control Timer Response: 183 s (TTR425711), 240=Routine Control Timer Response: 240 s (TTR431411), 205=Routine Control Timer Response: 205 s (TTR427911), 74=Routine Control Timer Response: 74 s (TTR414811), 14=Routine Control Timer Response: 14 s (TTR408811), 235=Routine Control Timer Response: 235 s (TTR430911), 120=Routine Control Timer Response: 120 s (TTR419411), 178=Routine Control Timer Response: 178 s (TTR425211), 250=Routine Control Timer Response: 250 s (TTR432411), 94=Routine Control Timer Response: 94 s (TTR416811), 70=Routine Control Timer Response: 70 s (TTR414411), 159=Routine Control Timer Response: 159 s (TTR423311), 190=Routine Control Timer Response: 190 s (TTR426411), 72=Routine Control Timer Response: 72 s (TTR414611), 52=Routine Control Timer Response: 52 s (TTR412611), 106=Routine Control Timer Response: 106 s (TTR418011), 25=Routine Control Timer Response: 25 s (TTR409911), 169=Routine Control Timer Response: 169 s (TTR424311), 101=Routine Control Timer Response: 101 s (TTR417511), 212=Routine Control Timer Response: 212 s (TTR428611), 199=Routine Control Timer Response: 199 s (TTR427311), 87=Routine Control Timer Response: 87 s (TTR416111), 67=Routine Control Timer Response: 67 s (TTR414111), 234=Routine Control Timer Response: 234 s (TTR430811), 115=Routine Control Timer Response: 115 s (TTR418911), 194=Routine Control Timer Response: 194 s (TTR426811), 227=Routine Control Timer Response: 227 s (TTR430111), 99=Routine Control Timer Response: 99 s (TTR417311), 210=Routine Control Timer Response: 210 s (TTR428411), 55=Routine Control Timer Response: 55 s (TTR412911), 0=Routine Control Timer Response: 0 s (TTR407411), 148=Routine Control Timer Response: 148 s (TTR422211), 151=Routine Control Timer Response: 151 s (TTR422511), 63=Routine Control Timer Response: 63 s (TTR413711), 119=Routine Control Timer Response: 119 s (TTR419311), 30=Routine Control Timer Response: 30 s (TTR410411), 134=Routine Control Timer Response: 134 s (TTR420811), 237=Routine Control Timer Response: 237 s (TTR431111), 222=Routine Control Timer Response: 222 s (TTR429611), 244=Routine Control Timer Response: 244 s (TTR431811), 64=Routine Control Timer Response: 64 s (TTR413811), 217=Routine Control Timer Response: 217 s (TTR429111), 39=Routine Control Timer Response: 39 s (TTR411311), 92=Routine Control Timer Response: 92 s (TTR416611), 155=Routine Control Timer Response: 155 s (TTR422911), 247=Routine Control Timer Response: 247 s (TTR432111), 126=Routine Control Timer Response: 126 s (TTR420011), 23=Routine Control Timer Response: 23 s (TTR409711), 185=Routine Control Timer Response: 185 s (TTR425911), 69=Routine Control Timer Response: 69 s (TTR414311), 139=Routine Control Timer Response: 139 s (TTR421311), 76=Routine Control Timer Response: 76 s (TTR415011), 121=Routine Control Timer Response: 121 s (TTR419511), 150=Routine Control Timer Response: 150 s (TTR422411), 122=Routine Control Timer Response: 122 s (TTR419611), 100=Routine Control Timer Response: 100 s (TTR417411), 46=Routine Control Timer Response: 46 s (TTR412011), 26=Routine Control Timer Response: 26 s (TTR410011), 81=Routine Control Timer Response: 81 s (TTR415511), 172=Routine Control Timer Response: 172 s (TTR424611), 138=Routine Control Timer Response: 138 s (TTR421211), 78=Routine Control Timer Response: 78 s (TTR415211), 15=Routine Control Timer Response: 15 s (TTR408911), 208=Routine Control Timer Response: 208 s (TTR428211), 7=Routine Control Timer Response: 7 s (TTR408111), 162=Routine Control Timer Response: 162 s (TTR423611), 225=Routine Control Timer Response: 225 s (TTR429911), 175=Routine Control Timer Response: 175 s (TTR424911), 4=Routine Control Timer Response: 4 s (TTR407811), 181=Routine Control Timer Response: 181 s (TTR425511), 83=Routine Control Timer Response: 83 s (TTR415711), 34=Routine Control Timer Response: 34 s (TTR410811), 248=Routine Control Timer Response: 248 s (TTR432211), 255=Routine Control Timer Response: infinite time (TTR432511), 50=Routine Control Timer Response: 50 s (TTR412411), 243=Routine Control Timer Response: 243 s (TTR431711), 176=Routine Control Timer Response: 176 s (TTR425011), 141=Routine Control Timer Response: 141 s (TTR421511), 145=Routine Control Timer Response: 145 s (TTR421911), 158=Routine Control Timer Response: 158 s (TTR423211), 127=Routine Control Timer Response: 127 s (TTR420111), 44=Routine Control Timer Response: 44 s (TTR411811), 197=Routine Control Timer Response: 197 s (TTR427111), 161=Routine Control Timer Response: 161 s (TTR423511), 233=Routine Control Timer Response: 233 s (TTR430711), 231=Routine Control Timer Response: 231 s (TTR430511), 114=Routine Control Timer Response: 114 s (TTR418811), 180=Routine Control Timer Response: 180 s (TTR425411), 226=Routine Control Timer Response: 226 s (TTR430011), 182=Routine Control Timer Response: 182 s (TTR425611), 207=Routine Control Timer Response: 207 s (TTR428111), 21=Routine Control Timer Response: 21 s (TTR409511), 86=Routine Control Timer Response: 86 s (TTR416011), 48=Routine Control Timer Response: 48 s (TTR412211)}  # Parameters: Routine Control Timer Response
      diagnostic-parameter bit-offset=16:
        diagnostic data element Routine_Request_Routine_Results_Response_Powerpath_IO_Control_Project_Specific_Routine_Control_Option_Parameter_1: base-type=uint8, compu-method=TEXTTABLE_ProjectSpecificRoutineControlOptionParameter1  # Parameters: Project Specific Routine Control Option Parameter 1
      diagnostic-parameter bit-offset=24:
        diagnostic data element Routine_Request_Routine_Results_Response_Powerpath_IO_Control_Project_Specific_Routine_Control_Option_Parameter_2: base-type=uint8, compu-method=TEXTTABLE_ProjectSpecificRoutineControlOptionParameter2  # Parameters: Project Specific Routine Control Option Parameter 2
    start Start_Subfunction  # Start Subfunction
      diagnostic-parameter bit-offset=0:
        diagnostic data element Routine_Start_Routine_Request_Powerpath_IO_Control_Routine_Control_Timer_Request: base-type=uint8, compu {6=Routine Control Timer Request: 6 seconds (TTR433111), 4=Routine Control Timer Request: 4 seconds (TTR432911), 56=Routine Control Timer Request: 56 seconds (TTR438111), 26=Routine Control Timer Request: 26 seconds (TTR435111), 38=Routine Control Timer Request: 38 seconds (TTR436311), 39=Routine Control Timer Request: 39 seconds (TTR436411), 46=Routine Control Timer Request: 46 seconds (TTR437111), 42=Routine Control Timer Request: 42 seconds (TTR436711), 50=Routine Control Timer Request: 50 seconds (TTR437511), 14=Routine Control Timer Request: 14 seconds (TTR433911), 36=Routine Control Timer Request: 36 seconds (TTR436111), 2=Routine Control Timer Request: 2 seconds (TTR432711), 27=Routine Control Timer Request: 27 seconds (TTR435211), 24=Routine Control Timer Request: 24 seconds (TTR434911), 35=Routine Control Timer Request: 35 seconds (TTR436011), 23=Routine Control Timer Request: 23 seconds (TTR434811), 43=Routine Control Timer Request: 43 seconds (TTR436811), 49=Routine Control Timer Request: 49 seconds (TTR437411), 54=Routine Control Timer Request: 54 seconds (TTR437911), 120=Routine Control Timer Request: 2 minutes (TTR438611), 58=Routine Control Timer Request: 58 seconds (TTR438311), 33=Routine Control Timer Request: 33 seconds (TTR435811), 28=Routine Control Timer Request: 28 seconds (TTR435311), 44=Routine Control Timer Request: 44 seconds (TTR436911), 57=Routine Control Timer Request: 57 seconds (TTR438211), 52=Routine Control Timer Request: 52 seconds (TTR437711), 32=Routine Control Timer Request: 32 seconds (TTR435711), 13=Routine Control Timer Request: 13 seconds (TTR433811), 21=Routine Control Timer Request: 21 seconds (TTR434611), 22=Routine Control Timer Request: 22 seconds (TTR434711), 30=Routine Control Timer Request: 30 seconds (TTR435511), 17=Routine Control Timer Request: 17 seconds (TTR434211), 25=Routine Control Timer Request: 25 seconds (TTR435011), 255=Routine Control Timer Request: infinite time (TTR432511), 3=Routine Control Timer Request: 3 seconds (TTR432811), 41=Routine Control Timer Request: 41 seconds (TTR436611), 11=Routine Control Timer Request: 11 seconds (TTR433611), 37=Routine Control Timer Request: 37 seconds (TTR436211), 240=Routine Control Timer Request: 4 minutes (TTR438811), 45=Routine Control Timer Request: 45 seconds (TTR437011), 18=Routine Control Timer Request: 18 seconds (TTR434311), 29=Routine Control Timer Request: 29 seconds (TTR435411), 59=Routine Control Timer Request: 59 seconds (TTR438411), 55=Routine Control Timer Request: 55 seconds (TTR438011), 47=Routine Control Timer Request: 47 seconds (TTR437211), 1=Routine Control Timer Request: 1 second (TTR432611), 10=Routine Control Timer Request: 10 seconds (TTR433511), 7=Routine Control Timer Request: 7 seconds (TTR433211), 60=Routine Control Timer Request: 1 minute (TTR438511), 16=Routine Control Timer Request: 16 seconds (TTR434111), 9=Routine Control Timer Request: 9 seconds (TTR433411), 15=Routine Control Timer Request: 15 seconds (TTR434011), 180=Routine Control Timer Request: 3 minutes (TTR438711), 34=Routine Control Timer Request: 34 seconds (TTR435911), 19=Routine Control Timer Request: 19 seconds (TTR434411), 31=Routine Control Timer Request: 31 seconds (TTR435611), 8=Routine Control Timer Request: 8 seconds (TTR433311), 5=Routine Control Timer Request: 5 seconds (TTR433011), 48=Routine Control Timer Request: 48 seconds (TTR437311), 12=Routine Control Timer Request: 12 seconds (TTR433711), 51=Routine Control Timer Request: 51 seconds (TTR437611), 40=Routine Control Timer Request: 40 seconds (TTR436511), 20=Routine Control Timer Request: 20 seconds (TTR434511), 53=Routine Control Timer Request: 53 seconds (TTR437811)}  # Parameters: Routine Control Timer Request
      diagnostic-parameter bit-offset=8:
        diagnostic data element Routine_Start_Routine_Request_Powerpath_IO_Control_Project_Specific_Routine_Control_Option_Parameter_1: base-type=uint8, compu-method=TEXTTABLE_ProjectSpecificRoutineControlOptionParameter1  # Parameters: Project Specific Routine Control Option Parameter 1
      diagnostic-parameter bit-offset=16:
        diagnostic data element Routine_Start_Routine_Request_Powerpath_IO_Control_Project_Specific_Routine_Control_Option_Parameter_2: base-type=uint8, compu-method=TEXTTABLE_ProjectSpecificRoutineControlOptionParameter2  # Parameters: Project Specific Routine Control Option Parameter 2
      diagnostic-parameter bit-offset=0:
        diagnostic data element Routine_Start_Routine_Response_Powerpath_IO_Control_Routine_Status_Routine_Result: base-type=uint8, compu-method=Powerpath_IO_Control/TEXTTABLE_RoutineStatusRoutineResult  # Parameters: Routine Status / Routine Result
    stop Stop_Subfunction  # Stop Subfunction
      diagnostic-parameter bit-offset=0:
        diagnostic data element Routine_Stop_Routine_Response_Powerpath_IO_Control_Routine_Status_Routine_Result: base-type=uint8, compu-method=Powerpath_IO_Control/TEXTTABLE_RoutineStatusRoutineResult  # Parameters: Routine Status / Routine Result
  compu method TEXTTABLE_ProjectSpecificRoutineControlOptionParameter1: 203=Project Specific Routine Control Option Parameter 1: 203 (TTR1026511), 15=Project Specific Routine Control Option Parameter 1: 015 (TTR1007711), 150=Project Specific Routine Control Option Parameter 1: 150 (TTR1021211), 238=Project Specific Routine Control Option Parameter 1: 238 (TTR1030011), 136=Project Specific Routine Control Option Parameter 1: 136 (TTR1019811), 122=Project Specific Routine Control Option Parameter 1: 122 (TTR1018411), 244=Project Specific Routine Control Option Parameter 1: 244 (TTR1030611), 251=Project Specific Routine Control Option Parameter 1: 251 (TTR1031311), 58=Project Specific Routine Control Option Parameter 1: 058 (TTR1012011), 86=Project Specific Routine Control Option Parameter 1: 086 (TTR1014811), 168=Project Specific Routine Control Option Parameter 1: 168 (TTR1023011), 87=Project Specific Routine Control Option Parameter 1: 087 (TTR1014911), 227=Project Specific Routine Control Option Parameter 1: 227 (TTR1028911), 102=Project Specific Routine Control Option Parameter 1: 102 (TTR1016411), 10=Project Specific Routine Control Option Parameter 1: 010 (TTR1007211), 191=Project Specific Routine Control Option Parameter 1: 191 (TTR1025311), 213=Project Specific Routine Control Option Parameter 1: 213 (TTR1027511), 219=Project Specific Routine Control Option Parameter 1: 219 (TTR1028111), 31=Project Specific Routine Control Option Parameter 1: 031 (TTR1009311), 72=Project Specific Routine Control Option Parameter 1: 072 (TTR1013411), 234=Project Specific Routine Control Option Parameter 1: 234 (TTR1029611), 252=Project Specific Routine Control Option Parameter 1: 252 (TTR1031411), 36=Project Specific Routine Control Option Parameter 1: 036 (TTR1009811), 236=Project Specific Routine Control Option Parameter 1: 236 (TTR1029811), 140=Project Specific Routine Control Option Parameter 1: 140 (TTR1020211), 209=Project Specific Routine Control Option Parameter 1: 209 (TTR1027111), 22=Project Specific Routine Control Option Parameter 1: 022 (TTR1008411), 56=Project Specific Routine Control Option Parameter 1: 056 (TTR1011811), 253=Project Specific Routine Control Option Parameter 1: 253 (TTR1031511), 41=Project Specific Routine Control Option Parameter 1: 041 (TTR1010311), 23=Project Specific Routine Control Option Parameter 1: 023 (TTR1008511), 137=Project Specific Routine Control Option Parameter 1: 137 (TTR1019911), 110=Project Specific Routine Control Option Parameter 1: 110 (TTR1017211), 172=Project Specific Routine Control Option Parameter 1: 172 (TTR1023411), 243=Project Specific Routine Control Option Parameter 1: 243 (TTR1030511), 25=Project Specific Routine Control Option Parameter 1: 025 (TTR1008711), 77=Project Specific Routine Control Option Parameter 1: 077 (TTR1013911), 76=Project Specific Routine Control Option Parameter 1: 076 (TTR1013811), 90=Project Specific Routine Control Option Parameter 1: 090 (TTR1015211), 114=Project Specific Routine Control Option Parameter 1: 114 (TTR1017611), 211=Project Specific Routine Control Option Parameter 1: 211 (TTR1027311), 215=Project Specific Routine Control Option Parameter 1: 215 (TTR1027711), 78=Project Specific Routine Control Option Parameter 1: 078 (TTR1014011), 157=Project Specific Routine Control Option Parameter 1: 157 (TTR1021911), 59=Project Specific Routine Control Option Parameter 1: 059 (TTR1012111), 156=Project Specific Routine Control Option Parameter 1: 156 (TTR1021811), 153=Project Specific Routine Control Option Parameter 1: 153 (TTR1021511), 50=Project Specific Routine Control Option Parameter 1: 050 (TTR1011211), 123=Project Specific Routine Control Option Parameter 1: 123 (TTR1018511), 26=Project Specific Routine Control Option Parameter 1: 026 (TTR1008811), 74=Project Specific Routine Control Option Parameter 1: 074 (TTR1013611), 67=Project Specific Routine Control Option Parameter 1: 067 (TTR1012911), 3=Project Specific Routine Control Option Parameter 1: 003 (TTR1006511), 104=Project Specific Routine Control Option Parameter 1: 104 (TTR1016611), 6=Project Specific Routine Control Option Parameter 1: 006 (TTR1006811), 154=Project Specific Routine Control Option Parameter 1: 154 (TTR1021611), 35=Project Specific Routine Control Option Parameter 1: 035 (TTR1009711), 49=Project Specific Routine Control Option Parameter 1: 049 (TTR1011111), 155=Project Specific Routine Control Option Parameter 1: 155 (TTR1021711), 68=Project Specific Routine Control Option Parameter 1: 068 (TTR1013011), 93=Project Specific Routine Control Option Parameter 1: 093 (TTR1015511), 180=Project Specific Routine Control Option Parameter 1: 180 (TTR1024211), 173=Project Specific Routine Control Option Parameter 1: 173 (TTR1023511), 113=Project Specific Routine Control Option Parameter 1: 113 (TTR1017511), 32=Project Specific Routine Control Option Parameter 1: 032 (TTR1009411), 29=Project Specific Routine Control Option Parameter 1: 029 (TTR1009111), 134=Project Specific Routine Control Option Parameter 1: 134 (TTR1019611), 47=Project Specific Routine Control Option Parameter 1: 047 (TTR1010911), 188=Project Specific Routine Control Option Parameter 1: 188 (TTR1025011), 8=Project Specific Routine Control Option Parameter 1: 008 (TTR1007011), 232=Project Specific Routine Control Option Parameter 1: 232 (TTR1029411), 179=Project Specific Routine Control Option Parameter 1: 179 (TTR1024111), 75=Project Specific Routine Control Option Parameter 1: 075 (TTR1013711), 55=Project Specific Routine Control Option Parameter 1: 055 (TTR1011711), 51=Project Specific Routine Control Option Parameter 1: 051 (TTR1011311), 30=Project Specific Routine Control Option Parameter 1: 030 (TTR1009211), 246=Project Specific Routine Control Option Parameter 1: 246 (TTR1030811), 129=Project Specific Routine Control Option Parameter 1: 129 (TTR1019111), 91=Project Specific Routine Control Option Parameter 1: 091 (TTR1015311), 80=Project Specific Routine Control Option Parameter 1: 080 (TTR1014211), 40=Project Specific Routine Control Option Parameter 1: 040 (TTR1010211), 202=Project Specific Routine Control Option Parameter 1: 202 (TTR1026411), 14=Project Specific Routine Control Option Parameter 1: 014 (TTR1007611), 24=Project Specific Routine Control Option Parameter 1: 024 (TTR1008611), 71=Project Specific Routine Control Option Parameter 1: 071 (TTR1013311), 174=Project Specific Routine Control Option Parameter 1: 174 (TTR1023611), 162=Project Specific Routine Control Option Parameter 1: 162 (TTR1022411), 245=Project Specific Routine Control Option Parameter 1: 245 (TTR1030711), 163=Project Specific Routine Control Option Parameter 1: 163 (TTR1022511), 205=Project Specific Routine Control Option Parameter 1: 205 (TTR1026711), 208=Project Specific Routine Control Option Parameter 1: 208 (TTR1027011), 158=Project Specific Routine Control Option Parameter 1: 158 (TTR1022011), 130=Project Specific Routine Control Option Parameter 1: 130 (TTR1019211), 112=Project Specific Routine Control Option Parameter 1: 112 (TTR1017411), 176=Project Specific Routine Control Option Parameter 1: 176 (TTR1023811), 201=Project Specific Routine Control Option Parameter 1: 201 (TTR1026311), 148=Project Specific Routine Control Option Parameter 1: 148 (TTR1021011), 228=Project Specific Routine Control Option Parameter 1: 228 (TTR1029011), 119=Project Specific Routine Control Option Parameter 1: 119 (TTR1018111), 103=Project Specific Routine Control Option Parameter 1: 103 (TTR1016511), 53=Project Specific Routine Control Option Parameter 1: 053 (TTR1011511), 18=Project Specific Routine Control Option Parameter 1: 018 (TTR1008011), 149=Project Specific Routine Control Option Parameter 1: 149 (TTR1021111), 226=Project Specific Routine Control Option Parameter 1: 226 (TTR1028811), 7=Project Specific Routine Control Option Parameter 1: 007 (TTR1006911), 164=Project Specific Routine Control Option Parameter 1: 164 (TTR1022611), 117=Project Specific Routine Control Option Parameter 1: 117 (TTR1017911), 60=Project Specific Routine Control Option Parameter 1: 060 (TTR1012211), 12=Project Specific Routine Control Option Parameter 1: 012 (TTR1007411), 64=Project Specific Routine Control Option Parameter 1: 064 (TTR1012611), 48=Project Specific Routine Control Option Parameter 1: 048 (TTR1011011), 44=Project Specific Routine Control Option Parameter 1: 044 (TTR1010611), 146=Project Specific Routine Control Option Parameter 1: 146 (TTR1020811), 221=Project Specific Routine Control Option Parameter 1: 221 (TTR1028311), 249=Project Specific Routine Control Option Parameter 1: 249 (TTR1031111), 235=Project Specific Routine Control Option Parameter 1: 235 (TTR1029711), 141=Project Specific Routine Control Option Parameter 1: 141 (TTR1020311), 127=Project Specific Routine Control Option Parameter 1: 127 (TTR1018911), 19=Project Specific Routine Control Option Parameter 1: 019 (TTR1008111), 181=Project Specific Routine Control Option Parameter 1: 181 (TTR1024311), 16=Project Specific Routine Control Option Parameter 1: 016 (TTR1007811), 171=Project Specific Routine Control Option Parameter 1: 171 (TTR1023311), 225=Project Specific Routine Control Option Parameter 1: 225 (TTR1028711), 230=Project Specific Routine Control Option Parameter 1: 230 (TTR1029211), 187=Project Specific Routine Control Option Parameter 1: 187 (TTR1024911), 237=Project Specific Routine Control Option Parameter 1: 237 (TTR1029911), 39=Project Specific Routine Control Option Parameter 1: 039 (TTR1010111), 121=Project Specific Routine Control Option Parameter 1: 121 (TTR1018311), 247=Project Specific Routine Control Option Parameter 1: 247 (TTR1030911), 189=Project Specific Routine Control Option Parameter 1: 189 (TTR1025111), 147=Project Specific Routine Control Option Parameter 1: 147 (TTR1020911), 88=Project Specific Routine Control Option Parameter 1: 088 (TTR1015011), 240=Project Specific Routine Control Option Parameter 1: 240 (TTR1030211), 100=Project Specific Routine Control Option Parameter 1: 100 (TTR1016211), 207=Project Specific Routine Control Option Parameter 1: 207 (TTR1026911), 175=Project Specific Routine Control Option Parameter 1: 175 (TTR1023711), 21=Project Specific Routine Control Option Parameter 1: 021 (TTR1008311), 109=Project Specific Routine Control Option Parameter 1: 109 (TTR1017111), 212=Project Specific Routine Control Option Parameter 1: 212 (TTR1027411), 239=Project Specific Routine Control Option Parameter 1: 239 (TTR1030111), 34=Project Specific Routine Control Option Parameter 1: 034 (TTR1009611), 120=Project Specific Routine Control Option Parameter 1: 120 (TTR1018211), 233=Project Specific Routine Control Option Parameter 1: 233 (TTR1029511), 89=Project Specific Routine Control Option Parameter 1: 089 (TTR1015111), 42=Project Specific Routine Control Option Parameter 1: 042 (TTR1010411), 183=Project Specific Routine Control Option Parameter 1: 183 (TTR1024511), 143=Project Specific Routine Control Option Parameter 1: 143 (TTR1020511), 124=Project Specific Routine Control Option Parameter 1: 124 (TTR1018611), 142=Project Specific Routine Control Option Parameter 1: 142 (TTR1020411), 248=Project Specific Routine Control Option Parameter 1: 248 (TTR1031011), 98=Project Specific Routine Control Option Parameter 1: 098 (TTR1016011), 223=Project Specific Routine Control Option Parameter 1: 223 (TTR1028511), 96=Project Specific Routine Control Option Parameter 1: 096 (TTR1015811), 242=Project Specific Routine Control Option Parameter 1: 242 (TTR1030411), 204=Project Specific Routine Control Option Parameter 1: 204 (TTR1026611), 27=Project Specific Routine Control Option Parameter 1: 027 (TTR1008911), 199=Project Specific Routine Control Option Parameter 1: 199 (TTR1026111), 97=Project Specific Routine Control Option Parameter 1: 097 (TTR1015911), 185=Project Specific Routine Control Option Parameter 1: 185 (TTR1024711), 250=Project Specific Routine Control Option Parameter 1: 250 (TTR1031211), 177=Project Specific Routine Control Option Parameter 1: 177 (TTR1023911), 222=Project Specific Routine Control Option Parameter 1: 222 (TTR1028411), 63=Project Specific Routine Control Option Parameter 1: 063 (TTR1012511), 220=Project Specific Routine Control Option Parameter 1: 220 (TTR1028211), 169=Project Specific Routine Control Option Parameter 1: 169 (TTR1023111), 9=Project Specific Routine Control Option Parameter 1: 009 (TTR1007111), 85=Project Specific Routine Control Option Parameter 1: 085 (TTR1014711), 184=Project Specific Routine Control Option Parameter 1: 184 (TTR1024611), 111=Project Specific Routine Control Option Parameter 1: 111 (TTR1017311), 105=Project Specific Routine Control Option Parameter 1: 105 (TTR1016711), 152=Project Specific Routine Control Option Parameter 1: 152 (TTR1021411), 83=Project Specific Routine Control Option Parameter 1: 083 (TTR1014511), 2=Project Specific Routine Control Option Parameter 1: 002 (TTR1006411), 108=Project Specific Routine Control Option Parameter 1: 108 (TTR1017011), 73=Project Specific Routine Control Option Parameter 1: 073 (TTR1013511), 195=Project Specific Routine Control Option Parameter 1: 195 (TTR1025711), 167=Project Specific Routine Control Option Parameter 1: 167 (TTR1022911), 17=Project Specific Routine Control Option Parameter 1: 017 (TTR1007911), 116=Project Specific Routine Control Option Parameter 1: 116 (TTR1017811), 218=Project Specific Routine Control Option Parameter 1: 218 (TTR1028011), 231=Project Specific Routine Control Option Parameter 1: 231 (TTR1029311), 57=Project Specific Routine Control Option Parameter 1: 057 (TTR1011911), 151=Project Specific Routine Control Option Parameter 1: 151 (TTR1021311), 192=Project Specific Routine Control Option Parameter 1: 192 (TTR1025411), 84=Project Specific Routine Control Option Parameter 1: 084 (TTR1014611), 161=Project Specific Routine Control Option Parameter 1: 161 (TTR1022311), 5=Project Specific Routine Control Option Parameter 1: 005 (TTR1006711), 132=Project Specific Routine Control Option Parameter 1: 132 (TTR1019411), 166=Project Specific Routine Control Option Parameter 1: 166 (TTR1022811), 210=Project Specific Routine Control Option Parameter 1: 210 (TTR1027211), 229=Project Specific Routine Control Option Parameter 1: 229 (TTR1029111), 198=Project Specific Routine Control Option Parameter 1: 198 (TTR1026011), 107=Project Specific Routine Control Option Parameter 1: 107 (TTR1016911), 46=Project Specific Routine Control Option Parameter 1: 046 (TTR1010811), 144=Project Specific Routine Control Option Parameter 1: 144 (TTR1020611), 178=Project Specific Routine Control Option Parameter 1: 178 (TTR1024011), 165=Project Specific Routine Control Option Parameter 1: 165 (TTR1022711), 133=Project Specific Routine Control Option Parameter 1: 133 (TTR1019511), 61=Project Specific Routine Control Option Parameter 1: 061 (TTR1012311), 38=Project Specific Routine Control Option Parameter 1: 038 (TTR1010011), 69=Project Specific Routine Control Option Parameter 1: 069 (TTR1013111), 145=Project Specific Routine Control Option Parameter 1: 145 (TTR1020711), 11=Project Specific Routine Control Option Parameter 1: 011 (TTR1007311), 1=Project Specific Routine Control Option Parameter 1: 001 (TTR1006311), 101=Project Specific Routine Control Option Parameter 1: 101 (TTR1016311), 214=Project Specific Routine Control Option Parameter 1: 214 (TTR1027611), 200=Project Specific Routine Control Option Parameter 1: 200 (TTR1026211), 81=Project Specific Routine Control Option Parameter 1: 081 (TTR1014311), 217=Project Specific Routine Control Option Parameter 1: 217 (TTR1027911), 241=Project Specific Routine Control Option Parameter 1: 241 (TTR1030311), 99=Project Specific Routine Control Option Parameter 1: 099 (TTR1016111), 95=Project Specific Routine Control Option Parameter 1: 095 (TTR1015711), 94=Project Specific Routine Control Option Parameter 1: 094 (TTR1015611), 37=Project Specific Routine Control Option Parameter 1: 037 (TTR1009911), 66=Project Specific Routine Control Option Parameter 1: 066 (TTR1012811), 126=Project Specific Routine Control Option Parameter 1: 126 (TTR1018811), 160=Project Specific Routine Control Option Parameter 1: 160 (TTR1022211), 54=Project Specific Routine Control Option Parameter 1: 054 (TTR1011611), 206=Project Specific Routine Control Option Parameter 1: 206 (TTR1026811), 194=Project Specific Routine Control Option Parameter 1: 194 (TTR1025611), 65=Project Specific Routine Control Option Parameter 1: 065 (TTR1012711), 115=Project Specific Routine Control Option Parameter 1: 115 (TTR1017711), 190=Project Specific Routine Control Option Parameter 1: 190 (TTR1025211), 4=Project Specific Routine Control Option Parameter 1: 004 (TTR1006611), 20=Project Specific Routine Control Option Parameter 1: 020 (TTR1008211), 135=Project Specific Routine Control Option Parameter 1: 135 (TTR1019711), 43=Project Specific Routine Control Option Parameter 1: 043 (TTR1010511), 106=Project Specific Routine Control Option Parameter 1: 106 (TTR1016811), 45=Project Specific Routine Control Option Parameter 1: 045 (TTR1010711), 13=Project Specific Routine Control Option Parameter 1: 013 (TTR1007511), 193=Project Specific Routine Control Option Parameter 1: 193 (TTR1025511), 131=Project Specific Routine Control Option Parameter 1: 131 (TTR1019311), 128=Project Specific Routine Control Option Parameter 1: 128 (TTR1019011), 28=Project Specific Routine Control Option Parameter 1: 028 (TTR1009011), 118=Project Specific Routine Control Option Parameter 1: 118 (TTR1018011), 182=Project Specific Routine Control Option Parameter 1: 182 (TTR1024411), 159=Project Specific Routine Control Option Parameter 1: 159 (TTR1022111), 52=Project Specific Routine Control Option Parameter 1: 052 (TTR1011411), 196=Project Specific Routine Control Option Parameter 1: 196 (TTR1025811), 139=Project Specific Routine Control Option Parameter 1: 139 (TTR1020111), 33=Project Specific Routine Control Option Parameter 1: 033 (TTR1009511), 224=Project Specific Routine Control Option Parameter 1: 224 (TTR1028611), 79=Project Specific Routine Control Option Parameter 1: 079 (TTR1014111), 82=Project Specific Routine Control Option Parameter 1: 082 (TTR1014411), 0=Project Specific Routine Control Option Parameter 1: Not assigned (TTR1006211), 62=Project Specific Routine Control Option Parameter 1: 062 (TTR1012411), 186=Project Specific Routine Control Option Parameter 1: 186 (TTR1024811), 216=Project Specific Routine Control Option Parameter 1: 216 (TTR1027811), 92=Project Specific Routine Control Option Parameter 1: 092 (TTR1015411), 197=Project Specific Routine Control Option Parameter 1: 197 (TTR1025911), 255=Project Specific Routine Control Option Parameter 1: All (TTR1031712), 254=Project Specific Routine Control Option Parameter 1: 254 (TTR1031611), 70=Project Specific Routine Control Option Parameter 1: 070 (TTR1013211), 125=Project Specific Routine Control Option Parameter 1: 125 (TTR1018711), 170=Project Specific Routine Control Option Parameter 1: 170 (TTR1023211), 138=Project Specific Routine Control Option Parameter 1: 138 (TTR1020011)
  compu method TEXTTABLE_ProjectSpecificRoutineControlOptionParameter2: 2=Project Specific Routine Control Option Parameter 2: Reserved (TTR1038011), 1=Project Specific Routine Control Option Parameter 2: Activate (TTR939211), 0=Project Specific Routine Control Option Parameter 2: Deactivate (TTR939311)
  compu method TEXTTABLE_RoutineStatusRoutineResult: 5=Routine Status: Routine Returned To ECU Control (TTR913), 2=Routine Status: Routine Aborted (TTR615), 4=Routine Status: Routine Finished Correctly (TTR815), 3=Routine Status: Routine Execution Stuck (TTR715), 1=Routine Status: Routine Active (TTR515), 0=Routine Status: Routine Inactive; Routine Result: No Results Available (TTR415TTR117), 16=Routine Result: Incorrect Results (TTR216), 32=Routine Result: Correct Results (TTR316)
  diagnostic routine control RoutineControlPowerpathIOControl: access-permission=READWRITEBasicSFDRole0x03ExtendedSession, routine-control-class=Diagnostic_Routine_Control_Class, routine=PowerpathIOControl  # RoutineControl_Powerpath IO Control
package /ZeC/Routine/Reset_ip_counter_wrong_udp_ports
  diagnostic routine ResetIpCounterWrongUdpPorts: id=0x05eb  # Reset_ip_counter_wrong_udp_ports
    request result Result_Subfunction  # Result Subfunction
      diagnostic-parameter bit-offset=0:
        diagnostic data element Routine_Request_Routine_Results_Response_Reset_ip_counter_wrong_udp_ports_Routine_Status: base-type=uint8, compu {1=Routine Status: Routine Active (TTR298712), 3=Routine Status: Routine Aborted (TTR298912), 2=Routine Status: Routine not active or finished correctly (TTR298812)}  # Parameters: Routine Status
      diagnostic-parameter bit-offset=8:
        diagnostic data element Routine_Request_Routine_Results_Response_Reset_ip_counter_wrong_udp_ports_Routine_Results: base-type=uint16, compu {65535=Routine Results: Correct Results (TTR342912), 1=Routine Results: No Results Available (TTR299112), 0=Routine Results: Incorrect Results (TTR343012)}  # Parameters: Routine Results
    start Start_Subfunction  # Start Subfunction
      diagnostic-parameter bit-offset=0:
        diagnostic data element Routine_Start_Routine_Request_Reset_ip_counter_wrong_udp_ports_Routine_Control_Option: array-size-semantics=FIXED-SIZE, max-number-of-elements=3, base-type=uint8, compu {262144=Routine Control Option: Grundeinstellung (TTR284312)}  # Parameters: Routine Control Option
      diagnostic-parameter bit-offset=0:
        diagnostic data element Routine_Start_Routine_Response_Reset_ip_counter_wrong_udp_ports_Routine_Status_Routine_Result: base-type=uint8, compu-method=Reset_ip_counter_wrong_udp_ports/TEXTTABLE_RoutineStatusRoutineResult  # Parameters: Routine Status / Routine Result
    stop Stop_Subfunction  # Stop Subfunction
      diagnostic-parameter bit-offset=0:
        diagnostic data element Routine_Stop_Routine_Response_Reset_ip_counter_wrong_udp_ports_Routine_Status_Routine_Result: base-type=uint8, compu-method=Reset_ip_counter_wrong_udp_ports/TEXTTABLE_RoutineStatusRoutineResult  # Parameters: Routine Status / Routine Result
  compu method TEXTTABLE_RoutineStatusRoutineResult: 2=Routine Status: Routine Aborted (TTR615), 4=Routine Status: Routine Finished Correctly (TTR815), 3=Routine Status: Routine Execution Stuck (TTR715), 1=Routine Status: Routine Active (TTR515), 0=Routine Status: Routine Inactive; Routine Result: No Results Available (TTR415TTR117), 16=Routine Result: Incorrect Results (TTR216), 32=Routine Result: Correct Results (TTR316)
  diagnostic routine control RoutineControlResetIpCounterWrongUdpPorts: access-permission=READWRITE0x01DefaultSession0x03ExtendedSession, routine-control-class=Diagnostic_Routine_Control_Class, routine=ResetIpCounterWrongUdpPorts  # RoutineControl_Reset_ip_counter_wrong_udp_ports
package /ZeC/Routine/Check_upload_preconditions
  diagnostic routine CheckUploadPreconditions: id=0x0594  # Check_upload_preconditions
    start Start_Subfunction  # Start Subfunction
      diagnostic-parameter bit-offset=0:
        diagnostic data element Routine_Start_Routine_Request_Check_upload_preconditions_Data_Block_ID: base-type=uint16, compu {30208=Data Block ID: Data_block_1 (TTR446812)}  # Parameters: Data Block ID
      diagnostic-parameter bit-offset=0:
        diagnostic data element Routine_Start_Routine_Response_Check_upload_preconditions_Data_Block_ID: base-type=uint16, compu {30208=Data Block ID: Data_block_1 (TTR446812)}  # Parameters: Data Block ID
      diagnostic-parameter bit-offset=16:
        diagnostic data element Routine_Start_Routine_Response_Check_upload_preconditions_Encryption_Method_Compression_Method: base-type=uint8, compu {0=Encryption Method: Unencrypted; Compression Method: Uncompressed (TTR234712TTR236312)}  # Parameters: Encryption Method / Compression Method
      diagnostic-parameter bit-offset=24:
        diagnostic data element Routine_Start_Routine_Response_Check_upload_preconditions_Memory_Size: base-type=uint32  # Parameters: Memory Size
      diagnostic-parameter bit-offset=56:
        diagnostic data element Routine_Start_Routine_Response_Check_upload_preconditions_Number_Of_Preconditions: base-type=uint8  # Parameters: Number Of Preconditions
      diagnostic-parameter bit-offset=64:
        diagnostic data element Routine_Start_Routine_Response_Check_upload_preconditions_Upload_Precondition: base-type=uint8, compu {1=Upload Precondition: Engine speed non-zero (TTR202613), 5=Upload Precondition: Vehicle speed non-zero (TTR203013)}  # Parameters: Upload Precondition
  diagnostic routine control RoutineControlCheckUploadPreconditions: access-permission=READWRITE0x03ExtendedSession, routine-control-class=Diagnostic_Routine_Control_Class, routine=CheckUploadPreconditions  # RoutineControl_Check_upload_preconditions
package /ZeC/services
  diagnostic clear diagnostic information CLEAR_DIAGNOSTIC_INFORMATION: access-permission=READ0x01DefaultSession0x02ECUProgrammingSession0x03ExtendedSession, clear-diagnostic-information-class=CLEAR_DIAGNOSTIC_INFORMATION_CLASS
  diagnostic clear diagnostic information class CLEAR_DIAGNOSTIC_INFORMATION_CLASS: access-permission-validity=ACCESS-PERMISSION-SERVICE-INSTANCE
  6 x diagnostic com control, all with access-permission=READ0x01DefaultSession0x02ECUProgrammingSession0x03ExtendedSession, com-control-class=COM_CONTROL_CLASS:
    COM_CONTROL_ENABLE_RX_AND_TX: category=ENABLE_RX_AND_TX
    COM_CONTROL_DISABLE_RX_AND_TX: category=DISABLE_RX_AND_TX
    COM_CONTROL_ENABLE_RX_AND_DISABLE_TX: category=ENABLE_RX_AND_DISABLE_TX
    COM_CONTROL_DISABLE_RX_AND_ENABLE_TX: category=DISABLE_RX_AND_ENABLE_TX
    COM_CONTROL_ENABLE_RX_AND_DISABLE_TX_WITH_ENHANCED_ADDRESS_INFORMATION: category=ENABLE_RX_AND_DISABLE_TX_WITH_ENHANCED_ADDRESS_INFORMATION
    COM_CONTROL_ENABLE_RX_AND_TX_WITH_ENHANCED_ADDRESS_INFORMATION: category=ENABLE_RX_AND_TX_WITH_ENHANCED_ADDRESS_INFORMATION
  diagnostic com control class COM_CONTROL_CLASS: access-permission-validity=ACCESS-PERMISSION-SERVICE-INSTANCE
  diagnostic control dtc setting CONTROL_DTC_SETTING_ENABLE: category=ENABLE, access-permission=READ0x01DefaultSession0x02ECUProgrammingSession0x03ExtendedSession, dtc-setting-class=CONTROL_DTC_SETTING_CLASS, dtc-setting-parameter=1
  diagnostic control dtc setting CONTROL_DTC_SETTING_DISABLE: category=DISABLE, access-permission=READ0x01DefaultSession0x02ECUProgrammingSession0x03ExtendedSession, dtc-setting-class=CONTROL_DTC_SETTING_CLASS, dtc-setting-parameter=2
  diagnostic control dtc setting class CONTROL_DTC_SETTING_CLASS: access-permission-validity=ACCESS-PERMISSION-SERVICE-INSTANCE
  diagnostic data transfer DATA_TRANSFER: access-permission=READ0x02ECUProgrammingSession, data-transfer-class=DATA_TRANSFER_CLASS
  diagnostic data transfer class DATA_TRANSFER_CLASS: access-permission-validity=ACCESS-PERMISSION-SERVICE-INSTANCE
  diagnostic ecu reset ECU_RESET_HARD_RESET: category=HARD_RESET, access-permission=READ0x01DefaultSession0x02ECUProgrammingSession0x03ExtendedSession, ecu-reset-class=ECU_RESET_CLASS, respond-to-reset=RESPOND-BEFORE-RESET
  diagnostic ecu reset ECU_RESET_KEY_OFF_ON_RESET: category=KEY_OFF_ON_RESET, access-permission=READ0x01DefaultSession0x02ECUProgrammingSession0x03ExtendedSession, ecu-reset-class=ECU_RESET_CLASS, respond-to-reset=RESPOND-BEFORE-RESET
  diagnostic ecu reset ECU_RESET_SOFT_RESET: category=SOFT_RESET, access-permission=READ0x01DefaultSession0x02ECUProgrammingSession0x03ExtendedSession, ecu-reset-class=ECU_RESET_CLASS, respond-to-reset=RESPOND-BEFORE-RESET
  diagnostic ecu reset class ECU_RESET_CLASS: access-permission-validity=ACCESS-PERMISSION-SERVICE-INSTANCE
  diagnostic read dtc information READ_DTC_INFORMATION_REPORT_DTC_BY_STATUS_MASK: category=REPORT_DTC_BY_STATUS_MASK, access-permission=READ0x01DefaultSession0x02ECUProgrammingSession0x03ExtendedSession, read-dtc-information-class=READ_DTC_INFORMATION_CLASS
  diagnostic read dtc information READ_DTC_INFORMATION_REPORT_DTC_EXT_DATA_RECORD_BY_DTC_NUMBER: category=REPORT_DTC_EXT_DATA_RECORD_BY_DTC_NUMBER, access-permission=READ0x01DefaultSession0x02ECUProgrammingSession0x03ExtendedSession, read-dtc-information-class=READ_DTC_INFORMATION_CLASS
  diagnostic read dtc information class READ_DTC_INFORMATION_CLASS: access-permission-validity=ACCESS-PERMISSION-SERVICE-INSTANCE
  diagnostic request download REQUEST_DOWNLOAD: access-permission=READ0x02ECUProgrammingSession, request-download-class=REQUEST_DOWNLOAD_CLASS
  diagnostic request download class REQUEST_DOWNLOAD_CLASS: access-permission-validity=ACCESS-PERMISSION-SERVICE-INSTANCE
  diagnostic transfer exit TRANSFER_EXIT: access-permission=READ0x02ECUProgrammingSession, transfer-exit-class=TRANSFER_EXIT_CLASS
  diagnostic transfer exit class TRANSFER_EXIT_CLASS: access-permission-validity=ACCESS-PERMISSION-SERVICE-INSTANCE
