[part 17 of 19: packages /ZeC/DTC/DTC/Power_Path_007_Short_to_BAT_Failure to /ZeC/DTC/DTC/LIN_23_Slave_12_Defect]
AUTOSAR XML (schema 00047)
package /ZeC/DTC/DTC/Power_Path_007_Short_to_BAT_Failure
  diagnostic trouble code uds Power_Path_007_Short_to_BAT_Failure: dtc-props=Dtc_Props_28d17a09, uds-dtc-value=0x005107
  diagnostic event EventPowerPath007ShortToBATFailure: aging-allowed=true, event-kind=SWC, prestorage-freeze-frame=false  # Event_Power_Path_007_Short_to_BAT_Failure
  diagnostic event to trouble code uds mapping EventDtcMapPowerPath007ShortToBATFailure: diagnostic-event=EventPowerPath007ShortToBATFailure, trouble-code-uds=Power_Path_007_Short_to_BAT_Failure  # Event_Dtc_Map_Power_Path_007_Short_to_BAT_Failure
  diagnostic event to operation cycle mapping EventOperCycleMapPowerPath007ShortToBATFailure: diagnostic-event=EventPowerPath007ShortToBATFailure, operation-cycle=DefaultOperationCycle  # Event_Oper_Cycle_Map_Power_Path_007_Short_to_BAT_Failure
  diagnostic event to debounce algorithm mapping EventDebounceMapPowerPath007ShortToBATFailure: debounce-algorithm=time_based, diagnostic-event=EventPowerPath007ShortToBATFailure  # EventDebounceMap_Power_Path_007_Short_to_BAT_Failure
package /ZeC/DTC/DTC/Power_Path_006_Short_to_BAT_Failure
  diagnostic trouble code uds Power_Path_006_Short_to_BAT_Failure: dtc-props=Dtc_Props_6ec87033, uds-dtc-value=0x005106
  diagnostic event EventPowerPath006ShortToBATFailure: aging-allowed=true, event-kind=SWC, prestorage-freeze-frame=false  # Event_Power_Path_006_Short_to_BAT_Failure
  diagnostic event to trouble code uds mapping EventDtcMapPowerPath006ShortToBATFailure: diagnostic-event=EventPowerPath006ShortToBATFailure, trouble-code-uds=Power_Path_006_Short_to_BAT_Failure  # Event_Dtc_Map_Power_Path_006_Short_to_BAT_Failure
  diagnostic event to operation cycle mapping EventOperCycleMapPowerPath006ShortToBATFailure: diagnostic-event=EventPowerPath006ShortToBATFailure, operation-cycle=DefaultOperationCycle  # Event_Oper_Cycle_Map_Power_Path_006_Short_to_BAT_Failure
  diagnostic event to debounce algorithm mapping EventDebounceMapPowerPath006ShortToBATFailure: debounce-algorithm=time_based, diagnostic-event=EventPowerPath006ShortToBATFailure  # EventDebounceMap_Power_Path_006_Short_to_BAT_Failure
package /ZeC/DTC/DTC/Power_Path_142_Over_Load_Failure
  diagnostic trouble code uds Power_Path_142_Over_Load_Failure: dtc-props=Dtc_Props_1dff1085, uds-dtc-value=0x00558e
  diagnostic event EventPowerPath142OverLoadFailure: aging-allowed=true, event-kind=SWC, prestorage-freeze-frame=false  # Event_Power_Path_142_Over_Load_Failure
  diagnostic event to trouble code uds mapping EventDtcMapPowerPath142OverLoadFailure: diagnostic-event=EventPowerPath142OverLoadFailure, trouble-code-uds=Power_Path_142_Over_Load_Failure  # Event_Dtc_Map_Power_Path_142_Over_Load_Failure
  diagnostic event to operation cycle mapping EventOperCycleMapPowerPath142OverLoadFailure: diagnostic-event=EventPowerPath142OverLoadFailure, operation-cycle=DefaultOperationCycle  # Event_Oper_Cycle_Map_Power_Path_142_Over_Load_Failure
  diagnostic event to debounce algorithm mapping EventDebounceMapPowerPath142OverLoadFailure: debounce-algorithm=time_based, diagnostic-event=EventPowerPath142OverLoadFailure  # EventDebounceMap_Power_Path_142_Over_Load_Failure
package /ZeC/DTC/DTC/Power_Path_010_Short_to_BAT_Failure
  diagnostic trouble code uds Power_Path_010_Short_to_BAT_Failure: dtc-props=Dtc_Props_5a0924a9, uds-dtc-value=0x00510a
  diagnostic event EventPowerPath010ShortToBATFailure: aging-allowed=true, event-kind=SWC, prestorage-freeze-frame=false  # Event_Power_Path_010_Short_to_BAT_Failure
  diagnostic event to trouble code uds mapping EventDtcMapPowerPath010ShortToBATFailure: diagnostic-event=EventPowerPath010ShortToBATFailure, trouble-code-uds=Power_Path_010_Short_to_BAT_Failure  # Event_Dtc_Map_Power_Path_010_Short_to_BAT_Failure
  diagnostic event to operation cycle mapping EventOperCycleMapPowerPath010ShortToBATFailure: diagnostic-event=EventPowerPath010ShortToBATFailure, operation-cycle=DefaultOperationCycle  # Event_Oper_Cycle_Map_Power_Path_010_Short_to_BAT_Failure
  diagnostic event to debounce algorithm mapping EventDebounceMapPowerPath010ShortToBATFailure: debounce-algorithm=time_based, diagnostic-event=EventPowerPath010ShortToBATFailure  # EventDebounceMap_Power_Path_010_Short_to_BAT_Failure
package /ZeC/DTC/DTC/Power_Path_141_Over_Load_Failure
  diagnostic trouble code uds Power_Path_141_Over_Load_Failure: dtc-props=Dtc_Props_5be61abf, uds-dtc-value=0x00558d
  diagnostic event EventPowerPath141OverLoadFailure: aging-allowed=true, event-kind=SWC, prestorage-freeze-frame=false  # Event_Power_Path_141_Over_Load_Failure
  diagnostic event to trouble code uds mapping EventDtcMapPowerPath141OverLoadFailure: diagnostic-event=EventPowerPath141OverLoadFailure, trouble-code-uds=Power_Path_141_Over_Load_Failure  # Event_Dtc_Map_Power_Path_141_Over_Load_Failure
  diagnostic event to operation cycle mapping EventOperCycleMapPowerPath141OverLoadFailure: diagnostic-event=EventPowerPath141OverLoadFailure, operation-cycle=DefaultOperationCycle  # Event_Oper_Cycle_Map_Power_Path_141_Over_Load_Failure
  diagnostic event to debounce algorithm mapping EventDebounceMapPowerPath141OverLoadFailure: debounce-algorithm=time_based, diagnostic-event=EventPowerPath141OverLoadFailure  # EventDebounceMap_Power_Path_141_Over_Load_Failure
package /ZeC/DTC/DTC/Power_Path_012_Short_to_BAT_Failure
  diagnostic trouble code uds Power_Path_012_Short_to_BAT_Failure: dtc-props=Dtc_Props_d63b30dd, uds-dtc-value=0x00510c
  diagnostic event EventPowerPath012ShortToBATFailure: aging-allowed=true, event-kind=SWC, prestorage-freeze-frame=false  # Event_Power_Path_012_Short_to_BAT_Failure
  diagnostic event to trouble code uds mapping EventDtcMapPowerPath012ShortToBATFailure: diagnostic-event=EventPowerPath012ShortToBATFailure, trouble-code-uds=Power_Path_012_Short_to_BAT_Failure  # Event_Dtc_Map_Power_Path_012_Short_to_BAT_Failure
  diagnostic event to operation cycle mapping EventOperCycleMapPowerPath012ShortToBATFailure: diagnostic-event=EventPowerPath012ShortToBATFailure, operation-cycle=DefaultOperationCycle  # Event_Oper_Cycle_Map_Power_Path_012_Short_to_BAT_Failure
  diagnostic event to debounce algorithm mapping EventDebounceMapPowerPath012ShortToBATFailure: debounce-algorithm=time_based, diagnostic-event=EventPowerPath012ShortToBATFailure  # EventDebounceMap_Power_Path_012_Short_to_BAT_Failure
package /ZeC/DTC/DTC/Power_Path_143_Over_Load_Failure
  diagnostic trouble code uds Power_Path_143_Over_Load_Failure: dtc-props=Dtc_Props_d7d40ecb, uds-dtc-value=0x00558f
  diagnostic event EventPowerPath143OverLoadFailure: aging-allowed=true, event-kind=SWC, prestorage-freeze-frame=false  # Event_Power_Path_143_Over_Load_Failure
  diagnostic event to trouble code uds mapping EventDtcMapPowerPath143OverLoadFailure: diagnostic-event=EventPowerPath143OverLoadFailure, trouble-code-uds=Power_Path_143_Over_Load_Failure  # Event_Dtc_Map_Power_Path_143_Over_Load_Failure
  diagnostic event to operation cycle mapping EventOperCycleMapPowerPath143OverLoadFailure: diagnostic-event=EventPowerPath143OverLoadFailure, operation-cycle=DefaultOperationCycle  # Event_Oper_Cycle_Map_Power_Path_143_Over_Load_Failure
  diagnostic event to debounce algorithm mapping EventDebounceMapPowerPath143OverLoadFailure: debounce-algorithm=time_based, diagnostic-event=EventPowerPath143OverLoadFailure  # EventDebounceMap_Power_Path_143_Over_Load_Failure
package /ZeC/DTC/DTC/Power_Path_011_Short_to_BAT_Failure
  diagnostic trouble code uds Power_Path_011_Short_to_BAT_Failure: dtc-props=Dtc_Props_90223ae7, uds-dtc-value=0x00510b
  diagnostic event EventPowerPath011ShortToBATFailure: aging-allowed=true, event-kind=SWC, prestorage-freeze-frame=false  # Event_Power_Path_011_Short_to_BAT_Failure
  diagnostic event to trouble code uds mapping EventDtcMapPowerPath011ShortToBATFailure: diagnostic-event=EventPowerPath011ShortToBATFailure, trouble-code-uds=Power_Path_011_Short_to_BAT_Failure  # Event_Dtc_Map_Power_Path_011_Short_to_BAT_Failure
  diagnostic event to operation cycle mapping EventOperCycleMapPowerPath011ShortToBATFailure: diagnostic-event=EventPowerPath011ShortToBATFailure, operation-cycle=DefaultOperationCycle  # Event_Oper_Cycle_Map_Power_Path_011_Short_to_BAT_Failure
  diagnostic event to debounce algorithm mapping EventDebounceMapPowerPath011ShortToBATFailure: debounce-algorithm=time_based, diagnostic-event=EventPowerPath011ShortToBATFailure  # EventDebounceMap_Power_Path_011_Short_to_BAT_Failure
package /ZeC/DTC/DTC/Power_Path_138_Over_Load_Failure
  diagnostic trouble code uds Power_Path_138_Over_Load_Failure: dtc-props=Dtc_Props_deea3e2c, uds-dtc-value=0x00558a
  diagnostic event EventPowerPath138OverLoadFailure: aging-allowed=true, event-kind=SWC, prestorage-freeze-frame=false  # Event_Power_Path_138_Over_Load_Failure
  diagnostic event to trouble code uds mapping EventDtcMapPowerPath138OverLoadFailure: diagnostic-event=EventPowerPath138OverLoadFailure, trouble-code-uds=Power_Path_138_Over_Load_Failure  # Event_Dtc_Map_Power_Path_138_Over_Load_Failure
  diagnostic event to operation cycle mapping EventOperCycleMapPowerPath138OverLoadFailure: diagnostic-event=EventPowerPath138OverLoadFailure, operation-cycle=DefaultOperationCycle  # Event_Oper_Cycle_Map_Power_Path_138_Over_Load_Failure
  diagnostic event to debounce algorithm mapping EventDebounceMapPowerPath138OverLoadFailure: debounce-algorithm=time_based, diagnostic-event=EventPowerPath138OverLoadFailure  # EventDebounceMap_Power_Path_138_Over_Load_Failure
package /ZeC/DTC/DTC/Power_Path_140_Over_Load_Failure
  diagnostic trouble code uds Power_Path_140_Over_Load_Failure: dtc-props=Dtc_Props_52d82a58, uds-dtc-value=0x00558c
  diagnostic event EventPowerPath140OverLoadFailure: aging-allowed=true, event-kind=SWC, prestorage-freeze-frame=false  # Event_Power_Path_140_Over_Load_Failure
  diagnostic event to trouble code uds mapping EventDtcMapPowerPath140OverLoadFailure: diagnostic-event=EventPowerPath140OverLoadFailure, trouble-code-uds=Power_Path_140_Over_Load_Failure  # Event_Dtc_Map_Power_Path_140_Over_Load_Failure
  diagnostic event to operation cycle mapping EventOperCycleMapPowerPath140OverLoadFailure: diagnostic-event=EventPowerPath140OverLoadFailure, operation-cycle=DefaultOperationCycle  # Event_Oper_Cycle_Map_Power_Path_140_Over_Load_Failure
  diagnostic event to debounce algorithm mapping EventDebounceMapPowerPath140OverLoadFailure: debounce-algorithm=time_based, diagnostic-event=EventPowerPath140OverLoadFailure  # EventDebounceMap_Power_Path_140_Over_Load_Failure
package /ZeC/DTC/DTC/Power_Path_139_Over_Load_Failure
  diagnostic trouble code uds Power_Path_139_Over_Load_Failure: dtc-props=Dtc_Props_14c12062, uds-dtc-value=0x00558b
  diagnostic event EventPowerPath139OverLoadFailure: aging-allowed=true, event-kind=SWC, prestorage-freeze-frame=false  # Event_Power_Path_139_Over_Load_Failure
  diagnostic event to trouble code uds mapping EventDtcMapPowerPath139OverLoadFailure: diagnostic-event=EventPowerPath139OverLoadFailure, trouble-code-uds=Power_Path_139_Over_Load_Failure  # Event_Dtc_Map_Power_Path_139_Over_Load_Failure
  diagnostic event to operation cycle mapping EventOperCycleMapPowerPath139OverLoadFailure: diagnostic-event=EventPowerPath139OverLoadFailure, operation-cycle=DefaultOperationCycle  # Event_Oper_Cycle_Map_Power_Path_139_Over_Load_Failure
  diagnostic event to debounce algorithm mapping EventDebounceMapPowerPath139OverLoadFailure: debounce-algorithm=time_based, diagnostic-event=EventPowerPath139OverLoadFailure  # EventDebounceMap_Power_Path_139_Over_Load_Failure
package /ZeC/DTC/DTC/Power_Path_144_Over_Load_Failure
  diagnostic trouble code uds Power_Path_144_Over_Load_Failure: dtc-props=Dtc_Props_634690d3, uds-dtc-value=0x005590
  diagnostic event EventPowerPath144OverLoadFailure: aging-allowed=true, event-kind=SWC, prestorage-freeze-frame=false  # Event_Power_Path_144_Over_Load_Failure
  diagnostic event to trouble code uds mapping EventDtcMapPowerPath144OverLoadFailure: diagnostic-event=EventPowerPath144OverLoadFailure, trouble-code-uds=Power_Path_144_Over_Load_Failure  # Event_Dtc_Map_Power_Path_144_Over_Load_Failure
  diagnostic event to operation cycle mapping EventOperCycleMapPowerPath144OverLoadFailure: diagnostic-event=EventPowerPath144OverLoadFailure, operation-cycle=DefaultOperationCycle  # Event_Oper_Cycle_Map_Power_Path_144_Over_Load_Failure
  diagnostic event to debounce algorithm mapping EventDebounceMapPowerPath144OverLoadFailure: debounce-algorithm=time_based, diagnostic-event=EventPowerPath144OverLoadFailure  # EventDebounceMap_Power_Path_144_Over_Load_Failure
package /ZeC/DTC/DTC/Power_Path_014_Short_to_BAT_Failure
  diagnostic trouble code uds Power_Path_014_Short_to_BAT_Failure: dtc-props=Dtc_Props_991c0a00, uds-dtc-value=0x00510e
  diagnostic event EventPowerPath014ShortToBATFailure: aging-allowed=true, event-kind=SWC, prestorage-freeze-frame=false  # Event_Power_Path_014_Short_to_BAT_Failure
  diagnostic event to trouble code uds mapping EventDtcMapPowerPath014ShortToBATFailure: diagnostic-event=EventPowerPath014ShortToBATFailure, trouble-code-uds=Power_Path_014_Short_to_BAT_Failure  # Event_Dtc_Map_Power_Path_014_Short_to_BAT_Failure
  diagnostic event to operation cycle mapping EventOperCycleMapPowerPath014ShortToBATFailure: diagnostic-event=EventPowerPath014ShortToBATFailure, operation-cycle=DefaultOperationCycle  # Event_Oper_Cycle_Map_Power_Path_014_Short_to_BAT_Failure
  diagnostic event to debounce algorithm mapping EventDebounceMapPowerPath014ShortToBATFailure: debounce-algorithm=time_based, diagnostic-event=EventPowerPath014ShortToBATFailure  # EventDebounceMap_Power_Path_014_Short_to_BAT_Failure
package /ZeC/DTC/DTC/Power_Path_013_Short_to_BAT_Failure
  diagnostic trouble code uds Power_Path_013_Short_to_BAT_Failure: dtc-props=Dtc_Props_df05003a, uds-dtc-value=0x00510d
  diagnostic event EventPowerPath013ShortToBATFailure: aging-allowed=true, event-kind=SWC, prestorage-freeze-frame=false  # Event_Power_Path_013_Short_to_BAT_Failure
  diagnostic event to trouble code uds mapping EventDtcMapPowerPath013ShortToBATFailure: diagnostic-event=EventPowerPath013ShortToBATFailure, trouble-code-uds=Power_Path_013_Short_to_BAT_Failure  # Event_Dtc_Map_Power_Path_013_Short_to_BAT_Failure
  diagnostic event to operation cycle mapping EventOperCycleMapPowerPath013ShortToBATFailure: diagnostic-event=EventPowerPath013ShortToBATFailure, operation-cycle=DefaultOperationCycle  # Event_Oper_Cycle_Map_Power_Path_013_Short_to_BAT_Failure
  diagnostic event to debounce algorithm mapping EventDebounceMapPowerPath013ShortToBATFailure: debounce-algorithm=time_based, diagnostic-event=EventPowerPath013ShortToBATFailure  # EventDebounceMap_Power_Path_013_Short_to_BAT_Failure
package /ZeC/DTC/DTC/Power_Path_160_Single_Device_Failure
  diagnostic trouble code uds Power_Path_160_Single_Device_Failure: dtc-props=Dtc_Props_c92c78b3, uds-dtc-value=0x0059a0
  diagnostic event EventPowerPath160SingleDeviceFailure: aging-allowed=true, event-kind=SWC, prestorage-freeze-frame=false  # Event_Power_Path_160_Single_Device_Failure
  diagnostic event to trouble code uds mapping EventDtcMapPowerPath160SingleDeviceFailure: diagnostic-event=EventPowerPath160SingleDeviceFailure, trouble-code-uds=Power_Path_160_Single_Device_Failure  # Event_Dtc_Map_Power_Path_160_Single_Device_Failure
  diagnostic event to operation cycle mapping EventOperCycleMapPowerPath160SingleDeviceFailure: diagnostic-event=EventPowerPath160SingleDeviceFailure, operation-cycle=DefaultOperationCycle  # Event_Oper_Cycle_Map_Power_Path_160_Single_Device_Failure
  diagnostic event to debounce algorithm mapping EventDebounceMapPowerPath160SingleDeviceFailure: debounce-algorithm=time_based, diagnostic-event=EventPowerPath160SingleDeviceFailure  # EventDebounceMap_Power_Path_160_Single_Device_Failure
package /ZeC/DTC/DTC/Power_Path_015_Short_to_BAT_Failure
  diagnostic trouble code uds Power_Path_015_Short_to_BAT_Failure: dtc-props=Dtc_Props_5337144e, uds-dtc-value=0x00510f
  diagnostic event EventPowerPath015ShortToBATFailure: aging-allowed=true, event-kind=SWC, prestorage-freeze-frame=false  # Event_Power_Path_015_Short_to_BAT_Failure
  diagnostic event to trouble code uds mapping EventDtcMapPowerPath015ShortToBATFailure: diagnostic-event=EventPowerPath015ShortToBATFailure, trouble-code-uds=Power_Path_015_Short_to_BAT_Failure  # Event_Dtc_Map_Power_Path_015_Short_to_BAT_Failure
  diagnostic event to operation cycle mapping EventOperCycleMapPowerPath015ShortToBATFailure: diagnostic-event=EventPowerPath015ShortToBATFailure, operation-cycle=DefaultOperationCycle  # Event_Oper_Cycle_Map_Power_Path_015_Short_to_BAT_Failure
  diagnostic event to debounce algorithm mapping EventDebounceMapPowerPath015ShortToBATFailure: debounce-algorithm=time_based, diagnostic-event=EventPowerPath015ShortToBATFailure  # EventDebounceMap_Power_Path_015_Short_to_BAT_Failure
package /ZeC/DTC/DTC/Power_Path_150_Over_Load_Failure
  diagnostic trouble code uds Power_Path_150_Over_Load_Failure: dtc-props=Dtc_Props_2c61aa0e, uds-dtc-value=0x005596
  diagnostic event EventPowerPath150OverLoadFailure: aging-allowed=true, event-kind=SWC, prestorage-freeze-frame=false  # Event_Power_Path_150_Over_Load_Failure
  diagnostic event to trouble code uds mapping EventDtcMapPowerPath150OverLoadFailure: diagnostic-event=EventPowerPath150OverLoadFailure, trouble-code-uds=Power_Path_150_Over_Load_Failure  # Event_Dtc_Map_Power_Path_150_Over_Load_Failure
  diagnostic event to operation cycle mapping EventOperCycleMapPowerPath150OverLoadFailure: diagnostic-event=EventPowerPath150OverLoadFailure, operation-cycle=DefaultOperationCycle  # Event_Oper_Cycle_Map_Power_Path_150_Over_Load_Failure
  diagnostic event to debounce algorithm mapping EventDebounceMapPowerPath150OverLoadFailure: debounce-algorithm=time_based, diagnostic-event=EventPowerPath150OverLoadFailure  # EventDebounceMap_Power_Path_150_Over_Load_Failure
package /ZeC/DTC/DTC/Power_Path_018_Short_to_BAT_Failure
  diagnostic trouble code uds Power_Path_018_Short_to_BAT_Failure: dtc-props=Dtc_Props_6b979e22, uds-dtc-value=0x005112
  diagnostic event EventPowerPath018ShortToBATFailure: aging-allowed=true, event-kind=SWC, prestorage-freeze-frame=false  # Event_Power_Path_018_Short_to_BAT_Failure
  diagnostic event to trouble code uds mapping EventDtcMapPowerPath018ShortToBATFailure: diagnostic-event=EventPowerPath018ShortToBATFailure, trouble-code-uds=Power_Path_018_Short_to_BAT_Failure  # Event_Dtc_Map_Power_Path_018_Short_to_BAT_Failure
  diagnostic event to operation cycle mapping EventOperCycleMapPowerPath018ShortToBATFailure: diagnostic-event=EventPowerPath018ShortToBATFailure, operation-cycle=DefaultOperationCycle  # Event_Oper_Cycle_Map_Power_Path_018_Short_to_BAT_Failure
  diagnostic event to debounce algorithm mapping EventDebounceMapPowerPath018ShortToBATFailure: debounce-algorithm=time_based, diagnostic-event=EventPowerPath018ShortToBATFailure  # EventDebounceMap_Power_Path_018_Short_to_BAT_Failure
package /ZeC/DTC/DTC/Power_Path_149_Over_Load_Failure
  diagnostic trouble code uds Power_Path_149_Over_Load_Failure: dtc-props=Dtc_Props_e64ab440, uds-dtc-value=0x005595
  diagnostic event EventPowerPath149OverLoadFailure: aging-allowed=true, event-kind=SWC, prestorage-freeze-frame=false  # Event_Power_Path_149_Over_Load_Failure
  diagnostic event to trouble code uds mapping EventDtcMapPowerPath149OverLoadFailure: diagnostic-event=EventPowerPath149OverLoadFailure, trouble-code-uds=Power_Path_149_Over_Load_Failure  # Event_Dtc_Map_Power_Path_149_Over_Load_Failure
  diagnostic event to operation cycle mapping EventOperCycleMapPowerPath149OverLoadFailure: diagnostic-event=EventPowerPath149OverLoadFailure, operation-cycle=DefaultOperationCycle  # Event_Oper_Cycle_Map_Power_Path_149_Over_Load_Failure
  diagnostic event to debounce algorithm mapping EventDebounceMapPowerPath149OverLoadFailure: debounce-algorithm=time_based, diagnostic-event=EventPowerPath149OverLoadFailure  # EventDebounceMap_Power_Path_149_Over_Load_Failure
package /ZeC/DTC/DTC/Power_Path_017_Short_to_BAT_Failure
  diagnostic trouble code uds Power_Path_017_Short_to_BAT_Failure: dtc-props=Dtc_Props_a1bc806c, uds-dtc-value=0x005111
  diagnostic event EventPowerPath017ShortToBATFailure: aging-allowed=true, event-kind=SWC, prestorage-freeze-frame=false  # Event_Power_Path_017_Short_to_BAT_Failure
  diagnostic event to trouble code uds mapping EventDtcMapPowerPath017ShortToBATFailure: diagnostic-event=EventPowerPath017ShortToBATFailure, trouble-code-uds=Power_Path_017_Short_to_BAT_Failure  # Event_Dtc_Map_Power_Path_017_Short_to_BAT_Failure
  diagnostic event to operation cycle mapping EventOperCycleMapPowerPath017ShortToBATFailure: diagnostic-event=EventPowerPath017ShortToBATFailure, operation-cycle=DefaultOperationCycle  # Event_Oper_Cycle_Map_Power_Path_017_Short_to_BAT_Failure
  diagnostic event to debounce algorithm mapping EventDebounceMapPowerPath017ShortToBATFailure: debounce-algorithm=time_based, diagnostic-event=EventPowerPath017ShortToBATFailure  # EventDebounceMap_Power_Path_017_Short_to_BAT_Failure
package /ZeC/DTC/DTC/Power_Path_020_Short_to_BAT_Failure
  diagnostic trouble code uds Power_Path_020_Short_to_BAT_Failure: dtc-props=Dtc_Props_24b0a4ff, uds-dtc-value=0x005114
  diagnostic event EventPowerPath020ShortToBATFailure: aging-allowed=true, event-kind=SWC, prestorage-freeze-frame=false  # Event_Power_Path_020_Short_to_BAT_Failure
  diagnostic event to trouble code uds mapping EventDtcMapPowerPath020ShortToBATFailure: diagnostic-event=EventPowerPath020ShortToBATFailure, trouble-code-uds=Power_Path_020_Short_to_BAT_Failure  # Event_Dtc_Map_Power_Path_020_Short_to_BAT_Failure
  diagnostic event to operation cycle mapping EventOperCycleMapPowerPath020ShortToBATFailure: diagnostic-event=EventPowerPath020ShortToBATFailure, operation-cycle=DefaultOperationCycle  # Event_Oper_Cycle_Map_Power_Path_020_Short_to_BAT_Failure
  diagnostic event to debounce algorithm mapping EventDebounceMapPowerPath020ShortToBATFailure: debounce-algorithm=time_based, diagnostic-event=EventPowerPath020ShortToBATFailure  # EventDebounceMap_Power_Path_020_Short_to_BAT_Failure
package /ZeC/DTC/DTC/Power_Path_152_Over_Load_Failure
  diagnostic trouble code uds Power_Path_152_Over_Load_Failure: dtc-props=Dtc_Props_3e1dcbc0, uds-dtc-value=0x005598
  diagnostic event EventPowerPath152OverLoadFailure: aging-allowed=true, event-kind=SWC, prestorage-freeze-frame=false  # Event_Power_Path_152_Over_Load_Failure
  diagnostic event to trouble code uds mapping EventDtcMapPowerPath152OverLoadFailure: diagnostic-event=EventPowerPath152OverLoadFailure, trouble-code-uds=Power_Path_152_Over_Load_Failure  # Event_Dtc_Map_Power_Path_152_Over_Load_Failure
  diagnostic event to operation cycle mapping EventOperCycleMapPowerPath152OverLoadFailure: diagnostic-event=EventPowerPath152OverLoadFailure, operation-cycle=DefaultOperationCycle  # Event_Oper_Cycle_Map_Power_Path_152_Over_Load_Failure
  diagnostic event to debounce algorithm mapping EventDebounceMapPowerPath152OverLoadFailure: debounce-algorithm=time_based, diagnostic-event=EventPowerPath152OverLoadFailure  # EventDebounceMap_Power_Path_152_Over_Load_Failure
package /ZeC/DTC/DTC/Power_Path_019_Short_to_BAT_Failure
  diagnostic trouble code uds Power_Path_019_Short_to_BAT_Failure: dtc-props=Dtc_Props_2d8e9418, uds-dtc-value=0x005113
  diagnostic event EventPowerPath019ShortToBATFailure: aging-allowed=true, event-kind=SWC, prestorage-freeze-frame=false  # Event_Power_Path_019_Short_to_BAT_Failure
  diagnostic event to trouble code uds mapping EventDtcMapPowerPath019ShortToBATFailure: diagnostic-event=EventPowerPath019ShortToBATFailure, trouble-code-uds=Power_Path_019_Short_to_BAT_Failure  # Event_Dtc_Map_Power_Path_019_Short_to_BAT_Failure
  diagnostic event to operation cycle mapping EventOperCycleMapPowerPath019ShortToBATFailure: diagnostic-event=EventPowerPath019ShortToBATFailure, operation-cycle=DefaultOperationCycle  # Event_Oper_Cycle_Map_Power_Path_019_Short_to_BAT_Failure
  diagnostic event to debounce algorithm mapping EventDebounceMapPowerPath019ShortToBATFailure: debounce-algorithm=time_based, diagnostic-event=EventPowerPath019ShortToBATFailure  # EventDebounceMap_Power_Path_019_Short_to_BAT_Failure
package /ZeC/DTC/DTC/Power_Path_151_Over_Load_Failure
  diagnostic trouble code uds Power_Path_151_Over_Load_Failure: dtc-props=Dtc_Props_6a78a034, uds-dtc-value=0x005597
  diagnostic event EventPowerPath151OverLoadFailure: aging-allowed=true, event-kind=SWC, prestorage-freeze-frame=false  # Event_Power_Path_151_Over_Load_Failure
  diagnostic event to trouble code uds mapping EventDtcMapPowerPath151OverLoadFailure: diagnostic-event=EventPowerPath151OverLoadFailure, trouble-code-uds=Power_Path_151_Over_Load_Failure  # Event_Dtc_Map_Power_Path_151_Over_Load_Failure
  diagnostic event to operation cycle mapping EventOperCycleMapPowerPath151OverLoadFailure: diagnostic-event=EventPowerPath151OverLoadFailure, operation-cycle=DefaultOperationCycle  # Event_Oper_Cycle_Map_Power_Path_151_Over_Load_Failure
  diagnostic event to debounce algorithm mapping EventDebounceMapPowerPath151OverLoadFailure: debounce-algorithm=time_based, diagnostic-event=EventPowerPath151OverLoadFailure  # EventDebounceMap_Power_Path_151_Over_Load_Failure
package /ZeC/DTC/DTC/Power_Path_146_Over_Load_Failure
  diagnostic trouble code uds Power_Path_146_Over_Load_Failure: dtc-props=Dtc_Props_ef7484a7, uds-dtc-value=0x005592
  diagnostic event EventPowerPath146OverLoadFailure: aging-allowed=true, event-kind=SWC, prestorage-freeze-frame=false  # Event_Power_Path_146_Over_Load_Failure
  diagnostic event to trouble code uds mapping EventDtcMapPowerPath146OverLoadFailure: diagnostic-event=EventPowerPath146OverLoadFailure, trouble-code-uds=Power_Path_146_Over_Load_Failure  # Event_Dtc_Map_Power_Path_146_Over_Load_Failure
  diagnostic event to operation cycle mapping EventOperCycleMapPowerPath146OverLoadFailure: diagnostic-event=EventPowerPath146OverLoadFailure, operation-cycle=DefaultOperationCycle  # Event_Oper_Cycle_Map_Power_Path_146_Over_Load_Failure
  diagnostic event to debounce algorithm mapping EventDebounceMapPowerPath146OverLoadFailure: debounce-algorithm=time_based, diagnostic-event=EventPowerPath146OverLoadFailure  # EventDebounceMap_Power_Path_146_Over_Load_Failure
package /ZeC/DTC/DTC/Power_Path_145_Over_Load_Failure
  diagnostic trouble code uds Power_Path_145_Over_Load_Failure: dtc-props=Dtc_Props_255f9ae9, uds-dtc-value=0x005591
  diagnostic event EventPowerPath145OverLoadFailure: aging-allowed=true, event-kind=SWC, prestorage-freeze-frame=false  # Event_Power_Path_145_Over_Load_Failure
  diagnostic event to trouble code uds mapping EventDtcMapPowerPath145OverLoadFailure: diagnostic-event=EventPowerPath145OverLoadFailure, trouble-code-uds=Power_Path_145_Over_Load_Failure  # Event_Dtc_Map_Power_Path_145_Over_Load_Failure
  diagnostic event to operation cycle mapping EventOperCycleMapPowerPath145OverLoadFailure: diagnostic-event=EventPowerPath145OverLoadFailure, operation-cycle=DefaultOperationCycle  # Event_Oper_Cycle_Map_Power_Path_145_Over_Load_Failure
  diagnostic event to debounce algorithm mapping EventDebounceMapPowerPath145OverLoadFailure: debounce-algorithm=time_based, diagnostic-event=EventPowerPath145OverLoadFailure  # EventDebounceMap_Power_Path_145_Over_Load_Failure
package /ZeC/DTC/DTC/Power_Path_148_Over_Load_Failure
  diagnostic trouble code uds Power_Path_148_Over_Load_Failure: dtc-props=Dtc_Props_a053be7a, uds-dtc-value=0x005594
  diagnostic event EventPowerPath148OverLoadFailure: aging-allowed=true, event-kind=SWC, prestorage-freeze-frame=false  # Event_Power_Path_148_Over_Load_Failure
  diagnostic event to trouble code uds mapping EventDtcMapPowerPath148OverLoadFailure: diagnostic-event=EventPowerPath148OverLoadFailure, trouble-code-uds=Power_Path_148_Over_Load_Failure  # Event_Dtc_Map_Power_Path_148_Over_Load_Failure
  diagnostic event to operation cycle mapping EventOperCycleMapPowerPath148OverLoadFailure: diagnostic-event=EventPowerPath148OverLoadFailure, operation-cycle=DefaultOperationCycle  # Event_Oper_Cycle_Map_Power_Path_148_Over_Load_Failure
  diagnostic event to debounce algorithm mapping EventDebounceMapPowerPath148OverLoadFailure: debounce-algorithm=time_based, diagnostic-event=EventPowerPath148OverLoadFailure  # EventDebounceMap_Power_Path_148_Over_Load_Failure
package /ZeC/DTC/DTC/Power_Path_016_Short_to_BAT_Failure
  diagnostic trouble code uds Power_Path_016_Short_to_BAT_Failure: dtc-props=Dtc_Props_e7a58a56, uds-dtc-value=0x005110
  diagnostic event EventPowerPath016ShortToBATFailure: aging-allowed=true, event-kind=SWC, prestorage-freeze-frame=false  # Event_Power_Path_016_Short_to_BAT_Failure
  diagnostic event to trouble code uds mapping EventDtcMapPowerPath016ShortToBATFailure: diagnostic-event=EventPowerPath016ShortToBATFailure, trouble-code-uds=Power_Path_016_Short_to_BAT_Failure  # Event_Dtc_Map_Power_Path_016_Short_to_BAT_Failure
  diagnostic event to operation cycle mapping EventOperCycleMapPowerPath016ShortToBATFailure: diagnostic-event=EventPowerPath016ShortToBATFailure, operation-cycle=DefaultOperationCycle  # Event_Oper_Cycle_Map_Power_Path_016_Short_to_BAT_Failure
  diagnostic event to debounce algorithm mapping EventDebounceMapPowerPath016ShortToBATFailure: debounce-algorithm=time_based, diagnostic-event=EventPowerPath016ShortToBATFailure  # EventDebounceMap_Power_Path_016_Short_to_BAT_Failure
package /ZeC/DTC/DTC/Power_Path_147_Over_Load_Failure
  diagnostic trouble code uds Power_Path_147_Over_Load_Failure: dtc-props=Dtc_Props_a96d8e9d, uds-dtc-value=0x005593
  diagnostic event EventPowerPath147OverLoadFailure: aging-allowed=true, event-kind=SWC, prestorage-freeze-frame=false  # Event_Power_Path_147_Over_Load_Failure
  diagnostic event to trouble code uds mapping EventDtcMapPowerPath147OverLoadFailure: diagnostic-event=EventPowerPath147OverLoadFailure, trouble-code-uds=Power_Path_147_Over_Load_Failure  # Event_Dtc_Map_Power_Path_147_Over_Load_Failure
  diagnostic event to operation cycle mapping EventOperCycleMapPowerPath147OverLoadFailure: diagnostic-event=EventPowerPath147OverLoadFailure, operation-cycle=DefaultOperationCycle  # Event_Oper_Cycle_Map_Power_Path_147_Over_Load_Failure
  diagnostic event to debounce algorithm mapping EventDebounceMapPowerPath147OverLoadFailure: debounce-algorithm=time_based, diagnostic-event=EventPowerPath147OverLoadFailure  # EventDebounceMap_Power_Path_147_Over_Load_Failure
package /ZeC/DTC/DTC/LIN_20_Slave_2_NoCommunication
  diagnostic trouble code uds LIN_20_Slave_2_NoCommunication: dtc-props=Dtc_Props_358996c7, uds-dtc-value=0x031408  # LIN 20 Slave 2_NoCommunication
  diagnostic event EventLIN20Slave2NoCommunication: aging-allowed=true, event-kind=SWC, prestorage-freeze-frame=false  # Event_LIN 20 Slave 2_NoCommunication
  diagnostic event to trouble code uds mapping EventDtcMapLIN20Slave2NoCommunication: diagnostic-event=EventLIN20Slave2NoCommunication, trouble-code-uds=LIN_20_Slave_2_NoCommunication  # Event_Dtc_Map_LIN 20 Slave 2_NoCommunication
  diagnostic event to operation cycle mapping EventOperCycleMapLIN20Slave2NoCommunication: diagnostic-event=EventLIN20Slave2NoCommunication, operation-cycle=DefaultOperationCycle  # Event_Oper_Cycle_Map_LIN 20 Slave 2_NoCommunication
  diagnostic event to debounce algorithm mapping EventDebounceMapLIN20Slave2NoCommunication: debounce-algorithm=counter_based, diagnostic-event=EventLIN20Slave2NoCommunication  # EventDebounceMap_LIN 20 Slave 2_NoCommunication
package /ZeC/DTC/DTC/LIN_20_Slave_3_Defect
  diagnostic trouble code uds LIN_20_Slave_3_Defect: dtc-props=Dtc_Props_358996c7, uds-dtc-value=0x031409  # LIN 20 Slave 3_Defect
  diagnostic event EventLIN20Slave3Defect: aging-allowed=true, event-kind=SWC, prestorage-freeze-frame=false  # Event_LIN 20 Slave 3_Defect
  diagnostic event to trouble code uds mapping EventDtcMapLIN20Slave3Defect: diagnostic-event=EventLIN20Slave3Defect, trouble-code-uds=LIN_20_Slave_3_Defect  # Event_Dtc_Map_LIN 20 Slave 3_Defect
  diagnostic event to operation cycle mapping EventOperCycleMapLIN20Slave3Defect: diagnostic-event=EventLIN20Slave3Defect, operation-cycle=DefaultOperationCycle  # Event_Oper_Cycle_Map_LIN 20 Slave 3_Defect
  diagnostic event to debounce algorithm mapping EventDebounceMapLIN20Slave3Defect: debounce-algorithm=counter_based, diagnostic-event=EventLIN20Slave3Defect  # EventDebounceMap_LIN 20 Slave 3_Defect
package /ZeC/DTC/DTC/LIN_20_Slave_15_NoCommunication
  diagnostic trouble code uds LIN_20_Slave_15_NoCommunication: dtc-props=Dtc_Props_358996c7, uds-dtc-value=0x031406  # LIN 20 Slave 15_NoCommunication
  diagnostic event EventLIN20Slave15NoCommunication: aging-allowed=true, event-kind=SWC, prestorage-freeze-frame=false  # Event_LIN 20 Slave 15_NoCommunication
  diagnostic event to trouble code uds mapping EventDtcMapLIN20Slave15NoCommunication: diagnostic-event=EventLIN20Slave15NoCommunication, trouble-code-uds=LIN_20_Slave_15_NoCommunication  # Event_Dtc_Map_LIN 20 Slave 15_NoCommunication
  diagnostic event to operation cycle mapping EventOperCycleMapLIN20Slave15NoCommunication: diagnostic-event=EventLIN20Slave15NoCommunication, operation-cycle=DefaultOperationCycle  # Event_Oper_Cycle_Map_LIN 20 Slave 15_NoCommunication
  diagnostic event to debounce algorithm mapping EventDebounceMapLIN20Slave15NoCommunication: debounce-algorithm=counter_based, diagnostic-event=EventLIN20Slave15NoCommunication  # EventDebounceMap_LIN 20 Slave 15_NoCommunication
package /ZeC/DTC/DTC/LIN_20_Slave_2_Defect
  diagnostic trouble code uds LIN_20_Slave_2_Defect: dtc-props=Dtc_Props_358996c7, uds-dtc-value=0x031407  # LIN 20 Slave 2_Defect
  diagnostic event EventLIN20Slave2Defect: aging-allowed=true, event-kind=SWC, prestorage-freeze-frame=false  # Event_LIN 20 Slave 2_Defect
  diagnostic event to trouble code uds mapping EventDtcMapLIN20Slave2Defect: diagnostic-event=EventLIN20Slave2Defect, trouble-code-uds=LIN_20_Slave_2_Defect  # Event_Dtc_Map_LIN 20 Slave 2_Defect
  diagnostic event to operation cycle mapping EventOperCycleMapLIN20Slave2Defect: diagnostic-event=EventLIN20Slave2Defect, operation-cycle=DefaultOperationCycle  # Event_Oper_Cycle_Map_LIN 20 Slave 2_Defect
  diagnostic event to debounce algorithm mapping EventDebounceMapLIN20Slave2Defect: debounce-algorithm=counter_based, diagnostic-event=EventLIN20Slave2Defect  # EventDebounceMap_LIN 20 Slave 2_Defect
package /ZeC/DTC/DTC/LIN_20_Slave_14_NoCommunication
  diagnostic trouble code uds LIN_20_Slave_14_NoCommunication: dtc-props=Dtc_Props_358996c7, uds-dtc-value=0x031404  # LIN 20 Slave 14_NoCommunication
  diagnostic event EventLIN20Slave14NoCommunication: aging-allowed=true, event-kind=SWC, prestorage-freeze-frame=false  # Event_LIN 20 Slave 14_NoCommunication
  diagnostic event to trouble code uds mapping EventDtcMapLIN20Slave14NoCommunication: diagnostic-event=EventLIN20Slave14NoCommunication, trouble-code-uds=LIN_20_Slave_14_NoCommunication  # Event_Dtc_Map_LIN 20 Slave 14_NoCommunication
  diagnostic event to operation cycle mapping EventOperCycleMapLIN20Slave14NoCommunication: diagnostic-event=EventLIN20Slave14NoCommunication, operation-cycle=DefaultOperationCycle  # Event_Oper_Cycle_Map_LIN 20 Slave 14_NoCommunication
  diagnostic event to debounce algorithm mapping EventDebounceMapLIN20Slave14NoCommunication: debounce-algorithm=counter_based, diagnostic-event=EventLIN20Slave14NoCommunication  # EventDebounceMap_LIN 20 Slave 14_NoCommunication
package /ZeC/DTC/DTC/Power_Path_120_Over_Load_Failure
  diagnostic trouble code uds Power_Path_120_Over_Load_Failure: dtc-props=Dtc_Props_42d35816, uds-dtc-value=0x005578
  diagnostic event EventPowerPath120OverLoadFailure: aging-allowed=true, event-kind=SWC, prestorage-freeze-frame=false  # Event_Power_Path_120_Over_Load_Failure
  diagnostic event to trouble code uds mapping EventDtcMapPowerPath120OverLoadFailure: diagnostic-event=EventPowerPath120OverLoadFailure, trouble-code-uds=Power_Path_120_Over_Load_Failure  # Event_Dtc_Map_Power_Path_120_Over_Load_Failure
  diagnostic event to operation cycle mapping EventOperCycleMapPowerPath120OverLoadFailure: diagnostic-event=EventPowerPath120OverLoadFailure, operation-cycle=DefaultOperationCycle  # Event_Oper_Cycle_Map_Power_Path_120_Over_Load_Failure
  diagnostic event to debounce algorithm mapping EventDebounceMapPowerPath120OverLoadFailure: debounce-algorithm=time_based, diagnostic-event=EventPowerPath120OverLoadFailure  # EventDebounceMap_Power_Path_120_Over_Load_Failure
package /ZeC/DTC/DTC/LIN_20_Slave_15_Defect
  diagnostic trouble code uds LIN_20_Slave_15_Defect: dtc-props=Dtc_Props_358996c7, uds-dtc-value=0x031405  # LIN 20 Slave 15_Defect
  diagnostic event EventLIN20Slave15Defect: aging-allowed=true, event-kind=SWC, prestorage-freeze-frame=false  # Event_LIN 20 Slave 15_Defect
  diagnostic event to trouble code uds mapping EventDtcMapLIN20Slave15Defect: diagnostic-event=EventLIN20Slave15Defect, trouble-code-uds=LIN_20_Slave_15_Defect  # Event_Dtc_Map_LIN 20 Slave 15_Defect
  diagnostic event to operation cycle mapping EventOperCycleMapLIN20Slave15Defect: diagnostic-event=EventLIN20Slave15Defect, operation-cycle=DefaultOperationCycle  # Event_Oper_Cycle_Map_LIN 20 Slave 15_Defect
  diagnostic event to debounce algorithm mapping EventDebounceMapLIN20Slave15Defect: debounce-algorithm=counter_based, diagnostic-event=EventLIN20Slave15Defect  # EventDebounceMap_LIN 20 Slave 15_Defect
package /ZeC/DTC/DTC/Power_Path_119_Over_Load_Failure
  diagnostic trouble code uds Power_Path_119_Over_Load_Failure: dtc-props=Dtc_Props_16b633e2, uds-dtc-value=0x005577
  diagnostic event EventPowerPath119OverLoadFailure: aging-allowed=true, event-kind=SWC, prestorage-freeze-frame=false  # Event_Power_Path_119_Over_Load_Failure
  diagnostic event to trouble code uds mapping EventDtcMapPowerPath119OverLoadFailure: diagnostic-event=EventPowerPath119OverLoadFailure, trouble-code-uds=Power_Path_119_Over_Load_Failure  # Event_Dtc_Map_Power_Path_119_Over_Load_Failure
  diagnostic event to operation cycle mapping EventOperCycleMapPowerPath119OverLoadFailure: diagnostic-event=EventPowerPath119OverLoadFailure, operation-cycle=DefaultOperationCycle  # Event_Oper_Cycle_Map_Power_Path_119_Over_Load_Failure
  diagnostic event to debounce algorithm mapping EventDebounceMapPowerPath119OverLoadFailure: debounce-algorithm=time_based, diagnostic-event=EventPowerPath119OverLoadFailure  # EventDebounceMap_Power_Path_119_Over_Load_Failure
package /ZeC/DTC/DTC/LIN_20_Slave_13_NoCommunication
  diagnostic trouble code uds LIN_20_Slave_13_NoCommunication: dtc-props=Dtc_Props_358996c7, uds-dtc-value=0x031402  # LIN 20 Slave 13_NoCommunication
  diagnostic event EventLIN20Slave13NoCommunication: aging-allowed=true, event-kind=SWC, prestorage-freeze-frame=false  # Event_LIN 20 Slave 13_NoCommunication
  diagnostic event to trouble code uds mapping EventDtcMapLIN20Slave13NoCommunication: diagnostic-event=EventLIN20Slave13NoCommunication, trouble-code-uds=LIN_20_Slave_13_NoCommunication  # Event_Dtc_Map_LIN 20 Slave 13_NoCommunication
  diagnostic event to operation cycle mapping EventOperCycleMapLIN20Slave13NoCommunication: diagnostic-event=EventLIN20Slave13NoCommunication, operation-cycle=DefaultOperationCycle  # Event_Oper_Cycle_Map_LIN 20 Slave 13_NoCommunication
  diagnostic event to debounce algorithm mapping EventDebounceMapLIN20Slave13NoCommunication: debounce-algorithm=counter_based, diagnostic-event=EventLIN20Slave13NoCommunication  # EventDebounceMap_LIN 20 Slave 13_NoCommunication
package /ZeC/DTC/DTC/LIN_20_Slave_14_Defect
  diagnostic trouble code uds LIN_20_Slave_14_Defect: dtc-props=Dtc_Props_358996c7, uds-dtc-value=0x031403  # LIN 20 Slave 14_Defect
  diagnostic event EventLIN20Slave14Defect: aging-allowed=true, event-kind=SWC, prestorage-freeze-frame=false  # Event_LIN 20 Slave 14_Defect
  diagnostic event to trouble code uds mapping EventDtcMapLIN20Slave14Defect: diagnostic-event=EventLIN20Slave14Defect, trouble-code-uds=LIN_20_Slave_14_Defect  # Event_Dtc_Map_LIN 20 Slave 14_Defect
  diagnostic event to operation cycle mapping EventOperCycleMapLIN20Slave14Defect: diagnostic-event=EventLIN20Slave14Defect, operation-cycle=DefaultOperationCycle  # Event_Oper_Cycle_Map_LIN 20 Slave 14_Defect
  diagnostic event to debounce algorithm mapping EventDebounceMapLIN20Slave14Defect: debounce-algorithm=counter_based, diagnostic-event=EventLIN20Slave14Defect  # EventDebounceMap_LIN 20 Slave 14_Defect
package /ZeC/DTC/DTC/Power_Path_121_Over_Load_Failure
  diagnostic trouble code uds Power_Path_121_Over_Load_Failure: dtc-props=Dtc_Props_4ca522c, uds-dtc-value=0x005579
  diagnostic event EventPowerPath121OverLoadFailure: aging-allowed=true, event-kind=SWC, prestorage-freeze-frame=false  # Event_Power_Path_121_Over_Load_Failure
  diagnostic event to trouble code uds mapping EventDtcMapPowerPath121OverLoadFailure: diagnostic-event=EventPowerPath121OverLoadFailure, trouble-code-uds=Power_Path_121_Over_Load_Failure  # Event_Dtc_Map_Power_Path_121_Over_Load_Failure
  diagnostic event to operation cycle mapping EventOperCycleMapPowerPath121OverLoadFailure: diagnostic-event=EventPowerPath121OverLoadFailure, operation-cycle=DefaultOperationCycle  # Event_Oper_Cycle_Map_Power_Path_121_Over_Load_Failure
  diagnostic event to debounce algorithm mapping EventDebounceMapPowerPath121OverLoadFailure: debounce-algorithm=time_based, diagnostic-event=EventPowerPath121OverLoadFailure  # EventDebounceMap_Power_Path_121_Over_Load_Failure
package /ZeC/DTC/DTC/Power_Path_125_Over_Load_Failure
  diagnostic trouble code uds Power_Path_125_Over_Load_Failure: dtc-props=Dtc_Props_e16249d1, uds-dtc-value=0x00557d
  diagnostic event EventPowerPath125OverLoadFailure: aging-allowed=true, event-kind=SWC, prestorage-freeze-frame=false  # Event_Power_Path_125_Over_Load_Failure
  diagnostic event to trouble code uds mapping EventDtcMapPowerPath125OverLoadFailure: diagnostic-event=EventPowerPath125OverLoadFailure, trouble-code-uds=Power_Path_125_Over_Load_Failure  # Event_Dtc_Map_Power_Path_125_Over_Load_Failure
  diagnostic event to operation cycle mapping EventOperCycleMapPowerPath125OverLoadFailure: diagnostic-event=EventPowerPath125OverLoadFailure, operation-cycle=DefaultOperationCycle  # Event_Oper_Cycle_Map_Power_Path_125_Over_Load_Failure
  diagnostic event to debounce algorithm mapping EventDebounceMapPowerPath125OverLoadFailure: debounce-algorithm=time_based, diagnostic-event=EventPowerPath125OverLoadFailure  # EventDebounceMap_Power_Path_125_Over_Load_Failure
package /ZeC/DTC/DTC/LIN_20_Slave_13_Defect
  diagnostic trouble code uds LIN_20_Slave_13_Defect: dtc-props=Dtc_Props_358996c7, uds-dtc-value=0x031401  # LIN 20 Slave 13_Defect
  diagnostic event EventLIN20Slave13Defect: aging-allowed=true, event-kind=SWC, prestorage-freeze-frame=false  # Event_LIN 20 Slave 13_Defect
  diagnostic event to trouble code uds mapping EventDtcMapLIN20Slave13Defect: diagnostic-event=EventLIN20Slave13Defect, trouble-code-uds=LIN_20_Slave_13_Defect  # Event_Dtc_Map_LIN 20 Slave 13_Defect
  diagnostic event to operation cycle mapping EventOperCycleMapLIN20Slave13Defect: diagnostic-event=EventLIN20Slave13Defect, operation-cycle=DefaultOperationCycle  # Event_Oper_Cycle_Map_LIN 20 Slave 13_Defect
  diagnostic event to debounce algorithm mapping EventDebounceMapLIN20Slave13Defect: debounce-algorithm=counter_based, diagnostic-event=EventLIN20Slave13Defect  # EventDebounceMap_LIN 20 Slave 13_Defect
package /ZeC/DTC/DTC/Power_Path_124_Over_Load_Failure
  diagnostic trouble code uds Power_Path_124_Over_Load_Failure: dtc-props=Dtc_Props_e85c7936, uds-dtc-value=0x00557c
  diagnostic event EventPowerPath124OverLoadFailure: aging-allowed=true, event-kind=SWC, prestorage-freeze-frame=false  # Event_Power_Path_124_Over_Load_Failure
  diagnostic event to trouble code uds mapping EventDtcMapPowerPath124OverLoadFailure: diagnostic-event=EventPowerPath124OverLoadFailure, trouble-code-uds=Power_Path_124_Over_Load_Failure  # Event_Dtc_Map_Power_Path_124_Over_Load_Failure
  diagnostic event to operation cycle mapping EventOperCycleMapPowerPath124OverLoadFailure: diagnostic-event=EventPowerPath124OverLoadFailure, operation-cycle=DefaultOperationCycle  # Event_Oper_Cycle_Map_Power_Path_124_Over_Load_Failure
  diagnostic event to debounce algorithm mapping EventDebounceMapPowerPath124OverLoadFailure: debounce-algorithm=time_based, diagnostic-event=EventPowerPath124OverLoadFailure  # EventDebounceMap_Power_Path_124_Over_Load_Failure
package /ZeC/DTC/DTC/Power_Path_127_Over_Load_Failure
  diagnostic trouble code uds Power_Path_127_Over_Load_Failure: dtc-props=Dtc_Props_6d505da5, uds-dtc-value=0x00557f
  diagnostic event EventPowerPath127OverLoadFailure: aging-allowed=true, event-kind=SWC, prestorage-freeze-frame=false  # Event_Power_Path_127_Over_Load_Failure
  diagnostic event to trouble code uds mapping EventDtcMapPowerPath127OverLoadFailure: diagnostic-event=EventPowerPath127OverLoadFailure, trouble-code-uds=Power_Path_127_Over_Load_Failure  # Event_Dtc_Map_Power_Path_127_Over_Load_Failure
  diagnostic event to operation cycle mapping EventOperCycleMapPowerPath127OverLoadFailure: diagnostic-event=EventPowerPath127OverLoadFailure, operation-cycle=DefaultOperationCycle  # Event_Oper_Cycle_Map_Power_Path_127_Over_Load_Failure
  diagnostic event to debounce algorithm mapping EventDebounceMapPowerPath127OverLoadFailure: debounce-algorithm=time_based, diagnostic-event=EventPowerPath127OverLoadFailure  # EventDebounceMap_Power_Path_127_Over_Load_Failure
package /ZeC/DTC/DTC/Power_Path_126_Over_Load_Failure
  diagnostic trouble code uds Power_Path_126_Over_Load_Failure: dtc-props=Dtc_Props_a77b43eb, uds-dtc-value=0x00557e
  diagnostic event EventPowerPath126OverLoadFailure: aging-allowed=true, event-kind=SWC, prestorage-freeze-frame=false  # Event_Power_Path_126_Over_Load_Failure
  diagnostic event to trouble code uds mapping EventDtcMapPowerPath126OverLoadFailure: diagnostic-event=EventPowerPath126OverLoadFailure, trouble-code-uds=Power_Path_126_Over_Load_Failure  # Event_Dtc_Map_Power_Path_126_Over_Load_Failure
  diagnostic event to operation cycle mapping EventOperCycleMapPowerPath126OverLoadFailure: diagnostic-event=EventPowerPath126OverLoadFailure, operation-cycle=DefaultOperationCycle  # Event_Oper_Cycle_Map_Power_Path_126_Over_Load_Failure
  diagnostic event to debounce algorithm mapping EventDebounceMapPowerPath126OverLoadFailure: debounce-algorithm=time_based, diagnostic-event=EventPowerPath126OverLoadFailure  # EventDebounceMap_Power_Path_126_Over_Load_Failure
package /ZeC/DTC/DTC/Power_Path_123_Over_Load_Failure
  diagnostic trouble code uds Power_Path_123_Over_Load_Failure: dtc-props=Dtc_Props_ae45730c, uds-dtc-value=0x00557b
  diagnostic event EventPowerPath123OverLoadFailure: aging-allowed=true, event-kind=SWC, prestorage-freeze-frame=false  # Event_Power_Path_123_Over_Load_Failure
  diagnostic event to trouble code uds mapping EventDtcMapPowerPath123OverLoadFailure: diagnostic-event=EventPowerPath123OverLoadFailure, trouble-code-uds=Power_Path_123_Over_Load_Failure  # Event_Dtc_Map_Power_Path_123_Over_Load_Failure
  diagnostic event to operation cycle mapping EventOperCycleMapPowerPath123OverLoadFailure: diagnostic-event=EventPowerPath123OverLoadFailure, operation-cycle=DefaultOperationCycle  # Event_Oper_Cycle_Map_Power_Path_123_Over_Load_Failure
  diagnostic event to debounce algorithm mapping EventDebounceMapPowerPath123OverLoadFailure: debounce-algorithm=time_based, diagnostic-event=EventPowerPath123OverLoadFailure  # EventDebounceMap_Power_Path_123_Over_Load_Failure
package /ZeC/DTC/DTC/Power_Path_122_Over_Load_Failure
  diagnostic trouble code uds Power_Path_122_Over_Load_Failure: dtc-props=Dtc_Props_646e6d42, uds-dtc-value=0x00557a
  diagnostic event EventPowerPath122OverLoadFailure: aging-allowed=true, event-kind=SWC, prestorage-freeze-frame=false  # Event_Power_Path_122_Over_Load_Failure
  diagnostic event to trouble code uds mapping EventDtcMapPowerPath122OverLoadFailure: diagnostic-event=EventPowerPath122OverLoadFailure, trouble-code-uds=Power_Path_122_Over_Load_Failure  # Event_Dtc_Map_Power_Path_122_Over_Load_Failure
  diagnostic event to operation cycle mapping EventOperCycleMapPowerPath122OverLoadFailure: diagnostic-event=EventPowerPath122OverLoadFailure, operation-cycle=DefaultOperationCycle  # Event_Oper_Cycle_Map_Power_Path_122_Over_Load_Failure
  diagnostic event to debounce algorithm mapping EventDebounceMapPowerPath122OverLoadFailure: debounce-algorithm=time_based, diagnostic-event=EventPowerPath122OverLoadFailure  # EventDebounceMap_Power_Path_122_Over_Load_Failure
package /ZeC/DTC/DTC/LIN_20_Slave_6_Defect
  diagnostic trouble code uds LIN_20_Slave_6_Defect: dtc-props=Dtc_Props_358996c7, uds-dtc-value=0x03140f  # LIN 20 Slave 6_Defect
  diagnostic event EventLIN20Slave6Defect: aging-allowed=true, event-kind=SWC, prestorage-freeze-frame=false  # Event_LIN 20 Slave 6_Defect
  diagnostic event to trouble code uds mapping EventDtcMapLIN20Slave6Defect: diagnostic-event=EventLIN20Slave6Defect, trouble-code-uds=LIN_20_Slave_6_Defect  # Event_Dtc_Map_LIN 20 Slave 6_Defect
  diagnostic event to operation cycle mapping EventOperCycleMapLIN20Slave6Defect: diagnostic-event=EventLIN20Slave6Defect, operation-cycle=DefaultOperationCycle  # Event_Oper_Cycle_Map_LIN 20 Slave 6_Defect
  diagnostic event to debounce algorithm mapping EventDebounceMapLIN20Slave6Defect: debounce-algorithm=counter_based, diagnostic-event=EventLIN20Slave6Defect  # EventDebounceMap_LIN 20 Slave 6_Defect
package /ZeC/DTC/DTC/LIN_20_Slave_5_Defect
  diagnostic trouble code uds LIN_20_Slave_5_Defect: dtc-props=Dtc_Props_358996c7, uds-dtc-value=0x03140d  # LIN 20 Slave 5_Defect
  diagnostic event EventLIN20Slave5Defect: aging-allowed=true, event-kind=SWC, prestorage-freeze-frame=false  # Event_LIN 20 Slave 5_Defect
  diagnostic event to trouble code uds mapping EventDtcMapLIN20Slave5Defect: diagnostic-event=EventLIN20Slave5Defect, trouble-code-uds=LIN_20_Slave_5_Defect  # Event_Dtc_Map_LIN 20 Slave 5_Defect
  diagnostic event to operation cycle mapping EventOperCycleMapLIN20Slave5Defect: diagnostic-event=EventLIN20Slave5Defect, operation-cycle=DefaultOperationCycle  # Event_Oper_Cycle_Map_LIN 20 Slave 5_Defect
  diagnostic event to debounce algorithm mapping EventDebounceMapLIN20Slave5Defect: debounce-algorithm=counter_based, diagnostic-event=EventLIN20Slave5Defect  # EventDebounceMap_LIN 20 Slave 5_Defect
package /ZeC/DTC/DTC/LIN_20_Slave_5_NoCommunication
  diagnostic trouble code uds LIN_20_Slave_5_NoCommunication: dtc-props=Dtc_Props_358996c7, uds-dtc-value=0x03140e  # LIN 20 Slave 5_NoCommunication
  diagnostic event EventLIN20Slave5NoCommunication: aging-allowed=true, event-kind=SWC, prestorage-freeze-frame=false  # Event_LIN 20 Slave 5_NoCommunication
  diagnostic event to trouble code uds mapping EventDtcMapLIN20Slave5NoCommunication: diagnostic-event=EventLIN20Slave5NoCommunication, trouble-code-uds=LIN_20_Slave_5_NoCommunication  # Event_Dtc_Map_LIN 20 Slave 5_NoCommunication
  diagnostic event to operation cycle mapping EventOperCycleMapLIN20Slave5NoCommunication: diagnostic-event=EventLIN20Slave5NoCommunication, operation-cycle=DefaultOperationCycle  # Event_Oper_Cycle_Map_LIN 20 Slave 5_NoCommunication
  diagnostic event to debounce algorithm mapping EventDebounceMapLIN20Slave5NoCommunication: debounce-algorithm=counter_based, diagnostic-event=EventLIN20Slave5NoCommunication  # EventDebounceMap_LIN 20 Slave 5_NoCommunication
package /ZeC/DTC/DTC/LIN_20_Slave_4_Defect
  diagnostic trouble code uds LIN_20_Slave_4_Defect: dtc-props=Dtc_Props_358996c7, uds-dtc-value=0x03140b  # LIN 20 Slave 4_Defect
  diagnostic event EventLIN20Slave4Defect: aging-allowed=true, event-kind=SWC, prestorage-freeze-frame=false  # Event_LIN 20 Slave 4_Defect
  diagnostic event to trouble code uds mapping EventDtcMapLIN20Slave4Defect: diagnostic-event=EventLIN20Slave4Defect, trouble-code-uds=LIN_20_Slave_4_Defect  # Event_Dtc_Map_LIN 20 Slave 4_Defect
  diagnostic event to operation cycle mapping EventOperCycleMapLIN20Slave4Defect: diagnostic-event=EventLIN20Slave4Defect, operation-cycle=DefaultOperationCycle  # Event_Oper_Cycle_Map_LIN 20 Slave 4_Defect
  diagnostic event to debounce algorithm mapping EventDebounceMapLIN20Slave4Defect: debounce-algorithm=counter_based, diagnostic-event=EventLIN20Slave4Defect  # EventDebounceMap_LIN 20 Slave 4_Defect
package /ZeC/DTC/DTC/LIN_20_Slave_4_NoCommunication
  diagnostic trouble code uds LIN_20_Slave_4_NoCommunication: dtc-props=Dtc_Props_358996c7, uds-dtc-value=0x03140c  # LIN 20 Slave 4_NoCommunication
  diagnostic event EventLIN20Slave4NoCommunication: aging-allowed=true, event-kind=SWC, prestorage-freeze-frame=false  # Event_LIN 20 Slave 4_NoCommunication
  diagnostic event to trouble code uds mapping EventDtcMapLIN20Slave4NoCommunication: diagnostic-event=EventLIN20Slave4NoCommunication, trouble-code-uds=LIN_20_Slave_4_NoCommunication  # Event_Dtc_Map_LIN 20 Slave 4_NoCommunication
  diagnostic event to operation cycle mapping EventOperCycleMapLIN20Slave4NoCommunication: diagnostic-event=EventLIN20Slave4NoCommunication, operation-cycle=DefaultOperationCycle  # Event_Oper_Cycle_Map_LIN 20 Slave 4_NoCommunication
  diagnostic event to debounce algorithm mapping EventDebounceMapLIN20Slave4NoCommunication: debounce-algorithm=counter_based, diagnostic-event=EventLIN20Slave4NoCommunication  # EventDebounceMap_LIN 20 Slave 4_NoCommunication
package /ZeC/DTC/DTC/Power_Path_001_Short_to_BAT_Failure
  diagnostic trouble code uds Power_Path_001_Short_to_BAT_Failure: dtc-props=Dtc_Props_67f640d4, uds-dtc-value=0x005101
  diagnostic event EventPowerPath001ShortToBATFailure: aging-allowed=true, event-kind=SWC, prestorage-freeze-frame=false  # Event_Power_Path_001_Short_to_BAT_Failure
  diagnostic event to trouble code uds mapping EventDtcMapPowerPath001ShortToBATFailure: diagnostic-event=EventPowerPath001ShortToBATFailure, trouble-code-uds=Power_Path_001_Short_to_BAT_Failure  # Event_Dtc_Map_Power_Path_001_Short_to_BAT_Failure
  diagnostic event to operation cycle mapping EventOperCycleMapPowerPath001ShortToBATFailure: diagnostic-event=EventPowerPath001ShortToBATFailure, operation-cycle=DefaultOperationCycle  # Event_Oper_Cycle_Map_Power_Path_001_Short_to_BAT_Failure
  diagnostic event to debounce algorithm mapping EventDebounceMapPowerPath001ShortToBATFailure: debounce-algorithm=time_based, diagnostic-event=EventPowerPath001ShortToBATFailure  # EventDebounceMap_Power_Path_001_Short_to_BAT_Failure
package /ZeC/DTC/DTC/Power_Path_133_Over_Load_Failure
  diagnostic trouble code uds Power_Path_133_Over_Load_Failure: dtc-props=Dtc_Props_200074f8, uds-dtc-value=0x005585
  diagnostic event EventPowerPath133OverLoadFailure: aging-allowed=true, event-kind=SWC, prestorage-freeze-frame=false  # Event_Power_Path_133_Over_Load_Failure
  diagnostic event to trouble code uds mapping EventDtcMapPowerPath133OverLoadFailure: diagnostic-event=EventPowerPath133OverLoadFailure, trouble-code-uds=Power_Path_133_Over_Load_Failure  # Event_Dtc_Map_Power_Path_133_Over_Load_Failure
  diagnostic event to operation cycle mapping EventOperCycleMapPowerPath133OverLoadFailure: diagnostic-event=EventPowerPath133OverLoadFailure, operation-cycle=DefaultOperationCycle  # Event_Oper_Cycle_Map_Power_Path_133_Over_Load_Failure
  diagnostic event to debounce algorithm mapping EventDebounceMapPowerPath133OverLoadFailure: debounce-algorithm=time_based, diagnostic-event=EventPowerPath133OverLoadFailure  # EventDebounceMap_Power_Path_133_Over_Load_Failure
package /ZeC/DTC/DTC/LIN_20_Slave_3_NoCommunication
  diagnostic trouble code uds LIN_20_Slave_3_NoCommunication: dtc-props=Dtc_Props_358996c7, uds-dtc-value=0x03140a  # LIN 20 Slave 3_NoCommunication
  diagnostic event EventLIN20Slave3NoCommunication: aging-allowed=true, event-kind=SWC, prestorage-freeze-frame=false  # Event_LIN 20 Slave 3_NoCommunication
  diagnostic event to trouble code uds mapping EventDtcMapLIN20Slave3NoCommunication: diagnostic-event=EventLIN20Slave3NoCommunication, trouble-code-uds=LIN_20_Slave_3_NoCommunication  # Event_Dtc_Map_LIN 20 Slave 3_NoCommunication
  diagnostic event to operation cycle mapping EventOperCycleMapLIN20Slave3NoCommunication: diagnostic-event=EventLIN20Slave3NoCommunication, operation-cycle=DefaultOperationCycle  # Event_Oper_Cycle_Map_LIN 20 Slave 3_NoCommunication
  diagnostic event to debounce algorithm mapping EventDebounceMapLIN20Slave3NoCommunication: debounce-algorithm=counter_based, diagnostic-event=EventLIN20Slave3NoCommunication  # EventDebounceMap_LIN 20 Slave 3_NoCommunication
package /ZeC/DTC/DTC/Power_Path_132_Over_Load_Failure
  diagnostic trouble code uds Power_Path_132_Over_Load_Failure: dtc-props=Dtc_Props_66197ec2, uds-dtc-value=0x005584
  diagnostic event EventPowerPath132OverLoadFailure: aging-allowed=true, event-kind=SWC, prestorage-freeze-frame=false  # Event_Power_Path_132_Over_Load_Failure
  diagnostic event to trouble code uds mapping EventDtcMapPowerPath132OverLoadFailure: diagnostic-event=EventPowerPath132OverLoadFailure, trouble-code-uds=Power_Path_132_Over_Load_Failure  # Event_Dtc_Map_Power_Path_132_Over_Load_Failure
  diagnostic event to operation cycle mapping EventOperCycleMapPowerPath132OverLoadFailure: diagnostic-event=EventPowerPath132OverLoadFailure, operation-cycle=DefaultOperationCycle  # Event_Oper_Cycle_Map_Power_Path_132_Over_Load_Failure
  diagnostic event to debounce algorithm mapping EventDebounceMapPowerPath132OverLoadFailure: debounce-algorithm=time_based, diagnostic-event=EventPowerPath132OverLoadFailure  # EventDebounceMap_Power_Path_132_Over_Load_Failure
package /ZeC/DTC/DTC/Power_Path_003_Short_to_BAT_Failure
  diagnostic trouble code uds Power_Path_003_Short_to_BAT_Failure: dtc-props=Dtc_Props_ebc454a0, uds-dtc-value=0x005103
  diagnostic event EventPowerPath003ShortToBATFailure: aging-allowed=true, event-kind=SWC, prestorage-freeze-frame=false  # Event_Power_Path_003_Short_to_BAT_Failure
  diagnostic event to trouble code uds mapping EventDtcMapPowerPath003ShortToBATFailure: diagnostic-event=EventPowerPath003ShortToBATFailure, trouble-code-uds=Power_Path_003_Short_to_BAT_Failure  # Event_Dtc_Map_Power_Path_003_Short_to_BAT_Failure
  diagnostic event to operation cycle mapping EventOperCycleMapPowerPath003ShortToBATFailure: diagnostic-event=EventPowerPath003ShortToBATFailure, operation-cycle=DefaultOperationCycle  # Event_Oper_Cycle_Map_Power_Path_003_Short_to_BAT_Failure
  diagnostic event to debounce algorithm mapping EventDebounceMapPowerPath003ShortToBATFailure: debounce-algorithm=time_based, diagnostic-event=EventPowerPath003ShortToBATFailure  # EventDebounceMap_Power_Path_003_Short_to_BAT_Failure
package /ZeC/DTC/DTC/Power_Path_135_Over_Load_Failure
  diagnostic trouble code uds Power_Path_135_Over_Load_Failure: dtc-props=Dtc_Props_ac32608c, uds-dtc-value=0x005587
  diagnostic event EventPowerPath135OverLoadFailure: aging-allowed=true, event-kind=SWC, prestorage-freeze-frame=false  # Event_Power_Path_135_Over_Load_Failure
  diagnostic event to trouble code uds mapping EventDtcMapPowerPath135OverLoadFailure: diagnostic-event=EventPowerPath135OverLoadFailure, trouble-code-uds=Power_Path_135_Over_Load_Failure  # Event_Dtc_Map_Power_Path_135_Over_Load_Failure
  diagnostic event to operation cycle mapping EventOperCycleMapPowerPath135OverLoadFailure: diagnostic-event=EventPowerPath135OverLoadFailure, operation-cycle=DefaultOperationCycle  # Event_Oper_Cycle_Map_Power_Path_135_Over_Load_Failure
  diagnostic event to debounce algorithm mapping EventDebounceMapPowerPath135OverLoadFailure: debounce-algorithm=time_based, diagnostic-event=EventPowerPath135OverLoadFailure  # EventDebounceMap_Power_Path_135_Over_Load_Failure
package /ZeC/DTC/DTC/Power_Path_002_Short_to_BAT_Failure
  diagnostic trouble code uds Power_Path_002_Short_to_BAT_Failure: dtc-props=Dtc_Props_addd5e9a, uds-dtc-value=0x005102
  diagnostic event EventPowerPath002ShortToBATFailure: aging-allowed=true, event-kind=SWC, prestorage-freeze-frame=false  # Event_Power_Path_002_Short_to_BAT_Failure
  diagnostic event to trouble code uds mapping EventDtcMapPowerPath002ShortToBATFailure: diagnostic-event=EventPowerPath002ShortToBATFailure, trouble-code-uds=Power_Path_002_Short_to_BAT_Failure  # Event_Dtc_Map_Power_Path_002_Short_to_BAT_Failure
  diagnostic event to operation cycle mapping EventOperCycleMapPowerPath002ShortToBATFailure: diagnostic-event=EventPowerPath002ShortToBATFailure, operation-cycle=DefaultOperationCycle  # Event_Oper_Cycle_Map_Power_Path_002_Short_to_BAT_Failure
  diagnostic event to debounce algorithm mapping EventDebounceMapPowerPath002ShortToBATFailure: debounce-algorithm=time_based, diagnostic-event=EventPowerPath002ShortToBATFailure  # EventDebounceMap_Power_Path_002_Short_to_BAT_Failure
package /ZeC/DTC/DTC/Power_Path_134_Over_Load_Failure
  diagnostic trouble code uds Power_Path_134_Over_Load_Failure: dtc-props=Dtc_Props_ea2b6ab6, uds-dtc-value=0x005586
  diagnostic event EventPowerPath134OverLoadFailure: aging-allowed=true, event-kind=SWC, prestorage-freeze-frame=false  # Event_Power_Path_134_Over_Load_Failure
  diagnostic event to trouble code uds mapping EventDtcMapPowerPath134OverLoadFailure: diagnostic-event=EventPowerPath134OverLoadFailure, trouble-code-uds=Power_Path_134_Over_Load_Failure  # Event_Dtc_Map_Power_Path_134_Over_Load_Failure
  diagnostic event to operation cycle mapping EventOperCycleMapPowerPath134OverLoadFailure: diagnostic-event=EventPowerPath134OverLoadFailure, operation-cycle=DefaultOperationCycle  # Event_Oper_Cycle_Map_Power_Path_134_Over_Load_Failure
  diagnostic event to debounce algorithm mapping EventDebounceMapPowerPath134OverLoadFailure: debounce-algorithm=time_based, diagnostic-event=EventPowerPath134OverLoadFailure  # EventDebounceMap_Power_Path_134_Over_Load_Failure
package /ZeC/DTC/DTC/Power_Path_129_Over_Load_Failure
  diagnostic trouble code uds Power_Path_129_Over_Load_Failure: dtc-props=Dtc_Props_e3155a51, uds-dtc-value=0x005581
  diagnostic event EventPowerPath129OverLoadFailure: aging-allowed=true, event-kind=SWC, prestorage-freeze-frame=false  # Event_Power_Path_129_Over_Load_Failure
  diagnostic event to trouble code uds mapping EventDtcMapPowerPath129OverLoadFailure: diagnostic-event=EventPowerPath129OverLoadFailure, trouble-code-uds=Power_Path_129_Over_Load_Failure  # Event_Dtc_Map_Power_Path_129_Over_Load_Failure
  diagnostic event to operation cycle mapping EventOperCycleMapPowerPath129OverLoadFailure: diagnostic-event=EventPowerPath129OverLoadFailure, operation-cycle=DefaultOperationCycle  # Event_Oper_Cycle_Map_Power_Path_129_Over_Load_Failure
  diagnostic event to debounce algorithm mapping EventDebounceMapPowerPath129OverLoadFailure: debounce-algorithm=time_based, diagnostic-event=EventPowerPath129OverLoadFailure  # EventDebounceMap_Power_Path_129_Over_Load_Failure
package /ZeC/DTC/DTC/Power_Path_128_Over_Load_Failure
  diagnostic trouble code uds Power_Path_128_Over_Load_Failure: dtc-props=Dtc_Props_a50c506b, uds-dtc-value=0x005580
  diagnostic event EventPowerPath128OverLoadFailure: aging-allowed=true, event-kind=SWC, prestorage-freeze-frame=false  # Event_Power_Path_128_Over_Load_Failure
  diagnostic event to trouble code uds mapping EventDtcMapPowerPath128OverLoadFailure: diagnostic-event=EventPowerPath128OverLoadFailure, trouble-code-uds=Power_Path_128_Over_Load_Failure  # Event_Dtc_Map_Power_Path_128_Over_Load_Failure
  diagnostic event to operation cycle mapping EventOperCycleMapPowerPath128OverLoadFailure: diagnostic-event=EventPowerPath128OverLoadFailure, operation-cycle=DefaultOperationCycle  # Event_Oper_Cycle_Map_Power_Path_128_Over_Load_Failure
  diagnostic event to debounce algorithm mapping EventDebounceMapPowerPath128OverLoadFailure: debounce-algorithm=time_based, diagnostic-event=EventPowerPath128OverLoadFailure  # EventDebounceMap_Power_Path_128_Over_Load_Failure
package /ZeC/DTC/DTC/Power_Path_131_Over_Load_Failure
  diagnostic trouble code uds Power_Path_131_Over_Load_Failure: dtc-props=Dtc_Props_6f274e25, uds-dtc-value=0x005583
  diagnostic event EventPowerPath131OverLoadFailure: aging-allowed=true, event-kind=SWC, prestorage-freeze-frame=false  # Event_Power_Path_131_Over_Load_Failure
  diagnostic event to trouble code uds mapping EventDtcMapPowerPath131OverLoadFailure: diagnostic-event=EventPowerPath131OverLoadFailure, trouble-code-uds=Power_Path_131_Over_Load_Failure  # Event_Dtc_Map_Power_Path_131_Over_Load_Failure
  diagnostic event to operation cycle mapping EventOperCycleMapPowerPath131OverLoadFailure: diagnostic-event=EventPowerPath131OverLoadFailure, operation-cycle=DefaultOperationCycle  # Event_Oper_Cycle_Map_Power_Path_131_Over_Load_Failure
  diagnostic event to debounce algorithm mapping EventDebounceMapPowerPath131OverLoadFailure: debounce-algorithm=time_based, diagnostic-event=EventPowerPath131OverLoadFailure  # EventDebounceMap_Power_Path_131_Over_Load_Failure
package /ZeC/DTC/DTC/Power_Path_130_Over_Load_Failure
  diagnostic trouble code uds Power_Path_130_Over_Load_Failure: dtc-props=Dtc_Props_293e441f, uds-dtc-value=0x005582
  diagnostic event EventPowerPath130OverLoadFailure: aging-allowed=true, event-kind=SWC, prestorage-freeze-frame=false  # Event_Power_Path_130_Over_Load_Failure
  diagnostic event to trouble code uds mapping EventDtcMapPowerPath130OverLoadFailure: diagnostic-event=EventPowerPath130OverLoadFailure, trouble-code-uds=Power_Path_130_Over_Load_Failure  # Event_Dtc_Map_Power_Path_130_Over_Load_Failure
  diagnostic event to operation cycle mapping EventOperCycleMapPowerPath130OverLoadFailure: diagnostic-event=EventPowerPath130OverLoadFailure, operation-cycle=DefaultOperationCycle  # Event_Oper_Cycle_Map_Power_Path_130_Over_Load_Failure
  diagnostic event to debounce algorithm mapping EventDebounceMapPowerPath130OverLoadFailure: debounce-algorithm=time_based, diagnostic-event=EventPowerPath130OverLoadFailure  # EventDebounceMap_Power_Path_130_Over_Load_Failure
package /ZeC/DTC/DTC/CAN_07_ECU_2_No_Communication
  diagnostic trouble code uds CAN_07_ECU_2_No_Communication: dtc-props=Dtc_Props_14158306, uds-dtc-value=0x032706
  diagnostic event EventCAN07ECU2NoCommunication: aging-allowed=true, event-kind=SWC, prestorage-freeze-frame=false  # Event_CAN_07_ECU_2_No_Communication
  diagnostic event to trouble code uds mapping EventDtcMapCAN07ECU2NoCommunication: diagnostic-event=EventCAN07ECU2NoCommunication, trouble-code-uds=CAN_07_ECU_2_No_Communication  # Event_Dtc_Map_CAN_07_ECU_2_No_Communication
  diagnostic event to operation cycle mapping EventOperCycleMapCAN07ECU2NoCommunication: diagnostic-event=EventCAN07ECU2NoCommunication, operation-cycle=DefaultOperationCycle  # Event_Oper_Cycle_Map_CAN_07_ECU_2_No_Communication
  diagnostic event to debounce algorithm mapping EventDebounceMapCAN07ECU2NoCommunication: debounce-algorithm=counter_based, diagnostic-event=EventCAN07ECU2NoCommunication  # EventDebounceMap_CAN_07_ECU_2_No_Communication
package /ZeC/DTC/DTC/CAN_07_ECU_3_No_Communication
  diagnostic trouble code uds CAN_07_ECU_3_No_Communication: dtc-props=Dtc_Props_14158306, uds-dtc-value=0x032707
  diagnostic event EventCAN07ECU3NoCommunication: aging-allowed=true, event-kind=SWC, prestorage-freeze-frame=false  # Event_CAN_07_ECU_3_No_Communication
  diagnostic event to trouble code uds mapping EventDtcMapCAN07ECU3NoCommunication: diagnostic-event=EventCAN07ECU3NoCommunication, trouble-code-uds=CAN_07_ECU_3_No_Communication  # Event_Dtc_Map_CAN_07_ECU_3_No_Communication
  diagnostic event to operation cycle mapping EventOperCycleMapCAN07ECU3NoCommunication: diagnostic-event=EventCAN07ECU3NoCommunication, operation-cycle=DefaultOperationCycle  # Event_Oper_Cycle_Map_CAN_07_ECU_3_No_Communication
  diagnostic event to debounce algorithm mapping EventDebounceMapCAN07ECU3NoCommunication: debounce-algorithm=counter_based, diagnostic-event=EventCAN07ECU3NoCommunication  # EventDebounceMap_CAN_07_ECU_3_No_Communication
package /ZeC/DTC/DTC/DB_CANFD_07_Error_Received_Value
  diagnostic trouble code uds DB_CANFD_07_Error_Received_Value: dtc-props=Dtc_Props_b618fb9, uds-dtc-value=0x032704
  diagnostic event EventDBCANFD07ErrorReceivedValue: aging-allowed=true, event-kind=SWC, prestorage-freeze-frame=false  # Event_DB_CANFD_07_Error_Received_Value
  diagnostic event to trouble code uds mapping EventDtcMapDBCANFD07ErrorReceivedValue: diagnostic-event=EventDBCANFD07ErrorReceivedValue, trouble-code-uds=DB_CANFD_07_Error_Received_Value  # Event_Dtc_Map_DB_CANFD_07_Error_Received_Value
  diagnostic event to operation cycle mapping EventOperCycleMapDBCANFD07ErrorReceivedValue: diagnostic-event=EventDBCANFD07ErrorReceivedValue, operation-cycle=DefaultOperationCycle  # Event_Oper_Cycle_Map_DB_CANFD_07_Error_Received_Value
  diagnostic event to debounce algorithm mapping EventDebounceMapDBCANFD07ErrorReceivedValue: debounce-algorithm=counter_based, diagnostic-event=EventDBCANFD07ErrorReceivedValue  # EventDebounceMap_DB_CANFD_07_Error_Received_Value
package /ZeC/DTC/DTC/CAN_07_ECU_1_No_Communication
  diagnostic trouble code uds CAN_07_ECU_1_No_Communication: dtc-props=Dtc_Props_14158306, uds-dtc-value=0x032705
  diagnostic event EventCAN07ECU1NoCommunication: aging-allowed=true, event-kind=SWC, prestorage-freeze-frame=false  # Event_CAN_07_ECU_1_No_Communication
  diagnostic event to trouble code uds mapping EventDtcMapCAN07ECU1NoCommunication: diagnostic-event=EventCAN07ECU1NoCommunication, trouble-code-uds=CAN_07_ECU_1_No_Communication  # Event_Dtc_Map_CAN_07_ECU_1_No_Communication
  diagnostic event to operation cycle mapping EventOperCycleMapCAN07ECU1NoCommunication: diagnostic-event=EventCAN07ECU1NoCommunication, operation-cycle=DefaultOperationCycle  # Event_Oper_Cycle_Map_CAN_07_ECU_1_No_Communication
  diagnostic event to debounce algorithm mapping EventDebounceMapCAN07ECU1NoCommunication: debounce-algorithm=counter_based, diagnostic-event=EventCAN07ECU1NoCommunication  # EventDebounceMap_CAN_07_ECU_1_No_Communication
package /ZeC/DTC/DTC/Power_Path_039_Short_to_BAT_Failure
  diagnostic trouble code uds Power_Path_039_Short_to_BAT_Failure: dtc-props=Dtc_Props_7f35fd38, uds-dtc-value=0x005127
  diagnostic event EventPowerPath039ShortToBATFailure: aging-allowed=true, event-kind=SWC, prestorage-freeze-frame=false  # Event_Power_Path_039_Short_to_BAT_Failure
  diagnostic event to trouble code uds mapping EventDtcMapPowerPath039ShortToBATFailure: diagnostic-event=EventPowerPath039ShortToBATFailure, trouble-code-uds=Power_Path_039_Short_to_BAT_Failure  # Event_Dtc_Map_Power_Path_039_Short_to_BAT_Failure
  diagnostic event to operation cycle mapping EventOperCycleMapPowerPath039ShortToBATFailure: diagnostic-event=EventPowerPath039ShortToBATFailure, operation-cycle=DefaultOperationCycle  # Event_Oper_Cycle_Map_Power_Path_039_Short_to_BAT_Failure
  diagnostic event to debounce algorithm mapping EventDebounceMapPowerPath039ShortToBATFailure: debounce-algorithm=time_based, diagnostic-event=EventPowerPath039ShortToBATFailure  # EventDebounceMap_Power_Path_039_Short_to_BAT_Failure
package /ZeC/DTC/DTC/DB_CANFD_07_No_Communication
  diagnostic trouble code uds DB_CANFD_07_No_Communication: dtc-props=Dtc_Props_14158306, uds-dtc-value=0x032702
  diagnostic event EventDBCANFD07NoCommunication: aging-allowed=true, event-kind=SWC, prestorage-freeze-frame=false  # Event_DB_CANFD_07_No_Communication
  diagnostic event to trouble code uds mapping EventDtcMapDBCANFD07NoCommunication: diagnostic-event=EventDBCANFD07NoCommunication, trouble-code-uds=DB_CANFD_07_No_Communication  # Event_Dtc_Map_DB_CANFD_07_No_Communication
  diagnostic event to operation cycle mapping EventOperCycleMapDBCANFD07NoCommunication: diagnostic-event=EventDBCANFD07NoCommunication, operation-cycle=DefaultOperationCycle  # Event_Oper_Cycle_Map_DB_CANFD_07_No_Communication
  diagnostic event to debounce algorithm mapping EventDebounceMapDBCANFD07NoCommunication: debounce-algorithm=counter_based, diagnostic-event=EventDBCANFD07NoCommunication  # EventDebounceMap_DB_CANFD_07_No_Communication
package /ZeC/DTC/DTC/Power_Path_038_Short_to_BAT_Failure
  diagnostic trouble code uds Power_Path_038_Short_to_BAT_Failure: dtc-props=Dtc_Props_392cf702, uds-dtc-value=0x005126
  diagnostic event EventPowerPath038ShortToBATFailure: aging-allowed=true, event-kind=SWC, prestorage-freeze-frame=false  # Event_Power_Path_038_Short_to_BAT_Failure
  diagnostic event to trouble code uds mapping EventDtcMapPowerPath038ShortToBATFailure: diagnostic-event=EventPowerPath038ShortToBATFailure, trouble-code-uds=Power_Path_038_Short_to_BAT_Failure  # Event_Dtc_Map_Power_Path_038_Short_to_BAT_Failure
  diagnostic event to operation cycle mapping EventOperCycleMapPowerPath038ShortToBATFailure: diagnostic-event=EventPowerPath038ShortToBATFailure, operation-cycle=DefaultOperationCycle  # Event_Oper_Cycle_Map_Power_Path_038_Short_to_BAT_Failure
  diagnostic event to debounce algorithm mapping EventDebounceMapPowerPath038ShortToBATFailure: debounce-algorithm=time_based, diagnostic-event=EventPowerPath038ShortToBATFailure  # EventDebounceMap_Power_Path_038_Short_to_BAT_Failure
package /ZeC/DTC/DTC/DB_CANFD_07_Single_Wire_Mode
  diagnostic trouble code uds DB_CANFD_07_Single_Wire_Mode: dtc-props=Dtc_Props_14158306, uds-dtc-value=0x032703
  diagnostic event EventDBCANFD07SingleWireMode: aging-allowed=true, event-kind=SWC, prestorage-freeze-frame=false  # Event_DB_CANFD_07_Single_Wire_Mode
  diagnostic event to trouble code uds mapping EventDtcMapDBCANFD07SingleWireMode: diagnostic-event=EventDBCANFD07SingleWireMode, trouble-code-uds=DB_CANFD_07_Single_Wire_Mode  # Event_Dtc_Map_DB_CANFD_07_Single_Wire_Mode
  diagnostic event to operation cycle mapping EventOperCycleMapDBCANFD07SingleWireMode: diagnostic-event=EventDBCANFD07SingleWireMode, operation-cycle=DefaultOperationCycle  # Event_Oper_Cycle_Map_DB_CANFD_07_Single_Wire_Mode
  diagnostic event to debounce algorithm mapping EventDebounceMapDBCANFD07SingleWireMode: debounce-algorithm=counter_based, diagnostic-event=EventDBCANFD07SingleWireMode  # EventDebounceMap_DB_CANFD_07_Single_Wire_Mode
package /ZeC/DTC/DTC/Power_Path_041_Short_to_BAT_Failure
  diagnostic trouble code uds Power_Path_041_Short_to_BAT_Failure: dtc-props=Dtc_Props_6d499cf6, uds-dtc-value=0x005129
  diagnostic event EventPowerPath041ShortToBATFailure: aging-allowed=true, event-kind=SWC, prestorage-freeze-frame=false  # Event_Power_Path_041_Short_to_BAT_Failure
  diagnostic event to trouble code uds mapping EventDtcMapPowerPath041ShortToBATFailure: diagnostic-event=EventPowerPath041ShortToBATFailure, trouble-code-uds=Power_Path_041_Short_to_BAT_Failure  # Event_Dtc_Map_Power_Path_041_Short_to_BAT_Failure
  diagnostic event to operation cycle mapping EventOperCycleMapPowerPath041ShortToBATFailure: diagnostic-event=EventPowerPath041ShortToBATFailure, operation-cycle=DefaultOperationCycle  # Event_Oper_Cycle_Map_Power_Path_041_Short_to_BAT_Failure
  diagnostic event to debounce algorithm mapping EventDebounceMapPowerPath041ShortToBATFailure: debounce-algorithm=time_based, diagnostic-event=EventPowerPath041ShortToBATFailure  # EventDebounceMap_Power_Path_041_Short_to_BAT_Failure
package /ZeC/DTC/DTC/Power_Path_040_Short_to_BAT_Failure
  diagnostic trouble code uds Power_Path_040_Short_to_BAT_Failure: dtc-props=Dtc_Props_2b5096cc, uds-dtc-value=0x005128
  diagnostic event EventPowerPath040ShortToBATFailure: aging-allowed=true, event-kind=SWC, prestorage-freeze-frame=false  # Event_Power_Path_040_Short_to_BAT_Failure
  diagnostic event to trouble code uds mapping EventDtcMapPowerPath040ShortToBATFailure: diagnostic-event=EventPowerPath040ShortToBATFailure, trouble-code-uds=Power_Path_040_Short_to_BAT_Failure  # Event_Dtc_Map_Power_Path_040_Short_to_BAT_Failure
  diagnostic event to operation cycle mapping EventOperCycleMapPowerPath040ShortToBATFailure: diagnostic-event=EventPowerPath040ShortToBATFailure, operation-cycle=DefaultOperationCycle  # Event_Oper_Cycle_Map_Power_Path_040_Short_to_BAT_Failure
  diagnostic event to debounce algorithm mapping EventDebounceMapPowerPath040ShortToBATFailure: debounce-algorithm=time_based, diagnostic-event=EventPowerPath040ShortToBATFailure  # EventDebounceMap_Power_Path_040_Short_to_BAT_Failure
package /ZeC/DTC/DTC/DB_CANFD_07_Defect
  diagnostic trouble code uds DB_CANFD_07_Defect: dtc-props=Dtc_Props_14158306, uds-dtc-value=0x032701
  diagnostic event EventDBCANFD07Defect: aging-allowed=true, event-kind=SWC, prestorage-freeze-frame=false  # Event_DB_CANFD_07_Defect
  diagnostic event to trouble code uds mapping EventDtcMapDBCANFD07Defect: diagnostic-event=EventDBCANFD07Defect, trouble-code-uds=DB_CANFD_07_Defect  # Event_Dtc_Map_DB_CANFD_07_Defect
  diagnostic event to operation cycle mapping EventOperCycleMapDBCANFD07Defect: diagnostic-event=EventDBCANFD07Defect, operation-cycle=DefaultOperationCycle  # Event_Oper_Cycle_Map_DB_CANFD_07_Defect
  diagnostic event to debounce algorithm mapping EventDebounceMapDBCANFD07Defect: debounce-algorithm=counter_based, diagnostic-event=EventDBCANFD07Defect  # EventDebounceMap_DB_CANFD_07_Defect
package /ZeC/DTC/DTC/Power_Path_044_Short_to_BAT_Failure
  diagnostic trouble code uds Power_Path_044_Short_to_BAT_Failure: dtc-props=Dtc_Props_81dfb7ec, uds-dtc-value=0x00512c
  diagnostic event EventPowerPath044ShortToBATFailure: aging-allowed=true, event-kind=SWC, prestorage-freeze-frame=false  # Event_Power_Path_044_Short_to_BAT_Failure
  diagnostic event to trouble code uds mapping EventDtcMapPowerPath044ShortToBATFailure: diagnostic-event=EventPowerPath044ShortToBATFailure, trouble-code-uds=Power_Path_044_Short_to_BAT_Failure  # Event_Dtc_Map_Power_Path_044_Short_to_BAT_Failure
  diagnostic event to operation cycle mapping EventOperCycleMapPowerPath044ShortToBATFailure: diagnostic-event=EventPowerPath044ShortToBATFailure, operation-cycle=DefaultOperationCycle  # Event_Oper_Cycle_Map_Power_Path_044_Short_to_BAT_Failure
  diagnostic event to debounce algorithm mapping EventDebounceMapPowerPath044ShortToBATFailure: debounce-algorithm=time_based, diagnostic-event=EventPowerPath044ShortToBATFailure  # EventDebounceMap_Power_Path_044_Short_to_BAT_Failure
package /ZeC/DTC/DTC/Power_Path_043_Short_to_BAT_Failure
  diagnostic trouble code uds Power_Path_043_Short_to_BAT_Failure: dtc-props=Dtc_Props_c7c6bdd6, uds-dtc-value=0x00512b
  diagnostic event EventPowerPath043ShortToBATFailure: aging-allowed=true, event-kind=SWC, prestorage-freeze-frame=false  # Event_Power_Path_043_Short_to_BAT_Failure
  diagnostic event to trouble code uds mapping EventDtcMapPowerPath043ShortToBATFailure: diagnostic-event=EventPowerPath043ShortToBATFailure, trouble-code-uds=Power_Path_043_Short_to_BAT_Failure  # Event_Dtc_Map_Power_Path_043_Short_to_BAT_Failure
  diagnostic event to operation cycle mapping EventOperCycleMapPowerPath043ShortToBATFailure: diagnostic-event=EventPowerPath043ShortToBATFailure, operation-cycle=DefaultOperationCycle  # Event_Oper_Cycle_Map_Power_Path_043_Short_to_BAT_Failure
  diagnostic event to debounce algorithm mapping EventDebounceMapPowerPath043ShortToBATFailure: debounce-algorithm=time_based, diagnostic-event=EventPowerPath043ShortToBATFailure  # EventDebounceMap_Power_Path_043_Short_to_BAT_Failure
package /ZeC/DTC/DTC/LIN_5_Local_Databus_Electrical_Failure
  diagnostic trouble code uds LIN_5_Local_Databus_Electrical_Failure: dtc-props=Dtc_Props_358996c7, uds-dtc-value=0x030521  # LIN 5 Local_Databus_Electrical_Failure
  diagnostic event EventLIN5LocalDatabusElectricalFailure: aging-allowed=true, event-kind=SWC, prestorage-freeze-frame=false  # Event_LIN 5 Local_Databus_Electrical_Failure
  diagnostic event to trouble code uds mapping EventDtcMapLIN5LocalDatabusElectricalFailure: diagnostic-event=EventLIN5LocalDatabusElectricalFailure, trouble-code-uds=LIN_5_Local_Databus_Electrical_Failure  # Event_Dtc_Map_LIN 5 Local_Databus_Electrical_Failure
  diagnostic event to operation cycle mapping EventOperCycleMapLIN5LocalDatabusElectricalFailure: diagnostic-event=EventLIN5LocalDatabusElectricalFailure, operation-cycle=DefaultOperationCycle  # Event_Oper_Cycle_Map_LIN 5 Local_Databus_Electrical_Failure
  diagnostic event to debounce algorithm mapping EventDebounceMapLIN5LocalDatabusElectricalFailure: debounce-algorithm=counter_based, diagnostic-event=EventLIN5LocalDatabusElectricalFailure  # EventDebounceMap_LIN 5 Local_Databus_Electrical_Failure
package /ZeC/DTC/DTC/Power_Path_046_Short_to_BAT_Failure
  diagnostic trouble code uds Power_Path_046_Short_to_BAT_Failure: dtc-props=Dtc_Props_cef88d31, uds-dtc-value=0x00512e
  diagnostic event EventPowerPath046ShortToBATFailure: aging-allowed=true, event-kind=SWC, prestorage-freeze-frame=false  # Event_Power_Path_046_Short_to_BAT_Failure
  diagnostic event to trouble code uds mapping EventDtcMapPowerPath046ShortToBATFailure: diagnostic-event=EventPowerPath046ShortToBATFailure, trouble-code-uds=Power_Path_046_Short_to_BAT_Failure  # Event_Dtc_Map_Power_Path_046_Short_to_BAT_Failure
  diagnostic event to operation cycle mapping EventOperCycleMapPowerPath046ShortToBATFailure: diagnostic-event=EventPowerPath046ShortToBATFailure, operation-cycle=DefaultOperationCycle  # Event_Oper_Cycle_Map_Power_Path_046_Short_to_BAT_Failure
  diagnostic event to debounce algorithm mapping EventDebounceMapPowerPath046ShortToBATFailure: debounce-algorithm=time_based, diagnostic-event=EventPowerPath046ShortToBATFailure  # EventDebounceMap_Power_Path_046_Short_to_BAT_Failure
package /ZeC/DTC/DTC/LIN_5_Databus_No_Comm
  diagnostic trouble code uds LIN_5_Databus_No_Comm: dtc-props=Dtc_Props_358996c7, uds-dtc-value=0x030520  # LIN 5 Databus_No_Comm
  diagnostic event EventLIN5DatabusNoComm: aging-allowed=true, event-kind=SWC, prestorage-freeze-frame=false  # Event_LIN 5 Databus_No_Comm
  diagnostic event to trouble code uds mapping EventDtcMapLIN5DatabusNoComm: diagnostic-event=EventLIN5DatabusNoComm, trouble-code-uds=LIN_5_Databus_No_Comm  # Event_Dtc_Map_LIN 5 Databus_No_Comm
  diagnostic event to operation cycle mapping EventOperCycleMapLIN5DatabusNoComm: diagnostic-event=EventLIN5DatabusNoComm, operation-cycle=DefaultOperationCycle  # Event_Oper_Cycle_Map_LIN 5 Databus_No_Comm
  diagnostic event to debounce algorithm mapping EventDebounceMapLIN5DatabusNoComm: debounce-algorithm=counter_based, diagnostic-event=EventLIN5DatabusNoComm  # EventDebounceMap_LIN 5 Databus_No_Comm
package /ZeC/DTC/DTC/Power_Path_045_Short_to_BAT_Failure
  diagnostic trouble code uds Power_Path_045_Short_to_BAT_Failure: dtc-props=Dtc_Props_88e1870b, uds-dtc-value=0x00512d
  diagnostic event EventPowerPath045ShortToBATFailure: aging-allowed=true, event-kind=SWC, prestorage-freeze-frame=false  # Event_Power_Path_045_Short_to_BAT_Failure
  diagnostic event to trouble code uds mapping EventDtcMapPowerPath045ShortToBATFailure: diagnostic-event=EventPowerPath045ShortToBATFailure, trouble-code-uds=Power_Path_045_Short_to_BAT_Failure  # Event_Dtc_Map_Power_Path_045_Short_to_BAT_Failure
  diagnostic event to operation cycle mapping EventOperCycleMapPowerPath045ShortToBATFailure: diagnostic-event=EventPowerPath045ShortToBATFailure, operation-cycle=DefaultOperationCycle  # Event_Oper_Cycle_Map_Power_Path_045_Short_to_BAT_Failure
  diagnostic event to debounce algorithm mapping EventDebounceMapPowerPath045ShortToBATFailure: debounce-algorithm=time_based, diagnostic-event=EventPowerPath045ShortToBATFailure  # EventDebounceMap_Power_Path_045_Short_to_BAT_Failure
package /ZeC/DTC/DTC/Power_Path_042_Short_to_BAT_Failure
  diagnostic trouble code uds Power_Path_042_Short_to_BAT_Failure: dtc-props=Dtc_Props_deda398, uds-dtc-value=0x00512a
  diagnostic event EventPowerPath042ShortToBATFailure: aging-allowed=true, event-kind=SWC, prestorage-freeze-frame=false  # Event_Power_Path_042_Short_to_BAT_Failure
  diagnostic event to trouble code uds mapping EventDtcMapPowerPath042ShortToBATFailure: diagnostic-event=EventPowerPath042ShortToBATFailure, trouble-code-uds=Power_Path_042_Short_to_BAT_Failure  # Event_Dtc_Map_Power_Path_042_Short_to_BAT_Failure
  diagnostic event to operation cycle mapping EventOperCycleMapPowerPath042ShortToBATFailure: diagnostic-event=EventPowerPath042ShortToBATFailure, operation-cycle=DefaultOperationCycle  # Event_Oper_Cycle_Map_Power_Path_042_Short_to_BAT_Failure
  diagnostic event to debounce algorithm mapping EventDebounceMapPowerPath042ShortToBATFailure: debounce-algorithm=time_based, diagnostic-event=EventPowerPath042ShortToBATFailure  # EventDebounceMap_Power_Path_042_Short_to_BAT_Failure
package /ZeC/DTC/DTC/Power_Path_047_Short_to_BAT_Failure
  diagnostic trouble code uds Power_Path_047_Short_to_BAT_Failure: dtc-props=Dtc_Props_4d3937f, uds-dtc-value=0x00512f
  diagnostic event EventPowerPath047ShortToBATFailure: aging-allowed=true, event-kind=SWC, prestorage-freeze-frame=false  # Event_Power_Path_047_Short_to_BAT_Failure
  diagnostic event to trouble code uds mapping EventDtcMapPowerPath047ShortToBATFailure: diagnostic-event=EventPowerPath047ShortToBATFailure, trouble-code-uds=Power_Path_047_Short_to_BAT_Failure  # Event_Dtc_Map_Power_Path_047_Short_to_BAT_Failure
  diagnostic event to operation cycle mapping EventOperCycleMapPowerPath047ShortToBATFailure: diagnostic-event=EventPowerPath047ShortToBATFailure, operation-cycle=DefaultOperationCycle  # Event_Oper_Cycle_Map_Power_Path_047_Short_to_BAT_Failure
  diagnostic event to debounce algorithm mapping EventDebounceMapPowerPath047ShortToBATFailure: debounce-algorithm=time_based, diagnostic-event=EventPowerPath047ShortToBATFailure  # EventDebounceMap_Power_Path_047_Short_to_BAT_Failure
package /ZeC/DTC/DTC/Power_Path_052_Short_to_BAT_Failure
  diagnostic trouble code uds Power_Path_052_Short_to_BAT_Failure: dtc-props=Dtc_Props_735423ce, uds-dtc-value=0x005134
  diagnostic event EventPowerPath052ShortToBATFailure: aging-allowed=true, event-kind=SWC, prestorage-freeze-frame=false  # Event_Power_Path_052_Short_to_BAT_Failure
  diagnostic event to trouble code uds mapping EventDtcMapPowerPath052ShortToBATFailure: diagnostic-event=EventPowerPath052ShortToBATFailure, trouble-code-uds=Power_Path_052_Short_to_BAT_Failure  # Event_Dtc_Map_Power_Path_052_Short_to_BAT_Failure
  diagnostic event to operation cycle mapping EventOperCycleMapPowerPath052ShortToBATFailure: diagnostic-event=EventPowerPath052ShortToBATFailure, operation-cycle=DefaultOperationCycle  # Event_Oper_Cycle_Map_Power_Path_052_Short_to_BAT_Failure
  diagnostic event to debounce algorithm mapping EventDebounceMapPowerPath052ShortToBATFailure: debounce-algorithm=time_based, diagnostic-event=EventPowerPath052ShortToBATFailure  # EventDebounceMap_Power_Path_052_Short_to_BAT_Failure
package /ZeC/DTC/DTC/Power_Path_051_Short_to_BAT_Failure
  diagnostic trouble code uds Power_Path_051_Short_to_BAT_Failure: dtc-props=Dtc_Props_7a6a1329, uds-dtc-value=0x005133
  diagnostic event EventPowerPath051ShortToBATFailure: aging-allowed=true, event-kind=SWC, prestorage-freeze-frame=false  # Event_Power_Path_051_Short_to_BAT_Failure
  diagnostic event to trouble code uds mapping EventDtcMapPowerPath051ShortToBATFailure: diagnostic-event=EventPowerPath051ShortToBATFailure, trouble-code-uds=Power_Path_051_Short_to_BAT_Failure  # Event_Dtc_Map_Power_Path_051_Short_to_BAT_Failure
  diagnostic event to operation cycle mapping EventOperCycleMapPowerPath051ShortToBATFailure: diagnostic-event=EventPowerPath051ShortToBATFailure, operation-cycle=DefaultOperationCycle  # Event_Oper_Cycle_Map_Power_Path_051_Short_to_BAT_Failure
  diagnostic event to debounce algorithm mapping EventDebounceMapPowerPath051ShortToBATFailure: debounce-algorithm=time_based, diagnostic-event=EventPowerPath051ShortToBATFailure  # EventDebounceMap_Power_Path_051_Short_to_BAT_Failure
package /ZeC/DTC/DTC/Power_Path_054_Short_to_BAT_Failure
  diagnostic trouble code uds Power_Path_054_Short_to_BAT_Failure: dtc-props=Dtc_Props_ff6637ba, uds-dtc-value=0x005136
  diagnostic event EventPowerPath054ShortToBATFailure: aging-allowed=true, event-kind=SWC, prestorage-freeze-frame=false  # Event_Power_Path_054_Short_to_BAT_Failure
  diagnostic event to trouble code uds mapping EventDtcMapPowerPath054ShortToBATFailure: diagnostic-event=EventPowerPath054ShortToBATFailure, trouble-code-uds=Power_Path_054_Short_to_BAT_Failure  # Event_Dtc_Map_Power_Path_054_Short_to_BAT_Failure
  diagnostic event to operation cycle mapping EventOperCycleMapPowerPath054ShortToBATFailure: diagnostic-event=EventPowerPath054ShortToBATFailure, operation-cycle=DefaultOperationCycle  # Event_Oper_Cycle_Map_Power_Path_054_Short_to_BAT_Failure
  diagnostic event to debounce algorithm mapping EventDebounceMapPowerPath054ShortToBATFailure: debounce-algorithm=time_based, diagnostic-event=EventPowerPath054ShortToBATFailure  # EventDebounceMap_Power_Path_054_Short_to_BAT_Failure
package /ZeC/DTC/DTC/Power_Path_053_Short_to_BAT_Failure
  diagnostic trouble code uds Power_Path_053_Short_to_BAT_Failure: dtc-props=Dtc_Props_354d29f4, uds-dtc-value=0x005135
  diagnostic event EventPowerPath053ShortToBATFailure: aging-allowed=true, event-kind=SWC, prestorage-freeze-frame=false  # Event_Power_Path_053_Short_to_BAT_Failure
  diagnostic event to trouble code uds mapping EventDtcMapPowerPath053ShortToBATFailure: diagnostic-event=EventPowerPath053ShortToBATFailure, trouble-code-uds=Power_Path_053_Short_to_BAT_Failure  # Event_Dtc_Map_Power_Path_053_Short_to_BAT_Failure
  diagnostic event to operation cycle mapping EventOperCycleMapPowerPath053ShortToBATFailure: diagnostic-event=EventPowerPath053ShortToBATFailure, operation-cycle=DefaultOperationCycle  # Event_Oper_Cycle_Map_Power_Path_053_Short_to_BAT_Failure
  diagnostic event to debounce algorithm mapping EventDebounceMapPowerPath053ShortToBATFailure: debounce-algorithm=time_based, diagnostic-event=EventPowerPath053ShortToBATFailure  # EventDebounceMap_Power_Path_053_Short_to_BAT_Failure
package /ZeC/DTC/DTC/Power_Path_048_Short_to_BAT_Failure
  diagnostic trouble code uds Power_Path_048_Short_to_BAT_Failure: dtc-props=Dtc_Props_b0410d67, uds-dtc-value=0x005130
  diagnostic event EventPowerPath048ShortToBATFailure: aging-allowed=true, event-kind=SWC, prestorage-freeze-frame=false  # Event_Power_Path_048_Short_to_BAT_Failure
  diagnostic event to trouble code uds mapping EventDtcMapPowerPath048ShortToBATFailure: diagnostic-event=EventPowerPath048ShortToBATFailure, trouble-code-uds=Power_Path_048_Short_to_BAT_Failure  # Event_Dtc_Map_Power_Path_048_Short_to_BAT_Failure
  diagnostic event to operation cycle mapping EventOperCycleMapPowerPath048ShortToBATFailure: diagnostic-event=EventPowerPath048ShortToBATFailure, operation-cycle=DefaultOperationCycle  # Event_Oper_Cycle_Map_Power_Path_048_Short_to_BAT_Failure
  diagnostic event to debounce algorithm mapping EventDebounceMapPowerPath048ShortToBATFailure: debounce-algorithm=time_based, diagnostic-event=EventPowerPath048ShortToBATFailure  # EventDebounceMap_Power_Path_048_Short_to_BAT_Failure
package /ZeC/DTC/DTC/Power_Path_050_Short_to_BAT_Failure
  diagnostic trouble code uds Power_Path_050_Short_to_BAT_Failure: dtc-props=Dtc_Props_3c731913, uds-dtc-value=0x005132
  diagnostic event EventPowerPath050ShortToBATFailure: aging-allowed=true, event-kind=SWC, prestorage-freeze-frame=false  # Event_Power_Path_050_Short_to_BAT_Failure
  diagnostic event to trouble code uds mapping EventDtcMapPowerPath050ShortToBATFailure: diagnostic-event=EventPowerPath050ShortToBATFailure, trouble-code-uds=Power_Path_050_Short_to_BAT_Failure  # Event_Dtc_Map_Power_Path_050_Short_to_BAT_Failure
  diagnostic event to operation cycle mapping EventOperCycleMapPowerPath050ShortToBATFailure: diagnostic-event=EventPowerPath050ShortToBATFailure, operation-cycle=DefaultOperationCycle  # Event_Oper_Cycle_Map_Power_Path_050_Short_to_BAT_Failure
  diagnostic event to debounce algorithm mapping EventDebounceMapPowerPath050ShortToBATFailure: debounce-algorithm=time_based, diagnostic-event=EventPowerPath050ShortToBATFailure  # EventDebounceMap_Power_Path_050_Short_to_BAT_Failure
package /ZeC/DTC/DTC/CAN_07_ECU_4_No_Communication
  diagnostic trouble code uds CAN_07_ECU_4_No_Communication: dtc-props=Dtc_Props_14158306, uds-dtc-value=0x032708
  diagnostic event EventCAN07ECU4NoCommunication: aging-allowed=true, event-kind=SWC, prestorage-freeze-frame=false  # Event_CAN_07_ECU_4_No_Communication
  diagnostic event to trouble code uds mapping EventDtcMapCAN07ECU4NoCommunication: diagnostic-event=EventCAN07ECU4NoCommunication, trouble-code-uds=CAN_07_ECU_4_No_Communication  # Event_Dtc_Map_CAN_07_ECU_4_No_Communication
  diagnostic event to operation cycle mapping EventOperCycleMapCAN07ECU4NoCommunication: diagnostic-event=EventCAN07ECU4NoCommunication, operation-cycle=DefaultOperationCycle  # Event_Oper_Cycle_Map_CAN_07_ECU_4_No_Communication
  diagnostic event to debounce algorithm mapping EventDebounceMapCAN07ECU4NoCommunication: debounce-algorithm=counter_based, diagnostic-event=EventCAN07ECU4NoCommunication  # EventDebounceMap_CAN_07_ECU_4_No_Communication
package /ZeC/DTC/DTC/Power_Path_049_Short_to_BAT_Failure
  diagnostic trouble code uds Power_Path_049_Short_to_BAT_Failure: dtc-props=Dtc_Props_f658075d, uds-dtc-value=0x005131
  diagnostic event EventPowerPath049ShortToBATFailure: aging-allowed=true, event-kind=SWC, prestorage-freeze-frame=false  # Event_Power_Path_049_Short_to_BAT_Failure
  diagnostic event to trouble code uds mapping EventDtcMapPowerPath049ShortToBATFailure: diagnostic-event=EventPowerPath049ShortToBATFailure, trouble-code-uds=Power_Path_049_Short_to_BAT_Failure  # Event_Dtc_Map_Power_Path_049_Short_to_BAT_Failure
  diagnostic event to operation cycle mapping EventOperCycleMapPowerPath049ShortToBATFailure: diagnostic-event=EventPowerPath049ShortToBATFailure, operation-cycle=DefaultOperationCycle  # Event_Oper_Cycle_Map_Power_Path_049_Short_to_BAT_Failure
  diagnostic event to debounce algorithm mapping EventDebounceMapPowerPath049ShortToBATFailure: debounce-algorithm=time_based, diagnostic-event=EventPowerPath049ShortToBATFailure  # EventDebounceMap_Power_Path_049_Short_to_BAT_Failure
package /ZeC/DTC/DTC/CAN_07_ECU_5_No_Communication
  diagnostic trouble code uds CAN_07_ECU_5_No_Communication: dtc-props=Dtc_Props_14158306, uds-dtc-value=0x032709
  diagnostic event EventCAN07ECU5NoCommunication: aging-allowed=true, event-kind=SWC, prestorage-freeze-frame=false  # Event_CAN_07_ECU_5_No_Communication
  diagnostic event to trouble code uds mapping EventDtcMapCAN07ECU5NoCommunication: diagnostic-event=EventCAN07ECU5NoCommunication, trouble-code-uds=CAN_07_ECU_5_No_Communication  # Event_Dtc_Map_CAN_07_ECU_5_No_Communication
  diagnostic event to operation cycle mapping EventOperCycleMapCAN07ECU5NoCommunication: diagnostic-event=EventCAN07ECU5NoCommunication, operation-cycle=DefaultOperationCycle  # Event_Oper_Cycle_Map_CAN_07_ECU_5_No_Communication
  diagnostic event to debounce algorithm mapping EventDebounceMapCAN07ECU5NoCommunication: debounce-algorithm=counter_based, diagnostic-event=EventCAN07ECU5NoCommunication  # EventDebounceMap_CAN_07_ECU_5_No_Communication
package /ZeC/DTC/DTC/Power_Path_025_Short_to_BAT_Failure
  diagnostic trouble code uds Power_Path_025_Short_to_BAT_Failure: dtc-props=Dtc_Props_fce7db7f, uds-dtc-value=0x005119
  diagnostic event EventPowerPath025ShortToBATFailure: aging-allowed=true, event-kind=SWC, prestorage-freeze-frame=false  # Event_Power_Path_025_Short_to_BAT_Failure
  diagnostic event to trouble code uds mapping EventDtcMapPowerPath025ShortToBATFailure: diagnostic-event=EventPowerPath025ShortToBATFailure, trouble-code-uds=Power_Path_025_Short_to_BAT_Failure  # Event_Dtc_Map_Power_Path_025_Short_to_BAT_Failure
  diagnostic event to operation cycle mapping EventOperCycleMapPowerPath025ShortToBATFailure: diagnostic-event=EventPowerPath025ShortToBATFailure, operation-cycle=DefaultOperationCycle  # Event_Oper_Cycle_Map_Power_Path_025_Short_to_BAT_Failure
  diagnostic event to debounce algorithm mapping EventDebounceMapPowerPath025ShortToBATFailure: debounce-algorithm=time_based, diagnostic-event=EventPowerPath025ShortToBATFailure  # EventDebounceMap_Power_Path_025_Short_to_BAT_Failure
package /ZeC/DTC/DTC/Power_Path_022_Short_to_BAT_Failure
  diagnostic trouble code uds Power_Path_022_Short_to_BAT_Failure: dtc-props=Dtc_Props_a882b08b, uds-dtc-value=0x005116
  diagnostic event EventPowerPath022ShortToBATFailure: aging-allowed=true, event-kind=SWC, prestorage-freeze-frame=false  # Event_Power_Path_022_Short_to_BAT_Failure
  diagnostic event to trouble code uds mapping EventDtcMapPowerPath022ShortToBATFailure: diagnostic-event=EventPowerPath022ShortToBATFailure, trouble-code-uds=Power_Path_022_Short_to_BAT_Failure  # Event_Dtc_Map_Power_Path_022_Short_to_BAT_Failure
  diagnostic event to operation cycle mapping EventOperCycleMapPowerPath022ShortToBATFailure: diagnostic-event=EventPowerPath022ShortToBATFailure, operation-cycle=DefaultOperationCycle  # Event_Oper_Cycle_Map_Power_Path_022_Short_to_BAT_Failure
  diagnostic event to debounce algorithm mapping EventDebounceMapPowerPath022ShortToBATFailure: debounce-algorithm=time_based, diagnostic-event=EventPowerPath022ShortToBATFailure  # EventDebounceMap_Power_Path_022_Short_to_BAT_Failure
package /ZeC/DTC/DTC/Power_Path_021_Short_to_BAT_Failure
  diagnostic trouble code uds Power_Path_021_Short_to_BAT_Failure: dtc-props=Dtc_Props_62a9aec5, uds-dtc-value=0x005115
  diagnostic event EventPowerPath021ShortToBATFailure: aging-allowed=true, event-kind=SWC, prestorage-freeze-frame=false  # Event_Power_Path_021_Short_to_BAT_Failure
  diagnostic event to trouble code uds mapping EventDtcMapPowerPath021ShortToBATFailure: diagnostic-event=EventPowerPath021ShortToBATFailure, trouble-code-uds=Power_Path_021_Short_to_BAT_Failure  # Event_Dtc_Map_Power_Path_021_Short_to_BAT_Failure
  diagnostic event to operation cycle mapping EventOperCycleMapPowerPath021ShortToBATFailure: diagnostic-event=EventPowerPath021ShortToBATFailure, operation-cycle=DefaultOperationCycle  # Event_Oper_Cycle_Map_Power_Path_021_Short_to_BAT_Failure
  diagnostic event to debounce algorithm mapping EventDebounceMapPowerPath021ShortToBATFailure: debounce-algorithm=time_based, diagnostic-event=EventPowerPath021ShortToBATFailure  # EventDebounceMap_Power_Path_021_Short_to_BAT_Failure
package /ZeC/DTC/DTC/Power_Path_153_Over_Load_Failure
  diagnostic trouble code uds Power_Path_153_Over_Load_Failure: dtc-props=Dtc_Props_7804c1fa, uds-dtc-value=0x005599
  diagnostic event EventPowerPath153OverLoadFailure: aging-allowed=true, event-kind=SWC, prestorage-freeze-frame=false  # Event_Power_Path_153_Over_Load_Failure
  diagnostic event to trouble code uds mapping EventDtcMapPowerPath153OverLoadFailure: diagnostic-event=EventPowerPath153OverLoadFailure, trouble-code-uds=Power_Path_153_Over_Load_Failure  # Event_Dtc_Map_Power_Path_153_Over_Load_Failure
  diagnostic event to operation cycle mapping EventOperCycleMapPowerPath153OverLoadFailure: diagnostic-event=EventPowerPath153OverLoadFailure, operation-cycle=DefaultOperationCycle  # Event_Oper_Cycle_Map_Power_Path_153_Over_Load_Failure
  diagnostic event to debounce algorithm mapping EventDebounceMapPowerPath153OverLoadFailure: debounce-algorithm=time_based, diagnostic-event=EventPowerPath153OverLoadFailure  # EventDebounceMap_Power_Path_153_Over_Load_Failure
package /ZeC/DTC/DTC/Power_Path_024_Short_to_BAT_Failure
  diagnostic trouble code uds Power_Path_024_Short_to_BAT_Failure: dtc-props=Dtc_Props_bafed145, uds-dtc-value=0x005118
  diagnostic event EventPowerPath024ShortToBATFailure: aging-allowed=true, event-kind=SWC, prestorage-freeze-frame=false  # Event_Power_Path_024_Short_to_BAT_Failure
  diagnostic event to trouble code uds mapping EventDtcMapPowerPath024ShortToBATFailure: diagnostic-event=EventPowerPath024ShortToBATFailure, trouble-code-uds=Power_Path_024_Short_to_BAT_Failure  # Event_Dtc_Map_Power_Path_024_Short_to_BAT_Failure
  diagnostic event to operation cycle mapping EventOperCycleMapPowerPath024ShortToBATFailure: diagnostic-event=EventPowerPath024ShortToBATFailure, operation-cycle=DefaultOperationCycle  # Event_Oper_Cycle_Map_Power_Path_024_Short_to_BAT_Failure
  diagnostic event to debounce algorithm mapping EventDebounceMapPowerPath024ShortToBATFailure: debounce-algorithm=time_based, diagnostic-event=EventPowerPath024ShortToBATFailure  # EventDebounceMap_Power_Path_024_Short_to_BAT_Failure
package /ZeC/DTC/DTC/Power_Path_023_Short_to_BAT_Failure
  diagnostic trouble code uds Power_Path_023_Short_to_BAT_Failure: dtc-props=Dtc_Props_ee9bbab1, uds-dtc-value=0x005117
  diagnostic event EventPowerPath023ShortToBATFailure: aging-allowed=true, event-kind=SWC, prestorage-freeze-frame=false  # Event_Power_Path_023_Short_to_BAT_Failure
  diagnostic event to trouble code uds mapping EventDtcMapPowerPath023ShortToBATFailure: diagnostic-event=EventPowerPath023ShortToBATFailure, trouble-code-uds=Power_Path_023_Short_to_BAT_Failure  # Event_Dtc_Map_Power_Path_023_Short_to_BAT_Failure
  diagnostic event to operation cycle mapping EventOperCycleMapPowerPath023ShortToBATFailure: diagnostic-event=EventPowerPath023ShortToBATFailure, operation-cycle=DefaultOperationCycle  # Event_Oper_Cycle_Map_Power_Path_023_Short_to_BAT_Failure
  diagnostic event to debounce algorithm mapping EventDebounceMapPowerPath023ShortToBATFailure: debounce-algorithm=time_based, diagnostic-event=EventPowerPath023ShortToBATFailure  # EventDebounceMap_Power_Path_023_Short_to_BAT_Failure
package /ZeC/DTC/DTC/Power_Path_027_Short_to_BAT_Failure
  diagnostic trouble code uds Power_Path_027_Short_to_BAT_Failure: dtc-props=Dtc_Props_5668fa5f, uds-dtc-value=0x00511b
  diagnostic event EventPowerPath027ShortToBATFailure: aging-allowed=true, event-kind=SWC, prestorage-freeze-frame=false  # Event_Power_Path_027_Short_to_BAT_Failure
  diagnostic event to trouble code uds mapping EventDtcMapPowerPath027ShortToBATFailure: diagnostic-event=EventPowerPath027ShortToBATFailure, trouble-code-uds=Power_Path_027_Short_to_BAT_Failure  # Event_Dtc_Map_Power_Path_027_Short_to_BAT_Failure
  diagnostic event to operation cycle mapping EventOperCycleMapPowerPath027ShortToBATFailure: diagnostic-event=EventPowerPath027ShortToBATFailure, operation-cycle=DefaultOperationCycle  # Event_Oper_Cycle_Map_Power_Path_027_Short_to_BAT_Failure
  diagnostic event to debounce algorithm mapping EventDebounceMapPowerPath027ShortToBATFailure: debounce-algorithm=time_based, diagnostic-event=EventPowerPath027ShortToBATFailure  # EventDebounceMap_Power_Path_027_Short_to_BAT_Failure
package /ZeC/DTC/DTC/Power_Path_159_Over_Load_Failure
  diagnostic trouble code uds Power_Path_159_Over_Load_Failure: dtc-props=Dtc_Props_119ece73, uds-dtc-value=0x00559f
  diagnostic event EventPowerPath159OverLoadFailure: aging-allowed=true, event-kind=SWC, prestorage-freeze-frame=false  # Event_Power_Path_159_Over_Load_Failure
  diagnostic event to trouble code uds mapping EventDtcMapPowerPath159OverLoadFailure: diagnostic-event=EventPowerPath159OverLoadFailure, trouble-code-uds=Power_Path_159_Over_Load_Failure  # Event_Dtc_Map_Power_Path_159_Over_Load_Failure
  diagnostic event to operation cycle mapping EventOperCycleMapPowerPath159OverLoadFailure: diagnostic-event=EventPowerPath159OverLoadFailure, operation-cycle=DefaultOperationCycle  # Event_Oper_Cycle_Map_Power_Path_159_Over_Load_Failure
  diagnostic event to debounce algorithm mapping EventDebounceMapPowerPath159OverLoadFailure: debounce-algorithm=time_based, diagnostic-event=EventPowerPath159OverLoadFailure  # EventDebounceMap_Power_Path_159_Over_Load_Failure
package /ZeC/DTC/DTC/Power_Path_026_Short_to_BAT_Failure
  diagnostic trouble code uds Power_Path_026_Short_to_BAT_Failure: dtc-props=Dtc_Props_9c43e411, uds-dtc-value=0x00511a
  diagnostic event EventPowerPath026ShortToBATFailure: aging-allowed=true, event-kind=SWC, prestorage-freeze-frame=false  # Event_Power_Path_026_Short_to_BAT_Failure
  diagnostic event to trouble code uds mapping EventDtcMapPowerPath026ShortToBATFailure: diagnostic-event=EventPowerPath026ShortToBATFailure, trouble-code-uds=Power_Path_026_Short_to_BAT_Failure  # Event_Dtc_Map_Power_Path_026_Short_to_BAT_Failure
  diagnostic event to operation cycle mapping EventOperCycleMapPowerPath026ShortToBATFailure: diagnostic-event=EventPowerPath026ShortToBATFailure, operation-cycle=DefaultOperationCycle  # Event_Oper_Cycle_Map_Power_Path_026_Short_to_BAT_Failure
  diagnostic event to debounce algorithm mapping EventDebounceMapPowerPath026ShortToBATFailure: debounce-algorithm=time_based, diagnostic-event=EventPowerPath026ShortToBATFailure  # EventDebounceMap_Power_Path_026_Short_to_BAT_Failure
package /ZeC/DTC/DTC/Power_Path_158_Over_Load_Failure
  diagnostic trouble code uds Power_Path_158_Over_Load_Failure: dtc-props=Dtc_Props_dbb5d03d, uds-dtc-value=0x00559e
  diagnostic event EventPowerPath158OverLoadFailure: aging-allowed=true, event-kind=SWC, prestorage-freeze-frame=false  # Event_Power_Path_158_Over_Load_Failure
  diagnostic event to trouble code uds mapping EventDtcMapPowerPath158OverLoadFailure: diagnostic-event=EventPowerPath158OverLoadFailure, trouble-code-uds=Power_Path_158_Over_Load_Failure  # Event_Dtc_Map_Power_Path_158_Over_Load_Failure
  diagnostic event to operation cycle mapping EventOperCycleMapPowerPath158OverLoadFailure: diagnostic-event=EventPowerPath158OverLoadFailure, operation-cycle=DefaultOperationCycle  # Event_Oper_Cycle_Map_Power_Path_158_Over_Load_Failure
  diagnostic event to debounce algorithm mapping EventDebounceMapPowerPath158OverLoadFailure: debounce-algorithm=time_based, diagnostic-event=EventPowerPath158OverLoadFailure  # EventDebounceMap_Power_Path_158_Over_Load_Failure
package /ZeC/DTC/DTC/CAN_07_ECU_6_No_Communication
  diagnostic trouble code uds CAN_07_ECU_6_No_Communication: dtc-props=Dtc_Props_14158306, uds-dtc-value=0x032710
  diagnostic event EventCAN07ECU6NoCommunication: aging-allowed=true, event-kind=SWC, prestorage-freeze-frame=false  # Event_CAN_07_ECU_6_No_Communication
  diagnostic event to trouble code uds mapping EventDtcMapCAN07ECU6NoCommunication: diagnostic-event=EventCAN07ECU6NoCommunication, trouble-code-uds=CAN_07_ECU_6_No_Communication  # Event_Dtc_Map_CAN_07_ECU_6_No_Communication
  diagnostic event to operation cycle mapping EventOperCycleMapCAN07ECU6NoCommunication: diagnostic-event=EventCAN07ECU6NoCommunication, operation-cycle=DefaultOperationCycle  # Event_Oper_Cycle_Map_CAN_07_ECU_6_No_Communication
  diagnostic event to debounce algorithm mapping EventDebounceMapCAN07ECU6NoCommunication: debounce-algorithm=counter_based, diagnostic-event=EventCAN07ECU6NoCommunication  # EventDebounceMap_CAN_07_ECU_6_No_Communication
package /ZeC/DTC/DTC/Power_Path_029_Short_to_BAT_Failure
  diagnostic trouble code uds Power_Path_029_Short_to_BAT_Failure: dtc-props=Dtc_Props_194fc082, uds-dtc-value=0x00511d
  diagnostic event EventPowerPath029ShortToBATFailure: aging-allowed=true, event-kind=SWC, prestorage-freeze-frame=false  # Event_Power_Path_029_Short_to_BAT_Failure
  diagnostic event to trouble code uds mapping EventDtcMapPowerPath029ShortToBATFailure: diagnostic-event=EventPowerPath029ShortToBATFailure, trouble-code-uds=Power_Path_029_Short_to_BAT_Failure  # Event_Dtc_Map_Power_Path_029_Short_to_BAT_Failure
  diagnostic event to operation cycle mapping EventOperCycleMapPowerPath029ShortToBATFailure: diagnostic-event=EventPowerPath029ShortToBATFailure, operation-cycle=DefaultOperationCycle  # Event_Oper_Cycle_Map_Power_Path_029_Short_to_BAT_Failure
  diagnostic event to debounce algorithm mapping EventDebounceMapPowerPath029ShortToBATFailure: debounce-algorithm=time_based, diagnostic-event=EventPowerPath029ShortToBATFailure  # EventDebounceMap_Power_Path_029_Short_to_BAT_Failure
package /ZeC/DTC/DTC/Power_Path_028_Short_to_BAT_Failure
  diagnostic trouble code uds Power_Path_028_Short_to_BAT_Failure: dtc-props=Dtc_Props_1071f065, uds-dtc-value=0x00511c
  diagnostic event EventPowerPath028ShortToBATFailure: aging-allowed=true, event-kind=SWC, prestorage-freeze-frame=false  # Event_Power_Path_028_Short_to_BAT_Failure
  diagnostic event to trouble code uds mapping EventDtcMapPowerPath028ShortToBATFailure: diagnostic-event=EventPowerPath028ShortToBATFailure, trouble-code-uds=Power_Path_028_Short_to_BAT_Failure  # Event_Dtc_Map_Power_Path_028_Short_to_BAT_Failure
  diagnostic event to operation cycle mapping EventOperCycleMapPowerPath028ShortToBATFailure: diagnostic-event=EventPowerPath028ShortToBATFailure, operation-cycle=DefaultOperationCycle  # Event_Oper_Cycle_Map_Power_Path_028_Short_to_BAT_Failure
  diagnostic event to debounce algorithm mapping EventDebounceMapPowerPath028ShortToBATFailure: debounce-algorithm=time_based, diagnostic-event=EventPowerPath028ShortToBATFailure  # EventDebounceMap_Power_Path_028_Short_to_BAT_Failure
package /ZeC/DTC/DTC/Power_Path_155_Over_Load_Failure
  diagnostic trouble code uds Power_Path_155_Over_Load_Failure: dtc-props=Dtc_Props_d28be0da, uds-dtc-value=0x00559b
  diagnostic event EventPowerPath155OverLoadFailure: aging-allowed=true, event-kind=SWC, prestorage-freeze-frame=false  # Event_Power_Path_155_Over_Load_Failure
  diagnostic event to trouble code uds mapping EventDtcMapPowerPath155OverLoadFailure: diagnostic-event=EventPowerPath155OverLoadFailure, trouble-code-uds=Power_Path_155_Over_Load_Failure  # Event_Dtc_Map_Power_Path_155_Over_Load_Failure
  diagnostic event to operation cycle mapping EventOperCycleMapPowerPath155OverLoadFailure: diagnostic-event=EventPowerPath155OverLoadFailure, operation-cycle=DefaultOperationCycle  # Event_Oper_Cycle_Map_Power_Path_155_Over_Load_Failure
  diagnostic event to debounce algorithm mapping EventDebounceMapPowerPath155OverLoadFailure: debounce-algorithm=time_based, diagnostic-event=EventPowerPath155OverLoadFailure  # EventDebounceMap_Power_Path_155_Over_Load_Failure
package /ZeC/DTC/DTC/Power_Path_154_Over_Load_Failure
  diagnostic trouble code uds Power_Path_154_Over_Load_Failure: dtc-props=Dtc_Props_18a0fe94, uds-dtc-value=0x00559a
  diagnostic event EventPowerPath154OverLoadFailure: aging-allowed=true, event-kind=SWC, prestorage-freeze-frame=false  # Event_Power_Path_154_Over_Load_Failure
  diagnostic event to trouble code uds mapping EventDtcMapPowerPath154OverLoadFailure: diagnostic-event=EventPowerPath154OverLoadFailure, trouble-code-uds=Power_Path_154_Over_Load_Failure  # Event_Dtc_Map_Power_Path_154_Over_Load_Failure
  diagnostic event to operation cycle mapping EventOperCycleMapPowerPath154OverLoadFailure: diagnostic-event=EventPowerPath154OverLoadFailure, operation-cycle=DefaultOperationCycle  # Event_Oper_Cycle_Map_Power_Path_154_Over_Load_Failure
  diagnostic event to debounce algorithm mapping EventDebounceMapPowerPath154OverLoadFailure: debounce-algorithm=time_based, diagnostic-event=EventPowerPath154OverLoadFailure  # EventDebounceMap_Power_Path_154_Over_Load_Failure
package /ZeC/DTC/DTC/Power_Path_157_Over_Load_Failure
  diagnostic trouble code uds Power_Path_157_Over_Load_Failure: dtc-props=Dtc_Props_9dacda07, uds-dtc-value=0x00559d
  diagnostic event EventPowerPath157OverLoadFailure: aging-allowed=true, event-kind=SWC, prestorage-freeze-frame=false  # Event_Power_Path_157_Over_Load_Failure
  diagnostic event to trouble code uds mapping EventDtcMapPowerPath157OverLoadFailure: diagnostic-event=EventPowerPath157OverLoadFailure, trouble-code-uds=Power_Path_157_Over_Load_Failure  # Event_Dtc_Map_Power_Path_157_Over_Load_Failure
  diagnostic event to operation cycle mapping EventOperCycleMapPowerPath157OverLoadFailure: diagnostic-event=EventPowerPath157OverLoadFailure, operation-cycle=DefaultOperationCycle  # Event_Oper_Cycle_Map_Power_Path_157_Over_Load_Failure
  diagnostic event to debounce algorithm mapping EventDebounceMapPowerPath157OverLoadFailure: debounce-algorithm=time_based, diagnostic-event=EventPowerPath157OverLoadFailure  # EventDebounceMap_Power_Path_157_Over_Load_Failure
package /ZeC/DTC/DTC/Power_Path_156_Over_Load_Failure
  diagnostic trouble code uds Power_Path_156_Over_Load_Failure: dtc-props=Dtc_Props_9492eae0, uds-dtc-value=0x00559c
  diagnostic event EventPowerPath156OverLoadFailure: aging-allowed=true, event-kind=SWC, prestorage-freeze-frame=false  # Event_Power_Path_156_Over_Load_Failure
  diagnostic event to trouble code uds mapping EventDtcMapPowerPath156OverLoadFailure: diagnostic-event=EventPowerPath156OverLoadFailure, trouble-code-uds=Power_Path_156_Over_Load_Failure  # Event_Dtc_Map_Power_Path_156_Over_Load_Failure
  diagnostic event to operation cycle mapping EventOperCycleMapPowerPath156OverLoadFailure: diagnostic-event=EventPowerPath156OverLoadFailure, operation-cycle=DefaultOperationCycle  # Event_Oper_Cycle_Map_Power_Path_156_Over_Load_Failure
  diagnostic event to debounce algorithm mapping EventDebounceMapPowerPath156OverLoadFailure: debounce-algorithm=time_based, diagnostic-event=EventPowerPath156OverLoadFailure  # EventDebounceMap_Power_Path_156_Over_Load_Failure
package /ZeC/DTC/DTC/Power_Path_031_Short_to_BAT_Failure
  diagnostic trouble code uds Power_Path_031_Short_to_BAT_Failure: dtc-props=Dtc_Props_957dd4f6, uds-dtc-value=0x00511f
  diagnostic event EventPowerPath031ShortToBATFailure: aging-allowed=true, event-kind=SWC, prestorage-freeze-frame=false  # Event_Power_Path_031_Short_to_BAT_Failure
  diagnostic event to trouble code uds mapping EventDtcMapPowerPath031ShortToBATFailure: diagnostic-event=EventPowerPath031ShortToBATFailure, trouble-code-uds=Power_Path_031_Short_to_BAT_Failure  # Event_Dtc_Map_Power_Path_031_Short_to_BAT_Failure
  diagnostic event to operation cycle mapping EventOperCycleMapPowerPath031ShortToBATFailure: diagnostic-event=EventPowerPath031ShortToBATFailure, operation-cycle=DefaultOperationCycle  # Event_Oper_Cycle_Map_Power_Path_031_Short_to_BAT_Failure
  diagnostic event to debounce algorithm mapping EventDebounceMapPowerPath031ShortToBATFailure: debounce-algorithm=time_based, diagnostic-event=EventPowerPath031ShortToBATFailure  # EventDebounceMap_Power_Path_031_Short_to_BAT_Failure
package /ZeC/DTC/DTC/Power_Path_030_Short_to_BAT_Failure
  diagnostic trouble code uds Power_Path_030_Short_to_BAT_Failure: dtc-props=Dtc_Props_5f56cab8, uds-dtc-value=0x00511e
  diagnostic event EventPowerPath030ShortToBATFailure: aging-allowed=true, event-kind=SWC, prestorage-freeze-frame=false  # Event_Power_Path_030_Short_to_BAT_Failure
  diagnostic event to trouble code uds mapping EventDtcMapPowerPath030ShortToBATFailure: diagnostic-event=EventPowerPath030ShortToBATFailure, trouble-code-uds=Power_Path_030_Short_to_BAT_Failure  # Event_Dtc_Map_Power_Path_030_Short_to_BAT_Failure
  diagnostic event to operation cycle mapping EventOperCycleMapPowerPath030ShortToBATFailure: diagnostic-event=EventPowerPath030ShortToBATFailure, operation-cycle=DefaultOperationCycle  # Event_Oper_Cycle_Map_Power_Path_030_Short_to_BAT_Failure
  diagnostic event to debounce algorithm mapping EventDebounceMapPowerPath030ShortToBATFailure: debounce-algorithm=time_based, diagnostic-event=EventPowerPath030ShortToBATFailure  # EventDebounceMap_Power_Path_030_Short_to_BAT_Failure
package /ZeC/DTC/DTC/Power_Path_035_Short_to_BAT_Failure
  diagnostic trouble code uds Power_Path_035_Short_to_BAT_Failure: dtc-props=Dtc_Props_bc20d391, uds-dtc-value=0x005123
  diagnostic event EventPowerPath035ShortToBATFailure: aging-allowed=true, event-kind=SWC, prestorage-freeze-frame=false  # Event_Power_Path_035_Short_to_BAT_Failure
  diagnostic event to trouble code uds mapping EventDtcMapPowerPath035ShortToBATFailure: diagnostic-event=EventPowerPath035ShortToBATFailure, trouble-code-uds=Power_Path_035_Short_to_BAT_Failure  # Event_Dtc_Map_Power_Path_035_Short_to_BAT_Failure
  diagnostic event to operation cycle mapping EventOperCycleMapPowerPath035ShortToBATFailure: diagnostic-event=EventPowerPath035ShortToBATFailure, operation-cycle=DefaultOperationCycle  # Event_Oper_Cycle_Map_Power_Path_035_Short_to_BAT_Failure
  diagnostic event to debounce algorithm mapping EventDebounceMapPowerPath035ShortToBATFailure: debounce-algorithm=time_based, diagnostic-event=EventPowerPath035ShortToBATFailure  # EventDebounceMap_Power_Path_035_Short_to_BAT_Failure
package /ZeC/DTC/DTC/Power_Path_034_Short_to_BAT_Failure
  diagnostic trouble code uds Power_Path_034_Short_to_BAT_Failure: dtc-props=Dtc_Props_fa39d9ab, uds-dtc-value=0x005122
  diagnostic event EventPowerPath034ShortToBATFailure: aging-allowed=true, event-kind=SWC, prestorage-freeze-frame=false  # Event_Power_Path_034_Short_to_BAT_Failure
  diagnostic event to trouble code uds mapping EventDtcMapPowerPath034ShortToBATFailure: diagnostic-event=EventPowerPath034ShortToBATFailure, trouble-code-uds=Power_Path_034_Short_to_BAT_Failure  # Event_Dtc_Map_Power_Path_034_Short_to_BAT_Failure
  diagnostic event to operation cycle mapping EventOperCycleMapPowerPath034ShortToBATFailure: diagnostic-event=EventPowerPath034ShortToBATFailure, operation-cycle=DefaultOperationCycle  # Event_Oper_Cycle_Map_Power_Path_034_Short_to_BAT_Failure
  diagnostic event to debounce algorithm mapping EventDebounceMapPowerPath034ShortToBATFailure: debounce-algorithm=time_based, diagnostic-event=EventPowerPath034ShortToBATFailure  # EventDebounceMap_Power_Path_034_Short_to_BAT_Failure
package /ZeC/DTC/DTC/Power_Path_037_Short_to_BAT_Failure
  diagnostic trouble code uds Power_Path_037_Short_to_BAT_Failure: dtc-props=Dtc_Props_f307e94c, uds-dtc-value=0x005125
  diagnostic event EventPowerPath037ShortToBATFailure: aging-allowed=true, event-kind=SWC, prestorage-freeze-frame=false  # Event_Power_Path_037_Short_to_BAT_Failure
  diagnostic event to trouble code uds mapping EventDtcMapPowerPath037ShortToBATFailure: diagnostic-event=EventPowerPath037ShortToBATFailure, trouble-code-uds=Power_Path_037_Short_to_BAT_Failure  # Event_Dtc_Map_Power_Path_037_Short_to_BAT_Failure
  diagnostic event to operation cycle mapping EventOperCycleMapPowerPath037ShortToBATFailure: diagnostic-event=EventPowerPath037ShortToBATFailure, operation-cycle=DefaultOperationCycle  # Event_Oper_Cycle_Map_Power_Path_037_Short_to_BAT_Failure
  diagnostic event to debounce algorithm mapping EventDebounceMapPowerPath037ShortToBATFailure: debounce-algorithm=time_based, diagnostic-event=EventPowerPath037ShortToBATFailure  # EventDebounceMap_Power_Path_037_Short_to_BAT_Failure
package /ZeC/DTC/DTC/Power_Path_036_Short_to_BAT_Failure
  diagnostic trouble code uds Power_Path_036_Short_to_BAT_Failure: dtc-props=Dtc_Props_b51ee376, uds-dtc-value=0x005124
  diagnostic event EventPowerPath036ShortToBATFailure: aging-allowed=true, event-kind=SWC, prestorage-freeze-frame=false  # Event_Power_Path_036_Short_to_BAT_Failure
  diagnostic event to trouble code uds mapping EventDtcMapPowerPath036ShortToBATFailure: diagnostic-event=EventPowerPath036ShortToBATFailure, trouble-code-uds=Power_Path_036_Short_to_BAT_Failure  # Event_Dtc_Map_Power_Path_036_Short_to_BAT_Failure
  diagnostic event to operation cycle mapping EventOperCycleMapPowerPath036ShortToBATFailure: diagnostic-event=EventPowerPath036ShortToBATFailure, operation-cycle=DefaultOperationCycle  # Event_Oper_Cycle_Map_Power_Path_036_Short_to_BAT_Failure
  diagnostic event to debounce algorithm mapping EventDebounceMapPowerPath036ShortToBATFailure: debounce-algorithm=time_based, diagnostic-event=EventPowerPath036ShortToBATFailure  # EventDebounceMap_Power_Path_036_Short_to_BAT_Failure
package /ZeC/DTC/DTC/Power_Path_033_Short_to_BAT_Failure
  diagnostic trouble code uds Power_Path_033_Short_to_BAT_Failure: dtc-props=Dtc_Props_3012c7e5, uds-dtc-value=0x005121
  diagnostic event EventPowerPath033ShortToBATFailure: aging-allowed=true, event-kind=SWC, prestorage-freeze-frame=false  # Event_Power_Path_033_Short_to_BAT_Failure
  diagnostic event to trouble code uds mapping EventDtcMapPowerPath033ShortToBATFailure: diagnostic-event=EventPowerPath033ShortToBATFailure, trouble-code-uds=Power_Path_033_Short_to_BAT_Failure  # Event_Dtc_Map_Power_Path_033_Short_to_BAT_Failure
  diagnostic event to operation cycle mapping EventOperCycleMapPowerPath033ShortToBATFailure: diagnostic-event=EventPowerPath033ShortToBATFailure, operation-cycle=DefaultOperationCycle  # Event_Oper_Cycle_Map_Power_Path_033_Short_to_BAT_Failure
  diagnostic event to debounce algorithm mapping EventDebounceMapPowerPath033ShortToBATFailure: debounce-algorithm=time_based, diagnostic-event=EventPowerPath033ShortToBATFailure  # EventDebounceMap_Power_Path_033_Short_to_BAT_Failure
package /ZeC/DTC/DTC/Power_Path_032_Short_to_BAT_Failure
  diagnostic trouble code uds Power_Path_032_Short_to_BAT_Failure: dtc-props=Dtc_Props_760bcddf, uds-dtc-value=0x005120
  diagnostic event EventPowerPath032ShortToBATFailure: aging-allowed=true, event-kind=SWC, prestorage-freeze-frame=false  # Event_Power_Path_032_Short_to_BAT_Failure
  diagnostic event to trouble code uds mapping EventDtcMapPowerPath032ShortToBATFailure: diagnostic-event=EventPowerPath032ShortToBATFailure, trouble-code-uds=Power_Path_032_Short_to_BAT_Failure  # Event_Dtc_Map_Power_Path_032_Short_to_BAT_Failure
  diagnostic event to operation cycle mapping EventOperCycleMapPowerPath032ShortToBATFailure: diagnostic-event=EventPowerPath032ShortToBATFailure, operation-cycle=DefaultOperationCycle  # Event_Oper_Cycle_Map_Power_Path_032_Short_to_BAT_Failure
  diagnostic event to debounce algorithm mapping EventDebounceMapPowerPath032ShortToBATFailure: debounce-algorithm=time_based, diagnostic-event=EventPowerPath032ShortToBATFailure  # EventDebounceMap_Power_Path_032_Short_to_BAT_Failure
package /ZeC/DTC/DTC/LIN_5_Slave_4_NoCommunication
  diagnostic trouble code uds LIN_5_Slave_4_NoCommunication: dtc-props=Dtc_Props_358996c7, uds-dtc-value=0x030505  # LIN 5 Slave 4_NoCommunication
  diagnostic event EventLIN5Slave4NoCommunication: aging-allowed=true, event-kind=SWC, prestorage-freeze-frame=false  # Event_LIN 5 Slave 4_NoCommunication
  diagnostic event to trouble code uds mapping EventDtcMapLIN5Slave4NoCommunication: diagnostic-event=EventLIN5Slave4NoCommunication, trouble-code-uds=LIN_5_Slave_4_NoCommunication  # Event_Dtc_Map_LIN 5 Slave 4_NoCommunication
  diagnostic event to operation cycle mapping EventOperCycleMapLIN5Slave4NoCommunication: diagnostic-event=EventLIN5Slave4NoCommunication, operation-cycle=DefaultOperationCycle  # Event_Oper_Cycle_Map_LIN 5 Slave 4_NoCommunication
  diagnostic event to debounce algorithm mapping EventDebounceMapLIN5Slave4NoCommunication: debounce-algorithm=counter_based, diagnostic-event=EventLIN5Slave4NoCommunication  # EventDebounceMap_LIN 5 Slave 4_NoCommunication
package /ZeC/DTC/DTC/Power_Path_073_Over_Load_Failure
  diagnostic trouble code uds Power_Path_073_Over_Load_Failure: dtc-props=Dtc_Props_956415a5, uds-dtc-value=0x005549
  diagnostic event EventPowerPath073OverLoadFailure: aging-allowed=true, event-kind=SWC, prestorage-freeze-frame=false  # Event_Power_Path_073_Over_Load_Failure
  diagnostic event to trouble code uds mapping EventDtcMapPowerPath073OverLoadFailure: diagnostic-event=EventPowerPath073OverLoadFailure, trouble-code-uds=Power_Path_073_Over_Load_Failure  # Event_Dtc_Map_Power_Path_073_Over_Load_Failure
  diagnostic event to operation cycle mapping EventOperCycleMapPowerPath073OverLoadFailure: diagnostic-event=EventPowerPath073OverLoadFailure, operation-cycle=DefaultOperationCycle  # Event_Oper_Cycle_Map_Power_Path_073_Over_Load_Failure
  diagnostic event to debounce algorithm mapping EventDebounceMapPowerPath073OverLoadFailure: debounce-algorithm=time_based, diagnostic-event=EventPowerPath073OverLoadFailure  # EventDebounceMap_Power_Path_073_Over_Load_Failure
package /ZeC/DTC/DTC/LIN_5_Slave_4_Defect
  diagnostic trouble code uds LIN_5_Slave_4_Defect: dtc-props=Dtc_Props_358996c7, uds-dtc-value=0x030504  # LIN 5 Slave 4_Defect
  diagnostic event EventLIN5Slave4Defect: aging-allowed=true, event-kind=SWC, prestorage-freeze-frame=false  # Event_LIN 5 Slave 4_Defect
  diagnostic event to trouble code uds mapping EventDtcMapLIN5Slave4Defect: diagnostic-event=EventLIN5Slave4Defect, trouble-code-uds=LIN_5_Slave_4_Defect  # Event_Dtc_Map_LIN 5 Slave 4_Defect
  diagnostic event to operation cycle mapping EventOperCycleMapLIN5Slave4Defect: diagnostic-event=EventLIN5Slave4Defect, operation-cycle=DefaultOperationCycle  # Event_Oper_Cycle_Map_LIN 5 Slave 4_Defect
  diagnostic event to debounce algorithm mapping EventDebounceMapLIN5Slave4Defect: debounce-algorithm=counter_based, diagnostic-event=EventLIN5Slave4Defect  # EventDebounceMap_LIN 5 Slave 4_Defect
package /ZeC/DTC/DTC/Power_Path_072_Over_Load_Failure
  diagnostic trouble code uds Power_Path_072_Over_Load_Failure: dtc-props=Dtc_Props_d37d1f9f, uds-dtc-value=0x005548
  diagnostic event EventPowerPath072OverLoadFailure: aging-allowed=true, event-kind=SWC, prestorage-freeze-frame=false  # Event_Power_Path_072_Over_Load_Failure
  diagnostic event to trouble code uds mapping EventDtcMapPowerPath072OverLoadFailure: diagnostic-event=EventPowerPath072OverLoadFailure, trouble-code-uds=Power_Path_072_Over_Load_Failure  # Event_Dtc_Map_Power_Path_072_Over_Load_Failure
  diagnostic event to operation cycle mapping EventOperCycleMapPowerPath072OverLoadFailure: diagnostic-event=EventPowerPath072OverLoadFailure, operation-cycle=DefaultOperationCycle  # Event_Oper_Cycle_Map_Power_Path_072_Over_Load_Failure
  diagnostic event to debounce algorithm mapping EventDebounceMapPowerPath072OverLoadFailure: debounce-algorithm=time_based, diagnostic-event=EventPowerPath072OverLoadFailure  # EventDebounceMap_Power_Path_072_Over_Load_Failure
package /ZeC/DTC/DTC/LIN_5_Slave_5_NoCommunication
  diagnostic trouble code uds LIN_5_Slave_5_NoCommunication: dtc-props=Dtc_Props_358996c7, uds-dtc-value=0x030507  # LIN 5 Slave 5_NoCommunication
  diagnostic event EventLIN5Slave5NoCommunication: aging-allowed=true, event-kind=SWC, prestorage-freeze-frame=false  # Event_LIN 5 Slave 5_NoCommunication
  diagnostic event to trouble code uds mapping EventDtcMapLIN5Slave5NoCommunication: diagnostic-event=EventLIN5Slave5NoCommunication, trouble-code-uds=LIN_5_Slave_5_NoCommunication  # Event_Dtc_Map_LIN 5 Slave 5_NoCommunication
  diagnostic event to operation cycle mapping EventOperCycleMapLIN5Slave5NoCommunication: diagnostic-event=EventLIN5Slave5NoCommunication, operation-cycle=DefaultOperationCycle  # Event_Oper_Cycle_Map_LIN 5 Slave 5_NoCommunication
  diagnostic event to debounce algorithm mapping EventDebounceMapLIN5Slave5NoCommunication: debounce-algorithm=counter_based, diagnostic-event=EventLIN5Slave5NoCommunication  # EventDebounceMap_LIN 5 Slave 5_NoCommunication
package /ZeC/DTC/DTC/LIN_15_Slave_3_NoCommunication
  diagnostic trouble code uds LIN_15_Slave_3_NoCommunication: dtc-props=Dtc_Props_358996c7, uds-dtc-value=0x030f1d  # LIN 15 Slave 3_NoCommunication
  diagnostic event EventLIN15Slave3NoCommunication: aging-allowed=true, event-kind=SWC, prestorage-freeze-frame=false  # Event_LIN 15 Slave 3_NoCommunication
  diagnostic event to trouble code uds mapping EventDtcMapLIN15Slave3NoCommunication: diagnostic-event=EventLIN15Slave3NoCommunication, trouble-code-uds=LIN_15_Slave_3_NoCommunication  # Event_Dtc_Map_LIN 15 Slave 3_NoCommunication
  diagnostic event to operation cycle mapping EventOperCycleMapLIN15Slave3NoCommunication: diagnostic-event=EventLIN15Slave3NoCommunication, operation-cycle=DefaultOperationCycle  # Event_Oper_Cycle_Map_LIN 15 Slave 3_NoCommunication
  diagnostic event to debounce algorithm mapping EventDebounceMapLIN15Slave3NoCommunication: debounce-algorithm=counter_based, diagnostic-event=EventLIN15Slave3NoCommunication  # EventDebounceMap_LIN 15 Slave 3_NoCommunication
package /ZeC/DTC/DTC/LIN_5_Slave_5_Defect
  diagnostic trouble code uds LIN_5_Slave_5_Defect: dtc-props=Dtc_Props_358996c7, uds-dtc-value=0x030506  # LIN 5 Slave 5_Defect
  diagnostic event EventLIN5Slave5Defect: aging-allowed=true, event-kind=SWC, prestorage-freeze-frame=false  # Event_LIN 5 Slave 5_Defect
  diagnostic event to trouble code uds mapping EventDtcMapLIN5Slave5Defect: diagnostic-event=EventLIN5Slave5Defect, trouble-code-uds=LIN_5_Slave_5_Defect  # Event_Dtc_Map_LIN 5 Slave 5_Defect
  diagnostic event to operation cycle mapping EventOperCycleMapLIN5Slave5Defect: diagnostic-event=EventLIN5Slave5Defect, operation-cycle=DefaultOperationCycle  # Event_Oper_Cycle_Map_LIN 5 Slave 5_Defect
  diagnostic event to debounce algorithm mapping EventDebounceMapLIN5Slave5Defect: debounce-algorithm=counter_based, diagnostic-event=EventLIN5Slave5Defect  # EventDebounceMap_LIN 5 Slave 5_Defect
package /ZeC/DTC/DTC/LIN_15_Slave_4_Defect
  diagnostic trouble code uds LIN_15_Slave_4_Defect: dtc-props=Dtc_Props_358996c7, uds-dtc-value=0x030f1e  # LIN 15 Slave 4_Defect
  diagnostic event EventLIN15Slave4Defect: aging-allowed=true, event-kind=SWC, prestorage-freeze-frame=false  # Event_LIN 15 Slave 4_Defect
  diagnostic event to trouble code uds mapping EventDtcMapLIN15Slave4Defect: diagnostic-event=EventLIN15Slave4Defect, trouble-code-uds=LIN_15_Slave_4_Defect  # Event_Dtc_Map_LIN 15 Slave 4_Defect
  diagnostic event to operation cycle mapping EventOperCycleMapLIN15Slave4Defect: diagnostic-event=EventLIN15Slave4Defect, operation-cycle=DefaultOperationCycle  # Event_Oper_Cycle_Map_LIN 15 Slave 4_Defect
  diagnostic event to debounce algorithm mapping EventDebounceMapLIN15Slave4Defect: debounce-algorithm=counter_based, diagnostic-event=EventLIN15Slave4Defect  # EventDebounceMap_LIN 15 Slave 4_Defect
package /ZeC/DTC/DTC/LIN_5_Slave_2_NoCommunication
  diagnostic trouble code uds LIN_5_Slave_2_NoCommunication: dtc-props=Dtc_Props_358996c7, uds-dtc-value=0x030501  # LIN 5 Slave 2_NoCommunication
  diagnostic event EventLIN5Slave2NoCommunication: aging-allowed=true, event-kind=SWC, prestorage-freeze-frame=false  # Event_LIN 5 Slave 2_NoCommunication
  diagnostic event to trouble code uds mapping EventDtcMapLIN5Slave2NoCommunication: diagnostic-event=EventLIN5Slave2NoCommunication, trouble-code-uds=LIN_5_Slave_2_NoCommunication  # Event_Dtc_Map_LIN 5 Slave 2_NoCommunication
  diagnostic event to operation cycle mapping EventOperCycleMapLIN5Slave2NoCommunication: diagnostic-event=EventLIN5Slave2NoCommunication, operation-cycle=DefaultOperationCycle  # Event_Oper_Cycle_Map_LIN 5 Slave 2_NoCommunication
  diagnostic event to debounce algorithm mapping EventDebounceMapLIN5Slave2NoCommunication: debounce-algorithm=counter_based, diagnostic-event=EventLIN5Slave2NoCommunication  # EventDebounceMap_LIN 5 Slave 2_NoCommunication
package /ZeC/DTC/DTC/LIN_15_Slave_2_NoCommunication
  diagnostic trouble code uds LIN_15_Slave_2_NoCommunication: dtc-props=Dtc_Props_358996c7, uds-dtc-value=0x030f1b  # LIN 15 Slave 2_NoCommunication
  diagnostic event EventLIN15Slave2NoCommunication: aging-allowed=true, event-kind=SWC, prestorage-freeze-frame=false  # Event_LIN 15 Slave 2_NoCommunication
  diagnostic event to trouble code uds mapping EventDtcMapLIN15Slave2NoCommunication: diagnostic-event=EventLIN15Slave2NoCommunication, trouble-code-uds=LIN_15_Slave_2_NoCommunication  # Event_Dtc_Map_LIN 15 Slave 2_NoCommunication
  diagnostic event to operation cycle mapping EventOperCycleMapLIN15Slave2NoCommunication: diagnostic-event=EventLIN15Slave2NoCommunication, operation-cycle=DefaultOperationCycle  # Event_Oper_Cycle_Map_LIN 15 Slave 2_NoCommunication
  diagnostic event to debounce algorithm mapping EventDebounceMapLIN15Slave2NoCommunication: debounce-algorithm=counter_based, diagnostic-event=EventLIN15Slave2NoCommunication  # EventDebounceMap_LIN 15 Slave 2_NoCommunication
package /ZeC/DTC/DTC/Power_Path_069_Over_Load_Failure
  diagnostic trouble code uds Power_Path_069_Over_Load_Failure: dtc-props=Dtc_Props_b2a601f, uds-dtc-value=0x005545
  diagnostic event EventPowerPath069OverLoadFailure: aging-allowed=true, event-kind=SWC, prestorage-freeze-frame=false  # Event_Power_Path_069_Over_Load_Failure
  diagnostic event to trouble code uds mapping EventDtcMapPowerPath069OverLoadFailure: diagnostic-event=EventPowerPath069OverLoadFailure, trouble-code-uds=Power_Path_069_Over_Load_Failure  # Event_Dtc_Map_Power_Path_069_Over_Load_Failure
  diagnostic event to operation cycle mapping EventOperCycleMapPowerPath069OverLoadFailure: diagnostic-event=EventPowerPath069OverLoadFailure, operation-cycle=DefaultOperationCycle  # Event_Oper_Cycle_Map_Power_Path_069_Over_Load_Failure
  diagnostic event to debounce algorithm mapping EventDebounceMapPowerPath069OverLoadFailure: debounce-algorithm=time_based, diagnostic-event=EventPowerPath069OverLoadFailure  # EventDebounceMap_Power_Path_069_Over_Load_Failure
package /ZeC/DTC/DTC/LIN_15_Slave_3_Defect
  diagnostic trouble code uds LIN_15_Slave_3_Defect: dtc-props=Dtc_Props_358996c7, uds-dtc-value=0x030f1c  # LIN 15 Slave 3_Defect
  diagnostic event EventLIN15Slave3Defect: aging-allowed=true, event-kind=SWC, prestorage-freeze-frame=false  # Event_LIN 15 Slave 3_Defect
  diagnostic event to trouble code uds mapping EventDtcMapLIN15Slave3Defect: diagnostic-event=EventLIN15Slave3Defect, trouble-code-uds=LIN_15_Slave_3_Defect  # Event_Dtc_Map_LIN 15 Slave 3_Defect
  diagnostic event to operation cycle mapping EventOperCycleMapLIN15Slave3Defect: diagnostic-event=EventLIN15Slave3Defect, operation-cycle=DefaultOperationCycle  # Event_Oper_Cycle_Map_LIN 15 Slave 3_Defect
  diagnostic event to debounce algorithm mapping EventDebounceMapLIN15Slave3Defect: debounce-algorithm=counter_based, diagnostic-event=EventLIN15Slave3Defect  # EventDebounceMap_LIN 15 Slave 3_Defect
package /ZeC/DTC/DTC/Power_Path_068_Over_Load_Failure
  diagnostic trouble code uds Power_Path_068_Over_Load_Failure: dtc-props=Dtc_Props_4d336a25, uds-dtc-value=0x005544
  diagnostic event EventPowerPath068OverLoadFailure: aging-allowed=true, event-kind=SWC, prestorage-freeze-frame=false  # Event_Power_Path_068_Over_Load_Failure
  diagnostic event to trouble code uds mapping EventDtcMapPowerPath068OverLoadFailure: diagnostic-event=EventPowerPath068OverLoadFailure, trouble-code-uds=Power_Path_068_Over_Load_Failure  # Event_Dtc_Map_Power_Path_068_Over_Load_Failure
  diagnostic event to operation cycle mapping EventOperCycleMapPowerPath068OverLoadFailure: diagnostic-event=EventPowerPath068OverLoadFailure, operation-cycle=DefaultOperationCycle  # Event_Oper_Cycle_Map_Power_Path_068_Over_Load_Failure
  diagnostic event to debounce algorithm mapping EventDebounceMapPowerPath068OverLoadFailure: debounce-algorithm=time_based, diagnostic-event=EventPowerPath068OverLoadFailure  # EventDebounceMap_Power_Path_068_Over_Load_Failure
package /ZeC/DTC/DTC/LIN_5_Slave_3_NoCommunication
  diagnostic trouble code uds LIN_5_Slave_3_NoCommunication: dtc-props=Dtc_Props_358996c7, uds-dtc-value=0x030503  # LIN 5 Slave 3_NoCommunication
  diagnostic event EventLIN5Slave3NoCommunication: aging-allowed=true, event-kind=SWC, prestorage-freeze-frame=false  # Event_LIN 5 Slave 3_NoCommunication
  diagnostic event to trouble code uds mapping EventDtcMapLIN5Slave3NoCommunication: diagnostic-event=EventLIN5Slave3NoCommunication, trouble-code-uds=LIN_5_Slave_3_NoCommunication  # Event_Dtc_Map_LIN 5 Slave 3_NoCommunication
  diagnostic event to operation cycle mapping EventOperCycleMapLIN5Slave3NoCommunication: diagnostic-event=EventLIN5Slave3NoCommunication, operation-cycle=DefaultOperationCycle  # Event_Oper_Cycle_Map_LIN 5 Slave 3_NoCommunication
  diagnostic event to debounce algorithm mapping EventDebounceMapLIN5Slave3NoCommunication: debounce-algorithm=counter_based, diagnostic-event=EventLIN5Slave3NoCommunication  # EventDebounceMap_LIN 5 Slave 3_NoCommunication
package /ZeC/DTC/DTC/Power_Path_071_Over_Load_Failure
  diagnostic trouble code uds Power_Path_071_Over_Load_Failure: dtc-props=Dtc_Props_8718746b, uds-dtc-value=0x005547
  diagnostic event EventPowerPath071OverLoadFailure: aging-allowed=true, event-kind=SWC, prestorage-freeze-frame=false  # Event_Power_Path_071_Over_Load_Failure
  diagnostic event to trouble code uds mapping EventDtcMapPowerPath071OverLoadFailure: diagnostic-event=EventPowerPath071OverLoadFailure, trouble-code-uds=Power_Path_071_Over_Load_Failure  # Event_Dtc_Map_Power_Path_071_Over_Load_Failure
  diagnostic event to operation cycle mapping EventOperCycleMapPowerPath071OverLoadFailure: diagnostic-event=EventPowerPath071OverLoadFailure, operation-cycle=DefaultOperationCycle  # Event_Oper_Cycle_Map_Power_Path_071_Over_Load_Failure
  diagnostic event to debounce algorithm mapping EventDebounceMapPowerPath071OverLoadFailure: debounce-algorithm=time_based, diagnostic-event=EventPowerPath071OverLoadFailure  # EventDebounceMap_Power_Path_071_Over_Load_Failure
package /ZeC/DTC/DTC/LIN_5_Slave_3_Defect
  diagnostic trouble code uds LIN_5_Slave_3_Defect: dtc-props=Dtc_Props_358996c7, uds-dtc-value=0x030502  # LIN 5 Slave 3_Defect
  diagnostic event EventLIN5Slave3Defect: aging-allowed=true, event-kind=SWC, prestorage-freeze-frame=false  # Event_LIN 5 Slave 3_Defect
  diagnostic event to trouble code uds mapping EventDtcMapLIN5Slave3Defect: diagnostic-event=EventLIN5Slave3Defect, trouble-code-uds=LIN_5_Slave_3_Defect  # Event_Dtc_Map_LIN 5 Slave 3_Defect
  diagnostic event to operation cycle mapping EventOperCycleMapLIN5Slave3Defect: diagnostic-event=EventLIN5Slave3Defect, operation-cycle=DefaultOperationCycle  # Event_Oper_Cycle_Map_LIN 5 Slave 3_Defect
  diagnostic event to debounce algorithm mapping EventDebounceMapLIN5Slave3Defect: debounce-algorithm=counter_based, diagnostic-event=EventLIN5Slave3Defect  # EventDebounceMap_LIN 5 Slave 3_Defect
package /ZeC/DTC/DTC/LIN_15_Slave_2_Defect
  diagnostic trouble code uds LIN_15_Slave_2_Defect: dtc-props=Dtc_Props_358996c7, uds-dtc-value=0x030f1a  # LIN 15 Slave 2_Defect
  diagnostic event EventLIN15Slave2Defect: aging-allowed=true, event-kind=SWC, prestorage-freeze-frame=false  # Event_LIN 15 Slave 2_Defect
  diagnostic event to trouble code uds mapping EventDtcMapLIN15Slave2Defect: diagnostic-event=EventLIN15Slave2Defect, trouble-code-uds=LIN_15_Slave_2_Defect  # Event_Dtc_Map_LIN 15 Slave 2_Defect
  diagnostic event to operation cycle mapping EventOperCycleMapLIN15Slave2Defect: diagnostic-event=EventLIN15Slave2Defect, operation-cycle=DefaultOperationCycle  # Event_Oper_Cycle_Map_LIN 15 Slave 2_Defect
  diagnostic event to debounce algorithm mapping EventDebounceMapLIN15Slave2Defect: debounce-algorithm=counter_based, diagnostic-event=EventLIN15Slave2Defect  # EventDebounceMap_LIN 15 Slave 2_Defect
package /ZeC/DTC/DTC/Power_Path_070_Over_Load_Failure
  diagnostic trouble code uds Power_Path_070_Over_Load_Failure: dtc-props=Dtc_Props_c1017e51, uds-dtc-value=0x005546
  diagnostic event EventPowerPath070OverLoadFailure: aging-allowed=true, event-kind=SWC, prestorage-freeze-frame=false  # Event_Power_Path_070_Over_Load_Failure
  diagnostic event to trouble code uds mapping EventDtcMapPowerPath070OverLoadFailure: diagnostic-event=EventPowerPath070OverLoadFailure, trouble-code-uds=Power_Path_070_Over_Load_Failure  # Event_Dtc_Map_Power_Path_070_Over_Load_Failure
  diagnostic event to operation cycle mapping EventOperCycleMapPowerPath070OverLoadFailure: diagnostic-event=EventPowerPath070OverLoadFailure, operation-cycle=DefaultOperationCycle  # Event_Oper_Cycle_Map_Power_Path_070_Over_Load_Failure
  diagnostic event to debounce algorithm mapping EventDebounceMapPowerPath070OverLoadFailure: debounce-algorithm=time_based, diagnostic-event=EventPowerPath070OverLoadFailure  # EventDebounceMap_Power_Path_070_Over_Load_Failure
package /ZeC/DTC/DTC/Power_Path_074_Over_Load_Failure
  diagnostic trouble code uds Power_Path_074_Over_Load_Failure: dtc-props=Dtc_Props_f5c02acb, uds-dtc-value=0x00554a
  diagnostic event EventPowerPath074OverLoadFailure: aging-allowed=true, event-kind=SWC, prestorage-freeze-frame=false  # Event_Power_Path_074_Over_Load_Failure
  diagnostic event to trouble code uds mapping EventDtcMapPowerPath074OverLoadFailure: diagnostic-event=EventPowerPath074OverLoadFailure, trouble-code-uds=Power_Path_074_Over_Load_Failure  # Event_Dtc_Map_Power_Path_074_Over_Load_Failure
  diagnostic event to operation cycle mapping EventOperCycleMapPowerPath074OverLoadFailure: diagnostic-event=EventPowerPath074OverLoadFailure, operation-cycle=DefaultOperationCycle  # Event_Oper_Cycle_Map_Power_Path_074_Over_Load_Failure
  diagnostic event to debounce algorithm mapping EventDebounceMapPowerPath074OverLoadFailure: debounce-algorithm=time_based, diagnostic-event=EventPowerPath074OverLoadFailure  # EventDebounceMap_Power_Path_074_Over_Load_Failure
package /ZeC/DTC/DTC/Power_Path_076_Over_Load_Failure
  diagnostic trouble code uds Power_Path_076_Over_Load_Failure: dtc-props=Dtc_Props_79f23ebf, uds-dtc-value=0x00554c
  diagnostic event EventPowerPath076OverLoadFailure: aging-allowed=true, event-kind=SWC, prestorage-freeze-frame=false  # Event_Power_Path_076_Over_Load_Failure
  diagnostic event to trouble code uds mapping EventDtcMapPowerPath076OverLoadFailure: diagnostic-event=EventPowerPath076OverLoadFailure, trouble-code-uds=Power_Path_076_Over_Load_Failure  # Event_Dtc_Map_Power_Path_076_Over_Load_Failure
  diagnostic event to operation cycle mapping EventOperCycleMapPowerPath076OverLoadFailure: diagnostic-event=EventPowerPath076OverLoadFailure, operation-cycle=DefaultOperationCycle  # Event_Oper_Cycle_Map_Power_Path_076_Over_Load_Failure
  diagnostic event to debounce algorithm mapping EventDebounceMapPowerPath076OverLoadFailure: debounce-algorithm=time_based, diagnostic-event=EventPowerPath076OverLoadFailure  # EventDebounceMap_Power_Path_076_Over_Load_Failure
package /ZeC/DTC/DTC/Power_Path_075_Over_Load_Failure
  diagnostic trouble code uds Power_Path_075_Over_Load_Failure: dtc-props=Dtc_Props_3feb3485, uds-dtc-value=0x00554b
  diagnostic event EventPowerPath075OverLoadFailure: aging-allowed=true, event-kind=SWC, prestorage-freeze-frame=false  # Event_Power_Path_075_Over_Load_Failure
  diagnostic event to trouble code uds mapping EventDtcMapPowerPath075OverLoadFailure: diagnostic-event=EventPowerPath075OverLoadFailure, trouble-code-uds=Power_Path_075_Over_Load_Failure  # Event_Dtc_Map_Power_Path_075_Over_Load_Failure
  diagnostic event to operation cycle mapping EventOperCycleMapPowerPath075OverLoadFailure: diagnostic-event=EventPowerPath075OverLoadFailure, operation-cycle=DefaultOperationCycle  # Event_Oper_Cycle_Map_Power_Path_075_Over_Load_Failure
  diagnostic event to debounce algorithm mapping EventDebounceMapPowerPath075OverLoadFailure: debounce-algorithm=time_based, diagnostic-event=EventPowerPath075OverLoadFailure  # EventDebounceMap_Power_Path_075_Over_Load_Failure
package /ZeC/DTC/DTC/LIN_15_Slave_15_Defect
  diagnostic trouble code uds LIN_15_Slave_15_Defect: dtc-props=Dtc_Props_358996c7, uds-dtc-value=0x030f18  # LIN 15 Slave 15_Defect
  diagnostic event EventLIN15Slave15Defect: aging-allowed=true, event-kind=SWC, prestorage-freeze-frame=false  # Event_LIN 15 Slave 15_Defect
  diagnostic event to trouble code uds mapping EventDtcMapLIN15Slave15Defect: diagnostic-event=EventLIN15Slave15Defect, trouble-code-uds=LIN_15_Slave_15_Defect  # Event_Dtc_Map_LIN 15 Slave 15_Defect
  diagnostic event to operation cycle mapping EventOperCycleMapLIN15Slave15Defect: diagnostic-event=EventLIN15Slave15Defect, operation-cycle=DefaultOperationCycle  # Event_Oper_Cycle_Map_LIN 15 Slave 15_Defect
  diagnostic event to debounce algorithm mapping EventDebounceMapLIN15Slave15Defect: debounce-algorithm=counter_based, diagnostic-event=EventLIN15Slave15Defect  # EventDebounceMap_LIN 15 Slave 15_Defect
package /ZeC/DTC/DTC/LIN_15_Slave_15_NoCommunication
  diagnostic trouble code uds LIN_15_Slave_15_NoCommunication: dtc-props=Dtc_Props_358996c7, uds-dtc-value=0x030f19  # LIN 15 Slave 15_NoCommunication
  diagnostic event EventLIN15Slave15NoCommunication: aging-allowed=true, event-kind=SWC, prestorage-freeze-frame=false  # Event_LIN 15 Slave 15_NoCommunication
  diagnostic event to trouble code uds mapping EventDtcMapLIN15Slave15NoCommunication: diagnostic-event=EventLIN15Slave15NoCommunication, trouble-code-uds=LIN_15_Slave_15_NoCommunication  # Event_Dtc_Map_LIN 15 Slave 15_NoCommunication
  diagnostic event to operation cycle mapping EventOperCycleMapLIN15Slave15NoCommunication: diagnostic-event=EventLIN15Slave15NoCommunication, operation-cycle=DefaultOperationCycle  # Event_Oper_Cycle_Map_LIN 15 Slave 15_NoCommunication
  diagnostic event to debounce algorithm mapping EventDebounceMapLIN15Slave15NoCommunication: debounce-algorithm=counter_based, diagnostic-event=EventLIN15Slave15NoCommunication  # EventDebounceMap_LIN 15 Slave 15_NoCommunication
package /ZeC/DTC/DTC/LIN_5_Slave_9_Defect
  diagnostic trouble code uds LIN_5_Slave_9_Defect: dtc-props=Dtc_Props_358996c7, uds-dtc-value=0x03050e  # LIN 5 Slave 9_Defect
  diagnostic event EventLIN5Slave9Defect: aging-allowed=true, event-kind=SWC, prestorage-freeze-frame=false  # Event_LIN 5 Slave 9_Defect
  diagnostic event to trouble code uds mapping EventDtcMapLIN5Slave9Defect: diagnostic-event=EventLIN5Slave9Defect, trouble-code-uds=LIN_5_Slave_9_Defect  # Event_Dtc_Map_LIN 5 Slave 9_Defect
  diagnostic event to operation cycle mapping EventOperCycleMapLIN5Slave9Defect: diagnostic-event=EventLIN5Slave9Defect, operation-cycle=DefaultOperationCycle  # Event_Oper_Cycle_Map_LIN 5 Slave 9_Defect
  diagnostic event to debounce algorithm mapping EventDebounceMapLIN5Slave9Defect: debounce-algorithm=counter_based, diagnostic-event=EventLIN5Slave9Defect  # EventDebounceMap_LIN 5 Slave 9_Defect
package /ZeC/DTC/DTC/LIN_5_Slave_8_NoCommunication
  diagnostic trouble code uds LIN_5_Slave_8_NoCommunication: dtc-props=Dtc_Props_358996c7, uds-dtc-value=0x03050d  # LIN 5 Slave 8_NoCommunication
  diagnostic event EventLIN5Slave8NoCommunication: aging-allowed=true, event-kind=SWC, prestorage-freeze-frame=false  # Event_LIN 5 Slave 8_NoCommunication
  diagnostic event to trouble code uds mapping EventDtcMapLIN5Slave8NoCommunication: diagnostic-event=EventLIN5Slave8NoCommunication, trouble-code-uds=LIN_5_Slave_8_NoCommunication  # Event_Dtc_Map_LIN 5 Slave 8_NoCommunication
  diagnostic event to operation cycle mapping EventOperCycleMapLIN5Slave8NoCommunication: diagnostic-event=EventLIN5Slave8NoCommunication, operation-cycle=DefaultOperationCycle  # Event_Oper_Cycle_Map_LIN 5 Slave 8_NoCommunication
  diagnostic event to debounce algorithm mapping EventDebounceMapLIN5Slave8NoCommunication: debounce-algorithm=counter_based, diagnostic-event=EventLIN5Slave8NoCommunication  # EventDebounceMap_LIN 5 Slave 8_NoCommunication
package /ZeC/DTC/DTC/LIN_5_Slave_9_NoCommunication
  diagnostic trouble code uds LIN_5_Slave_9_NoCommunication: dtc-props=Dtc_Props_358996c7, uds-dtc-value=0x03050f  # LIN 5 Slave 9_NoCommunication
  diagnostic event EventLIN5Slave9NoCommunication: aging-allowed=true, event-kind=SWC, prestorage-freeze-frame=false  # Event_LIN 5 Slave 9_NoCommunication
  diagnostic event to trouble code uds mapping EventDtcMapLIN5Slave9NoCommunication: diagnostic-event=EventLIN5Slave9NoCommunication, trouble-code-uds=LIN_5_Slave_9_NoCommunication  # Event_Dtc_Map_LIN 5 Slave 9_NoCommunication
  diagnostic event to operation cycle mapping EventOperCycleMapLIN5Slave9NoCommunication: diagnostic-event=EventLIN5Slave9NoCommunication, operation-cycle=DefaultOperationCycle  # Event_Oper_Cycle_Map_LIN 5 Slave 9_NoCommunication
  diagnostic event to debounce algorithm mapping EventDebounceMapLIN5Slave9NoCommunication: debounce-algorithm=counter_based, diagnostic-event=EventLIN5Slave9NoCommunication  # EventDebounceMap_LIN 5 Slave 9_NoCommunication
package /ZeC/DTC/DTC/LIN_5_Slave_7_Defect
  diagnostic trouble code uds LIN_5_Slave_7_Defect: dtc-props=Dtc_Props_358996c7, uds-dtc-value=0x03050a  # LIN 5 Slave 7_Defect
  diagnostic event EventLIN5Slave7Defect: aging-allowed=true, event-kind=SWC, prestorage-freeze-frame=false  # Event_LIN 5 Slave 7_Defect
  diagnostic event to trouble code uds mapping EventDtcMapLIN5Slave7Defect: diagnostic-event=EventLIN5Slave7Defect, trouble-code-uds=LIN_5_Slave_7_Defect  # Event_Dtc_Map_LIN 5 Slave 7_Defect
  diagnostic event to operation cycle mapping EventOperCycleMapLIN5Slave7Defect: diagnostic-event=EventLIN5Slave7Defect, operation-cycle=DefaultOperationCycle  # Event_Oper_Cycle_Map_LIN 5 Slave 7_Defect
  diagnostic event to debounce algorithm mapping EventDebounceMapLIN5Slave7Defect: debounce-algorithm=counter_based, diagnostic-event=EventLIN5Slave7Defect  # EventDebounceMap_LIN 5 Slave 7_Defect
package /ZeC/DTC/DTC/Power_Path_078_Over_Load_Failure
  diagnostic trouble code uds Power_Path_078_Over_Load_Failure: dtc-props=Dtc_Props_36d50462, uds-dtc-value=0x00554e
  diagnostic event EventPowerPath078OverLoadFailure: aging-allowed=true, event-kind=SWC, prestorage-freeze-frame=false  # Event_Power_Path_078_Over_Load_Failure
  diagnostic event to trouble code uds mapping EventDtcMapPowerPath078OverLoadFailure: diagnostic-event=EventPowerPath078OverLoadFailure, trouble-code-uds=Power_Path_078_Over_Load_Failure  # Event_Dtc_Map_Power_Path_078_Over_Load_Failure
  diagnostic event to operation cycle mapping EventOperCycleMapPowerPath078OverLoadFailure: diagnostic-event=EventPowerPath078OverLoadFailure, operation-cycle=DefaultOperationCycle  # Event_Oper_Cycle_Map_Power_Path_078_Over_Load_Failure
  diagnostic event to debounce algorithm mapping EventDebounceMapPowerPath078OverLoadFailure: debounce-algorithm=time_based, diagnostic-event=EventPowerPath078OverLoadFailure  # EventDebounceMap_Power_Path_078_Over_Load_Failure
package /ZeC/DTC/DTC/Power_Path_077_Over_Load_Failure
  diagnostic trouble code uds Power_Path_077_Over_Load_Failure: dtc-props=Dtc_Props_70cc0e58, uds-dtc-value=0x00554d
  diagnostic event EventPowerPath077OverLoadFailure: aging-allowed=true, event-kind=SWC, prestorage-freeze-frame=false  # Event_Power_Path_077_Over_Load_Failure
  diagnostic event to trouble code uds mapping EventDtcMapPowerPath077OverLoadFailure: diagnostic-event=EventPowerPath077OverLoadFailure, trouble-code-uds=Power_Path_077_Over_Load_Failure  # Event_Dtc_Map_Power_Path_077_Over_Load_Failure
  diagnostic event to operation cycle mapping EventOperCycleMapPowerPath077OverLoadFailure: diagnostic-event=EventPowerPath077OverLoadFailure, operation-cycle=DefaultOperationCycle  # Event_Oper_Cycle_Map_Power_Path_077_Over_Load_Failure
  diagnostic event to debounce algorithm mapping EventDebounceMapPowerPath077OverLoadFailure: debounce-algorithm=time_based, diagnostic-event=EventPowerPath077OverLoadFailure  # EventDebounceMap_Power_Path_077_Over_Load_Failure
package /ZeC/DTC/DTC/LIN_5_Slave_8_Defect
  diagnostic trouble code uds LIN_5_Slave_8_Defect: dtc-props=Dtc_Props_358996c7, uds-dtc-value=0x03050c  # LIN 5 Slave 8_Defect
  diagnostic event EventLIN5Slave8Defect: aging-allowed=true, event-kind=SWC, prestorage-freeze-frame=false  # Event_LIN 5 Slave 8_Defect
  diagnostic event to trouble code uds mapping EventDtcMapLIN5Slave8Defect: diagnostic-event=EventLIN5Slave8Defect, trouble-code-uds=LIN_5_Slave_8_Defect  # Event_Dtc_Map_LIN 5 Slave 8_Defect
  diagnostic event to operation cycle mapping EventOperCycleMapLIN5Slave8Defect: diagnostic-event=EventLIN5Slave8Defect, operation-cycle=DefaultOperationCycle  # Event_Oper_Cycle_Map_LIN 5 Slave 8_Defect
  diagnostic event to debounce algorithm mapping EventDebounceMapLIN5Slave8Defect: debounce-algorithm=counter_based, diagnostic-event=EventLIN5Slave8Defect  # EventDebounceMap_LIN 5 Slave 8_Defect
package /ZeC/DTC/DTC/LIN_15_Local_Databus_Electrical_Failure
  diagnostic trouble code uds LIN_15_Local_Databus_Electrical_Failure: dtc-props=Dtc_Props_358996c7, uds-dtc-value=0x030f21  # LIN 15 Local_Databus_Electrical_Failure
  diagnostic event EventLIN15LocalDatabusElectricalFailure: aging-allowed=true, event-kind=SWC, prestorage-freeze-frame=false  # Event_LIN 15 Local_Databus_Electrical_Failure
  diagnostic event to trouble code uds mapping EventDtcMapLIN15LocalDatabusElectricalFailure: diagnostic-event=EventLIN15LocalDatabusElectricalFailure, trouble-code-uds=LIN_15_Local_Databus_Electrical_Failure  # Event_Dtc_Map_LIN 15 Local_Databus_Electrical_Failure
  diagnostic event to operation cycle mapping EventOperCycleMapLIN15LocalDatabusElectricalFailure: diagnostic-event=EventLIN15LocalDatabusElectricalFailure, operation-cycle=DefaultOperationCycle  # Event_Oper_Cycle_Map_LIN 15 Local_Databus_Electrical_Failure
  diagnostic event to debounce algorithm mapping EventDebounceMapLIN15LocalDatabusElectricalFailure: debounce-algorithm=counter_based, diagnostic-event=EventLIN15LocalDatabusElectricalFailure  # EventDebounceMap_LIN 15 Local_Databus_Electrical_Failure
package /ZeC/DTC/DTC/LIN_5_Slave_7_NoCommunication
  diagnostic trouble code uds LIN_5_Slave_7_NoCommunication: dtc-props=Dtc_Props_358996c7, uds-dtc-value=0x03050b  # LIN 5 Slave 7_NoCommunication
  diagnostic event EventLIN5Slave7NoCommunication: aging-allowed=true, event-kind=SWC, prestorage-freeze-frame=false  # Event_LIN 5 Slave 7_NoCommunication
  diagnostic event to trouble code uds mapping EventDtcMapLIN5Slave7NoCommunication: diagnostic-event=EventLIN5Slave7NoCommunication, trouble-code-uds=LIN_5_Slave_7_NoCommunication  # Event_Dtc_Map_LIN 5 Slave 7_NoCommunication
  diagnostic event to operation cycle mapping EventOperCycleMapLIN5Slave7NoCommunication: diagnostic-event=EventLIN5Slave7NoCommunication, operation-cycle=DefaultOperationCycle  # Event_Oper_Cycle_Map_LIN 5 Slave 7_NoCommunication
  diagnostic event to debounce algorithm mapping EventDebounceMapLIN5Slave7NoCommunication: debounce-algorithm=counter_based, diagnostic-event=EventLIN5Slave7NoCommunication  # EventDebounceMap_LIN 5 Slave 7_NoCommunication
package /ZeC/DTC/DTC/Power_Path_079_Over_Load_Failure
  diagnostic trouble code uds Power_Path_079_Over_Load_Failure: dtc-props=Dtc_Props_fcfe1a2c, uds-dtc-value=0x00554f
  diagnostic event EventPowerPath079OverLoadFailure: aging-allowed=true, event-kind=SWC, prestorage-freeze-frame=false  # Event_Power_Path_079_Over_Load_Failure
  diagnostic event to trouble code uds mapping EventDtcMapPowerPath079OverLoadFailure: diagnostic-event=EventPowerPath079OverLoadFailure, trouble-code-uds=Power_Path_079_Over_Load_Failure  # Event_Dtc_Map_Power_Path_079_Over_Load_Failure
  diagnostic event to operation cycle mapping EventOperCycleMapPowerPath079OverLoadFailure: diagnostic-event=EventPowerPath079OverLoadFailure, operation-cycle=DefaultOperationCycle  # Event_Oper_Cycle_Map_Power_Path_079_Over_Load_Failure
  diagnostic event to debounce algorithm mapping EventDebounceMapPowerPath079OverLoadFailure: debounce-algorithm=time_based, diagnostic-event=EventPowerPath079OverLoadFailure  # EventDebounceMap_Power_Path_079_Over_Load_Failure
package /ZeC/DTC/DTC/Power_Path_082_Over_Load_Failure
  diagnostic trouble code uds Power_Path_082_Over_Load_Failure: dtc-props=Dtc_Props_c45e9040, uds-dtc-value=0x005552
  diagnostic event EventPowerPath082OverLoadFailure: aging-allowed=true, event-kind=SWC, prestorage-freeze-frame=false  # Event_Power_Path_082_Over_Load_Failure
  diagnostic event to trouble code uds mapping EventDtcMapPowerPath082OverLoadFailure: diagnostic-event=EventPowerPath082OverLoadFailure, trouble-code-uds=Power_Path_082_Over_Load_Failure  # Event_Dtc_Map_Power_Path_082_Over_Load_Failure
  diagnostic event to operation cycle mapping EventOperCycleMapPowerPath082OverLoadFailure: diagnostic-event=EventPowerPath082OverLoadFailure, operation-cycle=DefaultOperationCycle  # Event_Oper_Cycle_Map_Power_Path_082_Over_Load_Failure
  diagnostic event to debounce algorithm mapping EventDebounceMapPowerPath082OverLoadFailure: debounce-algorithm=time_based, diagnostic-event=EventPowerPath082OverLoadFailure  # EventDebounceMap_Power_Path_082_Over_Load_Failure
package /ZeC/DTC/DTC/LIN_15_Databus_No_Comm
  diagnostic trouble code uds LIN_15_Databus_No_Comm: dtc-props=Dtc_Props_358996c7, uds-dtc-value=0x030f20  # LIN 15 Databus_No_Comm
  diagnostic event EventLIN15DatabusNoComm: aging-allowed=true, event-kind=SWC, prestorage-freeze-frame=false  # Event_LIN 15 Databus_No_Comm
  diagnostic event to trouble code uds mapping EventDtcMapLIN15DatabusNoComm: diagnostic-event=EventLIN15DatabusNoComm, trouble-code-uds=LIN_15_Databus_No_Comm  # Event_Dtc_Map_LIN 15 Databus_No_Comm
  diagnostic event to operation cycle mapping EventOperCycleMapLIN15DatabusNoComm: diagnostic-event=EventLIN15DatabusNoComm, operation-cycle=DefaultOperationCycle  # Event_Oper_Cycle_Map_LIN 15 Databus_No_Comm
  diagnostic event to debounce algorithm mapping EventDebounceMapLIN15DatabusNoComm: debounce-algorithm=counter_based, diagnostic-event=EventLIN15DatabusNoComm  # EventDebounceMap_LIN 15 Databus_No_Comm
package /ZeC/DTC/DTC/Power_Path_081_Over_Load_Failure
  diagnostic trouble code uds Power_Path_081_Over_Load_Failure: dtc-props=Dtc_Props_e758e0e, uds-dtc-value=0x005551
  diagnostic event EventPowerPath081OverLoadFailure: aging-allowed=true, event-kind=SWC, prestorage-freeze-frame=false  # Event_Power_Path_081_Over_Load_Failure
  diagnostic event to trouble code uds mapping EventDtcMapPowerPath081OverLoadFailure: diagnostic-event=EventPowerPath081OverLoadFailure, trouble-code-uds=Power_Path_081_Over_Load_Failure  # Event_Dtc_Map_Power_Path_081_Over_Load_Failure
  diagnostic event to operation cycle mapping EventOperCycleMapPowerPath081OverLoadFailure: diagnostic-event=EventPowerPath081OverLoadFailure, operation-cycle=DefaultOperationCycle  # Event_Oper_Cycle_Map_Power_Path_081_Over_Load_Failure
  diagnostic event to debounce algorithm mapping EventDebounceMapPowerPath081OverLoadFailure: debounce-algorithm=time_based, diagnostic-event=EventPowerPath081OverLoadFailure  # EventDebounceMap_Power_Path_081_Over_Load_Failure
package /ZeC/DTC/DTC/Power_Path_084_Over_Load_Failure
  diagnostic trouble code uds Power_Path_084_Over_Load_Failure: dtc-props=Dtc_Props_8b79aa9d, uds-dtc-value=0x005554
  diagnostic event EventPowerPath084OverLoadFailure: aging-allowed=true, event-kind=SWC, prestorage-freeze-frame=false  # Event_Power_Path_084_Over_Load_Failure
  diagnostic event to trouble code uds mapping EventDtcMapPowerPath084OverLoadFailure: diagnostic-event=EventPowerPath084OverLoadFailure, trouble-code-uds=Power_Path_084_Over_Load_Failure  # Event_Dtc_Map_Power_Path_084_Over_Load_Failure
  diagnostic event to operation cycle mapping EventOperCycleMapPowerPath084OverLoadFailure: diagnostic-event=EventPowerPath084OverLoadFailure, operation-cycle=DefaultOperationCycle  # Event_Oper_Cycle_Map_Power_Path_084_Over_Load_Failure
  diagnostic event to debounce algorithm mapping EventDebounceMapPowerPath084OverLoadFailure: debounce-algorithm=time_based, diagnostic-event=EventPowerPath084OverLoadFailure  # EventDebounceMap_Power_Path_084_Over_Load_Failure
package /ZeC/DTC/DTC/Power_Path_083_Over_Load_Failure
  diagnostic trouble code uds Power_Path_083_Over_Load_Failure: dtc-props=Dtc_Props_82479a7a, uds-dtc-value=0x005553
  diagnostic event EventPowerPath083OverLoadFailure: aging-allowed=true, event-kind=SWC, prestorage-freeze-frame=false  # Event_Power_Path_083_Over_Load_Failure
  diagnostic event to trouble code uds mapping EventDtcMapPowerPath083OverLoadFailure: diagnostic-event=EventPowerPath083OverLoadFailure, trouble-code-uds=Power_Path_083_Over_Load_Failure  # Event_Dtc_Map_Power_Path_083_Over_Load_Failure
  diagnostic event to operation cycle mapping EventOperCycleMapPowerPath083OverLoadFailure: diagnostic-event=EventPowerPath083OverLoadFailure, operation-cycle=DefaultOperationCycle  # Event_Oper_Cycle_Map_Power_Path_083_Over_Load_Failure
  diagnostic event to debounce algorithm mapping EventDebounceMapPowerPath083OverLoadFailure: debounce-algorithm=time_based, diagnostic-event=EventPowerPath083OverLoadFailure  # EventDebounceMap_Power_Path_083_Over_Load_Failure
package /ZeC/DTC/DTC/LIN_5_Slave_6_NoCommunication
  diagnostic trouble code uds LIN_5_Slave_6_NoCommunication: dtc-props=Dtc_Props_358996c7, uds-dtc-value=0x030509  # LIN 5 Slave 6_NoCommunication
  diagnostic event EventLIN5Slave6NoCommunication: aging-allowed=true, event-kind=SWC, prestorage-freeze-frame=false  # Event_LIN 5 Slave 6_NoCommunication
  diagnostic event to trouble code uds mapping EventDtcMapLIN5Slave6NoCommunication: diagnostic-event=EventLIN5Slave6NoCommunication, trouble-code-uds=LIN_5_Slave_6_NoCommunication  # Event_Dtc_Map_LIN 5 Slave 6_NoCommunication
  diagnostic event to operation cycle mapping EventOperCycleMapLIN5Slave6NoCommunication: diagnostic-event=EventLIN5Slave6NoCommunication, operation-cycle=DefaultOperationCycle  # Event_Oper_Cycle_Map_LIN 5 Slave 6_NoCommunication
  diagnostic event to debounce algorithm mapping EventDebounceMapLIN5Slave6NoCommunication: debounce-algorithm=counter_based, diagnostic-event=EventLIN5Slave6NoCommunication  # EventDebounceMap_LIN 5 Slave 6_NoCommunication
package /ZeC/DTC/DTC/LIN_5_Slave_6_Defect
  diagnostic trouble code uds LIN_5_Slave_6_Defect: dtc-props=Dtc_Props_358996c7, uds-dtc-value=0x030508  # LIN 5 Slave 6_Defect
  diagnostic event EventLIN5Slave6Defect: aging-allowed=true, event-kind=SWC, prestorage-freeze-frame=false  # Event_LIN 5 Slave 6_Defect
  diagnostic event to trouble code uds mapping EventDtcMapLIN5Slave6Defect: diagnostic-event=EventLIN5Slave6Defect, trouble-code-uds=LIN_5_Slave_6_Defect  # Event_Dtc_Map_LIN 5 Slave 6_Defect
  diagnostic event to operation cycle mapping EventOperCycleMapLIN5Slave6Defect: diagnostic-event=EventLIN5Slave6Defect, operation-cycle=DefaultOperationCycle  # Event_Oper_Cycle_Map_LIN 5 Slave 6_Defect
  diagnostic event to debounce algorithm mapping EventDebounceMapLIN5Slave6Defect: debounce-algorithm=counter_based, diagnostic-event=EventLIN5Slave6Defect  # EventDebounceMap_LIN 5 Slave 6_Defect
package /ZeC/DTC/DTC/Power_Path_080_Over_Load_Failure
  diagnostic trouble code uds Power_Path_080_Over_Load_Failure: dtc-props=Dtc_Props_486c8434, uds-dtc-value=0x005550
  diagnostic event EventPowerPath080OverLoadFailure: aging-allowed=true, event-kind=SWC, prestorage-freeze-frame=false  # Event_Power_Path_080_Over_Load_Failure
  diagnostic event to trouble code uds mapping EventDtcMapPowerPath080OverLoadFailure: diagnostic-event=EventPowerPath080OverLoadFailure, trouble-code-uds=Power_Path_080_Over_Load_Failure  # Event_Dtc_Map_Power_Path_080_Over_Load_Failure
  diagnostic event to operation cycle mapping EventOperCycleMapPowerPath080OverLoadFailure: diagnostic-event=EventPowerPath080OverLoadFailure, operation-cycle=DefaultOperationCycle  # Event_Oper_Cycle_Map_Power_Path_080_Over_Load_Failure
  diagnostic event to debounce algorithm mapping EventDebounceMapPowerPath080OverLoadFailure: debounce-algorithm=time_based, diagnostic-event=EventPowerPath080OverLoadFailure  # EventDebounceMap_Power_Path_080_Over_Load_Failure
package /ZeC/DTC/DTC/LIN_5_Slave_12_Defect
  diagnostic trouble code uds LIN_5_Slave_12_Defect: dtc-props=Dtc_Props_358996c7, uds-dtc-value=0x030516  # LIN 5 Slave 12_Defect
  diagnostic event EventLIN5Slave12Defect: aging-allowed=true, event-kind=SWC, prestorage-freeze-frame=false  # Event_LIN 5 Slave 12_Defect
  diagnostic event to trouble code uds mapping EventDtcMapLIN5Slave12Defect: diagnostic-event=EventLIN5Slave12Defect, trouble-code-uds=LIN_5_Slave_12_Defect  # Event_Dtc_Map_LIN 5 Slave 12_Defect
  diagnostic event to operation cycle mapping EventOperCycleMapLIN5Slave12Defect: diagnostic-event=EventLIN5Slave12Defect, operation-cycle=DefaultOperationCycle  # Event_Oper_Cycle_Map_LIN 5 Slave 12_Defect
  diagnostic event to debounce algorithm mapping EventDebounceMapLIN5Slave12Defect: debounce-algorithm=counter_based, diagnostic-event=EventLIN5Slave12Defect  # EventDebounceMap_LIN 5 Slave 12_Defect
package /ZeC/DTC/DTC/Power_Path_056_Over_Load_Failure
  diagnostic trouble code uds Power_Path_056_Over_Load_Failure: dtc-props=Dtc_Props_ed1a5674, uds-dtc-value=0x005538
  diagnostic event EventPowerPath056OverLoadFailure: aging-allowed=true, event-kind=SWC, prestorage-freeze-frame=false  # Event_Power_Path_056_Over_Load_Failure
  diagnostic event to trouble code uds mapping EventDtcMapPowerPath056OverLoadFailure: diagnostic-event=EventPowerPath056OverLoadFailure, trouble-code-uds=Power_Path_056_Over_Load_Failure  # Event_Dtc_Map_Power_Path_056_Over_Load_Failure
  diagnostic event to operation cycle mapping EventOperCycleMapPowerPath056OverLoadFailure: diagnostic-event=EventPowerPath056OverLoadFailure, operation-cycle=DefaultOperationCycle  # Event_Oper_Cycle_Map_Power_Path_056_Over_Load_Failure
  diagnostic event to debounce algorithm mapping EventDebounceMapPowerPath056OverLoadFailure: debounce-algorithm=time_based, diagnostic-event=EventPowerPath056OverLoadFailure  # EventDebounceMap_Power_Path_056_Over_Load_Failure
package /ZeC/DTC/DTC/LIN_5_Slave_11_NoCommunication
  diagnostic trouble code uds LIN_5_Slave_11_NoCommunication: dtc-props=Dtc_Props_358996c7, uds-dtc-value=0x030515  # LIN 5 Slave 11_NoCommunication
  diagnostic event EventLIN5Slave11NoCommunication: aging-allowed=true, event-kind=SWC, prestorage-freeze-frame=false  # Event_LIN 5 Slave 11_NoCommunication
  diagnostic event to trouble code uds mapping EventDtcMapLIN5Slave11NoCommunication: diagnostic-event=EventLIN5Slave11NoCommunication, trouble-code-uds=LIN_5_Slave_11_NoCommunication  # Event_Dtc_Map_LIN 5 Slave 11_NoCommunication
  diagnostic event to operation cycle mapping EventOperCycleMapLIN5Slave11NoCommunication: diagnostic-event=EventLIN5Slave11NoCommunication, operation-cycle=DefaultOperationCycle  # Event_Oper_Cycle_Map_LIN 5 Slave 11_NoCommunication
  diagnostic event to debounce algorithm mapping EventDebounceMapLIN5Slave11NoCommunication: debounce-algorithm=counter_based, diagnostic-event=EventLIN5Slave11NoCommunication  # EventDebounceMap_LIN 5 Slave 11_NoCommunication
package /ZeC/DTC/DTC/Power_Path_055_Over_Load_Failure
  diagnostic trouble code uds Power_Path_055_Over_Load_Failure: dtc-props=Dtc_Props_b97f3d80, uds-dtc-value=0x005537
  diagnostic event EventPowerPath055OverLoadFailure: aging-allowed=true, event-kind=SWC, prestorage-freeze-frame=false  # Event_Power_Path_055_Over_Load_Failure
  diagnostic event to trouble code uds mapping EventDtcMapPowerPath055OverLoadFailure: diagnostic-event=EventPowerPath055OverLoadFailure, trouble-code-uds=Power_Path_055_Over_Load_Failure  # Event_Dtc_Map_Power_Path_055_Over_Load_Failure
  diagnostic event to operation cycle mapping EventOperCycleMapPowerPath055OverLoadFailure: diagnostic-event=EventPowerPath055OverLoadFailure, operation-cycle=DefaultOperationCycle  # Event_Oper_Cycle_Map_Power_Path_055_Over_Load_Failure
  diagnostic event to debounce algorithm mapping EventDebounceMapPowerPath055OverLoadFailure: debounce-algorithm=time_based, diagnostic-event=EventPowerPath055OverLoadFailure  # EventDebounceMap_Power_Path_055_Over_Load_Failure
package /ZeC/DTC/DTC/LIN_5_Slave_13_Defect
  diagnostic trouble code uds LIN_5_Slave_13_Defect: dtc-props=Dtc_Props_358996c7, uds-dtc-value=0x030518  # LIN 5 Slave 13_Defect
  diagnostic event EventLIN5Slave13Defect: aging-allowed=true, event-kind=SWC, prestorage-freeze-frame=false  # Event_LIN 5 Slave 13_Defect
  diagnostic event to trouble code uds mapping EventDtcMapLIN5Slave13Defect: diagnostic-event=EventLIN5Slave13Defect, trouble-code-uds=LIN_5_Slave_13_Defect  # Event_Dtc_Map_LIN 5 Slave 13_Defect
  diagnostic event to operation cycle mapping EventOperCycleMapLIN5Slave13Defect: diagnostic-event=EventLIN5Slave13Defect, operation-cycle=DefaultOperationCycle  # Event_Oper_Cycle_Map_LIN 5 Slave 13_Defect
  diagnostic event to debounce algorithm mapping EventDebounceMapLIN5Slave13Defect: debounce-algorithm=counter_based, diagnostic-event=EventLIN5Slave13Defect  # EventDebounceMap_LIN 5 Slave 13_Defect
package /ZeC/DTC/DTC/LIN_5_Slave_12_NoCommunication
  diagnostic trouble code uds LIN_5_Slave_12_NoCommunication: dtc-props=Dtc_Props_358996c7, uds-dtc-value=0x030517  # LIN 5 Slave 12_NoCommunication
  diagnostic event EventLIN5Slave12NoCommunication: aging-allowed=true, event-kind=SWC, prestorage-freeze-frame=false  # Event_LIN 5 Slave 12_NoCommunication
  diagnostic event to trouble code uds mapping EventDtcMapLIN5Slave12NoCommunication: diagnostic-event=EventLIN5Slave12NoCommunication, trouble-code-uds=LIN_5_Slave_12_NoCommunication  # Event_Dtc_Map_LIN 5 Slave 12_NoCommunication
  diagnostic event to operation cycle mapping EventOperCycleMapLIN5Slave12NoCommunication: diagnostic-event=EventLIN5Slave12NoCommunication, operation-cycle=DefaultOperationCycle  # Event_Oper_Cycle_Map_LIN 5 Slave 12_NoCommunication
  diagnostic event to debounce algorithm mapping EventDebounceMapLIN5Slave12NoCommunication: debounce-algorithm=counter_based, diagnostic-event=EventLIN5Slave12NoCommunication  # EventDebounceMap_LIN 5 Slave 12_NoCommunication
package /ZeC/DTC/DTC/Power_Path_057_Over_Load_Failure
  diagnostic trouble code uds Power_Path_057_Over_Load_Failure: dtc-props=Dtc_Props_ab035c4e, uds-dtc-value=0x005539
  diagnostic event EventPowerPath057OverLoadFailure: aging-allowed=true, event-kind=SWC, prestorage-freeze-frame=false  # Event_Power_Path_057_Over_Load_Failure
  diagnostic event to trouble code uds mapping EventDtcMapPowerPath057OverLoadFailure: diagnostic-event=EventPowerPath057OverLoadFailure, trouble-code-uds=Power_Path_057_Over_Load_Failure  # Event_Dtc_Map_Power_Path_057_Over_Load_Failure
  diagnostic event to operation cycle mapping EventOperCycleMapPowerPath057OverLoadFailure: diagnostic-event=EventPowerPath057OverLoadFailure, operation-cycle=DefaultOperationCycle  # Event_Oper_Cycle_Map_Power_Path_057_Over_Load_Failure
  diagnostic event to debounce algorithm mapping EventDebounceMapPowerPath057OverLoadFailure: debounce-algorithm=time_based, diagnostic-event=EventPowerPath057OverLoadFailure  # EventDebounceMap_Power_Path_057_Over_Load_Failure
package /ZeC/DTC/DTC/LIN_5_Slave_10_Defect
  diagnostic trouble code uds LIN_5_Slave_10_Defect: dtc-props=Dtc_Props_358996c7, uds-dtc-value=0x030512  # LIN 5 Slave 10_Defect
  diagnostic event EventLIN5Slave10Defect: aging-allowed=true, event-kind=SWC, prestorage-freeze-frame=false  # Event_LIN 5 Slave 10_Defect
  diagnostic event to trouble code uds mapping EventDtcMapLIN5Slave10Defect: diagnostic-event=EventLIN5Slave10Defect, trouble-code-uds=LIN_5_Slave_10_Defect  # Event_Dtc_Map_LIN 5 Slave 10_Defect
  diagnostic event to operation cycle mapping EventOperCycleMapLIN5Slave10Defect: diagnostic-event=EventLIN5Slave10Defect, operation-cycle=DefaultOperationCycle  # Event_Oper_Cycle_Map_LIN 5 Slave 10_Defect
  diagnostic event to debounce algorithm mapping EventDebounceMapLIN5Slave10Defect: debounce-algorithm=counter_based, diagnostic-event=EventLIN5Slave10Defect  # EventDebounceMap_LIN 5 Slave 10_Defect
package /ZeC/DTC/DTC/Power_Path_052_Over_Load_Failure
  diagnostic trouble code uds Power_Path_052_Over_Load_Failure: dtc-props=Dtc_Props_735423ce, uds-dtc-value=0x005534
  diagnostic event EventPowerPath052OverLoadFailure: aging-allowed=true, event-kind=SWC, prestorage-freeze-frame=false  # Event_Power_Path_052_Over_Load_Failure
  diagnostic event to trouble code uds mapping EventDtcMapPowerPath052OverLoadFailure: diagnostic-event=EventPowerPath052OverLoadFailure, trouble-code-uds=Power_Path_052_Over_Load_Failure  # Event_Dtc_Map_Power_Path_052_Over_Load_Failure
  diagnostic event to operation cycle mapping EventOperCycleMapPowerPath052OverLoadFailure: diagnostic-event=EventPowerPath052OverLoadFailure, operation-cycle=DefaultOperationCycle  # Event_Oper_Cycle_Map_Power_Path_052_Over_Load_Failure
  diagnostic event to debounce algorithm mapping EventDebounceMapPowerPath052OverLoadFailure: debounce-algorithm=time_based, diagnostic-event=EventPowerPath052OverLoadFailure  # EventDebounceMap_Power_Path_052_Over_Load_Failure
package /ZeC/DTC/DTC/LIN_5_Slave_1_NoCommunication
  diagnostic trouble code uds LIN_5_Slave_1_NoCommunication: dtc-props=Dtc_Props_358996c7, uds-dtc-value=0x030511  # LIN 5 Slave 1_NoCommunication
  diagnostic event EventLIN5Slave1NoCommunication: aging-allowed=true, event-kind=SWC, prestorage-freeze-frame=false  # Event_LIN 5 Slave 1_NoCommunication
  diagnostic event to trouble code uds mapping EventDtcMapLIN5Slave1NoCommunication: diagnostic-event=EventLIN5Slave1NoCommunication, trouble-code-uds=LIN_5_Slave_1_NoCommunication  # Event_Dtc_Map_LIN 5 Slave 1_NoCommunication
  diagnostic event to operation cycle mapping EventOperCycleMapLIN5Slave1NoCommunication: diagnostic-event=EventLIN5Slave1NoCommunication, operation-cycle=DefaultOperationCycle  # Event_Oper_Cycle_Map_LIN 5 Slave 1_NoCommunication
  diagnostic event to debounce algorithm mapping EventDebounceMapLIN5Slave1NoCommunication: debounce-algorithm=counter_based, diagnostic-event=EventLIN5Slave1NoCommunication  # EventDebounceMap_LIN 5 Slave 1_NoCommunication
package /ZeC/DTC/DTC/Power_Path_051_Over_Load_Failure
  diagnostic trouble code uds Power_Path_051_Over_Load_Failure: dtc-props=Dtc_Props_7a6a1329, uds-dtc-value=0x005533
  diagnostic event EventPowerPath051OverLoadFailure: aging-allowed=true, event-kind=SWC, prestorage-freeze-frame=false  # Event_Power_Path_051_Over_Load_Failure
  diagnostic event to trouble code uds mapping EventDtcMapPowerPath051OverLoadFailure: diagnostic-event=EventPowerPath051OverLoadFailure, trouble-code-uds=Power_Path_051_Over_Load_Failure  # Event_Dtc_Map_Power_Path_051_Over_Load_Failure
  diagnostic event to operation cycle mapping EventOperCycleMapPowerPath051OverLoadFailure: diagnostic-event=EventPowerPath051OverLoadFailure, operation-cycle=DefaultOperationCycle  # Event_Oper_Cycle_Map_Power_Path_051_Over_Load_Failure
  diagnostic event to debounce algorithm mapping EventDebounceMapPowerPath051OverLoadFailure: debounce-algorithm=time_based, diagnostic-event=EventPowerPath051OverLoadFailure  # EventDebounceMap_Power_Path_051_Over_Load_Failure
package /ZeC/DTC/DTC/LIN_5_Slave_11_Defect
  diagnostic trouble code uds LIN_5_Slave_11_Defect: dtc-props=Dtc_Props_358996c7, uds-dtc-value=0x030514  # LIN 5 Slave 11_Defect
  diagnostic event EventLIN5Slave11Defect: aging-allowed=true, event-kind=SWC, prestorage-freeze-frame=false  # Event_LIN 5 Slave 11_Defect
  diagnostic event to trouble code uds mapping EventDtcMapLIN5Slave11Defect: diagnostic-event=EventLIN5Slave11Defect, trouble-code-uds=LIN_5_Slave_11_Defect  # Event_Dtc_Map_LIN 5 Slave 11_Defect
  diagnostic event to operation cycle mapping EventOperCycleMapLIN5Slave11Defect: diagnostic-event=EventLIN5Slave11Defect, operation-cycle=DefaultOperationCycle  # Event_Oper_Cycle_Map_LIN 5 Slave 11_Defect
  diagnostic event to debounce algorithm mapping EventDebounceMapLIN5Slave11Defect: debounce-algorithm=counter_based, diagnostic-event=EventLIN5Slave11Defect  # EventDebounceMap_LIN 5 Slave 11_Defect
package /ZeC/DTC/DTC/Power_Path_054_Over_Load_Failure
  diagnostic trouble code uds Power_Path_054_Over_Load_Failure: dtc-props=Dtc_Props_ff6637ba, uds-dtc-value=0x005536
  diagnostic event EventPowerPath054OverLoadFailure: aging-allowed=true, event-kind=SWC, prestorage-freeze-frame=false  # Event_Power_Path_054_Over_Load_Failure
  diagnostic event to trouble code uds mapping EventDtcMapPowerPath054OverLoadFailure: diagnostic-event=EventPowerPath054OverLoadFailure, trouble-code-uds=Power_Path_054_Over_Load_Failure  # Event_Dtc_Map_Power_Path_054_Over_Load_Failure
  diagnostic event to operation cycle mapping EventOperCycleMapPowerPath054OverLoadFailure: diagnostic-event=EventPowerPath054OverLoadFailure, operation-cycle=DefaultOperationCycle  # Event_Oper_Cycle_Map_Power_Path_054_Over_Load_Failure
  diagnostic event to debounce algorithm mapping EventDebounceMapPowerPath054OverLoadFailure: debounce-algorithm=time_based, diagnostic-event=EventPowerPath054OverLoadFailure  # EventDebounceMap_Power_Path_054_Over_Load_Failure
package /ZeC/DTC/DTC/LIN_5_Slave_10_NoCommunication
  diagnostic trouble code uds LIN_5_Slave_10_NoCommunication: dtc-props=Dtc_Props_358996c7, uds-dtc-value=0x030513  # LIN 5 Slave 10_NoCommunication
  diagnostic event EventLIN5Slave10NoCommunication: aging-allowed=true, event-kind=SWC, prestorage-freeze-frame=false  # Event_LIN 5 Slave 10_NoCommunication
  diagnostic event to trouble code uds mapping EventDtcMapLIN5Slave10NoCommunication: diagnostic-event=EventLIN5Slave10NoCommunication, trouble-code-uds=LIN_5_Slave_10_NoCommunication  # Event_Dtc_Map_LIN 5 Slave 10_NoCommunication
  diagnostic event to operation cycle mapping EventOperCycleMapLIN5Slave10NoCommunication: diagnostic-event=EventLIN5Slave10NoCommunication, operation-cycle=DefaultOperationCycle  # Event_Oper_Cycle_Map_LIN 5 Slave 10_NoCommunication
  diagnostic event to debounce algorithm mapping EventDebounceMapLIN5Slave10NoCommunication: debounce-algorithm=counter_based, diagnostic-event=EventLIN5Slave10NoCommunication  # EventDebounceMap_LIN 5 Slave 10_NoCommunication
package /ZeC/DTC/DTC/Power_Path_053_Over_Load_Failure
  diagnostic trouble code uds Power_Path_053_Over_Load_Failure: dtc-props=Dtc_Props_354d29f4, uds-dtc-value=0x005535
  diagnostic event EventPowerPath053OverLoadFailure: aging-allowed=true, event-kind=SWC, prestorage-freeze-frame=false  # Event_Power_Path_053_Over_Load_Failure
  diagnostic event to trouble code uds mapping EventDtcMapPowerPath053OverLoadFailure: diagnostic-event=EventPowerPath053OverLoadFailure, trouble-code-uds=Power_Path_053_Over_Load_Failure  # Event_Dtc_Map_Power_Path_053_Over_Load_Failure
  diagnostic event to operation cycle mapping EventOperCycleMapPowerPath053OverLoadFailure: diagnostic-event=EventPowerPath053OverLoadFailure, operation-cycle=DefaultOperationCycle  # Event_Oper_Cycle_Map_Power_Path_053_Over_Load_Failure
  diagnostic event to debounce algorithm mapping EventDebounceMapPowerPath053OverLoadFailure: debounce-algorithm=time_based, diagnostic-event=EventPowerPath053OverLoadFailure  # EventDebounceMap_Power_Path_053_Over_Load_Failure
package /ZeC/DTC/DTC/LIN_5_Slave_1_Defect
  diagnostic trouble code uds LIN_5_Slave_1_Defect: dtc-props=Dtc_Props_358996c7, uds-dtc-value=0x030510  # LIN 5 Slave 1_Defect
  diagnostic event EventLIN5Slave1Defect: aging-allowed=true, event-kind=SWC, prestorage-freeze-frame=false  # Event_LIN 5 Slave 1_Defect
  diagnostic event to trouble code uds mapping EventDtcMapLIN5Slave1Defect: diagnostic-event=EventLIN5Slave1Defect, trouble-code-uds=LIN_5_Slave_1_Defect  # Event_Dtc_Map_LIN 5 Slave 1_Defect
  diagnostic event to operation cycle mapping EventOperCycleMapLIN5Slave1Defect: diagnostic-event=EventLIN5Slave1Defect, operation-cycle=DefaultOperationCycle  # Event_Oper_Cycle_Map_LIN 5 Slave 1_Defect
  diagnostic event to debounce algorithm mapping EventDebounceMapLIN5Slave1Defect: debounce-algorithm=counter_based, diagnostic-event=EventLIN5Slave1Defect  # EventDebounceMap_LIN 5 Slave 1_Defect
package /ZeC/DTC/DTC/Power_Path_059_Over_Load_Failure
  diagnostic trouble code uds Power_Path_059_Over_Load_Failure: dtc-props=Dtc_Props_18c7d6e, uds-dtc-value=0x00553b
  diagnostic event EventPowerPath059OverLoadFailure: aging-allowed=true, event-kind=SWC, prestorage-freeze-frame=false  # Event_Power_Path_059_Over_Load_Failure
  diagnostic event to trouble code uds mapping EventDtcMapPowerPath059OverLoadFailure: diagnostic-event=EventPowerPath059OverLoadFailure, trouble-code-uds=Power_Path_059_Over_Load_Failure  # Event_Dtc_Map_Power_Path_059_Over_Load_Failure
  diagnostic event to operation cycle mapping EventOperCycleMapPowerPath059OverLoadFailure: diagnostic-event=EventPowerPath059OverLoadFailure, operation-cycle=DefaultOperationCycle  # Event_Oper_Cycle_Map_Power_Path_059_Over_Load_Failure
  diagnostic event to debounce algorithm mapping EventDebounceMapPowerPath059OverLoadFailure: debounce-algorithm=time_based, diagnostic-event=EventPowerPath059OverLoadFailure  # EventDebounceMap_Power_Path_059_Over_Load_Failure
package /ZeC/DTC/DTC/Power_Path_058_Over_Load_Failure
  diagnostic trouble code uds Power_Path_058_Over_Load_Failure: dtc-props=Dtc_Props_cba76320, uds-dtc-value=0x00553a
  diagnostic event EventPowerPath058OverLoadFailure: aging-allowed=true, event-kind=SWC, prestorage-freeze-frame=false  # Event_Power_Path_058_Over_Load_Failure
  diagnostic event to trouble code uds mapping EventDtcMapPowerPath058OverLoadFailure: diagnostic-event=EventPowerPath058OverLoadFailure, trouble-code-uds=Power_Path_058_Over_Load_Failure  # Event_Dtc_Map_Power_Path_058_Over_Load_Failure
  diagnostic event to operation cycle mapping EventOperCycleMapPowerPath058OverLoadFailure: diagnostic-event=EventPowerPath058OverLoadFailure, operation-cycle=DefaultOperationCycle  # Event_Oper_Cycle_Map_Power_Path_058_Over_Load_Failure
  diagnostic event to debounce algorithm mapping EventDebounceMapPowerPath058OverLoadFailure: debounce-algorithm=time_based, diagnostic-event=EventPowerPath058OverLoadFailure  # EventDebounceMap_Power_Path_058_Over_Load_Failure
package /ZeC/DTC/DTC/LIN_5_Slave_2_Defect
  diagnostic trouble code uds LIN_5_Slave_2_Defect: dtc-props=Dtc_Props_358996c7, uds-dtc-value=0x03051e  # LIN 5 Slave 2_Defect
  diagnostic event EventLIN5Slave2Defect: aging-allowed=true, event-kind=SWC, prestorage-freeze-frame=false  # Event_LIN 5 Slave 2_Defect
  diagnostic event to trouble code uds mapping EventDtcMapLIN5Slave2Defect: diagnostic-event=EventLIN5Slave2Defect, trouble-code-uds=LIN_5_Slave_2_Defect  # Event_Dtc_Map_LIN 5 Slave 2_Defect
  diagnostic event to operation cycle mapping EventOperCycleMapLIN5Slave2Defect: diagnostic-event=EventLIN5Slave2Defect, operation-cycle=DefaultOperationCycle  # Event_Oper_Cycle_Map_LIN 5 Slave 2_Defect
  diagnostic event to debounce algorithm mapping EventDebounceMapLIN5Slave2Defect: debounce-algorithm=counter_based, diagnostic-event=EventLIN5Slave2Defect  # EventDebounceMap_LIN 5 Slave 2_Defect
package /ZeC/DTC/DTC/LIN_5_Slave_14_NoCommunication
  diagnostic trouble code uds LIN_5_Slave_14_NoCommunication: dtc-props=Dtc_Props_358996c7, uds-dtc-value=0x03051b  # LIN 5 Slave 14_NoCommunication
  diagnostic event EventLIN5Slave14NoCommunication: aging-allowed=true, event-kind=SWC, prestorage-freeze-frame=false  # Event_LIN 5 Slave 14_NoCommunication
  diagnostic event to trouble code uds mapping EventDtcMapLIN5Slave14NoCommunication: diagnostic-event=EventLIN5Slave14NoCommunication, trouble-code-uds=LIN_5_Slave_14_NoCommunication  # Event_Dtc_Map_LIN 5 Slave 14_NoCommunication
  diagnostic event to operation cycle mapping EventOperCycleMapLIN5Slave14NoCommunication: diagnostic-event=EventLIN5Slave14NoCommunication, operation-cycle=DefaultOperationCycle  # Event_Oper_Cycle_Map_LIN 5 Slave 14_NoCommunication
  diagnostic event to debounce algorithm mapping EventDebounceMapLIN5Slave14NoCommunication: debounce-algorithm=counter_based, diagnostic-event=EventLIN5Slave14NoCommunication  # EventDebounceMap_LIN 5 Slave 14_NoCommunication
package /ZeC/DTC/DTC/Power_Path_061_Over_Load_Failure
  diagnostic trouble code uds Power_Path_061_Over_Load_Failure: dtc-props=Dtc_Props_4eab47b3, uds-dtc-value=0x00553d
  diagnostic event EventPowerPath061OverLoadFailure: aging-allowed=true, event-kind=SWC, prestorage-freeze-frame=false  # Event_Power_Path_061_Over_Load_Failure
  diagnostic event to trouble code uds mapping EventDtcMapPowerPath061OverLoadFailure: diagnostic-event=EventPowerPath061OverLoadFailure, trouble-code-uds=Power_Path_061_Over_Load_Failure  # Event_Dtc_Map_Power_Path_061_Over_Load_Failure
  diagnostic event to operation cycle mapping EventOperCycleMapPowerPath061OverLoadFailure: diagnostic-event=EventPowerPath061OverLoadFailure, operation-cycle=DefaultOperationCycle  # Event_Oper_Cycle_Map_Power_Path_061_Over_Load_Failure
  diagnostic event to debounce algorithm mapping EventDebounceMapPowerPath061OverLoadFailure: debounce-algorithm=time_based, diagnostic-event=EventPowerPath061OverLoadFailure  # EventDebounceMap_Power_Path_061_Over_Load_Failure
package /ZeC/DTC/DTC/LIN_5_Slave_14_Defect
  diagnostic trouble code uds LIN_5_Slave_14_Defect: dtc-props=Dtc_Props_358996c7, uds-dtc-value=0x03051a  # LIN 5 Slave 14_Defect
  diagnostic event EventLIN5Slave14Defect: aging-allowed=true, event-kind=SWC, prestorage-freeze-frame=false  # Event_LIN 5 Slave 14_Defect
  diagnostic event to trouble code uds mapping EventDtcMapLIN5Slave14Defect: diagnostic-event=EventLIN5Slave14Defect, trouble-code-uds=LIN_5_Slave_14_Defect  # Event_Dtc_Map_LIN 5 Slave 14_Defect
  diagnostic event to operation cycle mapping EventOperCycleMapLIN5Slave14Defect: diagnostic-event=EventLIN5Slave14Defect, operation-cycle=DefaultOperationCycle  # Event_Oper_Cycle_Map_LIN 5 Slave 14_Defect
  diagnostic event to debounce algorithm mapping EventDebounceMapLIN5Slave14Defect: debounce-algorithm=counter_based, diagnostic-event=EventLIN5Slave14Defect  # EventDebounceMap_LIN 5 Slave 14_Defect
package /ZeC/DTC/DTC/Power_Path_060_Over_Load_Failure
  diagnostic trouble code uds Power_Path_060_Over_Load_Failure: dtc-props=Dtc_Props_47957754, uds-dtc-value=0x00553c
  diagnostic event EventPowerPath060OverLoadFailure: aging-allowed=true, event-kind=SWC, prestorage-freeze-frame=false  # Event_Power_Path_060_Over_Load_Failure
  diagnostic event to trouble code uds mapping EventDtcMapPowerPath060OverLoadFailure: diagnostic-event=EventPowerPath060OverLoadFailure, trouble-code-uds=Power_Path_060_Over_Load_Failure  # Event_Dtc_Map_Power_Path_060_Over_Load_Failure
  diagnostic event to operation cycle mapping EventOperCycleMapPowerPath060OverLoadFailure: diagnostic-event=EventPowerPath060OverLoadFailure, operation-cycle=DefaultOperationCycle  # Event_Oper_Cycle_Map_Power_Path_060_Over_Load_Failure
  diagnostic event to debounce algorithm mapping EventDebounceMapPowerPath060OverLoadFailure: debounce-algorithm=time_based, diagnostic-event=EventPowerPath060OverLoadFailure  # EventDebounceMap_Power_Path_060_Over_Load_Failure
package /ZeC/DTC/DTC/LIN_5_Slave_15_NoCommunication
  diagnostic trouble code uds LIN_5_Slave_15_NoCommunication: dtc-props=Dtc_Props_358996c7, uds-dtc-value=0x03051d  # LIN 5 Slave 15_NoCommunication
  diagnostic event EventLIN5Slave15NoCommunication: aging-allowed=true, event-kind=SWC, prestorage-freeze-frame=false  # Event_LIN 5 Slave 15_NoCommunication
  diagnostic event to trouble code uds mapping EventDtcMapLIN5Slave15NoCommunication: diagnostic-event=EventLIN5Slave15NoCommunication, trouble-code-uds=LIN_5_Slave_15_NoCommunication  # Event_Dtc_Map_LIN 5 Slave 15_NoCommunication
  diagnostic event to operation cycle mapping EventOperCycleMapLIN5Slave15NoCommunication: diagnostic-event=EventLIN5Slave15NoCommunication, operation-cycle=DefaultOperationCycle  # Event_Oper_Cycle_Map_LIN 5 Slave 15_NoCommunication
  diagnostic event to debounce algorithm mapping EventDebounceMapLIN5Slave15NoCommunication: debounce-algorithm=counter_based, diagnostic-event=EventLIN5Slave15NoCommunication  # EventDebounceMap_LIN 5 Slave 15_NoCommunication
package /ZeC/DTC/DTC/Power_Path_063_Over_Load_Failure
  diagnostic trouble code uds Power_Path_063_Over_Load_Failure: dtc-props=Dtc_Props_c29953c7, uds-dtc-value=0x00553f
  diagnostic event EventPowerPath063OverLoadFailure: aging-allowed=true, event-kind=SWC, prestorage-freeze-frame=false  # Event_Power_Path_063_Over_Load_Failure
  diagnostic event to trouble code uds mapping EventDtcMapPowerPath063OverLoadFailure: diagnostic-event=EventPowerPath063OverLoadFailure, trouble-code-uds=Power_Path_063_Over_Load_Failure  # Event_Dtc_Map_Power_Path_063_Over_Load_Failure
  diagnostic event to operation cycle mapping EventOperCycleMapPowerPath063OverLoadFailure: diagnostic-event=EventPowerPath063OverLoadFailure, operation-cycle=DefaultOperationCycle  # Event_Oper_Cycle_Map_Power_Path_063_Over_Load_Failure
  diagnostic event to debounce algorithm mapping EventDebounceMapPowerPath063OverLoadFailure: debounce-algorithm=time_based, diagnostic-event=EventPowerPath063OverLoadFailure  # EventDebounceMap_Power_Path_063_Over_Load_Failure
package /ZeC/DTC/DTC/LIN_5_Slave_15_Defect
  diagnostic trouble code uds LIN_5_Slave_15_Defect: dtc-props=Dtc_Props_358996c7, uds-dtc-value=0x03051c  # LIN 5 Slave 15_Defect
  diagnostic event EventLIN5Slave15Defect: aging-allowed=true, event-kind=SWC, prestorage-freeze-frame=false  # Event_LIN 5 Slave 15_Defect
  diagnostic event to trouble code uds mapping EventDtcMapLIN5Slave15Defect: diagnostic-event=EventLIN5Slave15Defect, trouble-code-uds=LIN_5_Slave_15_Defect  # Event_Dtc_Map_LIN 5 Slave 15_Defect
  diagnostic event to operation cycle mapping EventOperCycleMapLIN5Slave15Defect: diagnostic-event=EventLIN5Slave15Defect, operation-cycle=DefaultOperationCycle  # Event_Oper_Cycle_Map_LIN 5 Slave 15_Defect
  diagnostic event to debounce algorithm mapping EventDebounceMapLIN5Slave15Defect: debounce-algorithm=counter_based, diagnostic-event=EventLIN5Slave15Defect  # EventDebounceMap_LIN 5 Slave 15_Defect
package /ZeC/DTC/DTC/Power_Path_062_Over_Load_Failure
  diagnostic trouble code uds Power_Path_062_Over_Load_Failure: dtc-props=Dtc_Props_8b24d89, uds-dtc-value=0x00553e
  diagnostic event EventPowerPath062OverLoadFailure: aging-allowed=true, event-kind=SWC, prestorage-freeze-frame=false  # Event_Power_Path_062_Over_Load_Failure
  diagnostic event to trouble code uds mapping EventDtcMapPowerPath062OverLoadFailure: diagnostic-event=EventPowerPath062OverLoadFailure, trouble-code-uds=Power_Path_062_Over_Load_Failure  # Event_Dtc_Map_Power_Path_062_Over_Load_Failure
  diagnostic event to operation cycle mapping EventOperCycleMapPowerPath062OverLoadFailure: diagnostic-event=EventPowerPath062OverLoadFailure, operation-cycle=DefaultOperationCycle  # Event_Oper_Cycle_Map_Power_Path_062_Over_Load_Failure
  diagnostic event to debounce algorithm mapping EventDebounceMapPowerPath062OverLoadFailure: debounce-algorithm=time_based, diagnostic-event=EventPowerPath062OverLoadFailure  # EventDebounceMap_Power_Path_062_Over_Load_Failure
package /ZeC/DTC/DTC/Power_Path_065_Over_Load_Failure
  diagnostic trouble code uds Power_Path_065_Over_Load_Failure: dtc-props=Dtc_Props_c83f4eb6, uds-dtc-value=0x005541
  diagnostic event EventPowerPath065OverLoadFailure: aging-allowed=true, event-kind=SWC, prestorage-freeze-frame=false  # Event_Power_Path_065_Over_Load_Failure
  diagnostic event to trouble code uds mapping EventDtcMapPowerPath065OverLoadFailure: diagnostic-event=EventPowerPath065OverLoadFailure, trouble-code-uds=Power_Path_065_Over_Load_Failure  # Event_Dtc_Map_Power_Path_065_Over_Load_Failure
  diagnostic event to operation cycle mapping EventOperCycleMapPowerPath065OverLoadFailure: diagnostic-event=EventPowerPath065OverLoadFailure, operation-cycle=DefaultOperationCycle  # Event_Oper_Cycle_Map_Power_Path_065_Over_Load_Failure
  diagnostic event to debounce algorithm mapping EventDebounceMapPowerPath065OverLoadFailure: debounce-algorithm=time_based, diagnostic-event=EventPowerPath065OverLoadFailure  # EventDebounceMap_Power_Path_065_Over_Load_Failure
package /ZeC/DTC/DTC/Power_Path_064_Over_Load_Failure
  diagnostic trouble code uds Power_Path_064_Over_Load_Failure: dtc-props=Dtc_Props_8e26448c, uds-dtc-value=0x005540
  diagnostic event EventPowerPath064OverLoadFailure: aging-allowed=true, event-kind=SWC, prestorage-freeze-frame=false  # Event_Power_Path_064_Over_Load_Failure
  diagnostic event to trouble code uds mapping EventDtcMapPowerPath064OverLoadFailure: diagnostic-event=EventPowerPath064OverLoadFailure, trouble-code-uds=Power_Path_064_Over_Load_Failure  # Event_Dtc_Map_Power_Path_064_Over_Load_Failure
  diagnostic event to operation cycle mapping EventOperCycleMapPowerPath064OverLoadFailure: diagnostic-event=EventPowerPath064OverLoadFailure, operation-cycle=DefaultOperationCycle  # Event_Oper_Cycle_Map_Power_Path_064_Over_Load_Failure
  diagnostic event to debounce algorithm mapping EventDebounceMapPowerPath064OverLoadFailure: debounce-algorithm=time_based, diagnostic-event=EventPowerPath064OverLoadFailure  # EventDebounceMap_Power_Path_064_Over_Load_Failure
package /ZeC/DTC/DTC/Power_Path_067_Over_Load_Failure
  diagnostic trouble code uds Power_Path_067_Over_Load_Failure: dtc-props=Dtc_Props_440d5ac2, uds-dtc-value=0x005543
  diagnostic event EventPowerPath067OverLoadFailure: aging-allowed=true, event-kind=SWC, prestorage-freeze-frame=false  # Event_Power_Path_067_Over_Load_Failure
  diagnostic event to trouble code uds mapping EventDtcMapPowerPath067OverLoadFailure: diagnostic-event=EventPowerPath067OverLoadFailure, trouble-code-uds=Power_Path_067_Over_Load_Failure  # Event_Dtc_Map_Power_Path_067_Over_Load_Failure
  diagnostic event to operation cycle mapping EventOperCycleMapPowerPath067OverLoadFailure: diagnostic-event=EventPowerPath067OverLoadFailure, operation-cycle=DefaultOperationCycle  # Event_Oper_Cycle_Map_Power_Path_067_Over_Load_Failure
  diagnostic event to debounce algorithm mapping EventDebounceMapPowerPath067OverLoadFailure: debounce-algorithm=time_based, diagnostic-event=EventPowerPath067OverLoadFailure  # EventDebounceMap_Power_Path_067_Over_Load_Failure
package /ZeC/DTC/DTC/Power_Path_066_Over_Load_Failure
  diagnostic trouble code uds Power_Path_066_Over_Load_Failure: dtc-props=Dtc_Props_21450f8, uds-dtc-value=0x005542
  diagnostic event EventPowerPath066OverLoadFailure: aging-allowed=true, event-kind=SWC, prestorage-freeze-frame=false  # Event_Power_Path_066_Over_Load_Failure
  diagnostic event to trouble code uds mapping EventDtcMapPowerPath066OverLoadFailure: diagnostic-event=EventPowerPath066OverLoadFailure, trouble-code-uds=Power_Path_066_Over_Load_Failure  # Event_Dtc_Map_Power_Path_066_Over_Load_Failure
  diagnostic event to operation cycle mapping EventOperCycleMapPowerPath066OverLoadFailure: diagnostic-event=EventPowerPath066OverLoadFailure, operation-cycle=DefaultOperationCycle  # Event_Oper_Cycle_Map_Power_Path_066_Over_Load_Failure
  diagnostic event to debounce algorithm mapping EventDebounceMapPowerPath066OverLoadFailure: debounce-algorithm=time_based, diagnostic-event=EventPowerPath066OverLoadFailure  # EventDebounceMap_Power_Path_066_Over_Load_Failure
package /ZeC/DTC/DTC/LIN_5_Slave_13_NoCommunication
  diagnostic trouble code uds LIN_5_Slave_13_NoCommunication: dtc-props=Dtc_Props_358996c7, uds-dtc-value=0x030519  # LIN 5 Slave 13_NoCommunication
  diagnostic event EventLIN5Slave13NoCommunication: aging-allowed=true, event-kind=SWC, prestorage-freeze-frame=false  # Event_LIN 5 Slave 13_NoCommunication
  diagnostic event to trouble code uds mapping EventDtcMapLIN5Slave13NoCommunication: diagnostic-event=EventLIN5Slave13NoCommunication, trouble-code-uds=LIN_5_Slave_13_NoCommunication  # Event_Dtc_Map_LIN 5 Slave 13_NoCommunication
  diagnostic event to operation cycle mapping EventOperCycleMapLIN5Slave13NoCommunication: diagnostic-event=EventLIN5Slave13NoCommunication, operation-cycle=DefaultOperationCycle  # Event_Oper_Cycle_Map_LIN 5 Slave 13_NoCommunication
  diagnostic event to debounce algorithm mapping EventDebounceMapLIN5Slave13NoCommunication: debounce-algorithm=counter_based, diagnostic-event=EventLIN5Slave13NoCommunication  # EventDebounceMap_LIN 5 Slave 13_NoCommunication
package /ZeC/DTC/DTC/LIN_23_Slave_11_NoCommunication
  diagnostic trouble code uds LIN_23_Slave_11_NoCommunication: dtc-props=Dtc_Props_358996c7, uds-dtc-value=0x031815  # LIN 23 Slave 11_NoCommunication
  diagnostic event EventLIN23Slave11NoCommunication: aging-allowed=true, event-kind=SWC, prestorage-freeze-frame=false  # Event_LIN 23 Slave 11_NoCommunication
  diagnostic event to trouble code uds mapping EventDtcMapLIN23Slave11NoCommunication: diagnostic-event=EventLIN23Slave11NoCommunication, trouble-code-uds=LIN_23_Slave_11_NoCommunication  # Event_Dtc_Map_LIN 23 Slave 11_NoCommunication
  diagnostic event to operation cycle mapping EventOperCycleMapLIN23Slave11NoCommunication: diagnostic-event=EventLIN23Slave11NoCommunication, operation-cycle=DefaultOperationCycle  # Event_Oper_Cycle_Map_LIN 23 Slave 11_NoCommunication
  diagnostic event to debounce algorithm mapping EventDebounceMapLIN23Slave11NoCommunication: debounce-algorithm=counter_based, diagnostic-event=EventLIN23Slave11NoCommunication  # EventDebounceMap_LIN 23 Slave 11_NoCommunication
package /ZeC/DTC/DTC/LIN_23_Slave_12_Defect
  diagnostic trouble code uds LIN_23_Slave_12_Defect: dtc-props=Dtc_Props_358996c7, uds-dtc-value=0x031816  # LIN 23 Slave 12_Defect
  diagnostic event EventLIN23Slave12Defect: aging-allowed=true, event-kind=SWC, prestorage-freeze-frame=false  # Event_LIN 23 Slave 12_Defect
  diagnostic event to trouble code uds mapping EventDtcMapLIN23Slave12Defect: diagnostic-event=EventLIN23Slave12Defect, trouble-code-uds=LIN_23_Slave_12_Defect  # Event_Dtc_Map_LIN 23 Slave 12_Defect
  diagnostic event to operation cycle mapping EventOperCycleMapLIN23Slave12Defect: diagnostic-event=EventLIN23Slave12Defect, operation-cycle=DefaultOperationCycle  # Event_Oper_Cycle_Map_LIN 23 Slave 12_Defect
  diagnostic event to debounce algorithm mapping EventDebounceMapLIN23Slave12Defect: debounce-algorithm=counter_based, diagnostic-event=EventLIN23Slave12Defect  # EventDebounceMap_LIN 23 Slave 12_Defect
