[part 2 of 19: packages /ZeC/DataIdentifiers/CalibrationData/Write_generic_to_sub_system to /ZeC/DataIdentifiers/Identification/SWCO_list_vendor_id]
AUTOSAR XML (schema 00047)
package /ZeC/DataIdentifiers/CalibrationData/Write_generic_to_sub_system
  diagnostic data identifier WriteGenericToSubSystem: id=0x0251, represents-vin=false  # Write_generic_to_sub_system
    diagnostic-parameter bit-offset=0:
      diagnostic data element CalibrationData_0x0251_Write_generic_to_sub_system_Target_sub_system_node_address: base-type=uint16, compu {28=Target_sub_system_node_address: Fresh Air Blower Back (TTR243112), 469=Target_sub_system_node_address: Digital Sound System Control Module 4 (TTR912911), 232=Target_sub_system_node_address: Starter Generator Control Module Sub (TTR263012), 169=Target_sub_system_node_address: Pedestrian Protection Center (TTR256712), 236=Target_sub_system_node_address: Refrigerant Pressure And Temperature Sender 4 (TTR263412), 342=Target_sub_system_node_address: Cooler Fan 3 (TTR273712), 295=Target_sub_system_node_address: Coolant Valve (TTR269012), 17=Target_sub_system_node_address: Data Medium (TTR242012), 545=Target_sub_system_node_address: Sub System Driver Assistance 2 Extended (TTR910611), 483=Target_sub_system_node_address: Catalyst Heating 2 (TTR906511), 422=Target_sub_system_node_address: Theft Protection Antenna 8 (TTR279512), 530=Target_sub_system_node_address: Valve Block 6 In Passenger Side Rear Seat (TTR909111), 428=Target_sub_system_node_address: Emblem Illumination 1 (TTR279712), 40=Target_sub_system_node_address: Right Front Massage Seat Control Module (TTR244512), 379=Target_sub_system_node_address: Electrical Performance Map Cooling Unit (TTR277412), 14=Target_sub_system_node_address: Operating And Display Unit 1 (TTR241712), 549=Target_sub_system_node_address: Secondary Air Pump (TTR911011), 278=Target_sub_system_node_address: Window Transmittance Control Unit (TTR911711), 524=Target_sub_system_node_address: Valve Block 6 In Driver Side Front Seat (TTR908511), 127=Target_sub_system_node_address: Parkassist Entry (TTR253112), 195=Target_sub_system_node_address: Seat Cushion Fan 1 Front Left (TTR259312), 152=Target_sub_system_node_address: Multimedia Operating Unit 2 (TTR255012), 221=Target_sub_system_node_address: Seat Backrest Fan 1 Rear Left (TTR261912), 204=Target_sub_system_node_address: Operating And Display Unit 4 For Air Conditioning (TTR260212), 333=Target_sub_system_node_address: Control Unit Exit Warning Rear Right (TTR272812), 46=Target_sub_system_node_address: NOx Sensor 1 (TTR245512), 106=Target_sub_system_node_address: Battery Monitoring Control Module 2 (TTR251512), 464=Target_sub_system_node_address: Application Sub Server 1 Chassis OBD (TTR282712), 341=Target_sub_system_node_address: Display Unit Compass (TTR273612), 103=Target_sub_system_node_address: Door Handle Rear Left Kessy (TTR251212), 249=Target_sub_system_node_address: Convenience And Driver Assist Operating Unit 2 (TTR264712), 186=Target_sub_system_node_address: Valve Block 2 In Driver Side Front Seat (TTR258412), 165=Target_sub_system_node_address: Front Sensor Passenger (TTR256312), 542=Target_sub_system_node_address: Sub System 2 Driver Assistance 2 (TTR910311), 314=Target_sub_system_node_address: Radio Control Center (TTR270912), 11=Target_sub_system_node_address: LED Headlamp Powermodule Right (TTR241412), 513=Target_sub_system_node_address: Door Handle Outside Actuation Passenger Side (TTR907911), 187=Target_sub_system_node_address: Valve Block 3 In Driver Side Front Seat (TTR258512), 350=Target_sub_system_node_address: Sensor 1 Wet Detection (TTR274512), 33=Target_sub_system_node_address: Steering Column Lock Actuator (TTR243612), 330=Target_sub_system_node_address: Coolant Valve 4 (TTR272512), 434=Target_sub_system_node_address: HV Battery Monitoring Control Module 2 (TTR280012), 415=Target_sub_system_node_address: Theft Protection Antenna 1 (TTR278812), 375=Target_sub_system_node_address: Sensor Flap 1 Charge Plug Connector (TTR277012), 448=Target_sub_system_node_address: Kessy Slave Trunk (TTR281112), 27=Target_sub_system_node_address: Fresh Air Blower Front (TTR243012), 343=Target_sub_system_node_address: Control Module For Auxiliary Air Heater 2 (TTR273812), 98=Target_sub_system_node_address: Compact Disc Database (TTR250712), 18=Target_sub_system_node_address: Drivers Door Control Module (TTR242112), 99=Target_sub_system_node_address: Rear Climatronic Operating And Display Unit Left (TTR250812), 181=Target_sub_system_node_address: Valve Block 1 In Passenger Side Rear Seat (TTR257912), 156=Target_sub_system_node_address: Control Module For Auxiliary Blower Motors (TTR255412), 22=Target_sub_system_node_address: Sensor For Anti Theft Alarm System (TTR242512), 77=Target_sub_system_node_address: Passengers Rear Door Control Module (TTR248612), 47=Target_sub_system_node_address: NOx Sensor 2 (TTR245612), 23=Target_sub_system_node_address: Rear Lid Control Module 2 (TTR242612), 192=Target_sub_system_node_address: Coolant Heater (TTR259012), 439=Target_sub_system_node_address: Control Module For Auxiliary Air Heater 3 (TTR280512), 493=Target_sub_system_node_address: Front Sensor Driver Center 2 (TTR907511), 200=Target_sub_system_node_address: Seat Cushion Fan 2 Front Right (TTR259812), 70=Target_sub_system_node_address: Display Unit Front For Multimedia System (TTR247912), 196=Target_sub_system_node_address: Seat Cushion Fan 2 Front Left (TTR259412), 442=Target_sub_system_node_address: Aerodynamics Control Unit 3 (TTR912611), 399=Target_sub_system_node_address: Battery Monitoring Control Module 3 (TTR278512), 288=Target_sub_system_node_address: Electrical Variable Camshaft Phasing 1 (TTR268312), 144=Target_sub_system_node_address: Trailer Weight Nose Weight Detection (TTR254212), 191=Target_sub_system_node_address: Valve Block 3 In Passenger Side Front Seat (TTR258912), 308=Target_sub_system_node_address: Side Sensor B-Pillar Passenger Front (TTR270312), 418=Target_sub_system_node_address: Theft Protection Antenna 4 (TTR279112), 488=Target_sub_system_node_address: Application Sub Server 3 Power Train OBD (TTR907011), 466=Target_sub_system_node_address: Door Actuator Rear Driver Side (TTR282912), 310=Target_sub_system_node_address: Gear Selection Display (TTR270512), 189=Target_sub_system_node_address: Valve Block 1 In Passenger Side Front Seat (TTR258712), 172=Target_sub_system_node_address: Pedestrian Protection Passenger 2 (TTR257012), 193=Target_sub_system_node_address: Seat Backrest Fan 1 Front Left (TTR259112), 205=Target_sub_system_node_address: Operating And Display Unit 5 For Air Conditioning (TTR260312), 354=Target_sub_system_node_address: Stop Watch (TTR274912), 550=Target_sub_system_node_address: Secondary Air Pump 2 (TTR911111), 115=Target_sub_system_node_address: Rear Door Control Module (TTR252412), 543=Target_sub_system_node_address: Sub System 3 Driver Assistance 2 (TTR910411), 147=Target_sub_system_node_address: Volume Control 1 (TTR254512), 325=Target_sub_system_node_address: Flap 1 Charge Plug Connector (TTR272012), 512=Target_sub_system_node_address: Door Handle Outside Actuation Driver Side (TTR907811), 324=Target_sub_system_node_address: Catalyst Heating (TTR271912), 216=Target_sub_system_node_address: Cell Module Controller 8 (TTR261412), 38=Target_sub_system_node_address: Ceiling Light Module (TTR244312), 351=Target_sub_system_node_address: Sensor 2 Wet Detection (TTR274612), 269=Target_sub_system_node_address: Electrical Charger (TTR266612), 16=Target_sub_system_node_address: Right Rear Seat Ventilation Control Module (TTR241912), 139=Target_sub_system_node_address: Trailer Articulation Angle Sensor (TTR253712), 546=Target_sub_system_node_address: Sub System 2 Driver Assistance 2 Extended (TTR910711), 328=Target_sub_system_node_address: Coolant Valve 2 (TTR272312), 293=Target_sub_system_node_address: Air Quality Sensor 2 (TTR268812), 43=Target_sub_system_node_address: Belt Pretensioner Right (TTR244712), 97=Target_sub_system_node_address: Switch Module 2 For Rear Seat Front Passenger Side (TTR250612), 176=Target_sub_system_node_address: Switch For Rear Multicontour Seat Driver Side (TTR257412), 385=Target_sub_system_node_address: Heating Reductant Tank (TTR277812), 395=Target_sub_system_node_address: Coolant Pump 3 (TTR278212), 1=Target_sub_system_node_address: Control Unit For Wiper Motor (TTR240412), 291=Target_sub_system_node_address: Wireless Operating Unit 2 (TTR268612), 68=Target_sub_system_node_address: Hands Free System (TTR247712), 452=Target_sub_system_node_address: Rear Light Right 3 (TTR281512), 142=Target_sub_system_node_address: Convenience And Driver Assist Operating Unit (TTR254012), 230=Target_sub_system_node_address: Auxiliary Blower Motor Control 2 (TTR262812), 322=Target_sub_system_node_address: Park Lock Actuator (TTR271712), 105=Target_sub_system_node_address: Power Converter DC AC (TTR251412), 242=Target_sub_system_node_address: Cell Module Controller 14 (TTR264012), 478=Target_sub_system_node_address: Sub System 2 Driver Assistance (TTR906011), 450=Target_sub_system_node_address: Kessy Slave Roof Antenna (TTR281312), 74=Target_sub_system_node_address: Interface For External Multimedia Unit (TTR248312), 151=Target_sub_system_node_address: Active Accelerator Pedal (TTR254912), 302=Target_sub_system_node_address: Control Unit Heating 4 (TTR269712), 438=Target_sub_system_node_address: Communication Car2X (TTR280412), 229=Target_sub_system_node_address: Auxiliary Blower Motor Control 1 (TTR262712), 360=Target_sub_system_node_address: Dynamic Turn Signal Front Right (TTR275512), 123=Target_sub_system_node_address: Operating Unit Center Console 2 (TTR252712), 374=Target_sub_system_node_address: Seat Allocation Detection 6 (TTR276912), 219=Target_sub_system_node_address: Cell Module Controller 11 (TTR261712), 244=Target_sub_system_node_address: Cell Module Controller 16 (TTR264212), 32=Target_sub_system_node_address: Sun Roof (TTR243512), 275=Target_sub_system_node_address: Radiator Shutter 2 (TTR267212), 134=Target_sub_system_node_address: Belt Pretensioner 3rd Row Left (TTR253212), 326=Target_sub_system_node_address: Flap 2 Charge Plug Connector (TTR272112), 397=Target_sub_system_node_address: Electrical Charger 2 (TTR912411), 224=Target_sub_system_node_address: Seat Cushion Fan 2 Rear Left (TTR262212), 270=Target_sub_system_node_address: Rear Light Left 2 (TTR266712), 388=Target_sub_system_node_address: Side Camera Front Right (TTR912011), 166=Target_sub_system_node_address: Pedestrian Protection Driver (TTR256412), 20=Target_sub_system_node_address: Left Headlamp Power Output Stage (TTR242312), 174=Target_sub_system_node_address: Refrigerant Pressure And Temperature Sender 2 (TTR257212), 245=Target_sub_system_node_address: Seat Heating Rear 1 (TTR264312), 473=Target_sub_system_node_address: Rear Light Right 6 (TTR283412), 160=Target_sub_system_node_address: Side Sensor Driver Front (TTR255812), 495=Target_sub_system_node_address: Stereo Camera Head 2 (TTR907711), 443=Target_sub_system_node_address: Aerodynamics Control Unit 4 (TTR912711), 228=Target_sub_system_node_address: Seat Cushion Fan 2 Rear Right (TTR262612), 58=Target_sub_system_node_address: Steering Angle Sender Sub (TTR246712), 482=Target_sub_system_node_address: Application Sub Server Central 2 (TTR906411), 45=Target_sub_system_node_address: Selector Lever (TTR245412), 157=Target_sub_system_node_address: Operating And Display Unit 3 (TTR255512), 387=Target_sub_system_node_address: Side Camera Front Left (TTR911911), 153=Target_sub_system_node_address: Display Unit 3 For Multimedia System (TTR255112), 266=Target_sub_system_node_address: Sunlight Sensor (TTR266312), 432=Target_sub_system_node_address: Front Sensor Driver Center (TTR279812), 55=Target_sub_system_node_address: Battery Monitoring Control Module (TTR246412), 287=Target_sub_system_node_address: Belt Pretensioner 2nd Row Right (TTR268212), 376=Target_sub_system_node_address: Sensor Flap 2 Charge Plug Connector (TTR277112), 465=Target_sub_system_node_address: Application Sub Server 2 Chassis OBD (TTR282812), 309=Target_sub_system_node_address: Multi Function Steering Wheel Control Module 2 (TTR270412), 227=Target_sub_system_node_address: Seat Cushion Fan 1 Rear Right (TTR262512), 141=Target_sub_system_node_address: Range Of Vision Sensing (TTR253912), 54=Target_sub_system_node_address: Display Unit 1 For Multimedia System (TTR246312), 202=Target_sub_system_node_address: Operating And Display Unit 2 For Air Conditioning (TTR260012), 329=Target_sub_system_node_address: Coolant Valve 3 (TTR272412), 533=Target_sub_system_node_address: Camera Head Dash Cam (TTR909411), 155=Target_sub_system_node_address: Display Unit 5 For Multimedia System (TTR255312), 113=Target_sub_system_node_address: Rear Brake Actuator 2 (TTR252212), 345=Target_sub_system_node_address: Cooler Fan 4 (TTR274012), 107=Target_sub_system_node_address: Matrix Headlamp Powermodule 1 Left (TTR251612), 75=Target_sub_system_node_address: Relative Air Humidity Interior Sender (TTR248412), 517=Target_sub_system_node_address: Axle Disengagement (TTR908211), 492=Target_sub_system_node_address: Stereo Camera Head 1 (TTR907411), 339=Target_sub_system_node_address: Coolant Valve 7 (TTR273412), 528=Target_sub_system_node_address: Valve Block 6 In Driver Side Rear Seat (TTR908911), 262=Target_sub_system_node_address: Refrigerant Shut Off Valve 2 (TTR265912), 82=Target_sub_system_node_address: Roof Blind 2 (TTR249112), 386=Target_sub_system_node_address: Sensor 2 Fine Dust Concentration (TTR277912), 8=Target_sub_system_node_address: Right Front Seat Ventilation Control Module (TTR241112), 252=Target_sub_system_node_address: Valve Block 4 In Driver Side Rear Seat (TTR265012), 297=Target_sub_system_node_address: Interior Monitoring Rear (TTR269212), 267=Target_sub_system_node_address: Near Field Communication Control Module 2 (TTR266412), 283=Target_sub_system_node_address: Special Vehicle Assist Interface (TTR267812), 175=Target_sub_system_node_address: Refrigerant Pressure And Temperature Sender 3 (TTR257312), 240=Target_sub_system_node_address: Air Coolant Actuator 2 (TTR263812), 138=Target_sub_system_node_address: Brake Assistance Sub (TTR253612), 296=Target_sub_system_node_address: Near Field Communication Control Module 3 (TTR269112), 35=Target_sub_system_node_address: Tire Pressure Monitor Antenna (TTR243812), 356=Target_sub_system_node_address: Picnic Table Rear Passenger Side (TTR275112), 239=Target_sub_system_node_address: Air Coolant Actuator 1 (TTR263712), 462=Target_sub_system_node_address: Application Sub Server 3 Chassis (TTR282512), 12=Target_sub_system_node_address: LED Headlamp Powermodule 2 Left (TTR241512), 78=Target_sub_system_node_address: Sensor Controlled Power Rear Lid (TTR248712), 359=Target_sub_system_node_address: Dynamic Turn Signal Front Left (TTR275412), 470=Target_sub_system_node_address: Driver Monitoring Camera Sensor 1 (TTR283112), 59=Target_sub_system_node_address: Lane Change Assistant 2 (TTR246812), 534=Target_sub_system_node_address: Radar Sensor Front Center (TTR909511), 491=Target_sub_system_node_address: Ioniser 2 (TTR907311), 102=Target_sub_system_node_address: Door Handle Front Right Kessy (TTR251112), 525=Target_sub_system_node_address: Valve Block 5 In Passenger Side Front Seat (TTR908611), 225=Target_sub_system_node_address: Seat Backrest Fan 1 Rear Right (TTR262312), 305=Target_sub_system_node_address: Side Sensor A-Pillar Passenger Front (TTR270012), 34=Target_sub_system_node_address: Anti Theft Tilt System Control Unit (TTR243712), 377=Target_sub_system_node_address: Switch Charge Indicator Flap 1 Charge Plug Connector (TTR277212), 246=Target_sub_system_node_address: LED Warning Indicator (TTR264412), 211=Target_sub_system_node_address: Cell Module Controller 3 (TTR260912), 299=Target_sub_system_node_address: Control Unit Heating 1 (TTR269412), 162=Target_sub_system_node_address: Side Sensor Driver Rear (TTR256012), 39=Target_sub_system_node_address: Left Front Massage Seat Control Module (TTR244412), 536=Target_sub_system_node_address: Radar Sensor Rear Right (TTR909711), 3=Target_sub_system_node_address: Light Switch (TTR240612), 321=Target_sub_system_node_address: Card Reader TV Tuner (TTR271612), 79=Target_sub_system_node_address: Camera For Night Vision System (TTR248812), 83=Target_sub_system_node_address: Motor For Wind Deflector (TTR249212), 26=Target_sub_system_node_address: Remote Control Auxiliary Heater (TTR242912), 394=Target_sub_system_node_address: Coolant Pump 2 (TTR278112), 150=Target_sub_system_node_address: Operating And Display Unit 6 For Air Conditioning (TTR254812), 365=Target_sub_system_node_address: Area View Camera Slave Rear (TTR276012), 334=Target_sub_system_node_address: Control Unit Exit Warning Rear Left (TTR272912), 358=Target_sub_system_node_address: Refrigerant Expansion Valve 5 (TTR275312), 370=Target_sub_system_node_address: Seat Allocation Detection 2 (TTR276512), 238=Target_sub_system_node_address: Refrigerant Pressure And Temperature Sender 6 (TTR263612), 286=Target_sub_system_node_address: Belt Pretensioner 2nd Row Left (TTR268112), 21=Target_sub_system_node_address: Right Headlamp Power Output Stage (TTR242412), 148=Target_sub_system_node_address: Belt Buckle Presenter 2nd Row Left (TTR254612), 398=Target_sub_system_node_address: Android Control Unit (TTR278412), 66=Target_sub_system_node_address: Chip Card Reader Control Module (TTR247512), 346=Target_sub_system_node_address: Sensor High Voltage System 2 (TTR274112), 277=Target_sub_system_node_address: Radiator Shutter 4 (TTR267412), 80=Target_sub_system_node_address: Relative Humidity Sensor In Fresh Air Intake Duct (TTR248912), 250=Target_sub_system_node_address: Hydrogen Pump (TTR264812), 87=Target_sub_system_node_address: Switch Module For Rear Seat Driver Side (TTR249612), 253=Target_sub_system_node_address: Valve Block 4 In Passenger Side Rear Seat (TTR265112), 526=Target_sub_system_node_address: Valve Block 6 In Passenger Side Front Seat (TTR908711), 259=Target_sub_system_node_address: Refrigerant Expansion Valve 2 (TTR265612), 140=Target_sub_system_node_address: Cup Holder With Heater And Cooling Element (TTR253812), 353=Target_sub_system_node_address: Gauge Outside Air Temperature (TTR274812), 323=Target_sub_system_node_address: Media Connector (TTR271812), 312=Target_sub_system_node_address: Gear Selector Control Module (TTR270712), 304=Target_sub_system_node_address: Side Sensor A-Pillar Driver Front (TTR269912), 273=Target_sub_system_node_address: Sunlight Sensor 2 (TTR267012), 487=Target_sub_system_node_address: Application Sub Server 3 Chassis OBD (TTR906911), 371=Target_sub_system_node_address: Seat Allocation Detection 3 (TTR276612), 210=Target_sub_system_node_address: Cell Module Controller 2 (TTR260812), 90=Target_sub_system_node_address: Battery Charger Unit 1 (TTR249912), 124=Target_sub_system_node_address: Operating Unit Center Console 3 (TTR252812), 298=Target_sub_system_node_address: Cooler Fan 1 (TTR269312), 234=Target_sub_system_node_address: Media Player 2 Sub (TTR263212), 199=Target_sub_system_node_address: Seat Cushion Fan 1 Front Right (TTR259712), 453=Target_sub_system_node_address: Rear Light Left 4 (TTR281612), 226=Target_sub_system_node_address: Seat Backrest Fan 2 Rear Right (TTR262412), 264=Target_sub_system_node_address: Refrigerant Shut Off Valve 4 (TTR266112), 319=Target_sub_system_node_address: Front Climatronic Operating And Display Unit (TTR271412), 451=Target_sub_system_node_address: Rear Light Left 3 (TTR281412), 306=Target_sub_system_node_address: Sensor High Voltage System 1 (TTR270112), 494=Target_sub_system_node_address: Front Camera 3 (TTR907611), 248=Target_sub_system_node_address: Manual Transmission Fluid Pump (TTR264612), 30=Target_sub_system_node_address: Interior Light Module (TTR243312), 81=Target_sub_system_node_address: Rear Spoiler Adjustment (TTR249012), 201=Target_sub_system_node_address: Operating And Display Unit 1 For Air Conditioning (TTR259912), 76=Target_sub_system_node_address: Drivers Door Rear Control Module (TTR248512), 474=Target_sub_system_node_address: Hydrogen Sensor 1 (TTR283512), 344=Target_sub_system_node_address: Interior Temperature Sensor (TTR273912), 307=Target_sub_system_node_address: Side Sensor B-Pillar Driver Front (TTR270212), 364=Target_sub_system_node_address: Area View Camera Slave Right (TTR275912), 63=Target_sub_system_node_address: Air Quality Sensor (TTR247212), 178=Target_sub_system_node_address: Valve Block 2 In Driver Side Rear Seat (TTR257612), 538=Target_sub_system_node_address: Sub System 2 Driver Assistance Extended (TTR909911), 535=Target_sub_system_node_address: Radar Sensor Rear Left (TTR909611), 449=Target_sub_system_node_address: Kessy Slave Inside (TTR281212), 303=Target_sub_system_node_address: Operating Unit Drive Mode Selection (TTR269812), 335=Target_sub_system_node_address: Display Lane Change Assistent Right (TTR273012), 463=Target_sub_system_node_address: Application Sub Server 4 Chassis (TTR282612), 179=Target_sub_system_node_address: Valve Block 3 In Driver Side Rear Seat (TTR257712), 198=Target_sub_system_node_address: Seat Backrest Fan 2 Front Right (TTR259612), 2=Target_sub_system_node_address: Rain Light Recognition Sensor (TTR240512), 121=Target_sub_system_node_address: Data Medium 2 (TTR252512), 96=Target_sub_system_node_address: Switch Module 2 For Front Passenger Seat (TTR250512), 255=Target_sub_system_node_address: Valve Block 4 In Passenger Side Front Seat (TTR265312), 337=Target_sub_system_node_address: Coolant Valve 5 (TTR273212), 475=Target_sub_system_node_address: Hydrogen Sensor 2 (TTR905711), 125=Target_sub_system_node_address: Operating Unit Center Console 4 (TTR252912), 65=Target_sub_system_node_address: Telephone Handset 2 (TTR247412), 477=Target_sub_system_node_address: Hydrogen Sensor 4 (TTR905911), 468=Target_sub_system_node_address: Digital Sound System Control Module 3 (TTR912811), 317=Target_sub_system_node_address: Control Unit Ride Control System (TTR271212), 373=Target_sub_system_node_address: Seat Allocation Detection 5 (TTR276812), 454=Target_sub_system_node_address: Rear Light Right 4 (TTR281712), 84=Target_sub_system_node_address: Voltage Stabilizer (TTR249312), 455=Target_sub_system_node_address: Rear Light Left 5 (TTR281812), 71=Target_sub_system_node_address: Multimedia Operating Unit (TTR248012), 112=Target_sub_system_node_address: Rear Brake Actuator 1 (TTR252112), 541=Target_sub_system_node_address: Sub System Driver Assistance 2 (TTR910211), 60=Target_sub_system_node_address: Pitch Rate Sender (TTR246912), 213=Target_sub_system_node_address: Cell Module Controller 5 (TTR261112), 9=Target_sub_system_node_address: Left Rear Seat Ventilation Control Module (TTR241212), 220=Target_sub_system_node_address: Cell Module Controller 12 (TTR261812), 161=Target_sub_system_node_address: Side Sensor Passenger Front (TTR255912), 260=Target_sub_system_node_address: Refrigerant Expansion Valve 3 (TTR265712), 352=Target_sub_system_node_address: Button Seat Heating Rear (TTR274712), 361=Target_sub_system_node_address: Ignition Key 3 (TTR275612), 72=Target_sub_system_node_address: Digital Sound System Control Module 2 (TTR248112), 416=Target_sub_system_node_address: Theft Protection Antenna 2 (TTR278912), 88=Target_sub_system_node_address: Switch Module For Rear Seat Front Passenger Side (TTR249712), 540=Target_sub_system_node_address: Sub System 4 Driver Assistance Extended (TTR910111), 104=Target_sub_system_node_address: Door Handle Rear Right Kessy (TTR251312), 86=Target_sub_system_node_address: Switch Module For Front Passenger Seat (TTR249512), 349=Target_sub_system_node_address: Remote Control Remote Start (TTR274412), 363=Target_sub_system_node_address: Area View Camera Slave Left (TTR275812), 95=Target_sub_system_node_address: Neck Heating Right (TTR250412), 272=Target_sub_system_node_address: Rear Light Right 2 (TTR266912), 279=Target_sub_system_node_address: Sub System Driver Assistance (TTR911811), 338=Target_sub_system_node_address: Coolant Valve 6 (TTR273312), 36=Target_sub_system_node_address: Heated Windshield Control Module (TTR244012), 515=Target_sub_system_node_address: Door Handle Outside Actuation Rear Passenger Side (TTR908111), 168=Target_sub_system_node_address: Rear Sensor Center (TTR256612), 316=Target_sub_system_node_address: Control Unit E-Traction (TTR271112), 64=Target_sub_system_node_address: Display Unit 2 For Multimedia System (TTR247312), 237=Target_sub_system_node_address: Refrigerant Pressure And Temperature Sender 5 (TTR263512), 62=Target_sub_system_node_address: Electronic Ignition Lock (TTR247112), 5=Target_sub_system_node_address: Garage Door Opener Operating Unit (TTR240812), 235=Target_sub_system_node_address: Dedicated Short Range Communication Aerial (TTR263312), 42=Target_sub_system_node_address: Belt Pretensioner Left (TTR244612), 109=Target_sub_system_node_address: High Beam Powermodule Left (TTR251812), 445=Target_sub_system_node_address: Kessy Slave Front Right (TTR280812), 41=Target_sub_system_node_address: Control Module For Auxiliary Air Heater (TTR244812), 382=Target_sub_system_node_address: Display Vehicle Log (TTR277512), 284=Target_sub_system_node_address: Electric System Disconnection Diode (TTR267912), 52=Target_sub_system_node_address: Left Rear Massage Seat Control Module (TTR246112), 457=Target_sub_system_node_address: Application Sub Server 1 Power Train OBD (TTR282012), 436=Target_sub_system_node_address: Oil Pump Coolant Axle 2 (TTR280212), 135=Target_sub_system_node_address: Belt Pretensioner 3rd Row Right (TTR253312), 190=Target_sub_system_node_address: Valve Block 2 In Passenger Side Front Seat (TTR258812), 51=Target_sub_system_node_address: Right Rear Door Control Module (TTR246012), 281=Target_sub_system_node_address: Radio Interface (TTR267612), 421=Target_sub_system_node_address: Theft Protection Antenna 7 (TTR279412), 183=Target_sub_system_node_address: Valve Block 3 In Passenger Side Rear Seat (TTR258112), 456=Target_sub_system_node_address: Rear Light Right 5 (TTR281912), 143=Target_sub_system_node_address: Cradle Rear Climatronic Operating And Display Unit (TTR254112), 25=Target_sub_system_node_address: Automatic Day Night Interior Mirror (TTR242812), 417=Target_sub_system_node_address: Theft Protection Antenna 3 (TTR279012), 458=Target_sub_system_node_address: Application Sub Server 2 Power Train OBD (TTR282112), 315=Target_sub_system_node_address: Multimedia Extension (TTR271012), 73=Target_sub_system_node_address: Electrically Adjustable Steering Column (TTR248212), 340=Target_sub_system_node_address: Coolant Valve 8 (TTR273512), 396=Target_sub_system_node_address: Coolant Pump 4 (TTR278312), 91=Target_sub_system_node_address: Battery Charger Unit 2 (TTR250012), 145=Target_sub_system_node_address: Sensor Carbon Dioxide Concentration (TTR254312), 7=Target_sub_system_node_address: Left Front Seat Ventilation Control Module (TTR241012), 289=Target_sub_system_node_address: Electrical Variable Camshaft Phasing 2 (TTR268412), 167=Target_sub_system_node_address: Pedestrian Protection Passenger (TTR256512), 471=Target_sub_system_node_address: Pressure Sensor Filter Saturation (TTR283212), 110=Target_sub_system_node_address: High Beam Powermodule Right (TTR251912), 447=Target_sub_system_node_address: Kessy Slave Rear Right (TTR281012), 50=Target_sub_system_node_address: Left Rear Door Control Module (TTR245912), 137=Target_sub_system_node_address: Steering Column Switch (TTR253512), 257=Target_sub_system_node_address: Rear Climatronic Operating And Display Unit (TTR265412), 206=Target_sub_system_node_address: Pedestrian Protection Left Hand Side (TTR260412), 111=Target_sub_system_node_address: Air Suspension Compressor (TTR252012), 400=Target_sub_system_node_address: Virtual Pedal Door Opening Rear Driver Side (TTR278612), 158=Target_sub_system_node_address: Operating And Display Unit 4 (TTR255612), 214=Target_sub_system_node_address: Cell Module Controller 6 (TTR261212), 484=Target_sub_system_node_address: Sub System 4 Driver Assistance (TTR906611), 194=Target_sub_system_node_address: Seat Backrest Fan 2 Front Left (TTR259212), 551=Target_sub_system_node_address: Signal Light Front Left (TTR911211), 208=Target_sub_system_node_address: Battery Junction Box (TTR260612), 67=Target_sub_system_node_address: Traffic Data Aerial (TTR247612), 514=Target_sub_system_node_address: Door Handle Outside Actuation Rear Driver Side (TTR908011), 180=Target_sub_system_node_address: Switch For Rear Multicontour Seat Passenger Side (TTR257812), 529=Target_sub_system_node_address: Valve Block 5 In Passenger Side Rear Seat (TTR909011), 444=Target_sub_system_node_address: Kessy Slave Front Left (TTR280712), 384=Target_sub_system_node_address: Air Conditioning Compressor Sub 2 (TTR277712), 271=Target_sub_system_node_address: Rear Light Right 1 (TTR266812), 368=Target_sub_system_node_address: Mascot Motor (TTR276312), 331=Target_sub_system_node_address: Control Unit Exit Warning Front Right (TTR272612), 231=Target_sub_system_node_address: Infrared Sender For Front Observation Module (TTR262912), 348=Target_sub_system_node_address: Ventilation Pump (TTR274312), 177=Target_sub_system_node_address: Valve Block 1 In Driver Side Rear Seat (TTR257512), 459=Target_sub_system_node_address: Application Sub Server 1 Power Train (TTR282212), 420=Target_sub_system_node_address: Theft Protection Antenna 6 (TTR279312), 218=Target_sub_system_node_address: Cell Module Controller 10 (TTR261612), 544=Target_sub_system_node_address: Sub System 4 Driver Assistance 2 (TTR910511), 217=Target_sub_system_node_address: Cell Module Controller 9 (TTR261512), 19=Target_sub_system_node_address: Front Passengers Door Control Module (TTR242212), 369=Target_sub_system_node_address: Seat Allocation Detection 1 (TTR276412), 108=Target_sub_system_node_address: Matrix Headlamp Powermodule 1 Right (TTR251712), 163=Target_sub_system_node_address: Side Sensor Passenger Rear (TTR256112), 347=Target_sub_system_node_address: Door Control Panel Driver Side (TTR274212), 282=Target_sub_system_node_address: Video Self Protection Recorder (TTR267712), 441=Target_sub_system_node_address: Aerodynamics Control Unit 2 (TTR912511), 94=Target_sub_system_node_address: Neck Heating Left (TTR250312), 188=Target_sub_system_node_address: Switch For Front Multicontour Seat Passenger Side (TTR258612), 173=Target_sub_system_node_address: Central Sensor XY (TTR257112), 531=Target_sub_system_node_address: AC/DC Charger (TTR909211), 122=Target_sub_system_node_address: Operating Unit Center Console 1 (TTR252612), 261=Target_sub_system_node_address: Refrigerant Shut Off Valve 1 (TTR265812), 69=Target_sub_system_node_address: Telephone Handset (TTR247812), 207=Target_sub_system_node_address: Pedestrian Protection Right Hand Side (TTR260512), 292=Target_sub_system_node_address: Front Windshield Washer Pump (TTR268712), 480=Target_sub_system_node_address: Application Sub Server Central RxSWIN (TTR906211), 301=Target_sub_system_node_address: Control Unit Heating 3 (TTR269612), 56=Target_sub_system_node_address: Roof Blind (TTR246512), 285=Target_sub_system_node_address: Cradle Rear Climatronic Operating And Display Unit 2 (TTR268012), 215=Target_sub_system_node_address: Cell Module Controller 7 (TTR261312), 263=Target_sub_system_node_address: Refrigerant Shut Off Valve 3 (TTR266012), 31=Target_sub_system_node_address: Refrigerant Pressure And Temperature Sender (TTR243412), 435=Target_sub_system_node_address: Oil Pump Coolant Axle 1 (TTR280112), 4=Target_sub_system_node_address: Garage Door Opener Control Module (TTR240712), 532=Target_sub_system_node_address: Photovoltaic Regulator (TTR909311), 390=Target_sub_system_node_address: Side Camera Rear Right (TTR912211), 383=Target_sub_system_node_address: Active Oil Separator (TTR277612), 367=Target_sub_system_node_address: Gauge Oil Temperature (TTR276212), 53=Target_sub_system_node_address: Right Rear Massage Seat Control Module (TTR246212), 460=Target_sub_system_node_address: Application Sub Server 1 Chassis (TTR282312), 243=Target_sub_system_node_address: Cell Module Controller 15 (TTR264112), 274=Target_sub_system_node_address: Radiator Shutter (TTR267112), 490=Target_sub_system_node_address: Ignition System Box 2 (TTR907211), 6=Target_sub_system_node_address: Ignition Key (TTR240912), 327=Target_sub_system_node_address: Coolant Valve 1 (TTR272212), 486=Target_sub_system_node_address: Application Sub Server Central 4 (TTR906811), 233=Target_sub_system_node_address: Media Player 1 Sub (TTR263112), 0=Target_sub_system_node_address: reserved (TTR240312), 197=Target_sub_system_node_address: Seat Backrest Fan 1 Front Right (TTR259512), 366=Target_sub_system_node_address: Control Unit 2 For Wiper Motor (TTR276112), 37=Target_sub_system_node_address: Rear Light Left 1 (TTR244212), 89=Target_sub_system_node_address: Switch Module 2 For Driver Seat (TTR249812), 320=Target_sub_system_node_address: Auxiliary Display Unit (TTR271512), 29=Target_sub_system_node_address: Alternator (TTR243212), 552=Target_sub_system_node_address: Signal Light Front Right (TTR911311), 440=Target_sub_system_node_address: Sensor 1 Cell Voltage (TTR280612), 472=Target_sub_system_node_address: Rear Light Left 6 (TTR283312), 203=Target_sub_system_node_address: Operating And Display Unit 3 For Air Conditioning (TTR260112), 318=Target_sub_system_node_address: Control Unit Hands On Detection Steering Wheel (TTR271312), 92=Target_sub_system_node_address: Battery Charger Unit 3 (TTR250112), 149=Target_sub_system_node_address: Belt Buckle Presenter 2nd Row Right (TTR254712), 48=Target_sub_system_node_address: Ioniser (TTR245712), 280=Target_sub_system_node_address: Special Key Operating Unit (TTR267512), 254=Target_sub_system_node_address: Valve Block 4 In Driver Side Front Seat (TTR265212), 427=Target_sub_system_node_address: Gear Shift Operating Unit (TTR279612), 523=Target_sub_system_node_address: Valve Block 5 In Driver Side Front Seat (TTR908411), 24=Target_sub_system_node_address: Alarm Horn (TTR242712), 44=Target_sub_system_node_address: Occupant Detection (TTR245312), 357=Target_sub_system_node_address: Refrigerant Expansion Valve 4 (TTR275212), 362=Target_sub_system_node_address: Area View Camera Slave Front (TTR275712), 414=Target_sub_system_node_address: Virtual Pedal Door Opening Rear Passenger Side (TTR278712), 223=Target_sub_system_node_address: Seat Cushion Fan 1 Rear Left (TTR262112), 182=Target_sub_system_node_address: Valve Block 2 In Passenger Side Rear Seat (TTR258012), 251=Target_sub_system_node_address: Air Coolant Actuator 3 (TTR264912), 159=Target_sub_system_node_address: Operating And Display Unit 5 (TTR255712), 185=Target_sub_system_node_address: Valve Block 1 In Driver Side Front Seat (TTR258312), 437=Target_sub_system_node_address: Telephone Unit (TTR280312), 547=Target_sub_system_node_address: Sub System 3 Driver Assistance 2 Extended (TTR910811), 332=Target_sub_system_node_address: Control Unit Exit Warning Front Left (TTR272712), 391=Target_sub_system_node_address: Rear Camera (TTR912311), 355=Target_sub_system_node_address: Picnic Table Rear Driver Side (TTR275012), 485=Target_sub_system_node_address: Application Sub Server Central 3 (TTR906711), 170=Target_sub_system_node_address: Pedestrian Protection Contact (TTR256812), 247=Target_sub_system_node_address: Automatic Transmission Fluid Pump (TTR264512), 61=Target_sub_system_node_address: ESP Sensor Unit (TTR247012), 378=Target_sub_system_node_address: Switch Charge Indicator Flap 2 Charge Plug Connector (TTR277312), 100=Target_sub_system_node_address: Rear Climatronic Operating And Display Unit Right (TTR250912), 419=Target_sub_system_node_address: Theft Protection Antenna 5 (TTR279212), 164=Target_sub_system_node_address: Front Sensor Driver (TTR256212), 527=Target_sub_system_node_address: Valve Block 5 In Driver Side Rear Seat (TTR908811), 336=Target_sub_system_node_address: Display Lane Change Assistent Left (TTR273112), 15=Target_sub_system_node_address: Operating And Display Unit 2 (TTR241812), 265=Target_sub_system_node_address: Refrigerant Shut Off Valve 5 (TTR266212), 136=Target_sub_system_node_address: Injection Valve Heater Control Unit (TTR253412), 13=Target_sub_system_node_address: LED Headlamp Powermodule 2 Right (TTR241612), 222=Target_sub_system_node_address: Seat Backrest Fan 2 Rear Left (TTR262012), 49=Target_sub_system_node_address: Multi Function Steering Wheel Control Module (TTR245812), 154=Target_sub_system_node_address: Display Unit 4 For Multimedia System (TTR255212), 479=Target_sub_system_node_address: Sub System 3 Driver Assistance (TTR906111), 389=Target_sub_system_node_address: Side Camera Rear Left (TTR912111), 184=Target_sub_system_node_address: Switch For Front Multicontour Seat Driver Side (TTR258212), 467=Target_sub_system_node_address: Door Actuator Rear Passenger Side (TTR283012), 85=Target_sub_system_node_address: Switch Module For Driver Seat (TTR249412), 57=Target_sub_system_node_address: Sun Roof 2 (TTR246612), 209=Target_sub_system_node_address: Cell Module Controller 1 (TTR260712), 446=Target_sub_system_node_address: Kessy Slave Rear Left (TTR280912), 146=Target_sub_system_node_address: Sensor Fine Dust Concentration (TTR254412), 433=Target_sub_system_node_address: HV Battery Monitoring Control Module 1 (TTR279912), 300=Target_sub_system_node_address: Control Unit Heating 2 (TTR269512), 537=Target_sub_system_node_address: Sub System Driver Assistance Extended (TTR909811), 461=Target_sub_system_node_address: Application Sub Server 2 Chassis (TTR282412), 93=Target_sub_system_node_address: Air Conditioning Compressor Sub (TTR250212), 212=Target_sub_system_node_address: Cell Module Controller 4 (TTR261012), 290=Target_sub_system_node_address: Wireless Operating Unit 1 (TTR268512), 126=Target_sub_system_node_address: Interface For Radiodisplay (TTR253012), 241=Target_sub_system_node_address: Cell Module Controller 13 (TTR263912), 520=Target_sub_system_node_address: Emblem Illumination 2 (TTR908311), 276=Target_sub_system_node_address: Radiator Shutter 3 (TTR267312), 101=Target_sub_system_node_address: Door Handle Front Left Kessy (TTR251012), 548=Target_sub_system_node_address: Sub System 4 Driver Assistance 2 Extended (TTR910911), 258=Target_sub_system_node_address: Refrigerant Expansion Valve 1 (TTR265512), 539=Target_sub_system_node_address: Sub System 3 Driver Assistance Extended (TTR910011), 476=Target_sub_system_node_address: Hydrogen Sensor 3 (TTR905811), 294=Target_sub_system_node_address: Fragrancing System (TTR268912), 268=Target_sub_system_node_address: Clutch Control Unit Sub (TTR266512), 171=Target_sub_system_node_address: Pedestrian Protection Driver 2 (TTR256912), 489=Target_sub_system_node_address: Ignition System Box 1 (TTR907111), 311=Target_sub_system_node_address: Cooler Fan 2 (TTR270612), 114=Target_sub_system_node_address: Analog Clock (TTR252312), 313=Target_sub_system_node_address: Interior Light Module 2 (TTR270812), 10=Target_sub_system_node_address: LED Headlamp Powermodule Left (TTR241312), 372=Target_sub_system_node_address: Seat Allocation Detection 4 (TTR276712), 481=Target_sub_system_node_address: Sub System Digital Matrix Light (TTR906311), 393=Target_sub_system_node_address: Coolant Pump 1 (TTR278012)}  # Parameters: Target_sub_system_node_address
    diagnostic-parameter bit-offset=16:
      diagnostic data element CalibrationData_0x0251_Write_generic_to_sub_system_Target_data_identifier: base-type=uint16, compu {592=Target_data_identifier: Integrity_validation_data_configuration_list (TTR283713)}  # Parameters: Target_data_identifier
    diagnostic-parameter bit-offset=32:
      diagnostic data element CalibrationData_0x0251_Write_generic_to_sub_system_Data_record_target_data_identifier: array-size-semantics=VARIABLE-SIZE, max-number-of-elements=10, base-type=uint8  # Parameters: Data_record_target_data_identifier
  diagnostic write data by identifier WriteWriteGenericToSubSystem: access-permission=WRITEE2eSFDMode0x03ExtendedSession, data-identifier=WriteGenericToSubSystem, write-class=DiagnosticWriteDataByIdentifierClass  # Write_Write_generic_to_sub_system
package /ZeC/DataIdentifiers/CalibrationData/Productionmode_dev
  diagnostic data identifier ProductionmodeDev: id=0xc108, represents-vin=false  # Productionmode_dev
    diagnostic-parameter bit-offset=0:
      diagnostic data element CalibrationData_0xc108_Productionmode_dev_State: base-type=uint8, compu {0=State: Productionmode_for_development_use_not_active (TTR901111), 1=State: Productionmode_for_development_use_active (TTR901011)}  # Parameters: State
  diagnostic read data by identifier ReadProductionmodeDev: access-permission=READ0x01DefaultSession0x03ExtendedSession, data-identifier=ProductionmodeDev, read-class=DiagnosticReadDataByIdentifierClass  # Read_Productionmode_dev
  diagnostic write data by identifier WriteProductionmodeDev: access-permission=WRITEExtendedSFDRole0x03ExtendedSession, data-identifier=ProductionmodeDev, write-class=DiagnosticWriteDataByIdentifierClass  # Write_Productionmode_dev
package /ZeC/DataIdentifiers/CalibrationData/Integrity_validation_data_configuration_list
  diagnostic data identifier IntegrityValidationDataConfigurationList: id=0x0250, represents-vin=false  # Integrity_validation_data_configuration_list
    diagnostic-parameter bit-offset=0:
      diagnostic data element CalibrationData_0x0250_Integrity_validation_data_configuration_list_Number_of_identifiers: base-type=uint16  # Parameters: Number_of_identifiers
    diagnostic-parameter bit-offset=0:
      diagnostic data element CalibrationData_0x0250_Integrity_validation_data_configuration_list_Identifier: array-size-semantics=VARIABLE-SIZE, max-number-of-elements=710, base-type=uint8  # Parameters: Identifier
  diagnostic read data by identifier ReadIntegrityValidationDataConfigurationList: access-permission=READ0x01DefaultSession0x03ExtendedSession, data-identifier=IntegrityValidationDataConfigurationList, read-class=DiagnosticReadDataByIdentifierClass  # Read_Integrity_validation_data_configuration_list
  diagnostic write data by identifier WriteIntegrityValidationDataConfigurationList: access-permission=WRITEE2eSFDMode0x03ExtendedSession, data-identifier=IntegrityValidationDataConfigurationList, write-class=DiagnosticWriteDataByIdentifierClass  # Write_Integrity_validation_data_configuration_list
package /ZeC/DataIdentifiers/CalibrationData/Sec_switch_port_mirroring
  diagnostic data identifier SecSwitchPortMirroring: id=0x090a, represents-vin=false  # Sec_switch_port_mirroring
    diagnostic-parameter bit-offset=0:
      diagnostic data element CalibrationData_0x090a_Sec_switch_port_mirroring_Sec_switch_port_mirroring: base-type=uint16  # Parameters: Sec_switch_port_mirroring
  diagnostic read data by identifier ReadSecSwitchPortMirroring: access-permission=READBasicSFDRole0x03ExtendedSession, data-identifier=SecSwitchPortMirroring, read-class=DiagnosticReadDataByIdentifierClass  # Read_Sec_switch_port_mirroring
  diagnostic write data by identifier WriteSecSwitchPortMirroring: access-permission=WRITEBasicSFDRole0x03ExtendedSession, data-identifier=SecSwitchPortMirroring, write-class=DiagnosticWriteDataByIdentifierClass  # Write_Sec_switch_port_mirroring
package /ZeC/DataIdentifiers/CalibrationData/ECU_standalone_mode_2
  diagnostic data identifier ECUStandaloneMode2: id=0xc111, represents-vin=false  # ECU_standalone_mode_2
    diagnostic-parameter bit-offset=0:
      diagnostic data element CalibrationData_0xc111_ECU_standalone_mode_2_ECU_standalone_mode_2: base-type=uint32  # Parameters: ECU_standalone_mode_2
  diagnostic read data by identifier ReadECUStandaloneMode2: access-permission=READ0x01DefaultSession0x02ProgrammingSession0x03ExtendedSession, data-identifier=ECUStandaloneMode2, read-class=DiagnosticReadDataByIdentifierClass  # Read_ECU_standalone_mode_2
  diagnostic write data by identifier WriteECUStandaloneMode2: access-permission=WRITEBasicSFDRole0x03ExtendedSession, data-identifier=ECUStandaloneMode2, write-class=DiagnosticWriteDataByIdentifierClass  # Write_ECU_standalone_mode_2
package /ZeC/DataIdentifiers/CalibrationData/ECU_standalone_mode_1
  diagnostic data identifier ECUStandaloneMode1: id=0xc110, represents-vin=false  # ECU_standalone_mode_1
    diagnostic-parameter bit-offset=0:
      diagnostic data element CalibrationData_0xc110_ECU_standalone_mode_1_ECU_standalone_mode_1: base-type=uint32  # Parameters: ECU_standalone_mode_1
  diagnostic read data by identifier ReadECUStandaloneMode1: access-permission=READ0x01DefaultSession0x02ProgrammingSession0x03ExtendedSession, data-identifier=ECUStandaloneMode1, read-class=DiagnosticReadDataByIdentifierClass  # Read_ECU_standalone_mode_1
  diagnostic write data by identifier WriteECUStandaloneMode1: access-permission=WRITEBasicSFDRole0x03ExtendedSession, data-identifier=ECUStandaloneMode1, write-class=DiagnosticWriteDataByIdentifierClass  # Write_ECU_standalone_mode_1
package /ZeC/DataIdentifiers/CalibrationData/Slaves_Activation
  diagnostic data identifier SlavesActivation: id=0x77e0, represents-vin=false  # Slaves Activation
    diagnostic-parameter bit-offset=0:
      diagnostic data element CalibrationData_0x77e0_Slaves_Activation_LIN_Slaves_1_Activation_LIN_Slaves_2_Activation_LIN_Slaves_3_Activation7386B97: array-size-semantics=VARIABLE-SIZE, max-number-of-elements=46, base-type=uint8  # Parameters: LIN Slaves 1 Activation / LIN Slaves 2 Activation / LIN Slaves 3 Activation / LIN Slaves 4 Activation / LIN Slaves 5 Activation / LIN Slaves 6 Activation / LIN Slaves 7 Activation / LIN Slaves 8 Activation / LIN Slaves 9 Activation / LIN Slaves 10 Activation / LIN Slaves 11 Activation / LIN Slaves 12 Activation / LIN Slaves 13 Activation / LIN Slaves 14 Activation / LIN Slaves 15 Activation / Reserved
  diagnostic read data by identifier ReadSlavesActivation: access-permission=READ0x01DefaultSession0x03ExtendedSession, data-identifier=SlavesActivation, read-class=DiagnosticReadDataByIdentifierClass  # Read_Slaves Activation
  diagnostic write data by identifier WriteSlavesActivation: access-permission=WRITE0x03ExtendedSession, data-identifier=SlavesActivation, write-class=DiagnosticWriteDataByIdentifierClass  # Write_Slaves Activation
package /ZeC/DataIdentifiers/CalibrationData/dim_curve_58xt
  diagnostic data identifier DimCurve58xt: id=0x7b02, represents-vin=false  # dim_curve_58xt
    diagnostic-parameter bit-offset=0:
      diagnostic data element CalibrationData_0x7b02_dim_curve_58xt_x1: base-type=uint16  # Parameters: x1
    diagnostic-parameter bit-offset=16:
      diagnostic data element CalibrationData_0x7b02_dim_curve_58xt_x2: base-type=uint16  # Parameters: x2
    diagnostic-parameter bit-offset=32:
      diagnostic data element CalibrationData_0x7b02_dim_curve_58xt_x3: base-type=uint16  # Parameters: x3
    diagnostic-parameter bit-offset=48:
      diagnostic data element CalibrationData_0x7b02_dim_curve_58xt_x4: base-type=uint16  # Parameters: x4
    diagnostic-parameter bit-offset=64:
      diagnostic data element CalibrationData_0x7b02_dim_curve_58xt_x5: base-type=uint16  # Parameters: x5
    diagnostic-parameter bit-offset=80:
      diagnostic data element CalibrationData_0x7b02_dim_curve_58xt_x6: base-type=uint16  # Parameters: x6
    diagnostic-parameter bit-offset=96:
      diagnostic data element CalibrationData_0x7b02_dim_curve_58xt_x7: base-type=uint16  # Parameters: x7
    diagnostic-parameter bit-offset=112:
      diagnostic data element CalibrationData_0x7b02_dim_curve_58xt_y1: base-type=uint16  # Parameters: y1
    diagnostic-parameter bit-offset=128:
      diagnostic data element CalibrationData_0x7b02_dim_curve_58xt_y2: base-type=uint16  # Parameters: y2
    diagnostic-parameter bit-offset=144:
      diagnostic data element CalibrationData_0x7b02_dim_curve_58xt_y3: base-type=uint16  # Parameters: y3
    diagnostic-parameter bit-offset=160:
      diagnostic data element CalibrationData_0x7b02_dim_curve_58xt_y4: base-type=uint16  # Parameters: y4
    diagnostic-parameter bit-offset=176:
      diagnostic data element CalibrationData_0x7b02_dim_curve_58xt_y5: base-type=uint16  # Parameters: y5
    diagnostic-parameter bit-offset=192:
      diagnostic data element CalibrationData_0x7b02_dim_curve_58xt_y6: base-type=uint16  # Parameters: y6
    diagnostic-parameter bit-offset=208:
      diagnostic data element CalibrationData_0x7b02_dim_curve_58xt_y7: base-type=uint16  # Parameters: y7
  diagnostic read data by identifier ReadDimCurve58xt: access-permission=READBasicSFDRole0x03ExtendedSession, data-identifier=DimCurve58xt, read-class=DiagnosticReadDataByIdentifierClass  # Read_dim_curve_58xt
  diagnostic write data by identifier WriteDimCurve58xt: access-permission=WRITEE2eSFDMode0x03ExtendedSession, data-identifier=DimCurve58xt, write-class=DiagnosticWriteDataByIdentifierClass  # Write_dim_curve_58xt
package /ZeC/DataIdentifiers/CalibrationData/dim_curve_58xs
  diagnostic data identifier DimCurve58xs: id=0x7b01, represents-vin=false  # dim_curve_58xs
    diagnostic-parameter bit-offset=0:
      diagnostic data element CalibrationData_0x7b01_dim_curve_58xs_x1: base-type=uint16  # Parameters: x1
    diagnostic-parameter bit-offset=16:
      diagnostic data element CalibrationData_0x7b01_dim_curve_58xs_x2: base-type=uint16  # Parameters: x2
    diagnostic-parameter bit-offset=32:
      diagnostic data element CalibrationData_0x7b01_dim_curve_58xs_x3: base-type=uint16  # Parameters: x3
    diagnostic-parameter bit-offset=48:
      diagnostic data element CalibrationData_0x7b01_dim_curve_58xs_x4: base-type=uint16  # Parameters: x4
    diagnostic-parameter bit-offset=64:
      diagnostic data element CalibrationData_0x7b01_dim_curve_58xs_x5: base-type=uint16  # Parameters: x5
    diagnostic-parameter bit-offset=80:
      diagnostic data element CalibrationData_0x7b01_dim_curve_58xs_x6: base-type=uint16  # Parameters: x6
    diagnostic-parameter bit-offset=96:
      diagnostic data element CalibrationData_0x7b01_dim_curve_58xs_x7: base-type=uint16  # Parameters: x7
    diagnostic-parameter bit-offset=112:
      diagnostic data element CalibrationData_0x7b01_dim_curve_58xs_y1: base-type=uint16  # Parameters: y1
    diagnostic-parameter bit-offset=128:
      diagnostic data element CalibrationData_0x7b01_dim_curve_58xs_y2: base-type=uint16  # Parameters: y2
    diagnostic-parameter bit-offset=144:
      diagnostic data element CalibrationData_0x7b01_dim_curve_58xs_y3: base-type=uint16  # Parameters: y3
    diagnostic-parameter bit-offset=160:
      diagnostic data element CalibrationData_0x7b01_dim_curve_58xs_y4: base-type=uint16  # Parameters: y4
    diagnostic-parameter bit-offset=176:
      diagnostic data element CalibrationData_0x7b01_dim_curve_58xs_y5: base-type=uint16  # Parameters: y5
    diagnostic-parameter bit-offset=192:
      diagnostic data element CalibrationData_0x7b01_dim_curve_58xs_y6: base-type=uint16  # Parameters: y6
    diagnostic-parameter bit-offset=208:
      diagnostic data element CalibrationData_0x7b01_dim_curve_58xs_y7: base-type=uint16  # Parameters: y7
  diagnostic read data by identifier ReadDimCurve58xs: access-permission=READBasicSFDRole0x03ExtendedSession, data-identifier=DimCurve58xs, read-class=DiagnosticReadDataByIdentifierClass  # Read_dim_curve_58xs
  diagnostic write data by identifier WriteDimCurve58xs: access-permission=WRITEE2eSFDMode0x03ExtendedSession, data-identifier=DimCurve58xs, write-class=DiagnosticWriteDataByIdentifierClass  # Write_dim_curve_58xs
package /ZeC/DataIdentifiers/CalibrationData/Productionmode
  diagnostic data identifier Productionmode: id=0x04fe, represents-vin=false
    diagnostic-parameter bit-offset=0:
      diagnostic data element CalibrationData_0x04fe_Productionmode_Reserved: base-type=uint8  # Parameters: Reserved
    diagnostic-parameter bit-offset=8:
      diagnostic data element CalibrationData_0x04fe_Productionmode_Reserved_PMode_Bit_11_OBD_Reserved: base-type=uint8, compu {0=PMode_Bit_11_OBD: not_active (TTR202213), 8=PMode_Bit_11_OBD: active (TTR202313)}  # Parameters: Reserved / PMode_Bit_11_OBD / Reserved
    diagnostic-parameter bit-offset=16:
      diagnostic data element CalibrationData_0x04fe_Productionmode_Reserved_2: base-type=uint8  # Parameters: Reserved
  diagnostic read data by identifier ReadProductionmode: access-permission=READ0x01DefaultSession0x03ExtendedSession, data-identifier=Productionmode, read-class=DiagnosticReadDataByIdentifierClass  # Read_Productionmode
  diagnostic write data by identifier WriteProductionmode: access-permission=WRITEProductionSFDRole0x03ExtendedSession, data-identifier=Productionmode, write-class=DiagnosticWriteDataByIdentifierClass  # Write_Productionmode
package /ZeC/DataIdentifiers/CalibrationData/Vehicle_mode_production
  diagnostic data identifier VehicleModeProduction: id=0x0ef4, represents-vin=false  # Vehicle_mode_production
    diagnostic-parameter bit-offset=0:
      diagnostic data element CalibrationData_0x0ef4_Vehicle_mode_production_Production_Mode: base-type=uint8, compu {0=Production_Mode: not_active (TTR202213), 1=Production_Mode: active (TTR202313)}  # Parameters: Production_Mode
  diagnostic read data by identifier ReadVehicleModeProduction: access-permission=READ0x01DefaultSession0x03ExtendedSession, data-identifier=VehicleModeProduction, read-class=DiagnosticReadDataByIdentifierClass  # Read_Vehicle_mode_production
  diagnostic write data by identifier WriteVehicleModeProduction: access-permission=WRITEProductionSFDRole0x03ExtendedSession, data-identifier=VehicleModeProduction, write-class=DiagnosticWriteDataByIdentifierClass  # Write_Vehicle_mode_production
package /ZeC/DataIdentifiers/CalibrationData/Knockout_counter
  diagnostic data identifier KnockoutCounter: id=0x02ca, represents-vin=false  # Knockout_counter
    diagnostic-parameter bit-offset=0:
      diagnostic data element CalibrationData_0x02ca_Knockout_counter_ECUKnockOut_Ctr: base-type=uint8  # Parameters: ECUKnockOut_Ctr
    diagnostic-parameter bit-offset=8:
      diagnostic data element CalibrationData_0x02ca_Knockout_counter_BusKnockOut_Ctr: base-type=uint8  # Parameters: BusKnockOut_Ctr
  diagnostic read data by identifier ReadKnockoutCounter: access-permission=READ0x01DefaultSession0x03ExtendedSession, data-identifier=KnockoutCounter, read-class=DiagnosticReadDataByIdentifierClass  # Read_Knockout_counter
  diagnostic write data by identifier WriteKnockoutCounter: access-permission=WRITEExtendedSFDRole0x03ExtendedSession, data-identifier=KnockoutCounter, write-class=DiagnosticWriteDataByIdentifierClass  # Write_Knockout_counter
package /ZeC/DataIdentifiers/CalibrationData/Function_List_CAN_x
  diagnostic data identifier FunctionListCANX: id=0x77a0, represents-vin=false  # Function_List_CAN_x
    diagnostic-parameter bit-offset=0:
      diagnostic data element CalibrationData_0x77a0_Function_List_CAN_x_Reserved_0_0_2_CAN_Bus_Slave_1_Active_CAN_Bus_Slave_2_Active_CAN_Bus_C017B84: array-size-semantics=VARIABLE-SIZE, max-number-of-elements=10, base-type=uint8  # Parameters: Reserved_0_0_2 / CAN Bus Slave 1 Active / CAN Bus Slave 2 Active / CAN Bus Slave 3 Active / CAN Bus Slave 4 Active / CAN Bus Slave 5 Active / CAN Bus Slave 6 Active
  diagnostic read data by identifier ReadFunctionListCANX: access-permission=READ0x01DefaultSession, data-identifier=FunctionListCANX, read-class=DiagnosticReadDataByIdentifierClass  # Read_Function_List_CAN_x
  diagnostic write data by identifier WriteFunctionListCANX: access-permission=WRITE0x01DefaultSession, data-identifier=FunctionListCANX, write-class=DiagnosticWriteDataByIdentifierClass  # Write_Function_List_CAN_x
package /ZeC/DataIdentifiers/CalibrationData/dim_param_Kl58
  diagnostic data identifier DimParamKl58: id=0x7b04, represents-vin=false  # dim_param_Kl58
    diagnostic-parameter bit-offset=0:
      diagnostic data element CalibrationData_0x7b04_dim_param_Kl58_p_Fehlerwert_Kl_58xd: base-type=uint8  # Parameters: p_Fehlerwert_Kl_58xd
    diagnostic-parameter bit-offset=8:
      diagnostic data element CalibrationData_0x7b04_dim_param_Kl58_p_PWM_damping_aufdimmen: base-type=uint8  # Parameters: p_PWM_damping_aufdimmen
    diagnostic-parameter bit-offset=16:
      diagnostic data element CalibrationData_0x7b04_dim_param_Kl58_p_PWM_damping_abdimmen: base-type=uint8  # Parameters: p_PWM_damping_abdimmen
  diagnostic read data by identifier ReadDimParamKl58: access-permission=READBasicSFDRole0x03ExtendedSession, data-identifier=DimParamKl58, read-class=DiagnosticReadDataByIdentifierClass  # Read_dim_param_Kl58
  diagnostic write data by identifier WriteDimParamKl58: access-permission=WRITEE2eSFDMode0x03ExtendedSession, data-identifier=DimParamKl58, write-class=DiagnosticWriteDataByIdentifierClass  # Write_dim_param_Kl58
package /ZeC/DataIdentifiers/CalibrationData/dim_curve_WBT
  diagnostic data identifier DimCurveWBT: id=0x7b03, represents-vin=false  # dim_curve_WBT
    diagnostic-parameter bit-offset=0:
      diagnostic data element CalibrationData_0x7b03_dim_curve_WBT_x1: base-type=uint16  # Parameters: x1
    diagnostic-parameter bit-offset=16:
      diagnostic data element CalibrationData_0x7b03_dim_curve_WBT_x2: base-type=uint16  # Parameters: x2
    diagnostic-parameter bit-offset=32:
      diagnostic data element CalibrationData_0x7b03_dim_curve_WBT_x3: base-type=uint16  # Parameters: x3
    diagnostic-parameter bit-offset=48:
      diagnostic data element CalibrationData_0x7b03_dim_curve_WBT_x4: base-type=uint16  # Parameters: x4
    diagnostic-parameter bit-offset=64:
      diagnostic data element CalibrationData_0x7b03_dim_curve_WBT_x5: base-type=uint16  # Parameters: x5
    diagnostic-parameter bit-offset=80:
      diagnostic data element CalibrationData_0x7b03_dim_curve_WBT_x6: base-type=uint16  # Parameters: x6
    diagnostic-parameter bit-offset=96:
      diagnostic data element CalibrationData_0x7b03_dim_curve_WBT_y1: base-type=uint16  # Parameters: y1
    diagnostic-parameter bit-offset=112:
      diagnostic data element CalibrationData_0x7b03_dim_curve_WBT_y2: base-type=uint16  # Parameters: y2
    diagnostic-parameter bit-offset=128:
      diagnostic data element CalibrationData_0x7b03_dim_curve_WBT_y3: base-type=uint16  # Parameters: y3
    diagnostic-parameter bit-offset=144:
      diagnostic data element CalibrationData_0x7b03_dim_curve_WBT_y4: base-type=uint16  # Parameters: y4
    diagnostic-parameter bit-offset=160:
      diagnostic data element CalibrationData_0x7b03_dim_curve_WBT_y5: base-type=uint16  # Parameters: y5
    diagnostic-parameter bit-offset=176:
      diagnostic data element CalibrationData_0x7b03_dim_curve_WBT_y6: base-type=uint16  # Parameters: y6
  diagnostic read data by identifier ReadDimCurveWBT: access-permission=READBasicSFDRole0x03ExtendedSession, data-identifier=DimCurveWBT, read-class=DiagnosticReadDataByIdentifierClass  # Read_dim_curve_WBT
  diagnostic write data by identifier WriteDimCurveWBT: access-permission=WRITEE2eSFDMode0x03ExtendedSession, data-identifier=DimCurveWBT, write-class=DiagnosticWriteDataByIdentifierClass  # Write_dim_curve_WBT
package /ZeC/DataIdentifiers/CalibrationData/Knockout_timer
  diagnostic data identifier KnockoutTimer: id=0x02cb, represents-vin=false  # Knockout_timer
    diagnostic-parameter bit-offset=0:
      diagnostic data element CalibrationData_0x02cb_Knockout_timer_ECUKnockOut_Tmr_Reserved: base-type=uint8, compu {63=ECUKnockOut_Tmr: Function_disabled (TTR288912), 14=ECUKnockOut_Tmr: 14 min (TTR211213), 22=ECUKnockOut_Tmr: 22 min (TTR212013), 36=ECUKnockOut_Tmr: 36 min (TTR213413), 50=ECUKnockOut_Tmr: 50 min (TTR214813), 4=ECUKnockOut_Tmr: 4 min (TTR210213), 31=ECUKnockOut_Tmr: 31 min (TTR212913), 45=ECUKnockOut_Tmr: 45 min (TTR214313), 28=ECUKnockOut_Tmr: 28 min (TTR212613), 2=ECUKnockOut_Tmr: 2 min (TTR210013), 26=ECUKnockOut_Tmr: 26 min (TTR212413), 27=ECUKnockOut_Tmr: 27 min (TTR212513), 43=ECUKnockOut_Tmr: 43 min (TTR214113), 53=ECUKnockOut_Tmr: 53 min (TTR215113), 38=ECUKnockOut_Tmr: 38 min (TTR213613), 42=ECUKnockOut_Tmr: 42 min (TTR214013), 49=ECUKnockOut_Tmr: 49 min (TTR214713), 56=ECUKnockOut_Tmr: 56 min (TTR215413), 60=ECUKnockOut_Tmr: 60 min (TTR216013), 48=ECUKnockOut_Tmr: 48 min (TTR214613), 35=ECUKnockOut_Tmr: 35 min (TTR213313), 30=ECUKnockOut_Tmr: 30 min (TTR212813), 20=ECUKnockOut_Tmr: 20 min (TTR211813), 9=ECUKnockOut_Tmr: 9 min (TTR210713), 23=ECUKnockOut_Tmr: 23 min (TTR212113), 51=ECUKnockOut_Tmr: 51 min (TTR214913), 7=ECUKnockOut_Tmr: 7 min (TTR210513), 10=ECUKnockOut_Tmr: 10 min (TTR210813), 46=ECUKnockOut_Tmr: 46 min (TTR214413), 18=ECUKnockOut_Tmr: 18 min (TTR211613), 40=ECUKnockOut_Tmr: 40 min (TTR213813), 58=ECUKnockOut_Tmr: 58 min (TTR215814), 12=ECUKnockOut_Tmr: 12 min (TTR211013), 21=ECUKnockOut_Tmr: 21 min (TTR211913), 6=ECUKnockOut_Tmr: 6 min (TTR210413), 11=ECUKnockOut_Tmr: 11 min (TTR210913), 13=ECUKnockOut_Tmr: 13 min (TTR211113), 8=ECUKnockOut_Tmr: 8 min (TTR210613), 47=ECUKnockOut_Tmr: 47 min (TTR214514), 16=ECUKnockOut_Tmr: 16 min (TTR211413), 15=ECUKnockOut_Tmr: 15 min (TTR211313), 59=ECUKnockOut_Tmr: 59 min (TTR215914), 62=ECUKnockOut_Tmr: 62 min (TTR216213), 17=ECUKnockOut_Tmr: 17 min (TTR211513), 5=ECUKnockOut_Tmr: 5 min (TTR210313), 33=ECUKnockOut_Tmr: 33 min (TTR213113), 61=ECUKnockOut_Tmr: 61 min (TTR216113), 57=ECUKnockOut_Tmr: 57 min (TTR215513), 1=ECUKnockOut_Tmr: 1 min (TTR209913), 25=ECUKnockOut_Tmr: 25 min (TTR212313), 34=ECUKnockOut_Tmr: 34 min (TTR213213), 3=ECUKnockOut_Tmr: 3 min (TTR210113), 24=ECUKnockOut_Tmr: 24 min (TTR212213), 55=ECUKnockOut_Tmr: 55 min (TTR215313), 54=ECUKnockOut_Tmr: 54 min (TTR215213), 39=ECUKnockOut_Tmr: 39 min (TTR213713), 37=ECUKnockOut_Tmr: 37 min (TTR213514), 52=ECUKnockOut_Tmr: 52 min (TTR215013), 32=ECUKnockOut_Tmr: 32 min (TTR213013), 29=ECUKnockOut_Tmr: 29 min (TTR212713), 41=ECUKnockOut_Tmr: 41 min (TTR213913), 19=ECUKnockOut_Tmr: 19 min (TTR211713), 44=ECUKnockOut_Tmr: 44 min (TTR214213)}  # Parameters: ECUKnockOut_Tmr / Reserved
    diagnostic-parameter bit-offset=8:
      diagnostic data element CalibrationData_0x02cb_Knockout_timer_BusKnockOut_Tmr_BusKnockOut_Tmr_NVEM_Reserved: base-type=uint8, compu {63=BusKnockOut_Tmr: Function_disabled (TTR288912), 22=BusKnockOut_Tmr: 22 min (TTR212013), 36=BusKnockOut_Tmr: 36 min (TTR213413), 50=BusKnockOut_Tmr: 50 min (TTR214813), 31=BusKnockOut_Tmr: 31 min (TTR212913), 45=BusKnockOut_Tmr: 45 min (TTR214313), 28=BusKnockOut_Tmr: 28 min (TTR212613), 26=BusKnockOut_Tmr: 26 min (TTR212413), 27=BusKnockOut_Tmr: 27 min (TTR212513), 43=BusKnockOut_Tmr: 43 min (TTR214113), 53=BusKnockOut_Tmr: 53 min (TTR215113), 38=BusKnockOut_Tmr: 38 min (TTR213613), 42=BusKnockOut_Tmr: 42 min (TTR214013), 49=BusKnockOut_Tmr: 49 min (TTR214713), 56=BusKnockOut_Tmr: 56 min (TTR215413), 60=BusKnockOut_Tmr: 60 min (TTR216013), 48=BusKnockOut_Tmr: 48 min (TTR214613), 35=BusKnockOut_Tmr: 35 min (TTR213313), 30=BusKnockOut_Tmr: 30 min (TTR212813), 20=BusKnockOut_Tmr: 20 min (TTR211813), 23=BusKnockOut_Tmr: 23 min (TTR212113), 51=BusKnockOut_Tmr: 51 min (TTR214913), 46=BusKnockOut_Tmr: 46 min (TTR214413), 18=BusKnockOut_Tmr: 18 min (TTR211613), 40=BusKnockOut_Tmr: 40 min (TTR213813), 58=BusKnockOut_Tmr: 58 min (TTR215814), 21=BusKnockOut_Tmr: 21 min (TTR211913), 47=BusKnockOut_Tmr: 47 min (TTR214514), 16=BusKnockOut_Tmr: 16 min (TTR211413), 15=BusKnockOut_Tmr: 15 min (TTR211313), 59=BusKnockOut_Tmr: 59 min (TTR215914), 62=BusKnockOut_Tmr: 62 min (TTR216213), 17=BusKnockOut_Tmr: 17 min (TTR211513), 33=BusKnockOut_Tmr: 33 min (TTR213113), 61=BusKnockOut_Tmr: 61 min (TTR216113), 57=BusKnockOut_Tmr: 57 min (TTR215513), 25=BusKnockOut_Tmr: 25 min (TTR212313), 34=BusKnockOut_Tmr: 34 min (TTR213213), 24=BusKnockOut_Tmr: 24 min (TTR212213), 55=BusKnockOut_Tmr: 55 min (TTR215313), 54=BusKnockOut_Tmr: 54 min (TTR215213), 39=BusKnockOut_Tmr: 39 min (TTR213713), 37=BusKnockOut_Tmr: 37 min (TTR213514), 52=BusKnockOut_Tmr: 52 min (TTR215013), 32=BusKnockOut_Tmr: 32 min (TTR213013), 29=BusKnockOut_Tmr: 29 min (TTR212713), 41=BusKnockOut_Tmr: 41 min (TTR213913), 19=BusKnockOut_Tmr: 19 min (TTR211713), 44=BusKnockOut_Tmr: 44 min (TTR214213), 0=BusKnockOut_Tmr_NVEM: NVEM_coupling_not_active_or_not_implemented (TTR289012), 64=BusKnockOut_Tmr_NVEM: NVEM_coupling_active (TTR289112)}  # Parameters: BusKnockOut_Tmr / BusKnockOut_Tmr_NVEM / Reserved
  diagnostic read data by identifier ReadKnockoutTimer: access-permission=READ0x01DefaultSession0x03ExtendedSession, data-identifier=KnockoutTimer, read-class=DiagnosticReadDataByIdentifierClass  # Read_Knockout_timer
  diagnostic write data by identifier WriteKnockoutTimer: access-permission=WRITEExtendedSFDRole0x03ExtendedSession, data-identifier=KnockoutTimer, write-class=DiagnosticWriteDataByIdentifierClass  # Write_Knockout_timer
package /ZeC/DataIdentifiers/CalibrationData/Productionmode_deactivate
  diagnostic data identifier ProductionmodeDeactivate: id=0x04fc, represents-vin=false  # Productionmode deactivate
    diagnostic-parameter bit-offset=0:
      diagnostic data element CalibrationData_0x04fc_Productionmode_deactivate_P_Mode_Paramvalue: array-size-semantics=FIXED-SIZE, max-number-of-elements=3, base-type=uint8, compu {0=P-Mode Paramvalue: Productionmode deactivate (TTR308812)}  # Parameters: P-Mode Paramvalue
  diagnostic read data by identifier ReadProductionmodeDeactivate: access-permission=READ0x01DefaultSession0x03ExtendedSession, data-identifier=ProductionmodeDeactivate, read-class=DiagnosticReadDataByIdentifierClass  # Read_Productionmode deactivate
  diagnostic write data by identifier WriteProductionmodeDeactivate: access-permission=WRITE0x03ExtendedSession, data-identifier=ProductionmodeDeactivate, write-class=DiagnosticWriteDataByIdentifierClass  # Write_Productionmode deactivate
package /ZeC/DataIdentifiers/CalibrationData/SFD_development_mode_activation
  diagnostic data identifier SFDDevelopmentModeActivation: id=0xc10b, represents-vin=false  # SFD_development_mode_activation
    diagnostic-parameter bit-offset=0:
      diagnostic data element CalibrationData_0xc10b_SFD_development_mode_activation_Sfd_development_mode_activation: base-type=uint8, compu {0=Sfd_development_mode_activation: No_activation_active (TTR900711), 1=Sfd_development_mode_activation: SFD_development_mode_initialized (TTR900611)}  # Parameters: Sfd_development_mode_activation
  diagnostic read data by identifier ReadSFDDevelopmentModeActivation: access-permission=READ0x03ExtendedSession, data-identifier=SFDDevelopmentModeActivation, read-class=DiagnosticReadDataByIdentifierClass  # Read_SFD_development_mode_activation
  diagnostic write data by identifier WriteSFDDevelopmentModeActivation: access-permission=WRITEE2eSFDMode0x03ExtendedSession, data-identifier=SFDDevelopmentModeActivation, write-class=DiagnosticWriteDataByIdentifierClass  # Write_SFD_development_mode_activation
package /ZeC/DataIdentifiers/Coding/VW_Coding_Value
  diagnostic data identifier VWCodingValue: id=0x0600, represents-vin=false  # VW Coding Value
    diagnostic-parameter bit-offset=0:
      diagnostic data element Coding_0x0600_VW_Coding_Value_byte_0_brand_Vehicle_class: base-type=uint8, compu {6=byte_0_brand: VW-NFZ (TTR949811), 3=byte_0_brand: SKODA (TTR949511), 5=byte_0_brand: BENTLY (TTR949711), 10=byte_0_brand: Scania (TTR950211), 2=byte_0_brand: VW (TTR949411), 1=byte_0_brand: AUDI (TTR949311), 7=byte_0_brand: Porsche (TTR949911), 12=byte_0_brand: Reserved (TTR950411), 4=byte_0_brand: SEAT (TTR949611), 9=byte_0_brand: Bugatti (TTR950111), 0=byte_0_brand: noBrand; Vehicle class: none (TTR949211TTR1035611), 8=byte_0_brand: Lamborghini (TTR950011), 11=byte_0_brand: MAN (TTR950311)}  # Parameters: byte_0_brand / Vehicle class
    diagnostic-parameter bit-offset=8:
      diagnostic data element Coding_0x0600_VW_Coding_Value_Vehicle_Generation_Country_Coding: base-type=uint8, compu {0=Vehicle Generation: none; Country Coding: none (TTR1035611TTR1035611)}  # Parameters: Vehicle Generation / Country Coding
    diagnostic-parameter bit-offset=16:
      diagnostic data element Coding_0x0600_VW_Coding_Value_Vehicle_Variant_Vehicle_Variant_Supplement: base-type=uint8, compu {0=Vehicle Variant: none; Vehicle Variant Supplement: none (TTR1035611TTR1035611)}  # Parameters: Vehicle Variant / Vehicle Variant Supplement
    diagnostic-parameter bit-offset=24:
      diagnostic data element Coding_0x0600_VW_Coding_Value_Ethernet_Port_1_100_activation_Ethernet_Port_1_1000_activation_Ethernet_Port_2_1005D6972B: base-type=uint8, compu {1=Ethernet Port 1 100 activation: Active (TTR459711), 0=Ethernet Port 1 100 activation: Not_active; Ethernet Port 1 1000 activation: Not_active; Ethernet Port 2 1000 activation: Not_active; Ethernet Port 3 1000 activation: Not_active; Ethernet Port 1 2500 activation: Not_active (TTR459611TTR459611TTR459611TTR459611TTR459611), 2=Ethernet Port 1 1000 activation: Active (TTR459711), 4=Ethernet Port 2 1000 activation: Active (TTR459711), 8=Ethernet Port 3 1000 activation: Active (TTR459711), 16=Ethernet Port 1 2500 activation: Active (TTR459711)}  # Parameters: Ethernet Port 1 100 activation / Ethernet Port 1 1000 activation / Ethernet Port 2 1000 activation / Ethernet Port 3 1000 activation / Ethernet Port 1 2500 activation / Reserved_3_5_3
    diagnostic-parameter bit-offset=32:
      diagnostic data element Coding_0x0600_VW_Coding_Value_Reserved_0_0_8: array-size-semantics=VARIABLE-SIZE, max-number-of-elements=296, base-type=uint8  # Parameters: Reserved_0_0_8
  diagnostic read data by identifier ReadVWCodingValue: access-permission=READ0x01DefaultSession0x03ExtendedSession0x40EndOfLineSession0x4FDevelopmentSession, data-identifier=VWCodingValue, read-class=DiagnosticReadDataByIdentifierClass  # Read_VW Coding Value
  diagnostic write data by identifier WriteVWCodingValue: access-permission=WRITE0x03ExtendedSession0x40EndOfLineSession0x4FDevelopmentSession, data-identifier=VWCodingValue, write-class=DiagnosticWriteDataByIdentifierClass  # Write_VW Coding Value
package /ZeC/DataIdentifiers/Identification/Gateway_Component_List
  diagnostic data identifier GatewayComponentList: id=0x04a3, represents-vin=false  # Gateway Component List
    diagnostic-parameter bit-offset=0:
      diagnostic data element Identification_0x04a3_Gateway_Component_List_ECU_coded_Bit_0_ECU_coded_Bit_1_ECU_coded_Bit_2_ECU_coded_Bit_3_ECU98C112A: array-size-semantics=VARIABLE-SIZE, max-number-of-elements=1, base-type=uint8  # Parameters: ECU coded Bit 0 / ECU coded Bit 1 / ECU coded Bit 2 / ECU coded Bit 3 / ECU coded Bit 4 / ECU coded Bit 5 / ECU coded Bit 6 / ECU coded Bit 7
  diagnostic read data by identifier ReadGatewayComponentList: access-permission=READ0x01DefaultSession0x03ExtendedSession, data-identifier=GatewayComponentList, read-class=DiagnosticReadDataByIdentifierClass  # Read_Gateway Component List
  diagnostic write data by identifier WriteGatewayComponentList: access-permission=WRITEE2eSFDMode0x03ExtendedSession, data-identifier=GatewayComponentList, write-class=DiagnosticWriteDataByIdentifierClass  # Write_Gateway Component List
package /ZeC/DataIdentifiers/Identification/Gateway_component_list_ECU_node_address
  diagnostic data identifier GatewayComponentListECUNodeAddress: id=0xf1b7, represents-vin=false  # Gateway_component_list_ECU_node_address
    diagnostic-parameter bit-offset=0:
      diagnostic data element Identification_0xf1b7_Gateway_component_list_ECU_node_address_Node_address: array-size-semantics=VARIABLE-SIZE, max-number-of-elements=2, base-type=uint8  # Parameters: Node_address
  diagnostic read data by identifier ReadGatewayComponentListECUNodeAddress: access-permission=READ0x01DefaultSession0x03ExtendedSession, data-identifier=GatewayComponentListECUNodeAddress, read-class=DiagnosticReadDataByIdentifierClass  # Read_Gateway_component_list_ECU_node_address
package /ZeC/DataIdentifiers/Identification/VW_system_firmware_versions
  diagnostic data identifier VWSystemFirmwareVersions: id=0xf1b8, represents-vin=false  # VW_system_firmware_versions
    diagnostic-parameter bit-offset=0:
      diagnostic data element Identification_0xf1b8_VW_system_firmware_versions_Number_of_firmware_versions: base-type=uint8  # Parameters: Number_of_firmware_versions
    diagnostic-parameter bit-offset=8:
      diagnostic data element Identification_0xf1b8_VW_system_firmware_versions_Firmware_versions: array-size-semantics=VARIABLE-SIZE, max-number-of-elements=4, base-type=uint8  # Parameters: Firmware_versions
  diagnostic read data by identifier ReadVWSystemFirmwareVersions: access-permission=READ0x01DefaultSession0x02ProgrammingSession0x03ExtendedSession, data-identifier=VWSystemFirmwareVersions, read-class=DiagnosticReadDataByIdentifierClass  # Read_VW_system_firmware_versions
package /ZeC/DataIdentifiers/Identification/Gateway_component_list_ecu_authentication
  diagnostic data identifier GatewayComponentListEcuAuthentication: id=0x2ee1, represents-vin=false  # Gateway_component_list_ecu_authentication
    diagnostic-parameter bit-offset=0:
      diagnostic data element Identification_0x2ee1_Gateway_component_list_ecu_authentication_Ecu_authentication_Bit_0_Ecu_authentication_Bit_B9EAD3A: array-size-semantics=VARIABLE-SIZE, max-number-of-elements=1, base-type=uint8  # Parameters: Ecu_authentication Bit 0 / Ecu_authentication Bit 1 / Ecu_authentication Bit 2 / Ecu_authentication Bit 3 / Ecu_authentication Bit 4 / Ecu_authentication Bit 5 / Ecu_authentication Bit 6 / Ecu_authentication Bit 7
  diagnostic read data by identifier ReadGatewayComponentListEcuAuthentication: access-permission=READ0x01DefaultSession0x03ExtendedSession, data-identifier=GatewayComponentListEcuAuthentication, read-class=DiagnosticReadDataByIdentifierClass  # Read_Gateway_component_list_ecu_authentication
package /ZeC/DataIdentifiers/Identification/Gateway_component_list_diag_path
  diagnostic data identifier GatewayComponentListDiagPath: id=0x2ee0, represents-vin=false  # Gateway_component_list_diag_path
    diagnostic-parameter bit-offset=0:
      diagnostic data element Identification_0x2ee0_Gateway_component_list_diag_path_Diag_path_Bit_0_Diag_path_Bit_1_Diag_path_Bit_2_Diag_pathB316B35: base-type=uint8, compu {0=Diag_path Bit 0: ECU / Bus Interface Diagnosable; Diag_path Bit 1: ECU / Bus Interface Diagnosable; Diag_path Bit 2: ECU / Bus Interface Diagnosable; Diag_path Bit 3: ECU / Bus Interface Diagnosable; Diag_path Bit 4: ECU / Bus Interface Diagnosable; Diag_path Bit 5: ECU / Bus Interface Diagnosable; Diag_path Bit 6: ECU / Bus Interface Diagnosable; Diag_path Bit 7: ECU / Bus Interface Diagnosable (TTR231112TTR231112TTR231112TTR231112TTR231112TTR231112TTR231112TTR231112), 1=Diag_path Bit 0: ECU / Bus Interface Not Diagnosable (TTR231212), 2=Diag_path Bit 1: ECU / Bus Interface Not Diagnosable (TTR231212), 4=Diag_path Bit 2: ECU / Bus Interface Not Diagnosable (TTR231212), 8=Diag_path Bit 3: ECU / Bus Interface Not Diagnosable (TTR231212), 16=Diag_path Bit 4: ECU / Bus Interface Not Diagnosable (TTR231212), 32=Diag_path Bit 5: ECU / Bus Interface Not Diagnosable (TTR231212), 64=Diag_path Bit 6: ECU / Bus Interface Not Diagnosable (TTR231212), 128=Diag_path Bit 7: ECU / Bus Interface Not Diagnosable (TTR231212)}  # Parameters: Diag_path Bit 0 / Diag_path Bit 1 / Diag_path Bit 2 / Diag_path Bit 3 / Diag_path Bit 4 / Diag_path Bit 5 / Diag_path Bit 6 / Diag_path Bit 7
  diagnostic read data by identifier ReadGatewayComponentListDiagPath: access-permission=READ0x01DefaultSession0x03ExtendedSession, data-identifier=GatewayComponentListDiagPath, read-class=DiagnosticReadDataByIdentifierClass  # Read_Gateway_component_list_diag_path
package /ZeC/DataIdentifiers/Identification/Slave_list_data_set_description
  diagnostic data identifier SlaveListDataSetDescription: id=0x0252, represents-vin=false  # Slave_list_data_set_description
    diagnostic-parameter bit-offset=0:
      diagnostic data element Identification_0x0252_Slave_list_data_set_description_Number_Of_Expected_SubSystem_Identification: base-type=uint8  # Parameters: Number Of Expected SubSystem Identification
    diagnostic-parameter bit-offset=8:
      diagnostic data element Identification_0x0252_Slave_list_data_set_description_Number_Of_Retrieved_SubSystem_Identification: base-type=uint8  # Parameters: Number Of Retrieved SubSystem Identification
    diagnostic-parameter bit-offset=16:
      diagnostic data element Identification_0x0252_Slave_list_data_set_description_SubSystem_Name_SubSystem_Node_Address:  # Parameters: SubSystem Name / SubSystem Node Address
        array-size-semantics=FIXED-SIZE
        max-number-of-elements=2
        base-type=uint8
        compu {469=SubSystem Name: Digital Sound System Control Module 4 (TTR912911), 28=SubSystem Name: Fresh Air Blower Back (TTR243112), 232=SubSystem Name: Starter Generator Control Module Sub (TTR263012), 236=SubSystem Name: Refrigerant Pressure And Temperature Sender 4 (TTR263412), 169=SubSystem Name: Pedestrian Protection Center (TTR256712), 342=SubSystem Name: Cooler Fan 3 (TTR273712), 295=SubSystem Name: Coolant Valve (TTR269012), 17=SubSystem Name: Data Medium (TTR242012), 545=SubSystem Name: Sub System Driver Assistance 2 Extended (TTR910611), 483=SubSystem Name: Catalyst Heating 2 (TTR906511), 422=SubSystem Name: Theft Protection Antenna 8 (TTR279512), 530=SubSystem Name: Valve Block 6 In Passenger Side Rear Seat (TTR909111), 428=SubSystem Name: Emblem Illumination 1 (TTR279712), 40=SubSystem Name: Right Front Massage Seat Control Module (TTR244512), 14=SubSystem Name: Operating And Display Unit 1 (TTR241712), 379=SubSystem Name: Electrical Performance Map Cooling Unit (TTR277412), 549=SubSystem Name: Secondary Air Pump (TTR911011), 278=SubSystem Name: Window Transmittance Control Unit (TTR911711), 524=SubSystem Name: Valve Block 6 In Driver Side Front Seat (TTR908511), 127=SubSystem Name: Parkassist Entry (TTR253112), 195=SubSystem Name: Seat Cushion Fan 1 Front Left (TTR259312), 152=SubSystem Name: Multimedia Operating Unit 2 (TTR255012), 221=SubSystem Name: Seat Backrest Fan 1 Rear Left (TTR261912), 333=SubSystem Name: Control Unit Exit Warning Rear Right (TTR272812), 204=SubSystem Name: Operating And Display Unit 4 For Air Conditioning (TTR260212), 106=SubSystem Name: Battery Monitoring Control Module 2 (TTR251512), 46=SubSystem Name: NOx Sensor 1 (TTR245512), 341=SubSystem Name: Display Unit Compass (TTR273612), 464=SubSystem Name: Application Sub Server 1 Chassis OBD (TTR282712), 103=SubSystem Name: Door Handle Rear Left Kessy (TTR251212), 249=SubSystem Name: Convenience And Driver Assist Operating Unit 2 (TTR264712), 186=SubSystem Name: Valve Block 2 In Driver Side Front Seat (TTR258412), 542=SubSystem Name: Sub System 2 Driver Assistance 2 (TTR910311), 165=SubSystem Name: Front Sensor Passenger (TTR256312), 314=SubSystem Name: Radio Control Center (TTR270912), 11=SubSystem Name: LED Headlamp Powermodule Right (TTR241412), 513=SubSystem Name: Door Handle Outside Actuation Passenger Side (TTR907911), 187=SubSystem Name: Valve Block 3 In Driver Side Front Seat (TTR258512), 350=SubSystem Name: Sensor 1 Wet Detection (TTR274512), 33=SubSystem Name: Steering Column Lock Actuator (TTR243612), 434=SubSystem Name: HV Battery Monitoring Control Module 2 (TTR280012), 330=SubSystem Name: Coolant Valve 4 (TTR272512), 415=SubSystem Name: Theft Protection Antenna 1 (TTR278812), 375=SubSystem Name: Sensor Flap 1 Charge Plug Connector (TTR277012), 448=SubSystem Name: Kessy Slave Trunk (TTR281112), 27=SubSystem Name: Fresh Air Blower Front (TTR243012), 343=SubSystem Name: Control Module For Auxiliary Air Heater 2 (TTR273812), 18=SubSystem Name: Drivers Door Control Module (TTR242112), 98=SubSystem Name: Compact Disc Database (TTR250712), 99=SubSystem Name: Rear Climatronic Operating And Display Unit Left (TTR250812), 181=SubSystem Name: Valve Block 1 In Passenger Side Rear Seat (TTR257912), 22=SubSystem Name: Sensor For Anti Theft Alarm System (TTR242512), 156=SubSystem Name: Control Module For Auxiliary Blower Motors (TTR255412), 23=SubSystem Name: Rear Lid Control Module 2 (TTR242612), 47=SubSystem Name: NOx Sensor 2 (TTR245612), 77=SubSystem Name: Passengers Rear Door Control Module (TTR248612), 192=SubSystem Name: Coolant Heater (TTR259012), 439=SubSystem Name: Control Module For Auxiliary Air Heater 3 (TTR280512), 493=SubSystem Name: Front Sensor Driver Center 2 (TTR907511), 70=SubSystem Name: Display Unit Front For Multimedia System (TTR247912), 200=SubSystem Name: Seat Cushion Fan 2 Front Right (TTR259812), 196=SubSystem Name: Seat Cushion Fan 2 Front Left (TTR259412), 442=SubSystem Name: Aerodynamics Control Unit 3 (TTR912611), 399=SubSystem Name: Battery Monitoring Control Module 3 (TTR278512), 288=SubSystem Name: Electrical Variable Camshaft Phasing 1 (TTR268312), 191=SubSystem Name: Valve Block 3 In Passenger Side Front Seat (TTR258912), 144=SubSystem Name: Trailer Weight Nose Weight Detection (TTR254212), 418=SubSystem Name: Theft Protection Antenna 4 (TTR279112), 308=SubSystem Name: Side Sensor B-Pillar Passenger Front (TTR270312), 466=SubSystem Name: Door Actuator Rear Driver Side (TTR282912), 488=SubSystem Name: Application Sub Server 3 Power Train OBD (TTR907011), 189=SubSystem Name: Valve Block 1 In Passenger Side Front Seat (TTR258712), 310=SubSystem Name: Gear Selection Display (TTR270512), 354=SubSystem Name: Stop Watch (TTR274912), 205=SubSystem Name: Operating And Display Unit 5 For Air Conditioning (TTR260312), 193=SubSystem Name: Seat Backrest Fan 1 Front Left (TTR259112), 172=SubSystem Name: Pedestrian Protection Passenger 2 (TTR257012), 550=SubSystem Name: Secondary Air Pump 2 (TTR911111), 115=SubSystem Name: Rear Door Control Module (TTR252412), 543=SubSystem Name: Sub System 3 Driver Assistance 2 (TTR910411), 325=SubSystem Name: Flap 1 Charge Plug Connector (TTR272012), 147=SubSystem Name: Volume Control 1 (TTR254512), 512=SubSystem Name: Door Handle Outside Actuation Driver Side (TTR907811), 324=SubSystem Name: Catalyst Heating (TTR271912), 216=SubSystem Name: Cell Module Controller 8 (TTR261412), 38=SubSystem Name: Ceiling Light Module (TTR244312), 351=SubSystem Name: Sensor 2 Wet Detection (TTR274612), 269=SubSystem Name: Electrical Charger (TTR266612), 16=SubSystem Name: Right Rear Seat Ventilation Control Module (TTR241912), 139=SubSystem Name: Trailer Articulation Angle Sensor (TTR253712), 546=SubSystem Name: Sub System 2 Driver Assistance 2 Extended (TTR910711), 43=SubSystem Name: Belt Pretensioner Right (TTR244712), 293=SubSystem Name: Air Quality Sensor 2 (TTR268812), 328=SubSystem Name: Coolant Valve 2 (TTR272312), 97=SubSystem Name: Switch Module 2 For Rear Seat Front Passenger Side (TTR250612), 385=SubSystem Name: Heating Reductant Tank (TTR277812), 176=SubSystem Name: Switch For Rear Multicontour Seat Driver Side (TTR257412), 395=SubSystem Name: Coolant Pump 3 (TTR278212), 1=SubSystem Name: Control Unit For Wiper Motor (TTR240412), 291=SubSystem Name: Wireless Operating Unit 2 (TTR268612), 68=SubSystem Name: Hands Free System (TTR247712), 452=SubSystem Name: Rear Light Right 3 (TTR281512), 142=SubSystem Name: Convenience And Driver Assist Operating Unit (TTR254012), 230=SubSystem Name: Auxiliary Blower Motor Control 2 (TTR262812), 322=SubSystem Name: Park Lock Actuator (TTR271712), 478=SubSystem Name: Sub System 2 Driver Assistance (TTR906011), 242=SubSystem Name: Cell Module Controller 14 (TTR264012), 105=SubSystem Name: Power Converter DC AC (TTR251412), 450=SubSystem Name: Kessy Slave Roof Antenna (TTR281312), 74=SubSystem Name: Interface For External Multimedia Unit (TTR248312), 151=SubSystem Name: Active Accelerator Pedal (TTR254912), 302=SubSystem Name: Control Unit Heating 4 (TTR269712), 438=SubSystem Name: Communication Car2X (TTR280412), 229=SubSystem Name: Auxiliary Blower Motor Control 1 (TTR262712), 360=SubSystem Name: Dynamic Turn Signal Front Right (TTR275512), 123=SubSystem Name: Operating Unit Center Console 2 (TTR252712), 374=SubSystem Name: Seat Allocation Detection 6 (TTR276912), 219=SubSystem Name: Cell Module Controller 11 (TTR261712), 244=SubSystem Name: Cell Module Controller 16 (TTR264212), 32=SubSystem Name: Sun Roof (TTR243512), 275=SubSystem Name: Radiator Shutter 2 (TTR267212), 134=SubSystem Name: Belt Pretensioner 3rd Row Left (TTR253212), 326=SubSystem Name: Flap 2 Charge Plug Connector (TTR272112), 397=SubSystem Name: Electrical Charger 2 (TTR912411), 270=SubSystem Name: Rear Light Left 2 (TTR266712), 224=SubSystem Name: Seat Cushion Fan 2 Rear Left (TTR262212), 388=SubSystem Name: Side Camera Front Right (TTR912011), 166=SubSystem Name: Pedestrian Protection Driver (TTR256412), 20=SubSystem Name: Left Headlamp Power Output Stage (TTR242312), 245=SubSystem Name: Seat Heating Rear 1 (TTR264312), 174=SubSystem Name: Refrigerant Pressure And Temperature Sender 2 (TTR257212), 473=SubSystem Name: Rear Light Right 6 (TTR283412), 160=SubSystem Name: Side Sensor Driver Front (TTR255812), 495=SubSystem Name: Stereo Camera Head 2 (TTR907711), 228=SubSystem Name: Seat Cushion Fan 2 Rear Right (TTR262612), 443=SubSystem Name: Aerodynamics Control Unit 4 (TTR912711), 58=SubSystem Name: Steering Angle Sender Sub (TTR246712), 482=SubSystem Name: Application Sub Server Central 2 (TTR906411), 45=SubSystem Name: Selector Lever (TTR245412), 157=SubSystem Name: Operating And Display Unit 3 (TTR255512), 153=SubSystem Name: Display Unit 3 For Multimedia System (TTR255112), 387=SubSystem Name: Side Camera Front Left (TTR911911), 266=SubSystem Name: Sunlight Sensor (TTR266312), 432=SubSystem Name: Front Sensor Driver Center (TTR279812), 55=SubSystem Name: Battery Monitoring Control Module (TTR246412), 287=SubSystem Name: Belt Pretensioner 2nd Row Right (TTR268212), 376=SubSystem Name: Sensor Flap 2 Charge Plug Connector (TTR277112), 465=SubSystem Name: Application Sub Server 2 Chassis OBD (TTR282812), 309=SubSystem Name: Multi Function Steering Wheel Control Module 2 (TTR270412), 227=SubSystem Name: Seat Cushion Fan 1 Rear Right (TTR262512), 141=SubSystem Name: Range Of Vision Sensing (TTR253912), 54=SubSystem Name: Display Unit 1 For Multimedia System (TTR246312), 329=SubSystem Name: Coolant Valve 3 (TTR272412), 202=SubSystem Name: Operating And Display Unit 2 For Air Conditioning (TTR260012), 533=SubSystem Name: Camera Head Dash Cam (TTR909411), 155=SubSystem Name: Display Unit 5 For Multimedia System (TTR255312), 113=SubSystem Name: Rear Brake Actuator 2 (TTR252212), 345=SubSystem Name: Cooler Fan 4 (TTR274012), 107=SubSystem Name: Matrix Headlamp Powermodule 1 Left (TTR251612), 517=SubSystem Name: Axle Disengagement (TTR908211), 75=SubSystem Name: Relative Air Humidity Interior Sender (TTR248412), 339=SubSystem Name: Coolant Valve 7 (TTR273412), 492=SubSystem Name: Stereo Camera Head 1 (TTR907411), 528=SubSystem Name: Valve Block 6 In Driver Side Rear Seat (TTR908911), 262=SubSystem Name: Refrigerant Shut Off Valve 2 (TTR265912), 82=SubSystem Name: Roof Blind 2 (TTR249112), 386=SubSystem Name: Sensor 2 Fine Dust Concentration (TTR277912), 8=SubSystem Name: Right Front Seat Ventilation Control Module (TTR241112), 297=SubSystem Name: Interior Monitoring Rear (TTR269212), 252=SubSystem Name: Valve Block 4 In Driver Side Rear Seat (TTR265012), 267=SubSystem Name: Near Field Communication Control Module 2 (TTR266412), 283=SubSystem Name: Special Vehicle Assist Interface (TTR267812), 175=SubSystem Name: Refrigerant Pressure And Temperature Sender 3 (TTR257312), 138=SubSystem Name: Brake Assistance Sub (TTR253612), 240=SubSystem Name: Air Coolant Actuator 2 (TTR263812), 296=SubSystem Name: Near Field Communication Control Module 3 (TTR269112), 35=SubSystem Name: Tire Pressure Monitor Antenna (TTR243812), 356=SubSystem Name: Picnic Table Rear Passenger Side (TTR275112), 239=SubSystem Name: Air Coolant Actuator 1 (TTR263712), 462=SubSystem Name: Application Sub Server 3 Chassis (TTR282512), 12=SubSystem Name: LED Headlamp Powermodule 2 Left (TTR241512), 78=SubSystem Name: Sensor Controlled Power Rear Lid (TTR248712), 359=SubSystem Name: Dynamic Turn Signal Front Left (TTR275412), 59=SubSystem Name: Lane Change Assistant 2 (TTR246812), 470=SubSystem Name: Driver Monitoring Camera Sensor 1 (TTR283112), 534=SubSystem Name: Radar Sensor Front Center (TTR909511), 491=SubSystem Name: Ioniser 2 (TTR907311), 525=SubSystem Name: Valve Block 5 In Passenger Side Front Seat (TTR908611), 102=SubSystem Name: Door Handle Front Right Kessy (TTR251112), 377=SubSystem Name: Switch Charge Indicator Flap 1 Charge Plug Connector (TTR277212), 34=SubSystem Name: Anti Theft Tilt System Control Unit (TTR243712), 305=SubSystem Name: Side Sensor A-Pillar Passenger Front (TTR270012), 225=SubSystem Name: Seat Backrest Fan 1 Rear Right (TTR262312), 246=SubSystem Name: LED Warning Indicator (TTR264412), 211=SubSystem Name: Cell Module Controller 3 (TTR260912), 299=SubSystem Name: Control Unit Heating 1 (TTR269412), 162=SubSystem Name: Side Sensor Driver Rear (TTR256012), 39=SubSystem Name: Left Front Massage Seat Control Module (TTR244412), 3=SubSystem Name: Light Switch (TTR240612), 536=SubSystem Name: Radar Sensor Rear Right (TTR909711), 321=SubSystem Name: Card Reader TV Tuner (TTR271612), 79=SubSystem Name: Camera For Night Vision System (TTR248812), 83=SubSystem Name: Motor For Wind Deflector (TTR249212), 26=SubSystem Name: Remote Control Auxiliary Heater (TTR242912), 394=SubSystem Name: Coolant Pump 2 (TTR278112), 150=SubSystem Name: Operating And Display Unit 6 For Air Conditioning (TTR254812), 365=SubSystem Name: Area View Camera Slave Rear (TTR276012), 334=SubSystem Name: Control Unit Exit Warning Rear Left (TTR272912), 358=SubSystem Name: Refrigerant Expansion Valve 5 (TTR275312), 238=SubSystem Name: Refrigerant Pressure And Temperature Sender 6 (TTR263612), 370=SubSystem Name: Seat Allocation Detection 2 (TTR276512), 286=SubSystem Name: Belt Pretensioner 2nd Row Left (TTR268112), 21=SubSystem Name: Right Headlamp Power Output Stage (TTR242412), 148=SubSystem Name: Belt Buckle Presenter 2nd Row Left (TTR254612), 66=SubSystem Name: Chip Card Reader Control Module (TTR247512), 398=SubSystem Name: Android Control Unit (TTR278412), 346=SubSystem Name: Sensor High Voltage System 2 (TTR274112), 80=SubSystem Name: Relative Humidity Sensor In Fresh Air Intake Duct (TTR248912), 277=SubSystem Name: Radiator Shutter 4 (TTR267412), 250=SubSystem Name: Hydrogen Pump (TTR264812), 87=SubSystem Name: Switch Module For Rear Seat Driver Side (TTR249612), 253=SubSystem Name: Valve Block 4 In Passenger Side Rear Seat (TTR265112), 526=SubSystem Name: Valve Block 6 In Passenger Side Front Seat (TTR908711), 259=SubSystem Name: Refrigerant Expansion Valve 2 (TTR265612), 353=SubSystem Name: Gauge Outside Air Temperature (TTR274812), 140=SubSystem Name: Cup Holder With Heater And Cooling Element (TTR253812), 323=SubSystem Name: Media Connector (TTR271812), 273=SubSystem Name: Sunlight Sensor 2 (TTR267012), 304=SubSystem Name: Side Sensor A-Pillar Driver Front (TTR269912), 312=SubSystem Name: Gear Selector Control Module (TTR270712), 487=SubSystem Name: Application Sub Server 3 Chassis OBD (TTR906911), 210=SubSystem Name: Cell Module Controller 2 (TTR260812), 371=SubSystem Name: Seat Allocation Detection 3 (TTR276612), 90=SubSystem Name: Battery Charger Unit 1 (TTR249912), 124=SubSystem Name: Operating Unit Center Console 3 (TTR252812), 234=SubSystem Name: Media Player 2 Sub (TTR263212), 298=SubSystem Name: Cooler Fan 1 (TTR269312), 199=SubSystem Name: Seat Cushion Fan 1 Front Right (TTR259712), 453=SubSystem Name: Rear Light Left 4 (TTR281612), 226=SubSystem Name: Seat Backrest Fan 2 Rear Right (TTR262412), 264=SubSystem Name: Refrigerant Shut Off Valve 4 (TTR266112), 319=SubSystem Name: Front Climatronic Operating And Display Unit (TTR271412), 306=SubSystem Name: Sensor High Voltage System 1 (TTR270112), 451=SubSystem Name: Rear Light Left 3 (TTR281412), 494=SubSystem Name: Front Camera 3 (TTR907611), 248=SubSystem Name: Manual Transmission Fluid Pump (TTR264612), 81=SubSystem Name: Rear Spoiler Adjustment (TTR249012), 30=SubSystem Name: Interior Light Module (TTR243312), 201=SubSystem Name: Operating And Display Unit 1 For Air Conditioning (TTR259912), 76=SubSystem Name: Drivers Door Rear Control Module (TTR248512), 474=SubSystem Name: Hydrogen Sensor 1 (TTR283512), 344=SubSystem Name: Interior Temperature Sensor (TTR273912), 307=SubSystem Name: Side Sensor B-Pillar Driver Front (TTR270212), 364=SubSystem Name: Area View Camera Slave Right (TTR275912), 63=SubSystem Name: Air Quality Sensor (TTR247212), 178=SubSystem Name: Valve Block 2 In Driver Side Rear Seat (TTR257612), 538=SubSystem Name: Sub System 2 Driver Assistance Extended (TTR909911), 449=SubSystem Name: Kessy Slave Inside (TTR281212), 535=SubSystem Name: Radar Sensor Rear Left (TTR909611), 303=SubSystem Name: Operating Unit Drive Mode Selection (TTR269812), 335=SubSystem Name: Display Lane Change Assistent Right (TTR273012), 463=SubSystem Name: Application Sub Server 4 Chassis (TTR282612), 179=SubSystem Name: Valve Block 3 In Driver Side Rear Seat (TTR257712), 198=SubSystem Name: Seat Backrest Fan 2 Front Right (TTR259612), 2=SubSystem Name: Rain Light Recognition Sensor (TTR240512), 121=SubSystem Name: Data Medium 2 (TTR252512), 96=SubSystem Name: Switch Module 2 For Front Passenger Seat (TTR250512), 255=SubSystem Name: Valve Block 4 In Passenger Side Front Seat (TTR265312), 337=SubSystem Name: Coolant Valve 5 (TTR273212), 475=SubSystem Name: Hydrogen Sensor 2 (TTR905711), 125=SubSystem Name: Operating Unit Center Console 4 (TTR252912), 65=SubSystem Name: Telephone Handset 2 (TTR247412), 477=SubSystem Name: Hydrogen Sensor 4 (TTR905911), 468=SubSystem Name: Digital Sound System Control Module 3 (TTR912811), 317=SubSystem Name: Control Unit Ride Control System (TTR271212), 373=SubSystem Name: Seat Allocation Detection 5 (TTR276812), 454=SubSystem Name: Rear Light Right 4 (TTR281712), 455=SubSystem Name: Rear Light Left 5 (TTR281812), 84=SubSystem Name: Voltage Stabilizer (TTR249312), 71=SubSystem Name: Multimedia Operating Unit (TTR248012), 112=SubSystem Name: Rear Brake Actuator 1 (TTR252112), 541=SubSystem Name: Sub System Driver Assistance 2 (TTR910211), 213=SubSystem Name: Cell Module Controller 5 (TTR261112), 60=SubSystem Name: Pitch Rate Sender (TTR246912), 9=SubSystem Name: Left Rear Seat Ventilation Control Module (TTR241212), 220=SubSystem Name: Cell Module Controller 12 (TTR261812), 161=SubSystem Name: Side Sensor Passenger Front (TTR255912), 352=SubSystem Name: Button Seat Heating Rear (TTR274712), 260=SubSystem Name: Refrigerant Expansion Valve 3 (TTR265712), 361=SubSystem Name: Ignition Key 3 (TTR275612), 72=SubSystem Name: Digital Sound System Control Module 2 (TTR248112), 88=SubSystem Name: Switch Module For Rear Seat Front Passenger Side (TTR249712), 416=SubSystem Name: Theft Protection Antenna 2 (TTR278912), 540=SubSystem Name: Sub System 4 Driver Assistance Extended (TTR910111), 104=SubSystem Name: Door Handle Rear Right Kessy (TTR251312), 86=SubSystem Name: Switch Module For Front Passenger Seat (TTR249512), 363=SubSystem Name: Area View Camera Slave Left (TTR275812), 349=SubSystem Name: Remote Control Remote Start (TTR274412), 95=SubSystem Name: Neck Heating Right (TTR250412), 279=SubSystem Name: Sub System Driver Assistance (TTR911811), 272=SubSystem Name: Rear Light Right 2 (TTR266912), 36=SubSystem Name: Heated Windshield Control Module (TTR244012), 338=SubSystem Name: Coolant Valve 6 (TTR273312), 515=SubSystem Name: Door Handle Outside Actuation Rear Passenger Side (TTR908111), 168=SubSystem Name: Rear Sensor Center (TTR256612), 237=SubSystem Name: Refrigerant Pressure And Temperature Sender 5 (TTR263512), 64=SubSystem Name: Display Unit 2 For Multimedia System (TTR247312), 316=SubSystem Name: Control Unit E-Traction (TTR271112), 5=SubSystem Name: Garage Door Opener Operating Unit (TTR240812), 62=SubSystem Name: Electronic Ignition Lock (TTR247112), 42=SubSystem Name: Belt Pretensioner Left (TTR244612), 235=SubSystem Name: Dedicated Short Range Communication Aerial (TTR263312), 445=SubSystem Name: Kessy Slave Front Right (TTR280812), 109=SubSystem Name: High Beam Powermodule Left (TTR251812), 382=SubSystem Name: Display Vehicle Log (TTR277512), 41=SubSystem Name: Control Module For Auxiliary Air Heater (TTR244812), 284=SubSystem Name: Electric System Disconnection Diode (TTR267912), 52=SubSystem Name: Left Rear Massage Seat Control Module (TTR246112), 457=SubSystem Name: Application Sub Server 1 Power Train OBD (TTR282012), 436=SubSystem Name: Oil Pump Coolant Axle 2 (TTR280212), 135=SubSystem Name: Belt Pretensioner 3rd Row Right (TTR253312), 190=SubSystem Name: Valve Block 2 In Passenger Side Front Seat (TTR258812), 51=SubSystem Name: Right Rear Door Control Module (TTR246012), 421=SubSystem Name: Theft Protection Antenna 7 (TTR279412), 281=SubSystem Name: Radio Interface (TTR267612), 183=SubSystem Name: Valve Block 3 In Passenger Side Rear Seat (TTR258112), 456=SubSystem Name: Rear Light Right 5 (TTR281912), 143=SubSystem Name: Cradle Rear Climatronic Operating And Display Unit (TTR254112), 25=SubSystem Name: Automatic Day Night Interior Mirror (TTR242812), 417=SubSystem Name: Theft Protection Antenna 3 (TTR279012), 315=SubSystem Name: Multimedia Extension (TTR271012), 458=SubSystem Name: Application Sub Server 2 Power Train OBD (TTR282112), 73=SubSystem Name: Electrically Adjustable Steering Column (TTR248212), 340=SubSystem Name: Coolant Valve 8 (TTR273512), 396=SubSystem Name: Coolant Pump 4 (TTR278312), 91=SubSystem Name: Battery Charger Unit 2 (TTR250012), 145=SubSystem Name: Sensor Carbon Dioxide Concentration (TTR254312), 289=SubSystem Name: Electrical Variable Camshaft Phasing 2 (TTR268412), 7=SubSystem Name: Left Front Seat Ventilation Control Module (TTR241012), 167=SubSystem Name: Pedestrian Protection Passenger (TTR256512), 471=SubSystem Name: Pressure Sensor Filter Saturation (TTR283212), 110=SubSystem Name: High Beam Powermodule Right (TTR251912), 50=SubSystem Name: Left Rear Door Control Module (TTR245912), 447=SubSystem Name: Kessy Slave Rear Right (TTR281012), 257=SubSystem Name: Rear Climatronic Operating And Display Unit (TTR265412), 137=SubSystem Name: Steering Column Switch (TTR253512), 400=SubSystem Name: Virtual Pedal Door Opening Rear Driver Side (TTR278612), 111=SubSystem Name: Air Suspension Compressor (TTR252012), 206=SubSystem Name: Pedestrian Protection Left Hand Side (TTR260412), 158=SubSystem Name: Operating And Display Unit 4 (TTR255612), 214=SubSystem Name: Cell Module Controller 6 (TTR261212), 194=SubSystem Name: Seat Backrest Fan 2 Front Left (TTR259212), 484=SubSystem Name: Sub System 4 Driver Assistance (TTR906611), 551=SubSystem Name: Signal Light Front Left (TTR911211), 208=SubSystem Name: Battery Junction Box (TTR260612), 514=SubSystem Name: Door Handle Outside Actuation Rear Driver Side (TTR908011), 67=SubSystem Name: Traffic Data Aerial (TTR247612), 180=SubSystem Name: Switch For Rear Multicontour Seat Passenger Side (TTR257812), 529=SubSystem Name: Valve Block 5 In Passenger Side Rear Seat (TTR909011), 444=SubSystem Name: Kessy Slave Front Left (TTR280712), 271=SubSystem Name: Rear Light Right 1 (TTR266812), 384=SubSystem Name: Air Conditioning Compressor Sub 2 (TTR277712), 368=SubSystem Name: Mascot Motor (TTR276312), 231=SubSystem Name: Infrared Sender For Front Observation Module (TTR262912), 331=SubSystem Name: Control Unit Exit Warning Front Right (TTR272612), 348=SubSystem Name: Ventilation Pump (TTR274312), 177=SubSystem Name: Valve Block 1 In Driver Side Rear Seat (TTR257512), 459=SubSystem Name: Application Sub Server 1 Power Train (TTR282212), 420=SubSystem Name: Theft Protection Antenna 6 (TTR279312), 218=SubSystem Name: Cell Module Controller 10 (TTR261612), 544=SubSystem Name: Sub System 4 Driver Assistance 2 (TTR910511), 217=SubSystem Name: Cell Module Controller 9 (TTR261512), 369=SubSystem Name: Seat Allocation Detection 1 (TTR276412), 19=SubSystem Name: Front Passengers Door Control Module (TTR242212), 108=SubSystem Name: Matrix Headlamp Powermodule 1 Right (TTR251712), 163=SubSystem Name: Side Sensor Passenger Rear (TTR256112), 347=SubSystem Name: Door Control Panel Driver Side (TTR274212), 282=SubSystem Name: Video Self Protection Recorder (TTR267712), 441=SubSystem Name: Aerodynamics Control Unit 2 (TTR912511), 94=SubSystem Name: Neck Heating Left (TTR250312), 173=SubSystem Name: Central Sensor XY (TTR257112), 188=SubSystem Name: Switch For Front Multicontour Seat Passenger Side (TTR258612), 531=SubSystem Name: AC/DC Charger (TTR909211), 122=SubSystem Name: Operating Unit Center Console 1 (TTR252612), 292=SubSystem Name: Front Windshield Washer Pump (TTR268712), 207=SubSystem Name: Pedestrian Protection Right Hand Side (TTR260512), 69=SubSystem Name: Telephone Handset (TTR247812), 261=SubSystem Name: Refrigerant Shut Off Valve 1 (TTR265812), 56=SubSystem Name: Roof Blind (TTR246512), 301=SubSystem Name: Control Unit Heating 3 (TTR269612), 480=SubSystem Name: Application Sub Server Central RxSWIN (TTR906211), 285=SubSystem Name: Cradle Rear Climatronic Operating And Display Unit 2 (TTR268012), 215=SubSystem Name: Cell Module Controller 7 (TTR261312), 263=SubSystem Name: Refrigerant Shut Off Valve 3 (TTR266012), 31=SubSystem Name: Refrigerant Pressure And Temperature Sender (TTR243412), 435=SubSystem Name: Oil Pump Coolant Axle 1 (TTR280112), 4=SubSystem Name: Garage Door Opener Control Module (TTR240712), 532=SubSystem Name: Photovoltaic Regulator (TTR909311), 383=SubSystem Name: Active Oil Separator (TTR277612), 390=SubSystem Name: Side Camera Rear Right (TTR912211), 367=SubSystem Name: Gauge Oil Temperature (TTR276212), 53=SubSystem Name: Right Rear Massage Seat Control Module (TTR246212), 460=SubSystem Name: Application Sub Server 1 Chassis (TTR282312), 243=SubSystem Name: Cell Module Controller 15 (TTR264112), 274=SubSystem Name: Radiator Shutter (TTR267112), 327=SubSystem Name: Coolant Valve 1 (TTR272212), 6=SubSystem Name: Ignition Key (TTR240912), 490=SubSystem Name: Ignition System Box 2 (TTR907211), 233=SubSystem Name: Media Player 1 Sub (TTR263112), 486=SubSystem Name: Application Sub Server Central 4 (TTR906811), 366=SubSystem Name: Control Unit 2 For Wiper Motor (TTR276112), 197=SubSystem Name: Seat Backrest Fan 1 Front Right (TTR259512), 0=SubSystem Name: reserved (TTR240312), 37=SubSystem Name: Rear Light Left 1 (TTR244212), 320=SubSystem Name: Auxiliary Display Unit (TTR271512), 89=SubSystem Name: Switch Module 2 For Driver Seat (TTR249812), 29=SubSystem Name: Alternator (TTR243212), 552=SubSystem Name: Signal Light Front Right (TTR911311), 440=SubSystem Name: Sensor 1 Cell Voltage (TTR280612), 318=SubSystem Name: Control Unit Hands On Detection Steering Wheel (TTR271312), 203=SubSystem Name: Operating And Display Unit 3 For Air Conditioning (TTR260112), 472=SubSystem Name: Rear Light Left 6 (TTR283312), 92=SubSystem Name: Battery Charger Unit 3 (TTR250112), 149=SubSystem Name: Belt Buckle Presenter 2nd Row Right (TTR254712), 48=SubSystem Name: Ioniser (TTR245712), 280=SubSystem Name: Special Key Operating Unit (TTR267512), 254=SubSystem Name: Valve Block 4 In Driver Side Front Seat (TTR265212), 427=SubSystem Name: Gear Shift Operating Unit (TTR279612), 523=SubSystem Name: Valve Block 5 In Driver Side Front Seat (TTR908411), 24=SubSystem Name: Alarm Horn (TTR242712), 44=SubSystem Name: Occupant Detection (TTR245312), 357=SubSystem Name: Refrigerant Expansion Valve 4 (TTR275212), 362=SubSystem Name: Area View Camera Slave Front (TTR275712), 414=SubSystem Name: Virtual Pedal Door Opening Rear Passenger Side (TTR278712), 223=SubSystem Name: Seat Cushion Fan 1 Rear Left (TTR262112), 182=SubSystem Name: Valve Block 2 In Passenger Side Rear Seat (TTR258012), 251=SubSystem Name: Air Coolant Actuator 3 (TTR264912), 159=SubSystem Name: Operating And Display Unit 5 (TTR255712), 185=SubSystem Name: Valve Block 1 In Driver Side Front Seat (TTR258312), 437=SubSystem Name: Telephone Unit (TTR280312), 547=SubSystem Name: Sub System 3 Driver Assistance 2 Extended (TTR910811), 332=SubSystem Name: Control Unit Exit Warning Front Left (TTR272712), 355=SubSystem Name: Picnic Table Rear Driver Side (TTR275012), 391=SubSystem Name: Rear Camera (TTR912311), 485=SubSystem Name: Application Sub Server Central 3 (TTR906711), 170=SubSystem Name: Pedestrian Protection Contact (TTR256812), 247=SubSystem Name: Automatic Transmission Fluid Pump (TTR264512), 61=SubSystem Name: ESP Sensor Unit (TTR247012), 419=SubSystem Name: Theft Protection Antenna 5 (TTR279212), 100=SubSystem Name: Rear Climatronic Operating And Display Unit Right (TTR250912), 378=SubSystem Name: Switch Charge Indicator Flap 2 Charge Plug Connector (TTR277312), 164=SubSystem Name: Front Sensor Driver (TTR256212), 527=SubSystem Name: Valve Block 5 In Driver Side Rear Seat (TTR908811), 336=SubSystem Name: Display Lane Change Assistent Left (TTR273112), 15=SubSystem Name: Operating And Display Unit 2 (TTR241812), 265=SubSystem Name: Refrigerant Shut Off Valve 5 (TTR266212), 136=SubSystem Name: Injection Valve Heater Control Unit (TTR253412), 13=SubSystem Name: LED Headlamp Powermodule 2 Right (TTR241612), 222=SubSystem Name: Seat Backrest Fan 2 Rear Left (TTR262012), 49=SubSystem Name: Multi Function Steering Wheel Control Module (TTR245812), 154=SubSystem Name: Display Unit 4 For Multimedia System (TTR255212), 479=SubSystem Name: Sub System 3 Driver Assistance (TTR906111), 389=SubSystem Name: Side Camera Rear Left (TTR912111), 184=SubSystem Name: Switch For Front Multicontour Seat Driver Side (TTR258212), 467=SubSystem Name: Door Actuator Rear Passenger Side (TTR283012), 85=SubSystem Name: Switch Module For Driver Seat (TTR249412), 57=SubSystem Name: Sun Roof 2 (TTR246612), 209=SubSystem Name: Cell Module Controller 1 (TTR260712), 446=SubSystem Name: Kessy Slave Rear Left (TTR280912), 433=SubSystem Name: HV Battery Monitoring Control Module 1 (TTR279912), 146=SubSystem Name: Sensor Fine Dust Concentration (TTR254412), 300=SubSystem Name: Control Unit Heating 2 (TTR269512), 537=SubSystem Name: Sub System Driver Assistance Extended (TTR909811), 461=SubSystem Name: Application Sub Server 2 Chassis (TTR282412), 212=SubSystem Name: Cell Module Controller 4 (TTR261012), 93=SubSystem Name: Air Conditioning Compressor Sub (TTR250212), 290=SubSystem Name: Wireless Operating Unit 1 (TTR268512), 126=SubSystem Name: Interface For Radiodisplay (TTR253012), 241=SubSystem Name: Cell Module Controller 13 (TTR263912), 520=SubSystem Name: Emblem Illumination 2 (TTR908311), 276=SubSystem Name: Radiator Shutter 3 (TTR267312), 101=SubSystem Name: Door Handle Front Left Kessy (TTR251012), 258=SubSystem Name: Refrigerant Expansion Valve 1 (TTR265512), 548=SubSystem Name: Sub System 4 Driver Assistance 2 Extended (TTR910911), 539=SubSystem Name: Sub System 3 Driver Assistance Extended (TTR910011), 476=SubSystem Name: Hydrogen Sensor 3 (TTR905811), 294=SubSystem Name: Fragrancing System (TTR268912), 268=SubSystem Name: Clutch Control Unit Sub (TTR266512), 171=SubSystem Name: Pedestrian Protection Driver 2 (TTR256912), 489=SubSystem Name: Ignition System Box 1 (TTR907111), 114=SubSystem Name: Analog Clock (TTR252312), 311=SubSystem Name: Cooler Fan 2 (TTR270612), 10=SubSystem Name: LED Headlamp Powermodule Left (TTR241312), 313=SubSystem Name: Interior Light Module 2 (TTR270812), 372=SubSystem Name: Seat Allocation Detection 4 (TTR276712), 393=SubSystem Name: Coolant Pump 1 (TTR278012), 481=SubSystem Name: Sub System Digital Matrix Light (TTR906311)}
    diagnostic-parameter bit-offset=32:
      diagnostic data element Identification_0x0252_Slave_list_data_set_description_Data_set_ID: base-type=uint16  # Parameters: Data_set_ID
    diagnostic-parameter bit-offset=48:
      diagnostic data element Identification_0x0252_Slave_list_data_set_description_Data_set_name: array-size-semantics=FIXED-SIZE, max-number-of-elements=12, base-type=uint8  # Parameters: Data_set_name
    diagnostic-parameter bit-offset=144:
      diagnostic data element Identification_0x0252_Slave_list_data_set_description_Data_set_version: array-size-semantics=FIXED-SIZE, max-number-of-elements=4, base-type=uint8  # Parameters: Data_set_version
    diagnostic-parameter bit-offset=176:
      diagnostic data element Identification_0x0252_Slave_list_data_set_description_data_set_valid_data_set_plausible_data_set_used_by_applica974C89D: base-type=uint8, compu {0=data_set_valid: no; data_set_plausible: no; data_set_used_by_application: no (TTR199814TTR199814TTR199814), 1=data_set_valid: yes (TTR199914), 2=data_set_plausible: yes (TTR199914), 4=data_set_used_by_application: yes (TTR199914)}  # Parameters: data_set_valid / data_set_plausible / data_set_used_by_application / Reserved
  diagnostic read data by identifier ReadSlaveListDataSetDescription: access-permission=READ0x01DefaultSession0x03ExtendedSession, data-identifier=SlaveListDataSetDescription, read-class=DiagnosticReadDataByIdentifierClass  # Read_Slave_list_data_set_description
package /ZeC/DataIdentifiers/Identification/VW_Logical_Software_Block_Lock_Value
  diagnostic data identifier VWLogicalSoftwareBlockLockValue: id=0x040f, represents-vin=false  # VW Logical Software Block Lock Value
    diagnostic-parameter bit-offset=0:
      diagnostic data element Identification_0x040f_VW_Logical_Software_Block_Lock_Value_data_block_00: base-type=uint16  # Parameters: data block 00
  diagnostic read data by identifier ReadVWLogicalSoftwareBlockLockValue: access-permission=READ0x01DefaultSession0x02ProgrammingSession0x03ExtendedSession, data-identifier=VWLogicalSoftwareBlockLockValue, read-class=DiagnosticReadDataByIdentifierClass  # Read_VW Logical Software Block Lock Value
package /ZeC/DataIdentifiers/Identification/Slave_list_configuration_hash
  diagnostic data identifier SlaveListConfigurationHash: id=0x0248, represents-vin=false  # Slave_list_configuration_hash
    diagnostic-parameter bit-offset=0:
      diagnostic data element Identification_0x0248_Slave_list_configuration_hash_Number_Of_Expected_SubSystem_Identification: base-type=uint8  # Parameters: Number Of Expected SubSystem Identification
    diagnostic-parameter bit-offset=8:
      diagnostic data element Identification_0x0248_Slave_list_configuration_hash_Number_Of_Retrieved_SubSystem_Identification: base-type=uint8  # Parameters: Number Of Retrieved SubSystem Identification
    diagnostic-parameter bit-offset=16:
      diagnostic data element Identification_0x0248_Slave_list_configuration_hash_SubSystem_Node_Address_SubSystem_Name_Configuration_hash: array-size-semantics=VARIABLE-SIZE, max-number-of-elements=1700, base-type=uint8  # Parameters: SubSystem Node Address / SubSystem Name / Configuration_hash
  diagnostic read data by identifier ReadSlaveListConfigurationHash: access-permission=READ0x01DefaultSession0x03ExtendedSession, data-identifier=SlaveListConfigurationHash, read-class=DiagnosticReadDataByIdentifierClass  # Read_Slave_list_configuration_hash
package /ZeC/DataIdentifiers/Identification/Programming_hash
  diagnostic data identifier ProgrammingHash: id=0x0249, represents-vin=false  # Programming_hash
    diagnostic-parameter bit-offset=0:
      diagnostic data element Identification_0x0249_Programming_hash_Programming_hash: array-size-semantics=FIXED-SIZE, max-number-of-elements=32, base-type=uint8  # Parameters: Programming_hash
  diagnostic read data by identifier ReadProgrammingHash: access-permission=READ0x01DefaultSession0x03ExtendedSession, data-identifier=ProgrammingHash, read-class=DiagnosticReadDataByIdentifierClass  # Read_Programming_hash
package /ZeC/DataIdentifiers/Identification/Slave_list_programming_hash
  diagnostic data identifier SlaveListProgrammingHash: id=0x0247, represents-vin=false  # Slave_list_programming_hash
    diagnostic-parameter bit-offset=0:
      diagnostic data element Identification_0x0247_Slave_list_programming_hash_Number_Of_Expected_SubSystem_Identification: base-type=uint8  # Parameters: Number Of Expected SubSystem Identification
    diagnostic-parameter bit-offset=8:
      diagnostic data element Identification_0x0247_Slave_list_programming_hash_Number_Of_Retrieved_SubSystem_Identification: base-type=uint8  # Parameters: Number Of Retrieved SubSystem Identification
    diagnostic-parameter bit-offset=16:
      diagnostic data element Identification_0x0247_Slave_list_programming_hash_SubSystem_Node_Address_SubSystem_Name_Programming_hash: array-size-semantics=VARIABLE-SIZE, max-number-of-elements=1700, base-type=uint8  # Parameters: SubSystem Node Address / SubSystem Name / Programming_hash
  diagnostic read data by identifier ReadSlaveListProgrammingHash: access-permission=READ0x01DefaultSession0x03ExtendedSession, data-identifier=SlaveListProgrammingHash, read-class=DiagnosticReadDataByIdentifierClass  # Read_Slave_list_programming_hash
package /ZeC/DataIdentifiers/Identification/Software_composition_list
  diagnostic data identifier SoftwareCompositionList: id=0x0442, represents-vin=false  # Software_composition_list
    diagnostic-parameter bit-offset=0:
      diagnostic data element Identification_0x0442_Software_composition_list_SWCO_1_Sollverbau_SWCO_2_Sollverbau_SWCO_3_Sollverbau_SWCO_4_SolD98F182: array-size-semantics=VARIABLE-SIZE, max-number-of-elements=8, base-type=uint8  # Parameters: SWCO 1 (Sollverbau) / SWCO 2 (Sollverbau) / SWCO 3 (Sollverbau) / SWCO 4 (Sollverbau) / SWCO 5 (Sollverbau) / SWCO 6 (Sollverbau) / SWCO 7 (Sollverbau) / SWCO 8 (Sollverbau)
  diagnostic read data by identifier ReadSoftwareCompositionList: access-permission=READ0x01DefaultSession0x03ExtendedSession, data-identifier=SoftwareCompositionList, read-class=DiagnosticReadDataByIdentifierClass  # Read_Software_composition_list
  diagnostic write data by identifier WriteSoftwareCompositionList: access-permission=WRITEE2eSFDMode0x03ExtendedSession, data-identifier=SoftwareCompositionList, write-class=DiagnosticWriteDataByIdentifierClass  # Write_Software_composition_list
package /ZeC/DataIdentifiers/Identification/Configuration_hash
  diagnostic data identifier ConfigurationHash: id=0x0245, represents-vin=false  # Configuration_hash
    diagnostic-parameter bit-offset=0:
      diagnostic data element Identification_0x0245_Configuration_hash_Configuration_hash: array-size-semantics=FIXED-SIZE, max-number-of-elements=32, base-type=uint8  # Parameters: Configuration_hash
  diagnostic read data by identifier ReadConfigurationHash: access-permission=READ0x01DefaultSession0x03ExtendedSession, data-identifier=ConfigurationHash, read-class=DiagnosticReadDataByIdentifierClass  # Read_Configuration_hash
package /ZeC/DataIdentifiers/Identification/SWCO_list_sw_version_number
  diagnostic data identifier SWCOListSwVersionNumber: id=0x0124, represents-vin=false  # SWCO_list_sw_version_number
    diagnostic-parameter bit-offset=0:
      diagnostic data element Identification_0x0124_SWCO_list_sw_version_number_Major_Version_Number_Minor_Version_Number_Patch_Version_Number: array-size-semantics=VARIABLE-SIZE, max-number-of-elements=96, base-type=uint8  # Parameters: Major Version Number / Minor Version Number / Patch Version Number
  diagnostic read data by identifier ReadSWCOListSwVersionNumber: access-permission=READ0x01DefaultSession0x03ExtendedSession, data-identifier=SWCOListSwVersionNumber, read-class=DiagnosticReadDataByIdentifierClass  # Read_SWCO_list_sw_version_number
package /ZeC/DataIdentifiers/Identification/VW_LIN_Identification_Table
  diagnostic data identifier VWLINIdentificationTable: id=0x0760, represents-vin=false  # VW LIN Identification Table
    diagnostic-parameter bit-offset=0:
      diagnostic data element Identification_0x0760_VW_LIN_Identification_Table_LIN_Slave_Class_0_Product_ID: array-size-semantics=FIXED-SIZE, max-number-of-elements=5, base-type=uint8  # Parameters: LIN Slave Class 0 Product-ID
    diagnostic-parameter bit-offset=40:
      diagnostic data element Identification_0x0760_VW_LIN_Identification_Table_LIN_Bus_Segment: base-type=uint8, compu {0=LIN-Bus Segment: reserved (TTR228712), 6=LIN-Bus Segment: LIN Segment 6 (TTR229312), 2=LIN-Bus Segment: LIN Segment 2 (TTR228912), 1=LIN-Bus Segment: LIN Segment 1 (TTR228812), 255=LIN-Bus Segment: not_available (TTR229412), 3=LIN-Bus Segment: LIN Segment 3 (TTR229012), 4=LIN-Bus Segment: LIN Segment 4 (TTR229112), 5=LIN-Bus Segment: LIN Segment 5 (TTR229212)}  # Parameters: LIN-Bus Segment
    diagnostic-parameter bit-offset=48:
      diagnostic data element Identification_0x0760_VW_LIN_Identification_Table_LIN_Slave_Node_Address: base-type=uint8  # Parameters: LIN Slave Node Address
  diagnostic read data by identifier ReadVWLINIdentificationTable: access-permission=READ0x01DefaultSession0x03ExtendedSession, data-identifier=VWLINIdentificationTable, read-class=DiagnosticReadDataByIdentifierClass  # Read_VW LIN Identification Table
package /ZeC/DataIdentifiers/Identification/Software_composition_list_nr
  diagnostic data identifier SoftwareCompositionListNr: id=0x0441, represents-vin=false  # Software_composition_list_nr
    diagnostic-parameter bit-offset=0:
      diagnostic data element Identification_0x0441_Software_composition_list_nr_SWCO_1_SWCO_number_Byte_1_SWCO_1_SWCO_number_Byte_2_SWCO_1_SW3206DD0: array-size-semantics=VARIABLE-SIZE, max-number-of-elements=64, base-type=uint8  # Parameters: SWCO#1 (SWCO_number) Byte 1 / SWCO#1 (SWCO_number) Byte 2 / SWCO#1 (SWCO_number) Byte 3 / SWCO#1 (SWCO_number) Byte 4 / SWCO#1 (SWCO_number) Byte 5 / SWCO#1 (SWCO_number) Byte 6 / SWCO#1 (SWCO_number) Byte 7 / SWCO#1 (SWCO_number) Byte 8
  diagnostic read data by identifier ReadSoftwareCompositionListNr: access-permission=READ0x01DefaultSession0x03ExtendedSession, data-identifier=SoftwareCompositionListNr, read-class=DiagnosticReadDataByIdentifierClass  # Read_Software_composition_list_nr
package /ZeC/DataIdentifiers/Identification/JIT_Mio_Number
  diagnostic data identifier JITMioNumber: id=0x49bb, represents-vin=false  # JIT-Mio_Number
    diagnostic-parameter bit-offset=0:
      diagnostic data element Identification_0x49bb_JIT_Mio_Number_VNR: array-size-semantics=FIXED-SIZE, max-number-of-elements=3, base-type=uint8  # Parameters: VNR
    diagnostic-parameter bit-offset=24:
      diagnostic data element Identification_0x49bb_JIT_Mio_Number_MGR: array-size-semantics=FIXED-SIZE, max-number-of-elements=3, base-type=uint8  # Parameters: MGR
    diagnostic-parameter bit-offset=48:
      diagnostic data element Identification_0x49bb_JIT_Mio_Number_ENR: array-size-semantics=FIXED-SIZE, max-number-of-elements=3, base-type=uint8  # Parameters: ENR
    diagnostic-parameter bit-offset=72:
      diagnostic data element Identification_0x49bb_JIT_Mio_Number_Index: array-size-semantics=FIXED-SIZE, max-number-of-elements=2, base-type=uint8  # Parameters: Index
  diagnostic read data by identifier ReadJITMioNumber: access-permission=READ0x01DefaultSession0x03ExtendedSession, data-identifier=JITMioNumber, read-class=DiagnosticReadDataByIdentifierClass  # Read_JIT-Mio_Number
package /ZeC/DataIdentifiers/Identification/VW_Logical_Software_Block_Counter_Of_Programming_Attempts
  diagnostic data identifier VWLogicalSoftwareBlockCounterOfProgrammingAttempts: id=0x0407, represents-vin=false  # VW Logical Software Block Counter Of Programming Attempts
    diagnostic-parameter bit-offset=0:
      diagnostic data element Identification_0x0407_VW_Logical_Software_Block_Counter_Of_Programming_Attempts_data_block_00: base-type=uint16  # Parameters: data block 00
  diagnostic read data by identifier ReadVWLogicalSoftwareBlockCounterOfProgrammingAttempts: access-permission=READ0x01DefaultSession0x02ProgrammingSession0x03ExtendedSession, data-identifier=VWLogicalSoftwareBlockCounterOfProgrammingAttempts, read-class=DiagnosticReadDataByIdentifierClass  # Read_VW Logical Software Block Counter Of Programming Attempts
package /ZeC/DataIdentifiers/Identification/Programming_preconditions
  diagnostic data identifier ProgrammingPreconditions: id=0x0448, represents-vin=false  # Programming_preconditions
    diagnostic-parameter bit-offset=0:
      diagnostic data element Identification_0x0448_Programming_preconditions_Number_of_Programming_preconditions: base-type=uint8  # Parameters: Number_of_Programming_preconditions
    diagnostic-parameter bit-offset=8:
      diagnostic data element Identification_0x0448_Programming_preconditions_Programming_preconditions: array-size-semantics=VARIABLE-SIZE, max-number-of-elements=8, base-type=uint8  # Parameters: Programming_preconditions
  diagnostic read data by identifier ReadProgrammingPreconditions: access-permission=READ0x01DefaultSession0x02ProgrammingSession0x03ExtendedSession, data-identifier=ProgrammingPreconditions, read-class=DiagnosticReadDataByIdentifierClass  # Read_Programming_preconditions
package /ZeC/DataIdentifiers/Identification/Slave_component_list
  diagnostic data identifier SlaveComponentList: id=0x061a, represents-vin=false  # Slave_component_list
    diagnostic-parameter bit-offset=0:
      diagnostic data element Identification_0x061a_Slave_component_list_SubSystem_coded_Bit_0_SubSystem_coded_Bit_1_SubSystem_coded_Bit_2_Sub6C9418D: array-size-semantics=VARIABLE-SIZE, max-number-of-elements=32, base-type=uint8  # Parameters: SubSystem coded Bit 0 / SubSystem coded Bit 1 / SubSystem coded Bit 2 / SubSystem coded Bit 3 / SubSystem coded Bit 4 / SubSystem coded Bit 5 / SubSystem coded Bit 6 / SubSystem coded Bit 7
  diagnostic read data by identifier ReadSlaveComponentList: access-permission=READ0x01DefaultSession0x03ExtendedSession, data-identifier=SlaveComponentList, read-class=DiagnosticReadDataByIdentifierClass  # Read_Slave_component_list
  diagnostic write data by identifier WriteSlaveComponentList: access-permission=WRITEE2eSFDMode0x03ExtendedSession, data-identifier=SlaveComponentList, write-class=DiagnosticWriteDataByIdentifierClass  # Write_Slave_component_list
package /ZeC/DataIdentifiers/Identification/Slave_component_list_databus_identification
  diagnostic data identifier SlaveComponentListDatabusIdentification: id=0x061b, represents-vin=false  # Slave_component_list_databus_identification
    diagnostic-parameter bit-offset=0:
      diagnostic data element Identification_0x061b_Slave_component_list_databus_identification_Bus_ID: array-size-semantics=VARIABLE-SIZE, max-number-of-elements=250, base-type=uint8  # Parameters: Bus ID
  diagnostic read data by identifier ReadSlaveComponentListDatabusIdentification: access-permission=READ0x01DefaultSession0x03ExtendedSession, data-identifier=SlaveComponentListDatabusIdentification, read-class=DiagnosticReadDataByIdentifierClass  # Read_Slave_component_list_databus_identification
package /ZeC/DataIdentifiers/Identification/Vehicle_Identification_Number
  diagnostic data identifier VehicleIdentificationNumber: id=0xf190, represents-vin=false  # Vehicle Identification Number
    diagnostic-parameter bit-offset=0:
      diagnostic data element Identification_0xf190_Vehicle_Identification_Number_Vehicle_Identification_Number: array-size-semantics=FIXED-SIZE, max-number-of-elements=17, base-type=uint8  # Parameters: Vehicle Identification Number
  diagnostic read data by identifier ReadVehicleIdentificationNumber: access-permission=READ0x01DefaultSession0x02ProgrammingSession0x03ExtendedSession, data-identifier=VehicleIdentificationNumber, read-class=DiagnosticReadDataByIdentifierClass  # Read_Vehicle Identification Number
package /ZeC/DataIdentifiers/Identification/VW_ECU_Hardware_Number
  diagnostic data identifier VWECUHardwareNumber: id=0xf191, represents-vin=false  # VW ECU Hardware Number
    diagnostic-parameter bit-offset=0:
      diagnostic data element Identification_0xf191_VW_ECU_Hardware_Number_Vornummer: array-size-semantics=FIXED-SIZE, max-number-of-elements=3, base-type=uint8  # Parameters: Vornummer
    diagnostic-parameter bit-offset=24:
      diagnostic data element Identification_0xf191_VW_ECU_Hardware_Number_Mittelgruppe: array-size-semantics=FIXED-SIZE, max-number-of-elements=3, base-type=uint8  # Parameters: Mittelgruppe
    diagnostic-parameter bit-offset=48:
      diagnostic data element Identification_0xf191_VW_ECU_Hardware_Number_Endnummer: array-size-semantics=FIXED-SIZE, max-number-of-elements=3, base-type=uint8  # Parameters: Endnummer
    diagnostic-parameter bit-offset=72:
      diagnostic data element Identification_0xf191_VW_ECU_Hardware_Number_Index: array-size-semantics=FIXED-SIZE, max-number-of-elements=2, base-type=uint8  # Parameters: Index
  diagnostic read data by identifier ReadVWECUHardwareNumber: access-permission=READ0x01DefaultSession0x02ProgrammingSession0x03ExtendedSession, data-identifier=VWECUHardwareNumber, read-class=DiagnosticReadDataByIdentifierClass  # Read_VW ECU Hardware Number
package /ZeC/DataIdentifiers/Identification/System_Supplier_ECU_Software_Version_Number
  diagnostic data identifier SystemSupplierECUSoftwareVersionNumber: id=0xf195, represents-vin=false  # System Supplier ECU Software Version Number
    diagnostic-parameter bit-offset=0:
      diagnostic data element Identification_0xf195_System_Supplier_ECU_Software_Version_Number_System_Supplier_ECU_Software_Version_Number: array-size-semantics=VARIABLE-SIZE, max-number-of-elements=64, base-type=uint8  # Parameters: System Supplier ECU Software Version Number
  diagnostic read data by identifier ReadSystemSupplierECUSoftwareVersionNumber: access-permission=READ0x01DefaultSession0x02ProgrammingSession0x03ExtendedSession, data-identifier=SystemSupplierECUSoftwareVersionNumber, read-class=DiagnosticReadDataByIdentifierClass  # Read_System Supplier ECU Software Version Number
package /ZeC/DataIdentifiers/Identification/VW_System_Name_Or_Engine_Type
  diagnostic data identifier VWSystemNameOrEngineType: id=0xf197, represents-vin=false  # VW System Name Or Engine Type
    diagnostic-parameter bit-offset=0:
      diagnostic data element Identification_0xf197_VW_System_Name_Or_Engine_Type_VW_System_Name_Or_Engine_Type: array-size-semantics=FIXED-SIZE, max-number-of-elements=13, base-type=uint8  # Parameters: VW System Name Or Engine Type
  diagnostic read data by identifier ReadVWSystemNameOrEngineType: access-permission=READ0x01DefaultSession0x03ExtendedSession, data-identifier=VWSystemNameOrEngineType, read-class=DiagnosticReadDataByIdentifierClass  # Read_VW System Name Or Engine Type
package /ZeC/DataIdentifiers/Identification/VW_Workshop_System_Name
  diagnostic data identifier VWWorkshopSystemName: id=0xf1aa, represents-vin=false  # VW Workshop System Name
    diagnostic-parameter bit-offset=0:
      diagnostic data element Identification_0xf1aa_VW_Workshop_System_Name_VW_Workshop_System_Name: array-size-semantics=FIXED-SIZE, max-number-of-elements=5, base-type=uint8  # Parameters: VW Workshop System Name
  diagnostic read data by identifier ReadVWWorkshopSystemName: access-permission=READ0x01DefaultSession0x03ExtendedSession, data-identifier=VWWorkshopSystemName, read-class=DiagnosticReadDataByIdentifierClass  # Read_VW Workshop System Name
package /ZeC/DataIdentifiers/Identification/VW_Logical_Software_Block_Version
  diagnostic data identifier VWLogicalSoftwareBlockVersion: id=0xf1ab, represents-vin=false  # VW Logical Software Block Version
    diagnostic-parameter bit-offset=0:
      diagnostic data element Identification_0xf1ab_VW_Logical_Software_Block_Version_data_block_00: array-size-semantics=FIXED-SIZE, max-number-of-elements=4, base-type=uint8  # Parameters: data block 00
  diagnostic read data by identifier ReadVWLogicalSoftwareBlockVersion: access-permission=READ0x01DefaultSession0x02ProgrammingSession0x03ExtendedSession, data-identifier=VWLogicalSoftwareBlockVersion, read-class=DiagnosticReadDataByIdentifierClass  # Read_VW Logical Software Block Version
package /ZeC/DataIdentifiers/Identification/Slave_component_list_ecu_identification
  diagnostic data identifier SlaveComponentListEcuIdentification: id=0x061c, represents-vin=false  # Slave_component_list_ecu_identification
    diagnostic-parameter bit-offset=0:
      diagnostic data element Identification_0x061c_Slave_component_list_ecu_identification_SubSystem_Node_Address: array-size-semantics=VARIABLE-SIZE, max-number-of-elements=510, base-type=uint8  # Parameters: SubSystem Node Address
  diagnostic read data by identifier ReadSlaveComponentListEcuIdentification: access-permission=READ0x01DefaultSession0x03ExtendedSession, data-identifier=SlaveComponentListEcuIdentification, read-class=DiagnosticReadDataByIdentifierClass  # Read_Slave_component_list_ecu_identification
package /ZeC/DataIdentifiers/Identification/Slave_component_list_present
  diagnostic data identifier SlaveComponentListPresent: id=0x061d, represents-vin=false  # Slave_component_list_present
    diagnostic-parameter bit-offset=0:
      diagnostic data element Identification_0x061d_Slave_component_list_present_SubSystem_present_Bit_0_SubSystem_present_Bit_1_SubSystem_pre45E847D: array-size-semantics=VARIABLE-SIZE, max-number-of-elements=32, base-type=uint8  # Parameters: SubSystem present Bit 0 / SubSystem present Bit 1 / SubSystem present Bit 3 / SubSystem present Bit 2 / SubSystem present Bit 4 / SubSystem present Bit 5 / SubSystem present Bit 6 / SubSystem present Bit 7
  diagnostic read data by identifier ReadSlaveComponentListPresent: access-permission=READ0x01DefaultSession0x03ExtendedSession, data-identifier=SlaveComponentListPresent, read-class=DiagnosticReadDataByIdentifierClass  # Read_Slave_component_list_present
package /ZeC/DataIdentifiers/Identification/AUTOSAR_standard_application_software_identification
  diagnostic data identifier AUTOSARStandardApplicationSoftwareIdentification: id=0xf1af, represents-vin=false  # AUTOSAR_standard_application_software_identification
    diagnostic-parameter bit-offset=0:
      diagnostic data element Identification_0xf1af_AUTOSAR_standard_application_software_identification_Software_ID_wrapper_: base-type=uint16  # Parameters: Software-ID (wrapper)
    diagnostic-parameter bit-offset=16:
      diagnostic data element Identification_0xf1af_AUTOSAR_standard_application_software_identification_Vendor_ID: base-type=uint16  # Parameters: Vendor-ID
    diagnostic-parameter bit-offset=32:
      diagnostic data element Identification_0xf1af_AUTOSAR_standard_application_software_identification_Version_Number: array-size-semantics=FIXED-SIZE, max-number-of-elements=3, base-type=uint8  # Parameters: Version Number
  diagnostic read data by identifier ReadAUTOSARStandardApplicationSoftwareIdentification: access-permission=READ0x01DefaultSession0x03ExtendedSession, data-identifier=AUTOSARStandardApplicationSoftwareIdentification, read-class=DiagnosticReadDataByIdentifierClass  # Read_AUTOSAR_standard_application_software_identification
package /ZeC/DataIdentifiers/Identification/Slave_list_VW_spare_part_number
  diagnostic data identifier SlaveListVWSparePartNumber: id=0x0611, represents-vin=false  # Slave_list_VW_spare_part_number
    diagnostic-parameter bit-offset=0:
      diagnostic data element Identification_0x0611_Slave_list_VW_spare_part_number_Number_Of_Expected_SubSystem_Identification: base-type=uint8  # Parameters: Number Of Expected SubSystem Identification
    diagnostic-parameter bit-offset=8:
      diagnostic data element Identification_0x0611_Slave_list_VW_spare_part_number_Number_Of_Retrieved_SubSystem_Identification: base-type=uint8  # Parameters: Number Of Retrieved SubSystem Identification
    diagnostic-parameter bit-offset=16:
      diagnostic data element Identification_0x0611_Slave_list_VW_spare_part_number_SubSystem_Node_Address: base-type=uint16  # Parameters: SubSystem Node Address
    diagnostic-parameter bit-offset=32:
      diagnostic data element Identification_0x0611_Slave_list_VW_spare_part_number_VW_Spare_Part_Number: array-size-semantics=FIXED-SIZE, max-number-of-elements=11, base-type=uint8  # Parameters: VW Spare Part Number
  diagnostic read data by identifier ReadSlaveListVWSparePartNumber: access-permission=READ0x01DefaultSession0x03ExtendedSession, data-identifier=SlaveListVWSparePartNumber, read-class=DiagnosticReadDataByIdentifierClass  # Read_Slave_list_VW_spare_part_number
package /ZeC/DataIdentifiers/Identification/Function_list_status
  diagnostic data identifier FunctionListStatus: id=0xb1fe, represents-vin=false  # Function_list_status
    diagnostic-parameter bit-offset=0:
      diagnostic data element Identification_0xb1fe_Function_list_status_State_Calibration_Activation_Commissioning_Commissioning_status_ReserBCDF4E7: array-size-semantics=VARIABLE-SIZE, max-number-of-elements=32, base-type=uint8  # Parameters: State / Calibration / Activation / Commissioning / Commissioning status / Reserved / Status / Registration / Reserved / Reserved / Reserved
  diagnostic read data by identifier ReadFunctionListStatus: access-permission=READ0x01DefaultSession0x03ExtendedSession, data-identifier=FunctionListStatus, read-class=DiagnosticReadDataByIdentifierClass  # Read_Function_list_status
package /ZeC/DataIdentifiers/Identification/Slave_list_VW_software_version_number
  diagnostic data identifier SlaveListVWSoftwareVersionNumber: id=0x0612, represents-vin=false  # Slave_list_VW_software_version_number
    diagnostic-parameter bit-offset=0:
      diagnostic data element Identification_0x0612_Slave_list_VW_software_version_number_Number_Of_Expected_SubSystem_Identification: base-type=uint8  # Parameters: Number Of Expected SubSystem Identification
    diagnostic-parameter bit-offset=8:
      diagnostic data element Identification_0x0612_Slave_list_VW_software_version_number_Number_Of_Retrieved_SubSystem_Identification: base-type=uint8  # Parameters: Number Of Retrieved SubSystem Identification
    diagnostic-parameter bit-offset=16:
      diagnostic data element Identification_0x0612_Slave_list_VW_software_version_number_VW_Application_Software_Version_Number: array-size-semantics=VARIABLE-SIZE, max-number-of-elements=4, base-type=uint8  # Parameters: VW Application Software Version Number
  diagnostic read data by identifier ReadSlaveListVWSoftwareVersionNumber: access-permission=READ0x01DefaultSession0x03ExtendedSession, data-identifier=SlaveListVWSoftwareVersionNumber, read-class=DiagnosticReadDataByIdentifierClass  # Read_Slave_list_VW_software_version_number
package /ZeC/DataIdentifiers/Identification/SWCO_list_subsystem_node_address
  diagnostic data identifier SWCOListSubsystemNodeAddress: id=0xb1ff, represents-vin=false  # SWCO_list_subsystem_node_address
    diagnostic-parameter bit-offset=0:
      diagnostic data element Identification_0xb1ff_SWCO_list_subsystem_node_address_SubSystem_Node_Address: array-size-semantics=VARIABLE-SIZE, max-number-of-elements=16, base-type=uint8  # Parameters: SubSystem Node Address
  diagnostic read data by identifier ReadSWCOListSubsystemNodeAddress: access-permission=READ0x01DefaultSession0x03ExtendedSession, data-identifier=SWCOListSubsystemNodeAddress, read-class=DiagnosticReadDataByIdentifierClass  # Read_SWCO_list_subsystem_node_address
package /ZeC/DataIdentifiers/Identification/Data_block_description
  diagnostic data identifier DataBlockDescription: id=0x0411, represents-vin=false  # Data_block_description
    diagnostic-parameter bit-offset=0:
      diagnostic data element Identification_0x0411_Data_block_description_Number_Of_Data_Blocks: base-type=uint8  # Parameters: Number Of Data Blocks
    diagnostic-parameter bit-offset=8:
      diagnostic data element Identification_0x0411_Data_block_description_Data_Block_ID_Value_Data_Block_ID_Data_Block_Name_Data_Block_Version: array-size-semantics=VARIABLE-SIZE, max-number-of-elements=900, base-type=uint8  # Parameters: Data Block ID Value / Data Block ID / Data Block Name / Data Block Version
  diagnostic read data by identifier ReadDataBlockDescription: access-permission=READ0x01DefaultSession0x02ProgrammingSession0x03ExtendedSession, data-identifier=DataBlockDescription, read-class=DiagnosticReadDataByIdentifierClass  # Read_Data_block_description
package /ZeC/DataIdentifiers/Identification/Function_list_number
  diagnostic data identifier FunctionListNumber: id=0xb1fc, represents-vin=false  # Function_list_number
    diagnostic-parameter bit-offset=0:
      diagnostic data element Identification_0xb1fc_Function_list_number_Function_list_number: array-size-semantics=VARIABLE-SIZE, max-number-of-elements=64, base-type=uint8  # Parameters: Function_list_number
  diagnostic read data by identifier ReadFunctionListNumber: access-permission=READ0x01DefaultSession0x03ExtendedSession, data-identifier=FunctionListNumber, read-class=DiagnosticReadDataByIdentifierClass  # Read_Function_list_number
package /ZeC/DataIdentifiers/Identification/Function_list_version
  diagnostic data identifier FunctionListVersion: id=0xb1fd, represents-vin=false  # Function_list_version
    diagnostic-parameter bit-offset=0:
      diagnostic data element Identification_0xb1fd_Function_list_version_Major_Version_Number_Minor_Version_Number: array-size-semantics=VARIABLE-SIZE, max-number-of-elements=64, base-type=uint8  # Parameters: Major Version Number / Minor Version Number
  diagnostic read data by identifier ReadFunctionListVersion: access-permission=READ0x01DefaultSession0x03ExtendedSession, data-identifier=FunctionListVersion, read-class=DiagnosticReadDataByIdentifierClass  # Read_Function_list_version
package /ZeC/DataIdentifiers/Identification/Bootloader_TP_Blocksize
  diagnostic data identifier BootloaderTPBlocksize: id=0x0410, represents-vin=false  # Bootloader TP Blocksize
    diagnostic-parameter bit-offset=0:
      diagnostic data element Identification_0x0410_Bootloader_TP_Blocksize_Bootloader_TP_Blocksize: base-type=uint8  # Parameters: Bootloader TP Blocksize
  diagnostic read data by identifier ReadBootloaderTPBlocksize: access-permission=READ0x01DefaultSession0x02ProgrammingSession0x03ExtendedSession, data-identifier=BootloaderTPBlocksize, read-class=DiagnosticReadDataByIdentifierClass  # Read_Bootloader TP Blocksize
  diagnostic write data by identifier WriteBootloaderTPBlocksize: access-permission=WRITE0x02ProgrammingSession0x03ExtendedSession, data-identifier=BootloaderTPBlocksize, write-class=DiagnosticWriteDataByIdentifierClass  # Write_Bootloader TP Blocksize
package /ZeC/DataIdentifiers/Identification/Fingerprint
  diagnostic data identifier Fingerprint: id=0xf15a, represents-vin=false
    diagnostic-parameter bit-offset=0:
      diagnostic data element Identification_0xf15a_Fingerprint_Year: base-type=uint8  # Parameters: Year
    diagnostic-parameter bit-offset=8:
      diagnostic data element Identification_0xf15a_Fingerprint_Month: base-type=uint8  # Parameters: Month
    diagnostic-parameter bit-offset=16:
      diagnostic data element Identification_0xf15a_Fingerprint_Day: base-type=uint8  # Parameters: Day
    diagnostic-parameter bit-offset=24:
      diagnostic data element Identification_0xf15a_Fingerprint_Repair_Shop_Code_Or_Tester_Serial_Number: array-size-semantics=FIXED-SIZE, max-number-of-elements=6, base-type=uint8  # Parameters: Repair Shop Code Or Tester Serial Number
  diagnostic read data by identifier ReadFingerprint: access-permission=READSA11120x02ProgrammingSession, data-identifier=Fingerprint, read-class=DiagnosticReadDataByIdentifierClass  # Read_Fingerprint
  diagnostic write data by identifier WriteFingerprint: access-permission=WRITESA11120x02ProgrammingSession, data-identifier=Fingerprint, write-class=DiagnosticWriteDataByIdentifierClass  # Write_Fingerprint
package /ZeC/DataIdentifiers/Identification/ASAM_ODX_File_Identifier
  diagnostic data identifier ASAMODXFileIdentifier: id=0xf19e, represents-vin=false  # ASAM ODX File Identifier
    diagnostic-parameter bit-offset=0:
      diagnostic data element Identification_0xf19e_ASAM_ODX_File_Identifier_ASAM_ODX_File_Identifier: array-size-semantics=VARIABLE-SIZE, max-number-of-elements=25, base-type=uint8  # Parameters: ASAM ODX File Identifier
  diagnostic read data by identifier ReadASAMODXFileIdentifier: access-permission=READ0x01DefaultSession0x02ProgrammingSession0x03ExtendedSession, data-identifier=ASAMODXFileIdentifier, read-class=DiagnosticReadDataByIdentifierClass  # Read_ASAM ODX File Identifier
package /ZeC/DataIdentifiers/Identification/Fingerprint_And_Programming_Date_Of_Logical_Software_Blocks
  diagnostic data identifier FingerprintAndProgrammingDateOfLogicalSoftwareBlocks: id=0xf15b, represents-vin=false  # Fingerprint And Programming Date Of Logical Software Blocks
    diagnostic-parameter bit-offset=0:
      diagnostic data element Identification_0xf15b_Fingerprint_And_Programming_Date_Of_Logical_Software_Blocks_Year: base-type=uint8  # Parameters: Year
    diagnostic-parameter bit-offset=8:
      diagnostic data element Identification_0xf15b_Fingerprint_And_Programming_Date_Of_Logical_Software_Blocks_Month: base-type=uint8  # Parameters: Month
    diagnostic-parameter bit-offset=16:
      diagnostic data element Identification_0xf15b_Fingerprint_And_Programming_Date_Of_Logical_Software_Blocks_Day: base-type=uint8  # Parameters: Day
    diagnostic-parameter bit-offset=24:
      diagnostic data element Identification_0xf15b_Fingerprint_And_Programming_Date_Of_Logical_Software_Blocks_Repair_Shop_Code_Or_Tester_SerD392E19: array-size-semantics=FIXED-SIZE, max-number-of-elements=6, base-type=uint8  # Parameters: Repair Shop Code Or Tester Serial Number
    diagnostic-parameter bit-offset=72:
      diagnostic data element Identification_0xf15b_Fingerprint_And_Programming_Date_Of_Logical_Software_Blocks_Programming_State: base-type=uint8, compu {0=Programming State: Correct Result (TTR207613), 1=Programming State: Incorrect Result (TTR207713), 129=Programming State: Downgrade Protection: Invalid Block-ID Or Invalid Version Number (TTR287012), 128=Programming State: Downgrade Protection: Missing Or Invalid Driver (TTR286912)}  # Parameters: Programming State
  diagnostic read data by identifier ReadFingerprintAndProgrammingDateOfLogicalSoftwareBlocks: access-permission=READ0x01DefaultSession0x02ProgrammingSession0x03ExtendedSession, data-identifier=FingerprintAndProgrammingDateOfLogicalSoftwareBlocks, read-class=DiagnosticReadDataByIdentifierClass  # Read_Fingerprint And Programming Date Of Logical Software Blocks
package /ZeC/DataIdentifiers/Identification/VWClear_diagnostic_information_date_functional
  diagnostic data identifier VWClearDiagnosticInformationDateFunctional: id=0xf1b0, represents-vin=false  # VWClear_diagnostic_information_date_functional
    diagnostic-parameter bit-offset=0:
      diagnostic data element Identification_0xf1b0_VWClear_diagnostic_information_date_functional_Reserved_Year_Month_Day_Hour_Minute_Seconds: array-size-semantics=FIXED-SIZE, max-number-of-elements=5, base-type=uint8  # Parameters: Reserved / Year / Month / Day / Hour / Minute / Seconds
  diagnostic read data by identifier ReadVWClearDiagnosticInformationDateFunctional: access-permission=READ0x01DefaultSession0x03ExtendedSession, data-identifier=VWClearDiagnosticInformationDateFunctional, read-class=DiagnosticReadDataByIdentifierClass  # Read_VWClear_diagnostic_information_date_functional
package /ZeC/DataIdentifiers/Identification/Slave_list_VW_system_name_or_engine_type
  diagnostic data identifier SlaveListVWSystemNameOrEngineType: id=0x0617, represents-vin=false  # Slave_list_VW_system_name_or_engine_type
    diagnostic-parameter bit-offset=0:
      diagnostic data element Identification_0x0617_Slave_list_VW_system_name_or_engine_type_Number_Of_Expected_SubSystem_Identification: base-type=uint8  # Parameters: Number Of Expected SubSystem Identification
    diagnostic-parameter bit-offset=8:
      diagnostic data element Identification_0x0617_Slave_list_VW_system_name_or_engine_type_Number_Of_Retrieved_SubSystem_Identification: base-type=uint8  # Parameters: Number Of Retrieved SubSystem Identification
    diagnostic-parameter bit-offset=16:
      diagnostic data element Identification_0x0617_Slave_list_VW_system_name_or_engine_type_SubSystem_Node_Address: base-type=uint16  # Parameters: SubSystem Node Address
    diagnostic-parameter bit-offset=32:
      diagnostic data element Identification_0x0617_Slave_list_VW_system_name_or_engine_type_VW_System_Name_Or_Engine_Type: array-size-semantics=FIXED-SIZE, max-number-of-elements=13, base-type=uint8  # Parameters: VW System Name Or Engine Type
  diagnostic read data by identifier ReadSlaveListVWSystemNameOrEngineType: access-permission=READ0x01DefaultSession0x03ExtendedSession, data-identifier=SlaveListVWSystemNameOrEngineType, read-class=DiagnosticReadDataByIdentifierClass  # Read_Slave_list_VW_system_name_or_engine_type
package /ZeC/DataIdentifiers/Identification/VW_Application_data_set_identification
  diagnostic data identifier VWApplicationDataSetIdentification: id=0xf1b1, represents-vin=false  # VW_Application_data_set_identification
    diagnostic-parameter bit-offset=0:
      diagnostic data element Identification_0xf1b1_VW_Application_data_set_identification_data_set_ID: base-type=uint16  # Parameters: data_set_ID
    diagnostic-parameter bit-offset=16:
      diagnostic data element Identification_0xf1b1_VW_Application_data_set_identification_data_set_version: array-size-semantics=FIXED-SIZE, max-number-of-elements=4, base-type=uint8  # Parameters: data_set_version
    diagnostic-parameter bit-offset=48:
      diagnostic data element Identification_0xf1b1_VW_Application_data_set_identification_data_set_valid_data_set_plausible_data_set_used_by_BA23BC3: base-type=uint8, compu {0=data_set_valid: no; data_set_plausible: no; data_set_used_by_application: no (TTR199814TTR199814TTR199814), 1=data_set_valid: yes (TTR199914), 2=data_set_plausible: yes (TTR199914), 4=data_set_used_by_application: yes (TTR199914)}  # Parameters: data_set_valid / data_set_plausible / data_set_used_by_application / Reserved
  diagnostic read data by identifier ReadVWApplicationDataSetIdentification: access-permission=READ0x01DefaultSession0x03ExtendedSession, data-identifier=VWApplicationDataSetIdentification, read-class=DiagnosticReadDataByIdentifierClass  # Read_VW_Application_data_set_identification
package /ZeC/DataIdentifiers/Identification/Slave_list_OBD_class_description
  diagnostic data identifier SlaveListOBDClassDescription: id=0x0618, represents-vin=false  # Slave_list_OBD_class_description
    diagnostic-parameter bit-offset=0:
      diagnostic data element Identification_0x0618_Slave_list_OBD_class_description_Number_Of_Expected_SubSystem_Identification: base-type=uint8  # Parameters: Number Of Expected SubSystem Identification
    diagnostic-parameter bit-offset=8:
      diagnostic data element Identification_0x0618_Slave_list_OBD_class_description_Number_Of_Retrieved_SubSystem_Identification: base-type=uint8  # Parameters: Number Of Retrieved SubSystem Identification
    diagnostic-parameter bit-offset=16:
      diagnostic data element Identification_0x0618_Slave_list_OBD_class_description_SubSystem_Node_Address: base-type=uint16  # Parameters: SubSystem Node Address
    diagnostic-parameter bit-offset=32:
      diagnostic data element Identification_0x0618_Slave_list_OBD_class_description_Secondary_OBD_Component_Reserved: base-type=uint8, compu {1=Secondary OBD Component: System is Secondary OBD Component (TTR227312), 0=Secondary OBD Component: System is not Secondary OBD Component (TTR227212)}  # Parameters: Secondary OBD Component / Reserved
  diagnostic read data by identifier ReadSlaveListOBDClassDescription: access-permission=READ0x01DefaultSession0x03ExtendedSession, data-identifier=SlaveListOBDClassDescription, read-class=DiagnosticReadDataByIdentifierClass  # Read_Slave_list_OBD_class_description
package /ZeC/DataIdentifiers/Identification/Function_software_identification
  diagnostic data identifier FunctionSoftwareIdentification: id=0xf1b2, represents-vin=false  # Function_software_identification
    diagnostic-parameter bit-offset=0:
      diagnostic data element Identification_0xf1b2_Function_software_identification_Number_of_softwaremodules: base-type=uint8  # Parameters: Number_of_softwaremodules
    diagnostic-parameter bit-offset=8:
      diagnostic data element Identification_0xf1b2_Function_software_identification_Vendor_ID_Software_Version_Number: array-size-semantics=VARIABLE-SIZE, max-number-of-elements=8, base-type=uint8  # Parameters: Vendor_ID / Software_Version_Number
  diagnostic read data by identifier ReadFunctionSoftwareIdentification: access-permission=READ0x01DefaultSession0x03ExtendedSession, data-identifier=FunctionSoftwareIdentification, read-class=DiagnosticReadDataByIdentifierClass  # Read_Function_software_identification
package /ZeC/DataIdentifiers/Identification/Slave_list_ecu_serial_number
  diagnostic data identifier SlaveListEcuSerialNumber: id=0x0615, represents-vin=false  # Slave_list_ecu_serial_number
    diagnostic-parameter bit-offset=0:
      diagnostic data element Identification_0x0615_Slave_list_ecu_serial_number_Number_Of_Expected_SubSystem_Identification: base-type=uint8  # Parameters: Number Of Expected SubSystem Identification
    diagnostic-parameter bit-offset=8:
      diagnostic data element Identification_0x0615_Slave_list_ecu_serial_number_Number_Of_Retrieved_SubSystem_Identification: base-type=uint8  # Parameters: Number Of Retrieved SubSystem Identification
    diagnostic-parameter bit-offset=16:
      diagnostic data element Identification_0x0615_Slave_list_ecu_serial_number_SubSystem_Node_Address: base-type=uint16  # Parameters: SubSystem Node Address
    diagnostic-parameter bit-offset=32:
      diagnostic data element Identification_0x0615_Slave_list_ecu_serial_number_ECU_Serial_Number: array-size-semantics=FIXED-SIZE, max-number-of-elements=20, base-type=uint8  # Parameters: ECU Serial Number
  diagnostic read data by identifier ReadSlaveListEcuSerialNumber: access-permission=READ0x01DefaultSession0x03ExtendedSession, data-identifier=SlaveListEcuSerialNumber, read-class=DiagnosticReadDataByIdentifierClass  # Read_Slave_list_ecu_serial_number
package /ZeC/DataIdentifiers/Identification/VW_Data_set_name
  diagnostic data identifier VWDataSetName: id=0xf1b3, represents-vin=false  # VW_Data_set_name
    diagnostic-parameter bit-offset=0:
      diagnostic data element Identification_0xf1b3_VW_Data_set_name_number_of_data_set_names: base-type=uint8  # Parameters: number_of_data_set_names
    diagnostic-parameter bit-offset=16:
      diagnostic data element Identification_0xf1b3_VW_Data_set_name_data_set_ID: base-type=uint16  # Parameters: data_set_ID
    diagnostic-parameter bit-offset=32:
      diagnostic data element Identification_0xf1b3_VW_Data_set_name_data_set_name: array-size-semantics=FIXED-SIZE, max-number-of-elements=12, base-type=uint8  # Parameters: data_set_name
  diagnostic read data by identifier ReadVWDataSetName: access-permission=READ0x01DefaultSession0x03ExtendedSession, data-identifier=VWDataSetName, read-class=DiagnosticReadDataByIdentifierClass  # Read_VW_Data_set_name
package /ZeC/DataIdentifiers/Identification/Slave_list_VW_FAZIT_identification_string
  diagnostic data identifier SlaveListVWFAZITIdentificationString: id=0x0616, represents-vin=false  # Slave_list_VW_FAZIT_identification_string
    diagnostic-parameter bit-offset=0:
      diagnostic data element Identification_0x0616_Slave_list_VW_FAZIT_identification_string_Number_Of_Expected_SubSystem_Identification: base-type=uint8  # Parameters: Number Of Expected SubSystem Identification
    diagnostic-parameter bit-offset=8:
      diagnostic data element Identification_0x0616_Slave_list_VW_FAZIT_identification_string_Number_Of_Retrieved_SubSystem_Identification: base-type=uint8  # Parameters: Number Of Retrieved SubSystem Identification
    diagnostic-parameter bit-offset=16:
      diagnostic data element Identification_0x0616_Slave_list_VW_FAZIT_identification_string_SubSystem_Node_Address: base-type=uint16  # Parameters: SubSystem Node Address
    diagnostic-parameter bit-offset=32:
      diagnostic data element Identification_0x0616_Slave_list_VW_FAZIT_identification_string_ECU_Production_Plant_Number: array-size-semantics=FIXED-SIZE, max-number-of-elements=7, base-type=uint8  # Parameters: ECU Production Plant Number
    diagnostic-parameter bit-offset=88:
      diagnostic data element Identification_0x0616_Slave_list_VW_FAZIT_identification_string_ECU_Manufacturing_Date: array-size-semantics=FIXED-SIZE, max-number-of-elements=8, base-type=uint8  # Parameters: ECU Manufacturing Date
    diagnostic-parameter bit-offset=152:
      diagnostic data element Identification_0x0616_Slave_list_VW_FAZIT_identification_string_ECU_Production_Test_System_Number: array-size-semantics=FIXED-SIZE, max-number-of-elements=4, base-type=uint8  # Parameters: ECU Production Test System Number
    diagnostic-parameter bit-offset=184:
      diagnostic data element Identification_0x0616_Slave_list_VW_FAZIT_identification_string_Consecutive_Supplier_Number: array-size-semantics=FIXED-SIZE, max-number-of-elements=4, base-type=uint8  # Parameters: Consecutive Supplier Number
  diagnostic read data by identifier ReadSlaveListVWFAZITIdentificationString: access-permission=READ0x01DefaultSession0x03ExtendedSession, data-identifier=SlaveListVWFAZITIdentificationString, read-class=DiagnosticReadDataByIdentifierClass  # Read_Slave_list_VW_FAZIT_identification_string
package /ZeC/DataIdentifiers/Identification/Technical_specifications_version
  diagnostic data identifier TechnicalSpecificationsVersion: id=0xf1b4, represents-vin=false  # Technical_specifications_version
    diagnostic-parameter bit-offset=0:
      diagnostic data element Identification_0xf1b4_Technical_specifications_version_Major_Version_80114: base-type=uint8  # Parameters: Major Version 80114
    diagnostic-parameter bit-offset=8:
      diagnostic data element Identification_0xf1b4_Technical_specifications_version_Minor_Version_80114: base-type=uint8  # Parameters: Minor Version 80114
    diagnostic-parameter bit-offset=16:
      diagnostic data element Identification_0xf1b4_Technical_specifications_version_Major_Version_80124: base-type=uint8  # Parameters: Major Version 80124
    diagnostic-parameter bit-offset=24:
      diagnostic data element Identification_0xf1b4_Technical_specifications_version_Minor_Version_80124: base-type=uint8  # Parameters: Minor Version 80124
    diagnostic-parameter bit-offset=32:
      diagnostic data element Identification_0xf1b4_Technical_specifications_version_Major_Version_80125: base-type=uint8  # Parameters: Major Version 80125
    diagnostic-parameter bit-offset=40:
      diagnostic data element Identification_0xf1b4_Technical_specifications_version_Minor_Version_80125: base-type=uint8  # Parameters: Minor Version 80125
    diagnostic-parameter bit-offset=48:
      diagnostic data element Identification_0xf1b4_Technical_specifications_version_Major_Version_80126: base-type=uint8  # Parameters: Major Version 80126
    diagnostic-parameter bit-offset=56:
      diagnostic data element Identification_0xf1b4_Technical_specifications_version_Minor_Version_80126: base-type=uint8  # Parameters: Minor Version 80126
    diagnostic-parameter bit-offset=64:
      diagnostic data element Identification_0xf1b4_Technical_specifications_version_Major_Version_80127: base-type=uint8  # Parameters: Major Version 80127
    diagnostic-parameter bit-offset=72:
      diagnostic data element Identification_0xf1b4_Technical_specifications_version_Minor_Version_80127: base-type=uint8  # Parameters: Minor Version 80127
    diagnostic-parameter bit-offset=80:
      diagnostic data element Identification_0xf1b4_Technical_specifications_version_Major_Version_80128_3: base-type=uint8  # Parameters: Major Version 80128-3
    diagnostic-parameter bit-offset=88:
      diagnostic data element Identification_0xf1b4_Technical_specifications_version_Minor_Version_80128_3: base-type=uint8  # Parameters: Minor Version 80128-3
    diagnostic-parameter bit-offset=96:
      diagnostic data element Identification_0xf1b4_Technical_specifications_version_Major_Version_DSDL_Data_Set_Download_: base-type=uint8  # Parameters: Major Version DSDL (Data Set Download)
    diagnostic-parameter bit-offset=104:
      diagnostic data element Identification_0xf1b4_Technical_specifications_version_Minor_Version_DSDL_Data_Set_Download_: base-type=uint8  # Parameters: Minor Version DSDL (Data Set Download)
    diagnostic-parameter bit-offset=112:
      diagnostic data element Identification_0xf1b4_Technical_specifications_version_Major_Version_DUL_Data_Upload_: base-type=uint8  # Parameters: Major Version DUL (Data Upload)
    diagnostic-parameter bit-offset=120:
      diagnostic data element Identification_0xf1b4_Technical_specifications_version_Minor_Version_DUL_Data_Upload_: base-type=uint8  # Parameters: Minor Version DUL (Data Upload)
    diagnostic-parameter bit-offset=128:
      diagnostic data element Identification_0xf1b4_Technical_specifications_version_Major_Version_PVD_Protection_of_Vehicle_Diagnosis_: base-type=uint8  # Parameters: Major Version PVD (Protection of Vehicle Diagnosis)
    diagnostic-parameter bit-offset=136:
      diagnostic data element Identification_0xf1b4_Technical_specifications_version_Minor_Version_PVD_Protection_of_Vehicle_Diagnosis_: base-type=uint8  # Parameters: Minor Version PVD (Protection of Vehicle Diagnosis)
    diagnostic-parameter bit-offset=144:
      diagnostic data element Identification_0xf1b4_Technical_specifications_version_Major_Version_SWaP_Software_as_a_Product_: base-type=uint8  # Parameters: Major Version SWaP (Software as a Product)
    diagnostic-parameter bit-offset=152:
      diagnostic data element Identification_0xf1b4_Technical_specifications_version_Minor_Version_SWaP_Software_as_a_Product_: base-type=uint8  # Parameters: Minor Version SWaP (Software as a Product)
    diagnostic-parameter bit-offset=160:
      diagnostic data element Identification_0xf1b4_Technical_specifications_version_Major_Version_ORU_Online_Remote_Update_: base-type=uint8  # Parameters: Major Version ORU (Online Remote Update)
    diagnostic-parameter bit-offset=168:
      diagnostic data element Identification_0xf1b4_Technical_specifications_version_Minor_Version_ORU_Online_Remote_Update_: base-type=uint8  # Parameters: Minor Version ORU (Online Remote Update)
    diagnostic-parameter bit-offset=176:
      diagnostic data element Identification_0xf1b4_Technical_specifications_version_Major_Version_P_Mode_Production_Mode_: base-type=uint8  # Parameters: Major Version P-Mode (Production Mode)
    diagnostic-parameter bit-offset=184:
      diagnostic data element Identification_0xf1b4_Technical_specifications_version_Minor_Version_P_Mode_Production_Mode_: base-type=uint8  # Parameters: Minor Version P-Mode (Production Mode)
    diagnostic-parameter bit-offset=192:
      diagnostic data element Identification_0xf1b4_Technical_specifications_version_Major_Version_VKMS_Vehicle_Key_Management_System_: base-type=uint8  # Parameters: Major Version VKMS (Vehicle Key Management System)
    diagnostic-parameter bit-offset=200:
      diagnostic data element Identification_0xf1b4_Technical_specifications_version_Minor_Version_VKMS_Vehicle_Key_Management_System_: base-type=uint8  # Parameters: Minor Version VKMS (Vehicle Key Management System)
  diagnostic read data by identifier ReadTechnicalSpecificationsVersion: access-permission=READ0x01DefaultSession0x03ExtendedSession, data-identifier=TechnicalSpecificationsVersion, read-class=DiagnosticReadDataByIdentifierClass  # Read_Technical_specifications_version
package /ZeC/DataIdentifiers/Identification/Busmaster_description
  diagnostic data identifier BusmasterDescription: id=0xf1b5, represents-vin=false  # Busmaster_description
    diagnostic-parameter bit-offset=0:
      diagnostic data element Identification_0xf1b5_Busmaster_description_ECU_ID: base-type=uint16  # Parameters: ECU ID
    diagnostic-parameter bit-offset=16:
      diagnostic data element Identification_0xf1b5_Busmaster_description_Node_address: base-type=uint16  # Parameters: Node_address
    diagnostic-parameter bit-offset=32:
      diagnostic data element Identification_0xf1b5_Busmaster_description_DC0_systems_DC1_systems_DC2_DC2F_systems_DC3_or_DC4_high_low_systemsCEA793E: base-type=uint8, compu {0=DC0_systems: no; DC1_systems: no; DC2/DC2F_systems: no; DC3_or_DC4-high/low_systems: no; Virtual_systems: no; Software_cluster: no; Host_ECU: no (TTR199814TTR199814TTR199814TTR199814TTR199814TTR199814TTR199814), 1=DC0_systems: yes (TTR199914), 2=DC1_systems: yes (TTR199914), 4=DC2/DC2F_systems: yes (TTR199914), 8=DC3_or_DC4-high/low_systems: yes (TTR199914), 16=Virtual_systems: yes (TTR199914), 32=Software_cluster: yes (TTR199914), 128=Host_ECU: yes (TTR199914)}  # Parameters: DC0_systems / DC1_systems / DC2/DC2F_systems / DC3_or_DC4-high/low_systems / Virtual_systems / Software_cluster / reserved / Host_ECU
  diagnostic read data by identifier ReadBusmasterDescription: access-permission=READ0x01DefaultSession0x03ExtendedSession, data-identifier=BusmasterDescription, read-class=DiagnosticReadDataByIdentifierClass  # Read_Busmaster_description
package /ZeC/DataIdentifiers/Identification/Slave_list_VW_ecu_hardware_version_number
  diagnostic data identifier SlaveListVWEcuHardwareVersionNumber: id=0x0613, represents-vin=false  # Slave_list_VW_ecu_hardware_version_number
    diagnostic-parameter bit-offset=0:
      diagnostic data element Identification_0x0613_Slave_list_VW_ecu_hardware_version_number_Number_Of_Expected_SubSystem_Identification: base-type=uint8  # Parameters: Number Of Expected SubSystem Identification
    diagnostic-parameter bit-offset=8:
      diagnostic data element Identification_0x0613_Slave_list_VW_ecu_hardware_version_number_Number_Of_Retrieved_SubSystem_Identification: base-type=uint8  # Parameters: Number Of Retrieved SubSystem Identification
    diagnostic-parameter bit-offset=16:
      diagnostic data element Identification_0x0613_Slave_list_VW_ecu_hardware_version_number_SubSystem_Node_Address: base-type=uint16  # Parameters: SubSystem Node Address
    diagnostic-parameter bit-offset=32:
      diagnostic data element Identification_0x0613_Slave_list_VW_ecu_hardware_version_number_VW_ECU_Hardware_Version_Number: array-size-semantics=FIXED-SIZE, max-number-of-elements=3, base-type=uint8  # Parameters: VW ECU Hardware Version Number
  diagnostic read data by identifier ReadSlaveListVWEcuHardwareVersionNumber: access-permission=READ0x01DefaultSession0x03ExtendedSession, data-identifier=SlaveListVWEcuHardwareVersionNumber, read-class=DiagnosticReadDataByIdentifierClass  # Read_Slave_list_VW_ecu_hardware_version_number
package /ZeC/DataIdentifiers/Identification/Slave_list_VW_hardware_number
  diagnostic data identifier SlaveListVWHardwareNumber: id=0x0614, represents-vin=false  # Slave_list_VW_hardware_number
    diagnostic-parameter bit-offset=0:
      diagnostic data element Identification_0x0614_Slave_list_VW_hardware_number_Number_Of_Expected_SubSystem_Identification: base-type=uint8  # Parameters: Number Of Expected SubSystem Identification
    diagnostic-parameter bit-offset=8:
      diagnostic data element Identification_0x0614_Slave_list_VW_hardware_number_Number_Of_Retrieved_SubSystem_Identification: base-type=uint8  # Parameters: Number Of Retrieved SubSystem Identification
    diagnostic-parameter bit-offset=16:
      diagnostic data element Identification_0x0614_Slave_list_VW_hardware_number_SubSystem_Node_Address: base-type=uint16  # Parameters: SubSystem Node Address
    diagnostic-parameter bit-offset=32:
      diagnostic data element Identification_0x0614_Slave_list_VW_hardware_number_VW_ECU_Hardware_Number: array-size-semantics=FIXED-SIZE, max-number-of-elements=11, base-type=uint8  # Parameters: VW ECU Hardware Number
  diagnostic read data by identifier ReadSlaveListVWHardwareNumber: access-permission=READ0x01DefaultSession0x03ExtendedSession, data-identifier=SlaveListVWHardwareNumber, read-class=DiagnosticReadDataByIdentifierClass  # Read_Slave_list_VW_hardware_number
package /ZeC/DataIdentifiers/Identification/SWCL_identification
  diagnostic data identifier SWCLIdentification: id=0x01a6, represents-vin=false  # SWCL_identification
    diagnostic-parameter bit-offset=0:
      diagnostic data element Identification_0x01a6_SWCL_identification_Versioning: base-type=uint8  # Parameters: Versioning
    diagnostic-parameter bit-offset=8:
      diagnostic data element Identification_0x01a6_SWCL_identification_Diagnostic_address: base-type=uint16  # Parameters: Diagnostic_address
    diagnostic-parameter bit-offset=24:
      diagnostic data element Identification_0x01a6_SWCL_identification_FID: base-type=uint16  # Parameters: FID
  diagnostic read data by identifier ReadSWCLIdentification: access-permission=READ0x01DefaultSession0x03ExtendedSession, data-identifier=SWCLIdentification, read-class=DiagnosticReadDataByIdentifierClass  # Read_SWCL_identification
package /ZeC/DataIdentifiers/Identification/Software_vendor
  diagnostic data identifier SoftwareVendor: id=0x01a7, represents-vin=false  # Software_vendor
    diagnostic-parameter bit-offset=0:
      diagnostic data element Identification_0x01a7_Software_vendor_Versioning: base-type=uint8  # Parameters: Versioning
    diagnostic-parameter bit-offset=8:
      diagnostic data element Identification_0x01a7_Software_vendor_Vendor_ID: base-type=uint16  # Parameters: Vendor_ID
  diagnostic read data by identifier ReadSoftwareVendor: access-permission=READ0x01DefaultSession0x03ExtendedSession, data-identifier=SoftwareVendor, read-class=DiagnosticReadDataByIdentifierClass  # Read_Software_vendor
package /ZeC/DataIdentifiers/Identification/Gateway_Component_List_DiagProt
  diagnostic data identifier GatewayComponentListDiagProt: id=0x2a29, represents-vin=false  # Gateway Component List DiagProt
    diagnostic-parameter bit-offset=0:
      diagnostic data element Identification_0x2a29_Gateway_Component_List_DiagProt_ISO_TP_TP_2_0_TP_1_6_K_Line_Ethernet_Reserved: array-size-semantics=VARIABLE-SIZE, max-number-of-elements=1, base-type=uint8  # Parameters: ISO-TP / TP 2.0 / TP 1.6 / K-Line / Ethernet / Reserved
  diagnostic read data by identifier ReadGatewayComponentListDiagProt: access-permission=READ0x01DefaultSession0x03ExtendedSession, data-identifier=GatewayComponentListDiagProt, read-class=DiagnosticReadDataByIdentifierClass  # Read_Gateway Component List DiagProt
package /ZeC/DataIdentifiers/Identification/Gateway_Component_List_dtc
  diagnostic data identifier GatewayComponentListDtc: id=0x2a28, represents-vin=false  # Gateway Component List dtc
    diagnostic-parameter bit-offset=0:
      diagnostic data element Identification_0x2a28_Gateway_Component_List_dtc_ECU_Dtc_Bit_0_ECU_Dtc_Bit_1_ECU_Dtc_Bit_2_ECU_Dtc_Bit_3_ECU_Dtc9AD609B: array-size-semantics=VARIABLE-SIZE, max-number-of-elements=1, base-type=uint8  # Parameters: ECU Dtc Bit 0 / ECU Dtc Bit 1 / ECU Dtc Bit 2 / ECU Dtc Bit 3 / ECU Dtc Bit 4 / ECU Dtc Bit 5 / ECU Dtc Bit 6 / ECU Dtc Bit 7
  diagnostic read data by identifier ReadGatewayComponentListDtc: access-permission=READ0x01DefaultSession0x03ExtendedSession, data-identifier=GatewayComponentListDtc, read-class=DiagnosticReadDataByIdentifierClass  # Read_Gateway Component List dtc
package /ZeC/DataIdentifiers/Identification/Gateway_Component_List_Sleepindication
  diagnostic data identifier GatewayComponentListSleepindication: id=0x2a27, represents-vin=false  # Gateway_Component_List_Sleepindication
    diagnostic-parameter bit-offset=0:
      diagnostic data element Identification_0x2a27_Gateway_Component_List_Sleepindication_Sleep_Bit_0_Sleep_Bit_1_Sleep_Bit_2_Sleep_Bit_3_SleE0D06DC: array-size-semantics=VARIABLE-SIZE, max-number-of-elements=1, base-type=uint8  # Parameters: Sleep-Bit 0 / Sleep-Bit 1 / Sleep-Bit 2 / Sleep-Bit 3 / Sleep-Bit 4 / Sleep-Bit 5 / Sleep-Bit 6 / Sleep-Bit 7
  diagnostic read data by identifier ReadGatewayComponentListSleepindication: access-permission=READ0x01DefaultSession0x03ExtendedSession, data-identifier=GatewayComponentListSleepindication, read-class=DiagnosticReadDataByIdentifierClass  # Read_Gateway_Component_List_Sleepindication
package /ZeC/DataIdentifiers/Identification/Gateway_Component_List_present
  diagnostic data identifier GatewayComponentListPresent: id=0x2a26, represents-vin=false  # Gateway Component List present
    diagnostic-parameter bit-offset=0:
      diagnostic data element Identification_0x2a26_Gateway_Component_List_present_ECU_present_Bit_0_ECU_present_Bit_1_ECU_present_Bit_2_ECU_p145677B: array-size-semantics=VARIABLE-SIZE, max-number-of-elements=1, base-type=uint8  # Parameters: ECU present Bit 0 / ECU present Bit 1 / ECU present Bit 2 / ECU present Bit 3 / ECU present Bit 4 / ECU present Bit 5 / ECU present Bit 6 / ECU present Bit 7
  diagnostic read data by identifier ReadGatewayComponentListPresent: access-permission=READ0x01DefaultSession0x03ExtendedSession, data-identifier=GatewayComponentListPresent, read-class=DiagnosticReadDataByIdentifierClass  # Read_Gateway Component List present
package /ZeC/DataIdentifiers/Identification/Active_Diagnostic_Session
  diagnostic data identifier ActiveDiagnosticSession: id=0xf186, represents-vin=false  # Active Diagnostic Session
    diagnostic-parameter bit-offset=0:
      diagnostic data element Identification_0xf186_Active_Diagnostic_Session_Active_Diagnostic_Session: base-type=uint8, compu {2=Active Diagnostic Session: Programming Session (TTR209513), 64=Active Diagnostic Session: VW End Of Line (EoL)-Session (TTR209713), 3=Active Diagnostic Session: Extended Diagnostic Session (TTR209613), 1=Active Diagnostic Session: OBDII And VW Default Diagnostic Session (TTR209413)}  # Parameters: Active Diagnostic Session
  diagnostic read data by identifier ReadActiveDiagnosticSession: access-permission=READ0x01DefaultSession0x02ProgrammingSession0x03ExtendedSession, data-identifier=ActiveDiagnosticSession, read-class=DiagnosticReadDataByIdentifierClass  # Read_Active Diagnostic Session
package /ZeC/DataIdentifiers/Identification/VW_Spare_Part_Number
  diagnostic data identifier VWSparePartNumber: id=0xf187, represents-vin=false  # VW Spare Part Number
    diagnostic-parameter bit-offset=0:
      diagnostic data element Identification_0xf187_VW_Spare_Part_Number_Vornummer: array-size-semantics=FIXED-SIZE, max-number-of-elements=3, base-type=uint8  # Parameters: Vornummer
    diagnostic-parameter bit-offset=24:
      diagnostic data element Identification_0xf187_VW_Spare_Part_Number_Mittelgruppe: array-size-semantics=FIXED-SIZE, max-number-of-elements=3, base-type=uint8  # Parameters: Mittelgruppe
    diagnostic-parameter bit-offset=48:
      diagnostic data element Identification_0xf187_VW_Spare_Part_Number_Endnummer: array-size-semantics=FIXED-SIZE, max-number-of-elements=3, base-type=uint8  # Parameters: Endnummer
    diagnostic-parameter bit-offset=72:
      diagnostic data element Identification_0xf187_VW_Spare_Part_Number_Index: array-size-semantics=FIXED-SIZE, max-number-of-elements=2, base-type=uint8  # Parameters: Index
  diagnostic read data by identifier ReadVWSparePartNumber: access-permission=READ0x01DefaultSession0x02ProgrammingSession0x03ExtendedSession, data-identifier=VWSparePartNumber, read-class=DiagnosticReadDataByIdentifierClass  # Read_VW Spare Part Number
package /ZeC/DataIdentifiers/Identification/Software_type_number
  diagnostic data identifier SoftwareTypeNumber: id=0xc107, represents-vin=false  # Software_type_number
    diagnostic-parameter bit-offset=0:
      diagnostic data element Identification_0xc107_Software_type_number_Software_type_number: array-size-semantics=FIXED-SIZE, max-number-of-elements=11, base-type=uint8  # Parameters: Software_type_number
  diagnostic read data by identifier ReadSoftwareTypeNumber: access-permission=READ0x01DefaultSession0x03ExtendedSession, data-identifier=SoftwareTypeNumber, read-class=DiagnosticReadDataByIdentifierClass  # Read_Software_type_number
package /ZeC/DataIdentifiers/Identification/VW_Application_Software_Version_Number
  diagnostic data identifier VWApplicationSoftwareVersionNumber: id=0xf189, represents-vin=false  # VW Application Software Version Number
    diagnostic-parameter bit-offset=0:
      diagnostic data element Identification_0xf189_VW_Application_Software_Version_Number_VW_Application_Software_Version_Number: array-size-semantics=FIXED-SIZE, max-number-of-elements=4, base-type=uint8  # Parameters: VW Application Software Version Number
  diagnostic read data by identifier ReadVWApplicationSoftwareVersionNumber: access-permission=READ0x01DefaultSession0x02ProgrammingSession0x03ExtendedSession, data-identifier=VWApplicationSoftwareVersionNumber, read-class=DiagnosticReadDataByIdentifierClass  # Read_VW Application Software Version Number
package /ZeC/DataIdentifiers/Identification/ECU_Programming_Information
  diagnostic data identifier ECUProgrammingInformation: id=0xf1df, represents-vin=false  # ECU Programming Information
    diagnostic-parameter bit-offset=0:
      diagnostic data element Identification_0xf1df_ECU_Programming_Information_Reserved_Program_Consistency_Reserved_Programmability_Reserved: base-type=uint8, compu {0=Program Consistency: Program available; Programmability: not programmable (TTR232912TTR232712), 4=Program Consistency: No Program available (TTR233012), 64=Programmability: programmable (TTR232812)}  # Parameters: Reserved / Program Consistency / Reserved / Programmability / Reserved
  diagnostic read data by identifier ReadECUProgrammingInformation: access-permission=READ0x01DefaultSession0x02ProgrammingSession0x03ExtendedSession, data-identifier=ECUProgrammingInformation, read-class=DiagnosticReadDataByIdentifierClass  # Read_ECU Programming Information
package /ZeC/DataIdentifiers/Identification/Electronic_architecture
  diagnostic data identifier ElectronicArchitecture: id=0xc103, represents-vin=false  # Electronic_architecture
    diagnostic-parameter bit-offset=0:
      diagnostic data element Identification_0xc103_Electronic_architecture_Electronic_architecture: array-size-semantics=FIXED-SIZE, max-number-of-elements=3, base-type=uint8  # Parameters: Electronic_architecture
  diagnostic read data by identifier ReadElectronicArchitecture: access-permission=READ0x01DefaultSession0x03ExtendedSession, data-identifier=ElectronicArchitecture, read-class=DiagnosticReadDataByIdentifierClass  # Read_Electronic_architecture
package /ZeC/DataIdentifiers/Identification/VW_logical_block_downgrade_protection_versions
  diagnostic data identifier VWLogicalBlockDowngradeProtectionVersions: id=0x0189, represents-vin=false  # VW_logical_block_downgrade_protection_versions
    diagnostic-parameter bit-offset=0:
      diagnostic data element Identification_0x0189_VW_logical_block_downgrade_protection_versions_Versioning: base-type=uint8  # Parameters: Versioning
    diagnostic-parameter bit-offset=8:
      diagnostic data element Identification_0x0189_VW_logical_block_downgrade_protection_versions_Downgrade_Protection_Minimum_Version: array-size-semantics=FIXED-SIZE, max-number-of-elements=4, base-type=uint8  # Parameters: Downgrade Protection Minimum Version
    diagnostic-parameter bit-offset=40:
      diagnostic data element Identification_0x0189_VW_logical_block_downgrade_protection_versions_Downgrade_Protection_Current_Version: array-size-semantics=FIXED-SIZE, max-number-of-elements=4, base-type=uint8  # Parameters: Downgrade Protection Current Version
  diagnostic read data by identifier ReadVWLogicalBlockDowngradeProtectionVersions: access-permission=READ0x01DefaultSession0x02ProgrammingSession0x03ExtendedSession, data-identifier=VWLogicalBlockDowngradeProtectionVersions, read-class=DiagnosticReadDataByIdentifierClass  # Read_VW_logical_block_downgrade_protection_versions
package /ZeC/DataIdentifiers/Identification/ECU_Serial_Number
  diagnostic data identifier ECUSerialNumber: id=0xf18c, represents-vin=false  # ECU Serial Number
    diagnostic-parameter bit-offset=0:
      diagnostic data element Identification_0xf18c_ECU_Serial_Number_ECU_Serial_Number: array-size-semantics=FIXED-SIZE, max-number-of-elements=20, base-type=uint8  # Parameters: ECU Serial Number
  diagnostic read data by identifier ReadECUSerialNumber: access-permission=READ0x01DefaultSession0x02ProgrammingSession0x03ExtendedSession, data-identifier=ECUSerialNumber, read-class=DiagnosticReadDataByIdentifierClass  # Read_ECU Serial Number
package /ZeC/DataIdentifiers/Identification/SWC_list_vendor_id
  diagnostic data identifier SWCListVendorId: id=0x0143, represents-vin=false  # SWC_list_vendor_id
    diagnostic-parameter bit-offset=0:
      diagnostic data element Identification_0x0143_SWC_list_vendor_id_SWC_list_vendor_id: array-size-semantics=VARIABLE-SIZE, max-number-of-elements=16, base-type=uint8  # Parameters: SWC_list_vendor_id
  diagnostic read data by identifier ReadSWCListVendorId: access-permission=READ0x01DefaultSession0x03ExtendedSession, data-identifier=SWCListVendorId, read-class=DiagnosticReadDataByIdentifierClass  # Read_SWC_list_vendor_id
package /ZeC/DataIdentifiers/Identification/SWCO_list_number_of_swc
  diagnostic data identifier SWCOListNumberOfSwc: id=0x0144, represents-vin=false  # SWCO_list_number_of_swc
    diagnostic-parameter bit-offset=0:
      diagnostic data element Identification_0x0144_SWCO_list_number_of_swc_SWCO_list_number_of_swc: array-size-semantics=VARIABLE-SIZE, max-number-of-elements=16, base-type=uint8  # Parameters: SWCO_list_number_of_swc
  diagnostic read data by identifier ReadSWCOListNumberOfSwc: access-permission=READ0x01DefaultSession0x03ExtendedSession, data-identifier=SWCOListNumberOfSwc, read-class=DiagnosticReadDataByIdentifierClass  # Read_SWCO_list_number_of_swc
package /ZeC/DataIdentifiers/Identification/Regulation_x_software_identification_numbers
  diagnostic data identifier RegulationXSoftwareIdentificationNumbers: id=0xf18f, represents-vin=false  # Regulation_x_software_identification_numbers
    diagnostic-parameter bit-offset=0:
      diagnostic data element Identification_0xf18f_Regulation_x_software_identification_numbers_Regulation_x_software_identification_number: array-size-semantics=VARIABLE-SIZE, max-number-of-elements=50, base-type=uint8  # Parameters: Regulation_x_software_identification_number
  diagnostic read data by identifier ReadRegulationXSoftwareIdentificationNumbers: access-permission=READ0x01DefaultSession0x03ExtendedSession, data-identifier=RegulationXSoftwareIdentificationNumbers, read-class=DiagnosticReadDataByIdentifierClass  # Read_Regulation_x_software_identification_numbers
  diagnostic write data by identifier WriteRegulationXSoftwareIdentificationNumbers: access-permission=WRITEE2eSFDMode0x03ExtendedSession, data-identifier=RegulationXSoftwareIdentificationNumbers, write-class=DiagnosticWriteDataByIdentifierClass  # Write_Regulation_x_software_identification_numbers
package /ZeC/DataIdentifiers/Identification/ASAM_ODX_File_Version
  diagnostic data identifier ASAMODXFileVersion: id=0xf1a2, represents-vin=false  # ASAM ODX File Version
    diagnostic-parameter bit-offset=0:
      diagnostic data element Identification_0xf1a2_ASAM_ODX_File_Version_ASAM_ODX_File_Version: array-size-semantics=FIXED-SIZE, max-number-of-elements=6, base-type=uint8  # Parameters: ASAM ODX File Version
  diagnostic read data by identifier ReadASAMODXFileVersion: access-permission=READ0x01DefaultSession0x02ProgrammingSession0x03ExtendedSession, data-identifier=ASAMODXFileVersion, read-class=DiagnosticReadDataByIdentifierClass  # Read_ASAM ODX File Version
package /ZeC/DataIdentifiers/Identification/VW_ECU_Hardware_Version_Number
  diagnostic data identifier VWECUHardwareVersionNumber: id=0xf1a3, represents-vin=false  # VW ECU Hardware Version Number
    diagnostic-parameter bit-offset=0:
      diagnostic data element Identification_0xf1a3_VW_ECU_Hardware_Version_Number_VW_ECU_Hardware_Version_Number: array-size-semantics=FIXED-SIZE, max-number-of-elements=3, base-type=uint8  # Parameters: VW ECU Hardware Version Number
  diagnostic read data by identifier ReadVWECUHardwareVersionNumber: access-permission=READ0x01DefaultSession0x02ProgrammingSession0x03ExtendedSession, data-identifier=VWECUHardwareVersionNumber, read-class=DiagnosticReadDataByIdentifierClass  # Read_VW ECU Hardware Version Number
package /ZeC/DataIdentifiers/Identification/SWCO_list_spare_part_number
  diagnostic data identifier SWCOListSparePartNumber: id=0x011f, represents-vin=false  # SWCO_list_spare_part_number
    diagnostic-parameter bit-offset=0:
      diagnostic data element Identification_0x011f_SWCO_list_spare_part_number_VW_Spare_Part_Number: array-size-semantics=VARIABLE-SIZE, max-number-of-elements=88, base-type=uint8  # Parameters: VW Spare Part Number
  diagnostic read data by identifier ReadSWCOListSparePartNumber: access-permission=READ0x01DefaultSession0x03ExtendedSession, data-identifier=SWCOListSparePartNumber, read-class=DiagnosticReadDataByIdentifierClass  # Read_SWCO_list_spare_part_number
package /ZeC/DataIdentifiers/Identification/SWCO_list_system_name
  diagnostic data identifier SWCOListSystemName: id=0x011d, represents-vin=false  # SWCO_list_system_name
    diagnostic-parameter bit-offset=0:
      diagnostic data element Identification_0x011d_SWCO_list_system_name_VW_System_Name_Or_Engine_Type: array-size-semantics=VARIABLE-SIZE, max-number-of-elements=104, base-type=uint8  # Parameters: VW System Name Or Engine Type
  diagnostic read data by identifier ReadSWCOListSystemName: access-permission=READ0x01DefaultSession0x03ExtendedSession, data-identifier=SWCOListSystemName, read-class=DiagnosticReadDataByIdentifierClass  # Read_SWCO_list_system_name
package /ZeC/DataIdentifiers/Identification/SWCO_list_vendor_id
  diagnostic data identifier SWCOListVendorId: id=0x011e, represents-vin=false  # SWCO_list_vendor_id
    diagnostic-parameter bit-offset=0:
      diagnostic data element Identification_0x011e_SWCO_list_vendor_id_Vendor_ID: array-size-semantics=VARIABLE-SIZE, max-number-of-elements=16, base-type=uint8  # Parameters: Vendor_ID
  diagnostic read data by identifier ReadSWCOListVendorId: access-permission=READ0x01DefaultSession0x03ExtendedSession, data-identifier=SWCOListVendorId, read-class=DiagnosticReadDataByIdentifierClass  # Read_SWCO_list_vendor_id
