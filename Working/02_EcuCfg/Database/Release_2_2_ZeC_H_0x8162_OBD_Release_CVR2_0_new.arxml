[part 14 of 19: packages /ZeC/DTC/DTC/Power_Path_051_Short_to_GND_Failure to /ZeC/DTC/DTC/LIN_6_Slave_10_Defect]
AUTOSAR XML (schema 00047)
package /ZeC/DTC/DTC/Power_Path_051_Short_to_GND_Failure
  diagnostic trouble code uds Power_Path_051_Short_to_GND_Failure: dtc-props=Dtc_Props_7a6a1329, uds-dtc-value=0x005233
  diagnostic event EventPowerPath051ShortToGNDFailure: aging-allowed=true, event-kind=SWC, prestorage-freeze-frame=false  # Event_Power_Path_051_Short_to_GND_Failure
  diagnostic event to trouble code uds mapping EventDtcMapPowerPath051ShortToGNDFailure: diagnostic-event=EventPowerPath051ShortToGNDFailure, trouble-code-uds=Power_Path_051_Short_to_GND_Failure  # Event_Dtc_Map_Power_Path_051_Short_to_GND_Failure
  diagnostic event to operation cycle mapping EventOperCycleMapPowerPath051ShortToGNDFailure: diagnostic-event=EventPowerPath051ShortToGNDFailure, operation-cycle=DefaultOperationCycle  # Event_Oper_Cycle_Map_Power_Path_051_Short_to_GND_Failure
  diagnostic event to debounce algorithm mapping EventDebounceMapPowerPath051ShortToGNDFailure: debounce-algorithm=time_based, diagnostic-event=EventPowerPath051ShortToGNDFailure  # EventDebounceMap_Power_Path_051_Short_to_GND_Failure
package /ZeC/DTC/DTC/LIN_12_Slave_7_Defect
  diagnostic trouble code uds LIN_12_Slave_7_Defect: dtc-props=Dtc_Props_358996c7, uds-dtc-value=0x030c01  # LIN 12 Slave 7_Defect
  diagnostic event EventLIN12Slave7Defect: aging-allowed=true, event-kind=SWC, prestorage-freeze-frame=false  # Event_LIN 12 Slave 7_Defect
  diagnostic event to trouble code uds mapping EventDtcMapLIN12Slave7Defect: diagnostic-event=EventLIN12Slave7Defect, trouble-code-uds=LIN_12_Slave_7_Defect  # Event_Dtc_Map_LIN 12 Slave 7_Defect
  diagnostic event to operation cycle mapping EventOperCycleMapLIN12Slave7Defect: diagnostic-event=EventLIN12Slave7Defect, operation-cycle=DefaultOperationCycle  # Event_Oper_Cycle_Map_LIN 12 Slave 7_Defect
  diagnostic event to debounce algorithm mapping EventDebounceMapLIN12Slave7Defect: debounce-algorithm=counter_based, diagnostic-event=EventLIN12Slave7Defect  # EventDebounceMap_LIN 12 Slave 7_Defect
package /ZeC/DTC/DTC/Power_Path_050_Short_to_GND_Failure
  diagnostic trouble code uds Power_Path_050_Short_to_GND_Failure: dtc-props=Dtc_Props_3c731913, uds-dtc-value=0x005232
  diagnostic event EventPowerPath050ShortToGNDFailure: aging-allowed=true, event-kind=SWC, prestorage-freeze-frame=false  # Event_Power_Path_050_Short_to_GND_Failure
  diagnostic event to trouble code uds mapping EventDtcMapPowerPath050ShortToGNDFailure: diagnostic-event=EventPowerPath050ShortToGNDFailure, trouble-code-uds=Power_Path_050_Short_to_GND_Failure  # Event_Dtc_Map_Power_Path_050_Short_to_GND_Failure
  diagnostic event to operation cycle mapping EventOperCycleMapPowerPath050ShortToGNDFailure: diagnostic-event=EventPowerPath050ShortToGNDFailure, operation-cycle=DefaultOperationCycle  # Event_Oper_Cycle_Map_Power_Path_050_Short_to_GND_Failure
  diagnostic event to debounce algorithm mapping EventDebounceMapPowerPath050ShortToGNDFailure: debounce-algorithm=time_based, diagnostic-event=EventPowerPath050ShortToGNDFailure  # EventDebounceMap_Power_Path_050_Short_to_GND_Failure
package /ZeC/DTC/DTC/Power_Path_053_Short_to_GND_Failure
  diagnostic trouble code uds Power_Path_053_Short_to_GND_Failure: dtc-props=Dtc_Props_354d29f4, uds-dtc-value=0x005235
  diagnostic event EventPowerPath053ShortToGNDFailure: aging-allowed=true, event-kind=SWC, prestorage-freeze-frame=false  # Event_Power_Path_053_Short_to_GND_Failure
  diagnostic event to trouble code uds mapping EventDtcMapPowerPath053ShortToGNDFailure: diagnostic-event=EventPowerPath053ShortToGNDFailure, trouble-code-uds=Power_Path_053_Short_to_GND_Failure  # Event_Dtc_Map_Power_Path_053_Short_to_GND_Failure
  diagnostic event to operation cycle mapping EventOperCycleMapPowerPath053ShortToGNDFailure: diagnostic-event=EventPowerPath053ShortToGNDFailure, operation-cycle=DefaultOperationCycle  # Event_Oper_Cycle_Map_Power_Path_053_Short_to_GND_Failure
  diagnostic event to debounce algorithm mapping EventDebounceMapPowerPath053ShortToGNDFailure: debounce-algorithm=time_based, diagnostic-event=EventPowerPath053ShortToGNDFailure  # EventDebounceMap_Power_Path_053_Short_to_GND_Failure
package /ZeC/DTC/DTC/Power_Path_052_Short_to_GND_Failure
  diagnostic trouble code uds Power_Path_052_Short_to_GND_Failure: dtc-props=Dtc_Props_735423ce, uds-dtc-value=0x005234
  diagnostic event EventPowerPath052ShortToGNDFailure: aging-allowed=true, event-kind=SWC, prestorage-freeze-frame=false  # Event_Power_Path_052_Short_to_GND_Failure
  diagnostic event to trouble code uds mapping EventDtcMapPowerPath052ShortToGNDFailure: diagnostic-event=EventPowerPath052ShortToGNDFailure, trouble-code-uds=Power_Path_052_Short_to_GND_Failure  # Event_Dtc_Map_Power_Path_052_Short_to_GND_Failure
  diagnostic event to operation cycle mapping EventOperCycleMapPowerPath052ShortToGNDFailure: diagnostic-event=EventPowerPath052ShortToGNDFailure, operation-cycle=DefaultOperationCycle  # Event_Oper_Cycle_Map_Power_Path_052_Short_to_GND_Failure
  diagnostic event to debounce algorithm mapping EventDebounceMapPowerPath052ShortToGNDFailure: debounce-algorithm=time_based, diagnostic-event=EventPowerPath052ShortToGNDFailure  # EventDebounceMap_Power_Path_052_Short_to_GND_Failure
package /ZeC/DTC/DTC/Power_Path_049_Short_to_GND_Failure
  diagnostic trouble code uds Power_Path_049_Short_to_GND_Failure: dtc-props=Dtc_Props_f658075d, uds-dtc-value=0x005231
  diagnostic event EventPowerPath049ShortToGNDFailure: aging-allowed=true, event-kind=SWC, prestorage-freeze-frame=false  # Event_Power_Path_049_Short_to_GND_Failure
  diagnostic event to trouble code uds mapping EventDtcMapPowerPath049ShortToGNDFailure: diagnostic-event=EventPowerPath049ShortToGNDFailure, trouble-code-uds=Power_Path_049_Short_to_GND_Failure  # Event_Dtc_Map_Power_Path_049_Short_to_GND_Failure
  diagnostic event to operation cycle mapping EventOperCycleMapPowerPath049ShortToGNDFailure: diagnostic-event=EventPowerPath049ShortToGNDFailure, operation-cycle=DefaultOperationCycle  # Event_Oper_Cycle_Map_Power_Path_049_Short_to_GND_Failure
  diagnostic event to debounce algorithm mapping EventDebounceMapPowerPath049ShortToGNDFailure: debounce-algorithm=time_based, diagnostic-event=EventPowerPath049ShortToGNDFailure  # EventDebounceMap_Power_Path_049_Short_to_GND_Failure
package /ZeC/DTC/DTC/Power_Path_048_Short_to_GND_Failure
  diagnostic trouble code uds Power_Path_048_Short_to_GND_Failure: dtc-props=Dtc_Props_b0410d67, uds-dtc-value=0x005230
  diagnostic event EventPowerPath048ShortToGNDFailure: aging-allowed=true, event-kind=SWC, prestorage-freeze-frame=false  # Event_Power_Path_048_Short_to_GND_Failure
  diagnostic event to trouble code uds mapping EventDtcMapPowerPath048ShortToGNDFailure: diagnostic-event=EventPowerPath048ShortToGNDFailure, trouble-code-uds=Power_Path_048_Short_to_GND_Failure  # Event_Dtc_Map_Power_Path_048_Short_to_GND_Failure
  diagnostic event to operation cycle mapping EventOperCycleMapPowerPath048ShortToGNDFailure: diagnostic-event=EventPowerPath048ShortToGNDFailure, operation-cycle=DefaultOperationCycle  # Event_Oper_Cycle_Map_Power_Path_048_Short_to_GND_Failure
  diagnostic event to debounce algorithm mapping EventDebounceMapPowerPath048ShortToGNDFailure: debounce-algorithm=time_based, diagnostic-event=EventPowerPath048ShortToGNDFailure  # EventDebounceMap_Power_Path_048_Short_to_GND_Failure
package /ZeC/DTC/DTC/Power_Path_025_Short_to_GND_Failure
  diagnostic trouble code uds Power_Path_025_Short_to_GND_Failure: dtc-props=Dtc_Props_fce7db7f, uds-dtc-value=0x005219
  diagnostic event EventPowerPath025ShortToGNDFailure: aging-allowed=true, event-kind=SWC, prestorage-freeze-frame=false  # Event_Power_Path_025_Short_to_GND_Failure
  diagnostic event to trouble code uds mapping EventDtcMapPowerPath025ShortToGNDFailure: diagnostic-event=EventPowerPath025ShortToGNDFailure, trouble-code-uds=Power_Path_025_Short_to_GND_Failure  # Event_Dtc_Map_Power_Path_025_Short_to_GND_Failure
  diagnostic event to operation cycle mapping EventOperCycleMapPowerPath025ShortToGNDFailure: diagnostic-event=EventPowerPath025ShortToGNDFailure, operation-cycle=DefaultOperationCycle  # Event_Oper_Cycle_Map_Power_Path_025_Short_to_GND_Failure
  diagnostic event to debounce algorithm mapping EventDebounceMapPowerPath025ShortToGNDFailure: debounce-algorithm=time_based, diagnostic-event=EventPowerPath025ShortToGNDFailure  # EventDebounceMap_Power_Path_025_Short_to_GND_Failure
package /ZeC/DTC/DTC/Power_Path_024_Short_to_GND_Failure
  diagnostic trouble code uds Power_Path_024_Short_to_GND_Failure: dtc-props=Dtc_Props_bafed145, uds-dtc-value=0x005218
  diagnostic event EventPowerPath024ShortToGNDFailure: aging-allowed=true, event-kind=SWC, prestorage-freeze-frame=false  # Event_Power_Path_024_Short_to_GND_Failure
  diagnostic event to trouble code uds mapping EventDtcMapPowerPath024ShortToGNDFailure: diagnostic-event=EventPowerPath024ShortToGNDFailure, trouble-code-uds=Power_Path_024_Short_to_GND_Failure  # Event_Dtc_Map_Power_Path_024_Short_to_GND_Failure
  diagnostic event to operation cycle mapping EventOperCycleMapPowerPath024ShortToGNDFailure: diagnostic-event=EventPowerPath024ShortToGNDFailure, operation-cycle=DefaultOperationCycle  # Event_Oper_Cycle_Map_Power_Path_024_Short_to_GND_Failure
  diagnostic event to debounce algorithm mapping EventDebounceMapPowerPath024ShortToGNDFailure: debounce-algorithm=time_based, diagnostic-event=EventPowerPath024ShortToGNDFailure  # EventDebounceMap_Power_Path_024_Short_to_GND_Failure
package /ZeC/DTC/DTC/LIN_12_Slave_13_Defect
  diagnostic trouble code uds LIN_12_Slave_13_Defect: dtc-props=Dtc_Props_358996c7, uds-dtc-value=0x030c0f  # LIN 12 Slave 13_Defect
  diagnostic event EventLIN12Slave13Defect: aging-allowed=true, event-kind=SWC, prestorage-freeze-frame=false  # Event_LIN 12 Slave 13_Defect
  diagnostic event to trouble code uds mapping EventDtcMapLIN12Slave13Defect: diagnostic-event=EventLIN12Slave13Defect, trouble-code-uds=LIN_12_Slave_13_Defect  # Event_Dtc_Map_LIN 12 Slave 13_Defect
  diagnostic event to operation cycle mapping EventOperCycleMapLIN12Slave13Defect: diagnostic-event=EventLIN12Slave13Defect, operation-cycle=DefaultOperationCycle  # Event_Oper_Cycle_Map_LIN 12 Slave 13_Defect
  diagnostic event to debounce algorithm mapping EventDebounceMapLIN12Slave13Defect: debounce-algorithm=counter_based, diagnostic-event=EventLIN12Slave13Defect  # EventDebounceMap_LIN 12 Slave 13_Defect
package /ZeC/DTC/DTC/LIN_12_Slave_12_Defect
  diagnostic trouble code uds LIN_12_Slave_12_Defect: dtc-props=Dtc_Props_358996c7, uds-dtc-value=0x030c0d  # LIN 12 Slave 12_Defect
  diagnostic event EventLIN12Slave12Defect: aging-allowed=true, event-kind=SWC, prestorage-freeze-frame=false  # Event_LIN 12 Slave 12_Defect
  diagnostic event to trouble code uds mapping EventDtcMapLIN12Slave12Defect: diagnostic-event=EventLIN12Slave12Defect, trouble-code-uds=LIN_12_Slave_12_Defect  # Event_Dtc_Map_LIN 12 Slave 12_Defect
  diagnostic event to operation cycle mapping EventOperCycleMapLIN12Slave12Defect: diagnostic-event=EventLIN12Slave12Defect, operation-cycle=DefaultOperationCycle  # Event_Oper_Cycle_Map_LIN 12 Slave 12_Defect
  diagnostic event to debounce algorithm mapping EventDebounceMapLIN12Slave12Defect: debounce-algorithm=counter_based, diagnostic-event=EventLIN12Slave12Defect  # EventDebounceMap_LIN 12 Slave 12_Defect
package /ZeC/DTC/DTC/Power_Path_021_Short_to_GND_Failure
  diagnostic trouble code uds Power_Path_021_Short_to_GND_Failure: dtc-props=Dtc_Props_62a9aec5, uds-dtc-value=0x005215
  diagnostic event EventPowerPath021ShortToGNDFailure: aging-allowed=true, event-kind=SWC, prestorage-freeze-frame=false  # Event_Power_Path_021_Short_to_GND_Failure
  diagnostic event to trouble code uds mapping EventDtcMapPowerPath021ShortToGNDFailure: diagnostic-event=EventPowerPath021ShortToGNDFailure, trouble-code-uds=Power_Path_021_Short_to_GND_Failure  # Event_Dtc_Map_Power_Path_021_Short_to_GND_Failure
  diagnostic event to operation cycle mapping EventOperCycleMapPowerPath021ShortToGNDFailure: diagnostic-event=EventPowerPath021ShortToGNDFailure, operation-cycle=DefaultOperationCycle  # Event_Oper_Cycle_Map_Power_Path_021_Short_to_GND_Failure
  diagnostic event to debounce algorithm mapping EventDebounceMapPowerPath021ShortToGNDFailure: debounce-algorithm=time_based, diagnostic-event=EventPowerPath021ShortToGNDFailure  # EventDebounceMap_Power_Path_021_Short_to_GND_Failure
package /ZeC/DTC/DTC/Power_Path_153_Not_Found_Failure
  diagnostic trouble code uds Power_Path_153_Not_Found_Failure: dtc-props=Dtc_Props_7804c1fa, uds-dtc-value=0x005699
  diagnostic event EventPowerPath153NotFoundFailure: aging-allowed=true, event-kind=SWC, prestorage-freeze-frame=false  # Event_Power_Path_153_Not_Found_Failure
  diagnostic event to trouble code uds mapping EventDtcMapPowerPath153NotFoundFailure: diagnostic-event=EventPowerPath153NotFoundFailure, trouble-code-uds=Power_Path_153_Not_Found_Failure  # Event_Dtc_Map_Power_Path_153_Not_Found_Failure
  diagnostic event to operation cycle mapping EventOperCycleMapPowerPath153NotFoundFailure: diagnostic-event=EventPowerPath153NotFoundFailure, operation-cycle=DefaultOperationCycle  # Event_Oper_Cycle_Map_Power_Path_153_Not_Found_Failure
  diagnostic event to debounce algorithm mapping EventDebounceMapPowerPath153NotFoundFailure: debounce-algorithm=time_based, diagnostic-event=EventPowerPath153NotFoundFailure  # EventDebounceMap_Power_Path_153_Not_Found_Failure
package /ZeC/DTC/DTC/LIN_12_Slave_12_NoCommunication
  diagnostic trouble code uds LIN_12_Slave_12_NoCommunication: dtc-props=Dtc_Props_358996c7, uds-dtc-value=0x030c0e  # LIN 12 Slave 12_NoCommunication
  diagnostic event EventLIN12Slave12NoCommunication: aging-allowed=true, event-kind=SWC, prestorage-freeze-frame=false  # Event_LIN 12 Slave 12_NoCommunication
  diagnostic event to trouble code uds mapping EventDtcMapLIN12Slave12NoCommunication: diagnostic-event=EventLIN12Slave12NoCommunication, trouble-code-uds=LIN_12_Slave_12_NoCommunication  # Event_Dtc_Map_LIN 12 Slave 12_NoCommunication
  diagnostic event to operation cycle mapping EventOperCycleMapLIN12Slave12NoCommunication: diagnostic-event=EventLIN12Slave12NoCommunication, operation-cycle=DefaultOperationCycle  # Event_Oper_Cycle_Map_LIN 12 Slave 12_NoCommunication
  diagnostic event to debounce algorithm mapping EventDebounceMapLIN12Slave12NoCommunication: debounce-algorithm=counter_based, diagnostic-event=EventLIN12Slave12NoCommunication  # EventDebounceMap_LIN 12 Slave 12_NoCommunication
package /ZeC/DTC/DTC/Power_Path_020_Short_to_GND_Failure
  diagnostic trouble code uds Power_Path_020_Short_to_GND_Failure: dtc-props=Dtc_Props_24b0a4ff, uds-dtc-value=0x005214
  diagnostic event EventPowerPath020ShortToGNDFailure: aging-allowed=true, event-kind=SWC, prestorage-freeze-frame=false  # Event_Power_Path_020_Short_to_GND_Failure
  diagnostic event to trouble code uds mapping EventDtcMapPowerPath020ShortToGNDFailure: diagnostic-event=EventPowerPath020ShortToGNDFailure, trouble-code-uds=Power_Path_020_Short_to_GND_Failure  # Event_Dtc_Map_Power_Path_020_Short_to_GND_Failure
  diagnostic event to operation cycle mapping EventOperCycleMapPowerPath020ShortToGNDFailure: diagnostic-event=EventPowerPath020ShortToGNDFailure, operation-cycle=DefaultOperationCycle  # Event_Oper_Cycle_Map_Power_Path_020_Short_to_GND_Failure
  diagnostic event to debounce algorithm mapping EventDebounceMapPowerPath020ShortToGNDFailure: debounce-algorithm=time_based, diagnostic-event=EventPowerPath020ShortToGNDFailure  # EventDebounceMap_Power_Path_020_Short_to_GND_Failure
package /ZeC/DTC/DTC/Power_Path_152_Not_Found_Failure
  diagnostic trouble code uds Power_Path_152_Not_Found_Failure: dtc-props=Dtc_Props_3e1dcbc0, uds-dtc-value=0x005698
  diagnostic event EventPowerPath152NotFoundFailure: aging-allowed=true, event-kind=SWC, prestorage-freeze-frame=false  # Event_Power_Path_152_Not_Found_Failure
  diagnostic event to trouble code uds mapping EventDtcMapPowerPath152NotFoundFailure: diagnostic-event=EventPowerPath152NotFoundFailure, trouble-code-uds=Power_Path_152_Not_Found_Failure  # Event_Dtc_Map_Power_Path_152_Not_Found_Failure
  diagnostic event to operation cycle mapping EventOperCycleMapPowerPath152NotFoundFailure: diagnostic-event=EventPowerPath152NotFoundFailure, operation-cycle=DefaultOperationCycle  # Event_Oper_Cycle_Map_Power_Path_152_Not_Found_Failure
  diagnostic event to debounce algorithm mapping EventDebounceMapPowerPath152NotFoundFailure: debounce-algorithm=time_based, diagnostic-event=EventPowerPath152NotFoundFailure  # EventDebounceMap_Power_Path_152_Not_Found_Failure
package /ZeC/DTC/DTC/LIN_12_Slave_11_Defect
  diagnostic trouble code uds LIN_12_Slave_11_Defect: dtc-props=Dtc_Props_358996c7, uds-dtc-value=0x030c0b  # LIN 12 Slave 11_Defect
  diagnostic event EventLIN12Slave11Defect: aging-allowed=true, event-kind=SWC, prestorage-freeze-frame=false  # Event_LIN 12 Slave 11_Defect
  diagnostic event to trouble code uds mapping EventDtcMapLIN12Slave11Defect: diagnostic-event=EventLIN12Slave11Defect, trouble-code-uds=LIN_12_Slave_11_Defect  # Event_Dtc_Map_LIN 12 Slave 11_Defect
  diagnostic event to operation cycle mapping EventOperCycleMapLIN12Slave11Defect: diagnostic-event=EventLIN12Slave11Defect, operation-cycle=DefaultOperationCycle  # Event_Oper_Cycle_Map_LIN 12 Slave 11_Defect
  diagnostic event to debounce algorithm mapping EventDebounceMapLIN12Slave11Defect: debounce-algorithm=counter_based, diagnostic-event=EventLIN12Slave11Defect  # EventDebounceMap_LIN 12 Slave 11_Defect
package /ZeC/DTC/DTC/Power_Path_023_Short_to_GND_Failure
  diagnostic trouble code uds Power_Path_023_Short_to_GND_Failure: dtc-props=Dtc_Props_ee9bbab1, uds-dtc-value=0x005217
  diagnostic event EventPowerPath023ShortToGNDFailure: aging-allowed=true, event-kind=SWC, prestorage-freeze-frame=false  # Event_Power_Path_023_Short_to_GND_Failure
  diagnostic event to trouble code uds mapping EventDtcMapPowerPath023ShortToGNDFailure: diagnostic-event=EventPowerPath023ShortToGNDFailure, trouble-code-uds=Power_Path_023_Short_to_GND_Failure  # Event_Dtc_Map_Power_Path_023_Short_to_GND_Failure
  diagnostic event to operation cycle mapping EventOperCycleMapPowerPath023ShortToGNDFailure: diagnostic-event=EventPowerPath023ShortToGNDFailure, operation-cycle=DefaultOperationCycle  # Event_Oper_Cycle_Map_Power_Path_023_Short_to_GND_Failure
  diagnostic event to debounce algorithm mapping EventDebounceMapPowerPath023ShortToGNDFailure: debounce-algorithm=time_based, diagnostic-event=EventPowerPath023ShortToGNDFailure  # EventDebounceMap_Power_Path_023_Short_to_GND_Failure
package /ZeC/DTC/DTC/LIN_12_Slave_11_NoCommunication
  diagnostic trouble code uds LIN_12_Slave_11_NoCommunication: dtc-props=Dtc_Props_358996c7, uds-dtc-value=0x030c0c  # LIN 12 Slave 11_NoCommunication
  diagnostic event EventLIN12Slave11NoCommunication: aging-allowed=true, event-kind=SWC, prestorage-freeze-frame=false  # Event_LIN 12 Slave 11_NoCommunication
  diagnostic event to trouble code uds mapping EventDtcMapLIN12Slave11NoCommunication: diagnostic-event=EventLIN12Slave11NoCommunication, trouble-code-uds=LIN_12_Slave_11_NoCommunication  # Event_Dtc_Map_LIN 12 Slave 11_NoCommunication
  diagnostic event to operation cycle mapping EventOperCycleMapLIN12Slave11NoCommunication: diagnostic-event=EventLIN12Slave11NoCommunication, operation-cycle=DefaultOperationCycle  # Event_Oper_Cycle_Map_LIN 12 Slave 11_NoCommunication
  diagnostic event to debounce algorithm mapping EventDebounceMapLIN12Slave11NoCommunication: debounce-algorithm=counter_based, diagnostic-event=EventLIN12Slave11NoCommunication  # EventDebounceMap_LIN 12 Slave 11_NoCommunication
package /ZeC/DTC/DTC/Power_Path_022_Short_to_GND_Failure
  diagnostic trouble code uds Power_Path_022_Short_to_GND_Failure: dtc-props=Dtc_Props_a882b08b, uds-dtc-value=0x005216
  diagnostic event EventPowerPath022ShortToGNDFailure: aging-allowed=true, event-kind=SWC, prestorage-freeze-frame=false  # Event_Power_Path_022_Short_to_GND_Failure
  diagnostic event to trouble code uds mapping EventDtcMapPowerPath022ShortToGNDFailure: diagnostic-event=EventPowerPath022ShortToGNDFailure, trouble-code-uds=Power_Path_022_Short_to_GND_Failure  # Event_Dtc_Map_Power_Path_022_Short_to_GND_Failure
  diagnostic event to operation cycle mapping EventOperCycleMapPowerPath022ShortToGNDFailure: diagnostic-event=EventPowerPath022ShortToGNDFailure, operation-cycle=DefaultOperationCycle  # Event_Oper_Cycle_Map_Power_Path_022_Short_to_GND_Failure
  diagnostic event to debounce algorithm mapping EventDebounceMapPowerPath022ShortToGNDFailure: debounce-algorithm=time_based, diagnostic-event=EventPowerPath022ShortToGNDFailure  # EventDebounceMap_Power_Path_022_Short_to_GND_Failure
package /ZeC/DTC/DTC/LIN_21_Local_Databus_Electrical_Failure
  diagnostic trouble code uds LIN_21_Local_Databus_Electrical_Failure: dtc-props=Dtc_Props_358996c7, uds-dtc-value=0x031521  # LIN 21 Local_Databus_Electrical_Failure
  diagnostic event EventLIN21LocalDatabusElectricalFailure: aging-allowed=true, event-kind=SWC, prestorage-freeze-frame=false  # Event_LIN 21 Local_Databus_Electrical_Failure
  diagnostic event to trouble code uds mapping EventDtcMapLIN21LocalDatabusElectricalFailure: diagnostic-event=EventLIN21LocalDatabusElectricalFailure, trouble-code-uds=LIN_21_Local_Databus_Electrical_Failure  # Event_Dtc_Map_LIN 21 Local_Databus_Electrical_Failure
  diagnostic event to operation cycle mapping EventOperCycleMapLIN21LocalDatabusElectricalFailure: diagnostic-event=EventLIN21LocalDatabusElectricalFailure, operation-cycle=DefaultOperationCycle  # Event_Oper_Cycle_Map_LIN 21 Local_Databus_Electrical_Failure
  diagnostic event to debounce algorithm mapping EventDebounceMapLIN21LocalDatabusElectricalFailure: debounce-algorithm=counter_based, diagnostic-event=EventLIN21LocalDatabusElectricalFailure  # EventDebounceMap_LIN 21 Local_Databus_Electrical_Failure
package /ZeC/DTC/DTC/Power_Path_026_Short_to_GND_Failure
  diagnostic trouble code uds Power_Path_026_Short_to_GND_Failure: dtc-props=Dtc_Props_9c43e411, uds-dtc-value=0x00521a
  diagnostic event EventPowerPath026ShortToGNDFailure: aging-allowed=true, event-kind=SWC, prestorage-freeze-frame=false  # Event_Power_Path_026_Short_to_GND_Failure
  diagnostic event to trouble code uds mapping EventDtcMapPowerPath026ShortToGNDFailure: diagnostic-event=EventPowerPath026ShortToGNDFailure, trouble-code-uds=Power_Path_026_Short_to_GND_Failure  # Event_Dtc_Map_Power_Path_026_Short_to_GND_Failure
  diagnostic event to operation cycle mapping EventOperCycleMapPowerPath026ShortToGNDFailure: diagnostic-event=EventPowerPath026ShortToGNDFailure, operation-cycle=DefaultOperationCycle  # Event_Oper_Cycle_Map_Power_Path_026_Short_to_GND_Failure
  diagnostic event to debounce algorithm mapping EventDebounceMapPowerPath026ShortToGNDFailure: debounce-algorithm=time_based, diagnostic-event=EventPowerPath026ShortToGNDFailure  # EventDebounceMap_Power_Path_026_Short_to_GND_Failure
package /ZeC/DTC/DTC/Power_Path_158_Not_Found_Failure
  diagnostic trouble code uds Power_Path_158_Not_Found_Failure: dtc-props=Dtc_Props_dbb5d03d, uds-dtc-value=0x00569e
  diagnostic event EventPowerPath158NotFoundFailure: aging-allowed=true, event-kind=SWC, prestorage-freeze-frame=false  # Event_Power_Path_158_Not_Found_Failure
  diagnostic event to trouble code uds mapping EventDtcMapPowerPath158NotFoundFailure: diagnostic-event=EventPowerPath158NotFoundFailure, trouble-code-uds=Power_Path_158_Not_Found_Failure  # Event_Dtc_Map_Power_Path_158_Not_Found_Failure
  diagnostic event to operation cycle mapping EventOperCycleMapPowerPath158NotFoundFailure: diagnostic-event=EventPowerPath158NotFoundFailure, operation-cycle=DefaultOperationCycle  # Event_Oper_Cycle_Map_Power_Path_158_Not_Found_Failure
  diagnostic event to debounce algorithm mapping EventDebounceMapPowerPath158NotFoundFailure: debounce-algorithm=time_based, diagnostic-event=EventPowerPath158NotFoundFailure  # EventDebounceMap_Power_Path_158_Not_Found_Failure
package /ZeC/DTC/DTC/LIN_12_Slave_10_NoCommunication
  diagnostic trouble code uds LIN_12_Slave_10_NoCommunication: dtc-props=Dtc_Props_358996c7, uds-dtc-value=0x030c0a  # LIN 12 Slave 10_NoCommunication
  diagnostic event EventLIN12Slave10NoCommunication: aging-allowed=true, event-kind=SWC, prestorage-freeze-frame=false  # Event_LIN 12 Slave 10_NoCommunication
  diagnostic event to trouble code uds mapping EventDtcMapLIN12Slave10NoCommunication: diagnostic-event=EventLIN12Slave10NoCommunication, trouble-code-uds=LIN_12_Slave_10_NoCommunication  # Event_Dtc_Map_LIN 12 Slave 10_NoCommunication
  diagnostic event to operation cycle mapping EventOperCycleMapLIN12Slave10NoCommunication: diagnostic-event=EventLIN12Slave10NoCommunication, operation-cycle=DefaultOperationCycle  # Event_Oper_Cycle_Map_LIN 12 Slave 10_NoCommunication
  diagnostic event to debounce algorithm mapping EventDebounceMapLIN12Slave10NoCommunication: debounce-algorithm=counter_based, diagnostic-event=EventLIN12Slave10NoCommunication  # EventDebounceMap_LIN 12 Slave 10_NoCommunication
package /ZeC/DTC/DTC/Power_Path_157_Not_Found_Failure
  diagnostic trouble code uds Power_Path_157_Not_Found_Failure: dtc-props=Dtc_Props_9dacda07, uds-dtc-value=0x00569d
  diagnostic event EventPowerPath157NotFoundFailure: aging-allowed=true, event-kind=SWC, prestorage-freeze-frame=false  # Event_Power_Path_157_Not_Found_Failure
  diagnostic event to trouble code uds mapping EventDtcMapPowerPath157NotFoundFailure: diagnostic-event=EventPowerPath157NotFoundFailure, trouble-code-uds=Power_Path_157_Not_Found_Failure  # Event_Dtc_Map_Power_Path_157_Not_Found_Failure
  diagnostic event to operation cycle mapping EventOperCycleMapPowerPath157NotFoundFailure: diagnostic-event=EventPowerPath157NotFoundFailure, operation-cycle=DefaultOperationCycle  # Event_Oper_Cycle_Map_Power_Path_157_Not_Found_Failure
  diagnostic event to debounce algorithm mapping EventDebounceMapPowerPath157NotFoundFailure: debounce-algorithm=time_based, diagnostic-event=EventPowerPath157NotFoundFailure  # EventDebounceMap_Power_Path_157_Not_Found_Failure
package /ZeC/DTC/DTC/Power_Path_028_Short_to_GND_Failure
  diagnostic trouble code uds Power_Path_028_Short_to_GND_Failure: dtc-props=Dtc_Props_1071f065, uds-dtc-value=0x00521c
  diagnostic event EventPowerPath028ShortToGNDFailure: aging-allowed=true, event-kind=SWC, prestorage-freeze-frame=false  # Event_Power_Path_028_Short_to_GND_Failure
  diagnostic event to trouble code uds mapping EventDtcMapPowerPath028ShortToGNDFailure: diagnostic-event=EventPowerPath028ShortToGNDFailure, trouble-code-uds=Power_Path_028_Short_to_GND_Failure  # Event_Dtc_Map_Power_Path_028_Short_to_GND_Failure
  diagnostic event to operation cycle mapping EventOperCycleMapPowerPath028ShortToGNDFailure: diagnostic-event=EventPowerPath028ShortToGNDFailure, operation-cycle=DefaultOperationCycle  # Event_Oper_Cycle_Map_Power_Path_028_Short_to_GND_Failure
  diagnostic event to debounce algorithm mapping EventDebounceMapPowerPath028ShortToGNDFailure: debounce-algorithm=time_based, diagnostic-event=EventPowerPath028ShortToGNDFailure  # EventDebounceMap_Power_Path_028_Short_to_GND_Failure
package /ZeC/DTC/DTC/LIN_21_Databus_No_Comm
  diagnostic trouble code uds LIN_21_Databus_No_Comm: dtc-props=Dtc_Props_358996c7, uds-dtc-value=0x031520  # LIN 21 Databus_No_Comm
  diagnostic event EventLIN21DatabusNoComm: aging-allowed=true, event-kind=SWC, prestorage-freeze-frame=false  # Event_LIN 21 Databus_No_Comm
  diagnostic event to trouble code uds mapping EventDtcMapLIN21DatabusNoComm: diagnostic-event=EventLIN21DatabusNoComm, trouble-code-uds=LIN_21_Databus_No_Comm  # Event_Dtc_Map_LIN 21 Databus_No_Comm
  diagnostic event to operation cycle mapping EventOperCycleMapLIN21DatabusNoComm: diagnostic-event=EventLIN21DatabusNoComm, operation-cycle=DefaultOperationCycle  # Event_Oper_Cycle_Map_LIN 21 Databus_No_Comm
  diagnostic event to debounce algorithm mapping EventDebounceMapLIN21DatabusNoComm: debounce-algorithm=counter_based, diagnostic-event=EventLIN21DatabusNoComm  # EventDebounceMap_LIN 21 Databus_No_Comm
package /ZeC/DTC/DTC/Power_Path_027_Short_to_GND_Failure
  diagnostic trouble code uds Power_Path_027_Short_to_GND_Failure: dtc-props=Dtc_Props_5668fa5f, uds-dtc-value=0x00521b
  diagnostic event EventPowerPath027ShortToGNDFailure: aging-allowed=true, event-kind=SWC, prestorage-freeze-frame=false  # Event_Power_Path_027_Short_to_GND_Failure
  diagnostic event to trouble code uds mapping EventDtcMapPowerPath027ShortToGNDFailure: diagnostic-event=EventPowerPath027ShortToGNDFailure, trouble-code-uds=Power_Path_027_Short_to_GND_Failure  # Event_Dtc_Map_Power_Path_027_Short_to_GND_Failure
  diagnostic event to operation cycle mapping EventOperCycleMapPowerPath027ShortToGNDFailure: diagnostic-event=EventPowerPath027ShortToGNDFailure, operation-cycle=DefaultOperationCycle  # Event_Oper_Cycle_Map_Power_Path_027_Short_to_GND_Failure
  diagnostic event to debounce algorithm mapping EventDebounceMapPowerPath027ShortToGNDFailure: debounce-algorithm=time_based, diagnostic-event=EventPowerPath027ShortToGNDFailure  # EventDebounceMap_Power_Path_027_Short_to_GND_Failure
package /ZeC/DTC/DTC/Power_Path_159_Not_Found_Failure
  diagnostic trouble code uds Power_Path_159_Not_Found_Failure: dtc-props=Dtc_Props_119ece73, uds-dtc-value=0x00569f
  diagnostic event EventPowerPath159NotFoundFailure: aging-allowed=true, event-kind=SWC, prestorage-freeze-frame=false  # Event_Power_Path_159_Not_Found_Failure
  diagnostic event to trouble code uds mapping EventDtcMapPowerPath159NotFoundFailure: diagnostic-event=EventPowerPath159NotFoundFailure, trouble-code-uds=Power_Path_159_Not_Found_Failure  # Event_Dtc_Map_Power_Path_159_Not_Found_Failure
  diagnostic event to operation cycle mapping EventOperCycleMapPowerPath159NotFoundFailure: diagnostic-event=EventPowerPath159NotFoundFailure, operation-cycle=DefaultOperationCycle  # Event_Oper_Cycle_Map_Power_Path_159_Not_Found_Failure
  diagnostic event to debounce algorithm mapping EventDebounceMapPowerPath159NotFoundFailure: debounce-algorithm=time_based, diagnostic-event=EventPowerPath159NotFoundFailure  # EventDebounceMap_Power_Path_159_Not_Found_Failure
package /ZeC/DTC/DTC/Power_Path_154_Not_Found_Failure
  diagnostic trouble code uds Power_Path_154_Not_Found_Failure: dtc-props=Dtc_Props_18a0fe94, uds-dtc-value=0x00569a
  diagnostic event EventPowerPath154NotFoundFailure: aging-allowed=true, event-kind=SWC, prestorage-freeze-frame=false  # Event_Power_Path_154_Not_Found_Failure
  diagnostic event to trouble code uds mapping EventDtcMapPowerPath154NotFoundFailure: diagnostic-event=EventPowerPath154NotFoundFailure, trouble-code-uds=Power_Path_154_Not_Found_Failure  # Event_Dtc_Map_Power_Path_154_Not_Found_Failure
  diagnostic event to operation cycle mapping EventOperCycleMapPowerPath154NotFoundFailure: diagnostic-event=EventPowerPath154NotFoundFailure, operation-cycle=DefaultOperationCycle  # Event_Oper_Cycle_Map_Power_Path_154_Not_Found_Failure
  diagnostic event to debounce algorithm mapping EventDebounceMapPowerPath154NotFoundFailure: debounce-algorithm=time_based, diagnostic-event=EventPowerPath154NotFoundFailure  # EventDebounceMap_Power_Path_154_Not_Found_Failure
package /ZeC/DTC/DTC/Power_Path_156_Not_Found_Failure
  diagnostic trouble code uds Power_Path_156_Not_Found_Failure: dtc-props=Dtc_Props_9492eae0, uds-dtc-value=0x00569c
  diagnostic event EventPowerPath156NotFoundFailure: aging-allowed=true, event-kind=SWC, prestorage-freeze-frame=false  # Event_Power_Path_156_Not_Found_Failure
  diagnostic event to trouble code uds mapping EventDtcMapPowerPath156NotFoundFailure: diagnostic-event=EventPowerPath156NotFoundFailure, trouble-code-uds=Power_Path_156_Not_Found_Failure  # Event_Dtc_Map_Power_Path_156_Not_Found_Failure
  diagnostic event to operation cycle mapping EventOperCycleMapPowerPath156NotFoundFailure: diagnostic-event=EventPowerPath156NotFoundFailure, operation-cycle=DefaultOperationCycle  # Event_Oper_Cycle_Map_Power_Path_156_Not_Found_Failure
  diagnostic event to debounce algorithm mapping EventDebounceMapPowerPath156NotFoundFailure: debounce-algorithm=time_based, diagnostic-event=EventPowerPath156NotFoundFailure  # EventDebounceMap_Power_Path_156_Not_Found_Failure
package /ZeC/DTC/DTC/Power_Path_155_Not_Found_Failure
  diagnostic trouble code uds Power_Path_155_Not_Found_Failure: dtc-props=Dtc_Props_d28be0da, uds-dtc-value=0x00569b
  diagnostic event EventPowerPath155NotFoundFailure: aging-allowed=true, event-kind=SWC, prestorage-freeze-frame=false  # Event_Power_Path_155_Not_Found_Failure
  diagnostic event to trouble code uds mapping EventDtcMapPowerPath155NotFoundFailure: diagnostic-event=EventPowerPath155NotFoundFailure, trouble-code-uds=Power_Path_155_Not_Found_Failure  # Event_Dtc_Map_Power_Path_155_Not_Found_Failure
  diagnostic event to operation cycle mapping EventOperCycleMapPowerPath155NotFoundFailure: diagnostic-event=EventPowerPath155NotFoundFailure, operation-cycle=DefaultOperationCycle  # Event_Oper_Cycle_Map_Power_Path_155_Not_Found_Failure
  diagnostic event to debounce algorithm mapping EventDebounceMapPowerPath155NotFoundFailure: debounce-algorithm=time_based, diagnostic-event=EventPowerPath155NotFoundFailure  # EventDebounceMap_Power_Path_155_Not_Found_Failure
package /ZeC/DTC/DTC/LIN_12_Slave_4_Defect
  diagnostic trouble code uds LIN_12_Slave_4_Defect: dtc-props=Dtc_Props_358996c7, uds-dtc-value=0x030c19  # LIN 12 Slave 4_Defect
  diagnostic event EventLIN12Slave4Defect: aging-allowed=true, event-kind=SWC, prestorage-freeze-frame=false  # Event_LIN 12 Slave 4_Defect
  diagnostic event to trouble code uds mapping EventDtcMapLIN12Slave4Defect: diagnostic-event=EventLIN12Slave4Defect, trouble-code-uds=LIN_12_Slave_4_Defect  # Event_Dtc_Map_LIN 12 Slave 4_Defect
  diagnostic event to operation cycle mapping EventOperCycleMapLIN12Slave4Defect: diagnostic-event=EventLIN12Slave4Defect, operation-cycle=DefaultOperationCycle  # Event_Oper_Cycle_Map_LIN 12 Slave 4_Defect
  diagnostic event to debounce algorithm mapping EventDebounceMapLIN12Slave4Defect: debounce-algorithm=counter_based, diagnostic-event=EventLIN12Slave4Defect  # EventDebounceMap_LIN 12 Slave 4_Defect
package /ZeC/DTC/DTC/LIN_12_Slave_3_Defect
  diagnostic trouble code uds LIN_12_Slave_3_Defect: dtc-props=Dtc_Props_358996c7, uds-dtc-value=0x030c17  # LIN 12 Slave 3_Defect
  diagnostic event EventLIN12Slave3Defect: aging-allowed=true, event-kind=SWC, prestorage-freeze-frame=false  # Event_LIN 12 Slave 3_Defect
  diagnostic event to trouble code uds mapping EventDtcMapLIN12Slave3Defect: diagnostic-event=EventLIN12Slave3Defect, trouble-code-uds=LIN_12_Slave_3_Defect  # Event_Dtc_Map_LIN 12 Slave 3_Defect
  diagnostic event to operation cycle mapping EventOperCycleMapLIN12Slave3Defect: diagnostic-event=EventLIN12Slave3Defect, operation-cycle=DefaultOperationCycle  # Event_Oper_Cycle_Map_LIN 12 Slave 3_Defect
  diagnostic event to debounce algorithm mapping EventDebounceMapLIN12Slave3Defect: debounce-algorithm=counter_based, diagnostic-event=EventLIN12Slave3Defect  # EventDebounceMap_LIN 12 Slave 3_Defect
package /ZeC/DTC/DTC/LIN_12_Slave_3_NoCommunication
  diagnostic trouble code uds LIN_12_Slave_3_NoCommunication: dtc-props=Dtc_Props_358996c7, uds-dtc-value=0x030c18  # LIN 12 Slave 3_NoCommunication
  diagnostic event EventLIN12Slave3NoCommunication: aging-allowed=true, event-kind=SWC, prestorage-freeze-frame=false  # Event_LIN 12 Slave 3_NoCommunication
  diagnostic event to trouble code uds mapping EventDtcMapLIN12Slave3NoCommunication: diagnostic-event=EventLIN12Slave3NoCommunication, trouble-code-uds=LIN_12_Slave_3_NoCommunication  # Event_Dtc_Map_LIN 12 Slave 3_NoCommunication
  diagnostic event to operation cycle mapping EventOperCycleMapLIN12Slave3NoCommunication: diagnostic-event=EventLIN12Slave3NoCommunication, operation-cycle=DefaultOperationCycle  # Event_Oper_Cycle_Map_LIN 12 Slave 3_NoCommunication
  diagnostic event to debounce algorithm mapping EventDebounceMapLIN12Slave3NoCommunication: debounce-algorithm=counter_based, diagnostic-event=EventLIN12Slave3NoCommunication  # EventDebounceMap_LIN 12 Slave 3_NoCommunication
package /ZeC/DTC/DTC/LIN_12_Slave_2_Defect
  diagnostic trouble code uds LIN_12_Slave_2_Defect: dtc-props=Dtc_Props_358996c7, uds-dtc-value=0x030c15  # LIN 12 Slave 2_Defect
  diagnostic event EventLIN12Slave2Defect: aging-allowed=true, event-kind=SWC, prestorage-freeze-frame=false  # Event_LIN 12 Slave 2_Defect
  diagnostic event to trouble code uds mapping EventDtcMapLIN12Slave2Defect: diagnostic-event=EventLIN12Slave2Defect, trouble-code-uds=LIN_12_Slave_2_Defect  # Event_Dtc_Map_LIN 12 Slave 2_Defect
  diagnostic event to operation cycle mapping EventOperCycleMapLIN12Slave2Defect: diagnostic-event=EventLIN12Slave2Defect, operation-cycle=DefaultOperationCycle  # Event_Oper_Cycle_Map_LIN 12 Slave 2_Defect
  diagnostic event to debounce algorithm mapping EventDebounceMapLIN12Slave2Defect: debounce-algorithm=counter_based, diagnostic-event=EventLIN12Slave2Defect  # EventDebounceMap_LIN 12 Slave 2_Defect
package /ZeC/DTC/DTC/Power_Path_030_Short_to_GND_Failure
  diagnostic trouble code uds Power_Path_030_Short_to_GND_Failure: dtc-props=Dtc_Props_5f56cab8, uds-dtc-value=0x00521e
  diagnostic event EventPowerPath030ShortToGNDFailure: aging-allowed=true, event-kind=SWC, prestorage-freeze-frame=false  # Event_Power_Path_030_Short_to_GND_Failure
  diagnostic event to trouble code uds mapping EventDtcMapPowerPath030ShortToGNDFailure: diagnostic-event=EventPowerPath030ShortToGNDFailure, trouble-code-uds=Power_Path_030_Short_to_GND_Failure  # Event_Dtc_Map_Power_Path_030_Short_to_GND_Failure
  diagnostic event to operation cycle mapping EventOperCycleMapPowerPath030ShortToGNDFailure: diagnostic-event=EventPowerPath030ShortToGNDFailure, operation-cycle=DefaultOperationCycle  # Event_Oper_Cycle_Map_Power_Path_030_Short_to_GND_Failure
  diagnostic event to debounce algorithm mapping EventDebounceMapPowerPath030ShortToGNDFailure: debounce-algorithm=time_based, diagnostic-event=EventPowerPath030ShortToGNDFailure  # EventDebounceMap_Power_Path_030_Short_to_GND_Failure
package /ZeC/DTC/DTC/LIN_12_Slave_2_NoCommunication
  diagnostic trouble code uds LIN_12_Slave_2_NoCommunication: dtc-props=Dtc_Props_358996c7, uds-dtc-value=0x030c16  # LIN 12 Slave 2_NoCommunication
  diagnostic event EventLIN12Slave2NoCommunication: aging-allowed=true, event-kind=SWC, prestorage-freeze-frame=false  # Event_LIN 12 Slave 2_NoCommunication
  diagnostic event to trouble code uds mapping EventDtcMapLIN12Slave2NoCommunication: diagnostic-event=EventLIN12Slave2NoCommunication, trouble-code-uds=LIN_12_Slave_2_NoCommunication  # Event_Dtc_Map_LIN 12 Slave 2_NoCommunication
  diagnostic event to operation cycle mapping EventOperCycleMapLIN12Slave2NoCommunication: diagnostic-event=EventLIN12Slave2NoCommunication, operation-cycle=DefaultOperationCycle  # Event_Oper_Cycle_Map_LIN 12 Slave 2_NoCommunication
  diagnostic event to debounce algorithm mapping EventDebounceMapLIN12Slave2NoCommunication: debounce-algorithm=counter_based, diagnostic-event=EventLIN12Slave2NoCommunication  # EventDebounceMap_LIN 12 Slave 2_NoCommunication
package /ZeC/DTC/DTC/Power_Path_029_Short_to_GND_Failure
  diagnostic trouble code uds Power_Path_029_Short_to_GND_Failure: dtc-props=Dtc_Props_194fc082, uds-dtc-value=0x00521d
  diagnostic event EventPowerPath029ShortToGNDFailure: aging-allowed=true, event-kind=SWC, prestorage-freeze-frame=false  # Event_Power_Path_029_Short_to_GND_Failure
  diagnostic event to trouble code uds mapping EventDtcMapPowerPath029ShortToGNDFailure: diagnostic-event=EventPowerPath029ShortToGNDFailure, trouble-code-uds=Power_Path_029_Short_to_GND_Failure  # Event_Dtc_Map_Power_Path_029_Short_to_GND_Failure
  diagnostic event to operation cycle mapping EventOperCycleMapPowerPath029ShortToGNDFailure: diagnostic-event=EventPowerPath029ShortToGNDFailure, operation-cycle=DefaultOperationCycle  # Event_Oper_Cycle_Map_Power_Path_029_Short_to_GND_Failure
  diagnostic event to debounce algorithm mapping EventDebounceMapPowerPath029ShortToGNDFailure: debounce-algorithm=time_based, diagnostic-event=EventPowerPath029ShortToGNDFailure  # EventDebounceMap_Power_Path_029_Short_to_GND_Failure
package /ZeC/DTC/DTC/LIN_12_Slave_15_Defect
  diagnostic trouble code uds LIN_12_Slave_15_Defect: dtc-props=Dtc_Props_358996c7, uds-dtc-value=0x030c13  # LIN 12 Slave 15_Defect
  diagnostic event EventLIN12Slave15Defect: aging-allowed=true, event-kind=SWC, prestorage-freeze-frame=false  # Event_LIN 12 Slave 15_Defect
  diagnostic event to trouble code uds mapping EventDtcMapLIN12Slave15Defect: diagnostic-event=EventLIN12Slave15Defect, trouble-code-uds=LIN_12_Slave_15_Defect  # Event_Dtc_Map_LIN 12 Slave 15_Defect
  diagnostic event to operation cycle mapping EventOperCycleMapLIN12Slave15Defect: diagnostic-event=EventLIN12Slave15Defect, operation-cycle=DefaultOperationCycle  # Event_Oper_Cycle_Map_LIN 12 Slave 15_Defect
  diagnostic event to debounce algorithm mapping EventDebounceMapLIN12Slave15Defect: debounce-algorithm=counter_based, diagnostic-event=EventLIN12Slave15Defect  # EventDebounceMap_LIN 12 Slave 15_Defect
package /ZeC/DTC/DTC/LIN_12_Slave_15_NoCommunication
  diagnostic trouble code uds LIN_12_Slave_15_NoCommunication: dtc-props=Dtc_Props_358996c7, uds-dtc-value=0x030c14  # LIN 12 Slave 15_NoCommunication
  diagnostic event EventLIN12Slave15NoCommunication: aging-allowed=true, event-kind=SWC, prestorage-freeze-frame=false  # Event_LIN 12 Slave 15_NoCommunication
  diagnostic event to trouble code uds mapping EventDtcMapLIN12Slave15NoCommunication: diagnostic-event=EventLIN12Slave15NoCommunication, trouble-code-uds=LIN_12_Slave_15_NoCommunication  # Event_Dtc_Map_LIN 12 Slave 15_NoCommunication
  diagnostic event to operation cycle mapping EventOperCycleMapLIN12Slave15NoCommunication: diagnostic-event=EventLIN12Slave15NoCommunication, operation-cycle=DefaultOperationCycle  # Event_Oper_Cycle_Map_LIN 12 Slave 15_NoCommunication
  diagnostic event to debounce algorithm mapping EventDebounceMapLIN12Slave15NoCommunication: debounce-algorithm=counter_based, diagnostic-event=EventLIN12Slave15NoCommunication  # EventDebounceMap_LIN 12 Slave 15_NoCommunication
package /ZeC/DTC/DTC/Power_Path_031_Short_to_GND_Failure
  diagnostic trouble code uds Power_Path_031_Short_to_GND_Failure: dtc-props=Dtc_Props_957dd4f6, uds-dtc-value=0x00521f
  diagnostic event EventPowerPath031ShortToGNDFailure: aging-allowed=true, event-kind=SWC, prestorage-freeze-frame=false  # Event_Power_Path_031_Short_to_GND_Failure
  diagnostic event to trouble code uds mapping EventDtcMapPowerPath031ShortToGNDFailure: diagnostic-event=EventPowerPath031ShortToGNDFailure, trouble-code-uds=Power_Path_031_Short_to_GND_Failure  # Event_Dtc_Map_Power_Path_031_Short_to_GND_Failure
  diagnostic event to operation cycle mapping EventOperCycleMapPowerPath031ShortToGNDFailure: diagnostic-event=EventPowerPath031ShortToGNDFailure, operation-cycle=DefaultOperationCycle  # Event_Oper_Cycle_Map_Power_Path_031_Short_to_GND_Failure
  diagnostic event to debounce algorithm mapping EventDebounceMapPowerPath031ShortToGNDFailure: debounce-algorithm=time_based, diagnostic-event=EventPowerPath031ShortToGNDFailure  # EventDebounceMap_Power_Path_031_Short_to_GND_Failure
package /ZeC/DTC/DTC/LIN_12_Slave_14_Defect
  diagnostic trouble code uds LIN_12_Slave_14_Defect: dtc-props=Dtc_Props_358996c7, uds-dtc-value=0x030c11  # LIN 12 Slave 14_Defect
  diagnostic event EventLIN12Slave14Defect: aging-allowed=true, event-kind=SWC, prestorage-freeze-frame=false  # Event_LIN 12 Slave 14_Defect
  diagnostic event to trouble code uds mapping EventDtcMapLIN12Slave14Defect: diagnostic-event=EventLIN12Slave14Defect, trouble-code-uds=LIN_12_Slave_14_Defect  # Event_Dtc_Map_LIN 12 Slave 14_Defect
  diagnostic event to operation cycle mapping EventOperCycleMapLIN12Slave14Defect: diagnostic-event=EventLIN12Slave14Defect, operation-cycle=DefaultOperationCycle  # Event_Oper_Cycle_Map_LIN 12 Slave 14_Defect
  diagnostic event to debounce algorithm mapping EventDebounceMapLIN12Slave14Defect: debounce-algorithm=counter_based, diagnostic-event=EventLIN12Slave14Defect  # EventDebounceMap_LIN 12 Slave 14_Defect
package /ZeC/DTC/DTC/Power_Path_034_Short_to_GND_Failure
  diagnostic trouble code uds Power_Path_034_Short_to_GND_Failure: dtc-props=Dtc_Props_fa39d9ab, uds-dtc-value=0x005222
  diagnostic event EventPowerPath034ShortToGNDFailure: aging-allowed=true, event-kind=SWC, prestorage-freeze-frame=false  # Event_Power_Path_034_Short_to_GND_Failure
  diagnostic event to trouble code uds mapping EventDtcMapPowerPath034ShortToGNDFailure: diagnostic-event=EventPowerPath034ShortToGNDFailure, trouble-code-uds=Power_Path_034_Short_to_GND_Failure  # Event_Dtc_Map_Power_Path_034_Short_to_GND_Failure
  diagnostic event to operation cycle mapping EventOperCycleMapPowerPath034ShortToGNDFailure: diagnostic-event=EventPowerPath034ShortToGNDFailure, operation-cycle=DefaultOperationCycle  # Event_Oper_Cycle_Map_Power_Path_034_Short_to_GND_Failure
  diagnostic event to debounce algorithm mapping EventDebounceMapPowerPath034ShortToGNDFailure: debounce-algorithm=time_based, diagnostic-event=EventPowerPath034ShortToGNDFailure  # EventDebounceMap_Power_Path_034_Short_to_GND_Failure
package /ZeC/DTC/DTC/LIN_12_Slave_14_NoCommunication
  diagnostic trouble code uds LIN_12_Slave_14_NoCommunication: dtc-props=Dtc_Props_358996c7, uds-dtc-value=0x030c12  # LIN 12 Slave 14_NoCommunication
  diagnostic event EventLIN12Slave14NoCommunication: aging-allowed=true, event-kind=SWC, prestorage-freeze-frame=false  # Event_LIN 12 Slave 14_NoCommunication
  diagnostic event to trouble code uds mapping EventDtcMapLIN12Slave14NoCommunication: diagnostic-event=EventLIN12Slave14NoCommunication, trouble-code-uds=LIN_12_Slave_14_NoCommunication  # Event_Dtc_Map_LIN 12 Slave 14_NoCommunication
  diagnostic event to operation cycle mapping EventOperCycleMapLIN12Slave14NoCommunication: diagnostic-event=EventLIN12Slave14NoCommunication, operation-cycle=DefaultOperationCycle  # Event_Oper_Cycle_Map_LIN 12 Slave 14_NoCommunication
  diagnostic event to debounce algorithm mapping EventDebounceMapLIN12Slave14NoCommunication: debounce-algorithm=counter_based, diagnostic-event=EventLIN12Slave14NoCommunication  # EventDebounceMap_LIN 12 Slave 14_NoCommunication
package /ZeC/DTC/DTC/Power_Path_033_Short_to_GND_Failure
  diagnostic trouble code uds Power_Path_033_Short_to_GND_Failure: dtc-props=Dtc_Props_3012c7e5, uds-dtc-value=0x005221
  diagnostic event EventPowerPath033ShortToGNDFailure: aging-allowed=true, event-kind=SWC, prestorage-freeze-frame=false  # Event_Power_Path_033_Short_to_GND_Failure
  diagnostic event to trouble code uds mapping EventDtcMapPowerPath033ShortToGNDFailure: diagnostic-event=EventPowerPath033ShortToGNDFailure, trouble-code-uds=Power_Path_033_Short_to_GND_Failure  # Event_Dtc_Map_Power_Path_033_Short_to_GND_Failure
  diagnostic event to operation cycle mapping EventOperCycleMapPowerPath033ShortToGNDFailure: diagnostic-event=EventPowerPath033ShortToGNDFailure, operation-cycle=DefaultOperationCycle  # Event_Oper_Cycle_Map_Power_Path_033_Short_to_GND_Failure
  diagnostic event to debounce algorithm mapping EventDebounceMapPowerPath033ShortToGNDFailure: debounce-algorithm=time_based, diagnostic-event=EventPowerPath033ShortToGNDFailure  # EventDebounceMap_Power_Path_033_Short_to_GND_Failure
package /ZeC/DTC/DTC/Power_Path_036_Short_to_GND_Failure
  diagnostic trouble code uds Power_Path_036_Short_to_GND_Failure: dtc-props=Dtc_Props_b51ee376, uds-dtc-value=0x005224
  diagnostic event EventPowerPath036ShortToGNDFailure: aging-allowed=true, event-kind=SWC, prestorage-freeze-frame=false  # Event_Power_Path_036_Short_to_GND_Failure
  diagnostic event to trouble code uds mapping EventDtcMapPowerPath036ShortToGNDFailure: diagnostic-event=EventPowerPath036ShortToGNDFailure, trouble-code-uds=Power_Path_036_Short_to_GND_Failure  # Event_Dtc_Map_Power_Path_036_Short_to_GND_Failure
  diagnostic event to operation cycle mapping EventOperCycleMapPowerPath036ShortToGNDFailure: diagnostic-event=EventPowerPath036ShortToGNDFailure, operation-cycle=DefaultOperationCycle  # Event_Oper_Cycle_Map_Power_Path_036_Short_to_GND_Failure
  diagnostic event to debounce algorithm mapping EventDebounceMapPowerPath036ShortToGNDFailure: debounce-algorithm=time_based, diagnostic-event=EventPowerPath036ShortToGNDFailure  # EventDebounceMap_Power_Path_036_Short_to_GND_Failure
package /ZeC/DTC/DTC/LIN_12_Slave_13_NoCommunication
  diagnostic trouble code uds LIN_12_Slave_13_NoCommunication: dtc-props=Dtc_Props_358996c7, uds-dtc-value=0x030c10  # LIN 12 Slave 13_NoCommunication
  diagnostic event EventLIN12Slave13NoCommunication: aging-allowed=true, event-kind=SWC, prestorage-freeze-frame=false  # Event_LIN 12 Slave 13_NoCommunication
  diagnostic event to trouble code uds mapping EventDtcMapLIN12Slave13NoCommunication: diagnostic-event=EventLIN12Slave13NoCommunication, trouble-code-uds=LIN_12_Slave_13_NoCommunication  # Event_Dtc_Map_LIN 12 Slave 13_NoCommunication
  diagnostic event to operation cycle mapping EventOperCycleMapLIN12Slave13NoCommunication: diagnostic-event=EventLIN12Slave13NoCommunication, operation-cycle=DefaultOperationCycle  # Event_Oper_Cycle_Map_LIN 12 Slave 13_NoCommunication
  diagnostic event to debounce algorithm mapping EventDebounceMapLIN12Slave13NoCommunication: debounce-algorithm=counter_based, diagnostic-event=EventLIN12Slave13NoCommunication  # EventDebounceMap_LIN 12 Slave 13_NoCommunication
package /ZeC/DTC/DTC/Power_Path_035_Short_to_GND_Failure
  diagnostic trouble code uds Power_Path_035_Short_to_GND_Failure: dtc-props=Dtc_Props_bc20d391, uds-dtc-value=0x005223
  diagnostic event EventPowerPath035ShortToGNDFailure: aging-allowed=true, event-kind=SWC, prestorage-freeze-frame=false  # Event_Power_Path_035_Short_to_GND_Failure
  diagnostic event to trouble code uds mapping EventDtcMapPowerPath035ShortToGNDFailure: diagnostic-event=EventPowerPath035ShortToGNDFailure, trouble-code-uds=Power_Path_035_Short_to_GND_Failure  # Event_Dtc_Map_Power_Path_035_Short_to_GND_Failure
  diagnostic event to operation cycle mapping EventOperCycleMapPowerPath035ShortToGNDFailure: diagnostic-event=EventPowerPath035ShortToGNDFailure, operation-cycle=DefaultOperationCycle  # Event_Oper_Cycle_Map_Power_Path_035_Short_to_GND_Failure
  diagnostic event to debounce algorithm mapping EventDebounceMapPowerPath035ShortToGNDFailure: debounce-algorithm=time_based, diagnostic-event=EventPowerPath035ShortToGNDFailure  # EventDebounceMap_Power_Path_035_Short_to_GND_Failure
package /ZeC/DTC/DTC/Power_Path_032_Short_to_GND_Failure
  diagnostic trouble code uds Power_Path_032_Short_to_GND_Failure: dtc-props=Dtc_Props_760bcddf, uds-dtc-value=0x005220
  diagnostic event EventPowerPath032ShortToGNDFailure: aging-allowed=true, event-kind=SWC, prestorage-freeze-frame=false  # Event_Power_Path_032_Short_to_GND_Failure
  diagnostic event to trouble code uds mapping EventDtcMapPowerPath032ShortToGNDFailure: diagnostic-event=EventPowerPath032ShortToGNDFailure, trouble-code-uds=Power_Path_032_Short_to_GND_Failure  # Event_Dtc_Map_Power_Path_032_Short_to_GND_Failure
  diagnostic event to operation cycle mapping EventOperCycleMapPowerPath032ShortToGNDFailure: diagnostic-event=EventPowerPath032ShortToGNDFailure, operation-cycle=DefaultOperationCycle  # Event_Oper_Cycle_Map_Power_Path_032_Short_to_GND_Failure
  diagnostic event to debounce algorithm mapping EventDebounceMapPowerPath032ShortToGNDFailure: debounce-algorithm=time_based, diagnostic-event=EventPowerPath032ShortToGNDFailure  # EventDebounceMap_Power_Path_032_Short_to_GND_Failure
package /ZeC/DTC/DTC/Power_Path_072_Short_to_GND_Failure
  diagnostic trouble code uds Power_Path_072_Short_to_GND_Failure: dtc-props=Dtc_Props_d37d1f9f, uds-dtc-value=0x005248
  diagnostic event EventPowerPath072ShortToGNDFailure: aging-allowed=true, event-kind=SWC, prestorage-freeze-frame=false  # Event_Power_Path_072_Short_to_GND_Failure
  diagnostic event to trouble code uds mapping EventDtcMapPowerPath072ShortToGNDFailure: diagnostic-event=EventPowerPath072ShortToGNDFailure, trouble-code-uds=Power_Path_072_Short_to_GND_Failure  # Event_Dtc_Map_Power_Path_072_Short_to_GND_Failure
  diagnostic event to operation cycle mapping EventOperCycleMapPowerPath072ShortToGNDFailure: diagnostic-event=EventPowerPath072ShortToGNDFailure, operation-cycle=DefaultOperationCycle  # Event_Oper_Cycle_Map_Power_Path_072_Short_to_GND_Failure
  diagnostic event to debounce algorithm mapping EventDebounceMapPowerPath072ShortToGNDFailure: debounce-algorithm=time_based, diagnostic-event=EventPowerPath072ShortToGNDFailure  # EventDebounceMap_Power_Path_072_Short_to_GND_Failure
package /ZeC/DTC/DTC/Power_Path_071_Short_to_GND_Failure
  diagnostic trouble code uds Power_Path_071_Short_to_GND_Failure: dtc-props=Dtc_Props_8718746b, uds-dtc-value=0x005247
  diagnostic event EventPowerPath071ShortToGNDFailure: aging-allowed=true, event-kind=SWC, prestorage-freeze-frame=false  # Event_Power_Path_071_Short_to_GND_Failure
  diagnostic event to trouble code uds mapping EventDtcMapPowerPath071ShortToGNDFailure: diagnostic-event=EventPowerPath071ShortToGNDFailure, trouble-code-uds=Power_Path_071_Short_to_GND_Failure  # Event_Dtc_Map_Power_Path_071_Short_to_GND_Failure
  diagnostic event to operation cycle mapping EventOperCycleMapPowerPath071ShortToGNDFailure: diagnostic-event=EventPowerPath071ShortToGNDFailure, operation-cycle=DefaultOperationCycle  # Event_Oper_Cycle_Map_Power_Path_071_Short_to_GND_Failure
  diagnostic event to debounce algorithm mapping EventDebounceMapPowerPath071ShortToGNDFailure: debounce-algorithm=time_based, diagnostic-event=EventPowerPath071ShortToGNDFailure  # EventDebounceMap_Power_Path_071_Short_to_GND_Failure
package /ZeC/DTC/DTC/Power_Path_073_Short_to_GND_Failure
  diagnostic trouble code uds Power_Path_073_Short_to_GND_Failure: dtc-props=Dtc_Props_956415a5, uds-dtc-value=0x005249
  diagnostic event EventPowerPath073ShortToGNDFailure: aging-allowed=true, event-kind=SWC, prestorage-freeze-frame=false  # Event_Power_Path_073_Short_to_GND_Failure
  diagnostic event to trouble code uds mapping EventDtcMapPowerPath073ShortToGNDFailure: diagnostic-event=EventPowerPath073ShortToGNDFailure, trouble-code-uds=Power_Path_073_Short_to_GND_Failure  # Event_Dtc_Map_Power_Path_073_Short_to_GND_Failure
  diagnostic event to operation cycle mapping EventOperCycleMapPowerPath073ShortToGNDFailure: diagnostic-event=EventPowerPath073ShortToGNDFailure, operation-cycle=DefaultOperationCycle  # Event_Oper_Cycle_Map_Power_Path_073_Short_to_GND_Failure
  diagnostic event to debounce algorithm mapping EventDebounceMapPowerPath073ShortToGNDFailure: debounce-algorithm=time_based, diagnostic-event=EventPowerPath073ShortToGNDFailure  # EventDebounceMap_Power_Path_073_Short_to_GND_Failure
package /ZeC/DTC/DTC/Power_Path_077_Short_to_GND_Failure
  diagnostic trouble code uds Power_Path_077_Short_to_GND_Failure: dtc-props=Dtc_Props_70cc0e58, uds-dtc-value=0x00524d
  diagnostic event EventPowerPath077ShortToGNDFailure: aging-allowed=true, event-kind=SWC, prestorage-freeze-frame=false  # Event_Power_Path_077_Short_to_GND_Failure
  diagnostic event to trouble code uds mapping EventDtcMapPowerPath077ShortToGNDFailure: diagnostic-event=EventPowerPath077ShortToGNDFailure, trouble-code-uds=Power_Path_077_Short_to_GND_Failure  # Event_Dtc_Map_Power_Path_077_Short_to_GND_Failure
  diagnostic event to operation cycle mapping EventOperCycleMapPowerPath077ShortToGNDFailure: diagnostic-event=EventPowerPath077ShortToGNDFailure, operation-cycle=DefaultOperationCycle  # Event_Oper_Cycle_Map_Power_Path_077_Short_to_GND_Failure
  diagnostic event to debounce algorithm mapping EventDebounceMapPowerPath077ShortToGNDFailure: debounce-algorithm=time_based, diagnostic-event=EventPowerPath077ShortToGNDFailure  # EventDebounceMap_Power_Path_077_Short_to_GND_Failure
package /ZeC/DTC/DTC/Power_Path_076_Short_to_GND_Failure
  diagnostic trouble code uds Power_Path_076_Short_to_GND_Failure: dtc-props=Dtc_Props_79f23ebf, uds-dtc-value=0x00524c
  diagnostic event EventPowerPath076ShortToGNDFailure: aging-allowed=true, event-kind=SWC, prestorage-freeze-frame=false  # Event_Power_Path_076_Short_to_GND_Failure
  diagnostic event to trouble code uds mapping EventDtcMapPowerPath076ShortToGNDFailure: diagnostic-event=EventPowerPath076ShortToGNDFailure, trouble-code-uds=Power_Path_076_Short_to_GND_Failure  # Event_Dtc_Map_Power_Path_076_Short_to_GND_Failure
  diagnostic event to operation cycle mapping EventOperCycleMapPowerPath076ShortToGNDFailure: diagnostic-event=EventPowerPath076ShortToGNDFailure, operation-cycle=DefaultOperationCycle  # Event_Oper_Cycle_Map_Power_Path_076_Short_to_GND_Failure
  diagnostic event to debounce algorithm mapping EventDebounceMapPowerPath076ShortToGNDFailure: debounce-algorithm=time_based, diagnostic-event=EventPowerPath076ShortToGNDFailure  # EventDebounceMap_Power_Path_076_Short_to_GND_Failure
package /ZeC/DTC/DTC/Power_Path_079_Short_to_GND_Failure
  diagnostic trouble code uds Power_Path_079_Short_to_GND_Failure: dtc-props=Dtc_Props_fcfe1a2c, uds-dtc-value=0x00524f
  diagnostic event EventPowerPath079ShortToGNDFailure: aging-allowed=true, event-kind=SWC, prestorage-freeze-frame=false  # Event_Power_Path_079_Short_to_GND_Failure
  diagnostic event to trouble code uds mapping EventDtcMapPowerPath079ShortToGNDFailure: diagnostic-event=EventPowerPath079ShortToGNDFailure, trouble-code-uds=Power_Path_079_Short_to_GND_Failure  # Event_Dtc_Map_Power_Path_079_Short_to_GND_Failure
  diagnostic event to operation cycle mapping EventOperCycleMapPowerPath079ShortToGNDFailure: diagnostic-event=EventPowerPath079ShortToGNDFailure, operation-cycle=DefaultOperationCycle  # Event_Oper_Cycle_Map_Power_Path_079_Short_to_GND_Failure
  diagnostic event to debounce algorithm mapping EventDebounceMapPowerPath079ShortToGNDFailure: debounce-algorithm=time_based, diagnostic-event=EventPowerPath079ShortToGNDFailure  # EventDebounceMap_Power_Path_079_Short_to_GND_Failure
package /ZeC/DTC/DTC/Power_Path_078_Short_to_GND_Failure
  diagnostic trouble code uds Power_Path_078_Short_to_GND_Failure: dtc-props=Dtc_Props_36d50462, uds-dtc-value=0x00524e
  diagnostic event EventPowerPath078ShortToGNDFailure: aging-allowed=true, event-kind=SWC, prestorage-freeze-frame=false  # Event_Power_Path_078_Short_to_GND_Failure
  diagnostic event to trouble code uds mapping EventDtcMapPowerPath078ShortToGNDFailure: diagnostic-event=EventPowerPath078ShortToGNDFailure, trouble-code-uds=Power_Path_078_Short_to_GND_Failure  # Event_Dtc_Map_Power_Path_078_Short_to_GND_Failure
  diagnostic event to operation cycle mapping EventOperCycleMapPowerPath078ShortToGNDFailure: diagnostic-event=EventPowerPath078ShortToGNDFailure, operation-cycle=DefaultOperationCycle  # Event_Oper_Cycle_Map_Power_Path_078_Short_to_GND_Failure
  diagnostic event to debounce algorithm mapping EventDebounceMapPowerPath078ShortToGNDFailure: debounce-algorithm=time_based, diagnostic-event=EventPowerPath078ShortToGNDFailure  # EventDebounceMap_Power_Path_078_Short_to_GND_Failure
package /ZeC/DTC/DTC/Power_Path_075_Short_to_GND_Failure
  diagnostic trouble code uds Power_Path_075_Short_to_GND_Failure: dtc-props=Dtc_Props_3feb3485, uds-dtc-value=0x00524b
  diagnostic event EventPowerPath075ShortToGNDFailure: aging-allowed=true, event-kind=SWC, prestorage-freeze-frame=false  # Event_Power_Path_075_Short_to_GND_Failure
  diagnostic event to trouble code uds mapping EventDtcMapPowerPath075ShortToGNDFailure: diagnostic-event=EventPowerPath075ShortToGNDFailure, trouble-code-uds=Power_Path_075_Short_to_GND_Failure  # Event_Dtc_Map_Power_Path_075_Short_to_GND_Failure
  diagnostic event to operation cycle mapping EventOperCycleMapPowerPath075ShortToGNDFailure: diagnostic-event=EventPowerPath075ShortToGNDFailure, operation-cycle=DefaultOperationCycle  # Event_Oper_Cycle_Map_Power_Path_075_Short_to_GND_Failure
  diagnostic event to debounce algorithm mapping EventDebounceMapPowerPath075ShortToGNDFailure: debounce-algorithm=time_based, diagnostic-event=EventPowerPath075ShortToGNDFailure  # EventDebounceMap_Power_Path_075_Short_to_GND_Failure
package /ZeC/DTC/DTC/Power_Path_074_Short_to_GND_Failure
  diagnostic trouble code uds Power_Path_074_Short_to_GND_Failure: dtc-props=Dtc_Props_f5c02acb, uds-dtc-value=0x00524a
  diagnostic event EventPowerPath074ShortToGNDFailure: aging-allowed=true, event-kind=SWC, prestorage-freeze-frame=false  # Event_Power_Path_074_Short_to_GND_Failure
  diagnostic event to trouble code uds mapping EventDtcMapPowerPath074ShortToGNDFailure: diagnostic-event=EventPowerPath074ShortToGNDFailure, trouble-code-uds=Power_Path_074_Short_to_GND_Failure  # Event_Dtc_Map_Power_Path_074_Short_to_GND_Failure
  diagnostic event to operation cycle mapping EventOperCycleMapPowerPath074ShortToGNDFailure: diagnostic-event=EventPowerPath074ShortToGNDFailure, operation-cycle=DefaultOperationCycle  # Event_Oper_Cycle_Map_Power_Path_074_Short_to_GND_Failure
  diagnostic event to debounce algorithm mapping EventDebounceMapPowerPath074ShortToGNDFailure: debounce-algorithm=time_based, diagnostic-event=EventPowerPath074ShortToGNDFailure  # EventDebounceMap_Power_Path_074_Short_to_GND_Failure
package /ZeC/DTC/DTC/Power_Path_085_Short_to_GND_Failure
  diagnostic trouble code uds Power_Path_085_Short_to_GND_Failure: dtc-props=Dtc_Props_cd60a0a7, uds-dtc-value=0x005255
  diagnostic event EventPowerPath085ShortToGNDFailure: aging-allowed=true, event-kind=SWC, prestorage-freeze-frame=false  # Event_Power_Path_085_Short_to_GND_Failure
  diagnostic event to trouble code uds mapping EventDtcMapPowerPath085ShortToGNDFailure: diagnostic-event=EventPowerPath085ShortToGNDFailure, trouble-code-uds=Power_Path_085_Short_to_GND_Failure  # Event_Dtc_Map_Power_Path_085_Short_to_GND_Failure
  diagnostic event to operation cycle mapping EventOperCycleMapPowerPath085ShortToGNDFailure: diagnostic-event=EventPowerPath085ShortToGNDFailure, operation-cycle=DefaultOperationCycle  # Event_Oper_Cycle_Map_Power_Path_085_Short_to_GND_Failure
  diagnostic event to debounce algorithm mapping EventDebounceMapPowerPath085ShortToGNDFailure: debounce-algorithm=time_based, diagnostic-event=EventPowerPath085ShortToGNDFailure  # EventDebounceMap_Power_Path_085_Short_to_GND_Failure
package /ZeC/DTC/DTC/Power_Path_084_Short_to_GND_Failure
  diagnostic trouble code uds Power_Path_084_Short_to_GND_Failure: dtc-props=Dtc_Props_8b79aa9d, uds-dtc-value=0x005254
  diagnostic event EventPowerPath084ShortToGNDFailure: aging-allowed=true, event-kind=SWC, prestorage-freeze-frame=false  # Event_Power_Path_084_Short_to_GND_Failure
  diagnostic event to trouble code uds mapping EventDtcMapPowerPath084ShortToGNDFailure: diagnostic-event=EventPowerPath084ShortToGNDFailure, trouble-code-uds=Power_Path_084_Short_to_GND_Failure  # Event_Dtc_Map_Power_Path_084_Short_to_GND_Failure
  diagnostic event to operation cycle mapping EventOperCycleMapPowerPath084ShortToGNDFailure: diagnostic-event=EventPowerPath084ShortToGNDFailure, operation-cycle=DefaultOperationCycle  # Event_Oper_Cycle_Map_Power_Path_084_Short_to_GND_Failure
  diagnostic event to debounce algorithm mapping EventDebounceMapPowerPath084ShortToGNDFailure: debounce-algorithm=time_based, diagnostic-event=EventPowerPath084ShortToGNDFailure  # EventDebounceMap_Power_Path_084_Short_to_GND_Failure
package /ZeC/DTC/DTC/Power_Path_087_Short_to_GND_Failure
  diagnostic trouble code uds Power_Path_087_Short_to_GND_Failure: dtc-props=Dtc_Props_4152b4d3, uds-dtc-value=0x005257
  diagnostic event EventPowerPath087ShortToGNDFailure: aging-allowed=true, event-kind=SWC, prestorage-freeze-frame=false  # Event_Power_Path_087_Short_to_GND_Failure
  diagnostic event to trouble code uds mapping EventDtcMapPowerPath087ShortToGNDFailure: diagnostic-event=EventPowerPath087ShortToGNDFailure, trouble-code-uds=Power_Path_087_Short_to_GND_Failure  # Event_Dtc_Map_Power_Path_087_Short_to_GND_Failure
  diagnostic event to operation cycle mapping EventOperCycleMapPowerPath087ShortToGNDFailure: diagnostic-event=EventPowerPath087ShortToGNDFailure, operation-cycle=DefaultOperationCycle  # Event_Oper_Cycle_Map_Power_Path_087_Short_to_GND_Failure
  diagnostic event to debounce algorithm mapping EventDebounceMapPowerPath087ShortToGNDFailure: debounce-algorithm=time_based, diagnostic-event=EventPowerPath087ShortToGNDFailure  # EventDebounceMap_Power_Path_087_Short_to_GND_Failure
package /ZeC/DTC/DTC/Power_Path_086_Short_to_GND_Failure
  diagnostic trouble code uds Power_Path_086_Short_to_GND_Failure: dtc-props=Dtc_Props_74bbee9, uds-dtc-value=0x005256
  diagnostic event EventPowerPath086ShortToGNDFailure: aging-allowed=true, event-kind=SWC, prestorage-freeze-frame=false  # Event_Power_Path_086_Short_to_GND_Failure
  diagnostic event to trouble code uds mapping EventDtcMapPowerPath086ShortToGNDFailure: diagnostic-event=EventPowerPath086ShortToGNDFailure, trouble-code-uds=Power_Path_086_Short_to_GND_Failure  # Event_Dtc_Map_Power_Path_086_Short_to_GND_Failure
  diagnostic event to operation cycle mapping EventOperCycleMapPowerPath086ShortToGNDFailure: diagnostic-event=EventPowerPath086ShortToGNDFailure, operation-cycle=DefaultOperationCycle  # Event_Oper_Cycle_Map_Power_Path_086_Short_to_GND_Failure
  diagnostic event to debounce algorithm mapping EventDebounceMapPowerPath086ShortToGNDFailure: debounce-algorithm=time_based, diagnostic-event=EventPowerPath086ShortToGNDFailure  # EventDebounceMap_Power_Path_086_Short_to_GND_Failure
package /ZeC/DTC/DTC/Power_Path_081_Short_to_GND_Failure
  diagnostic trouble code uds Power_Path_081_Short_to_GND_Failure: dtc-props=Dtc_Props_e758e0e, uds-dtc-value=0x005251
  diagnostic event EventPowerPath081ShortToGNDFailure: aging-allowed=true, event-kind=SWC, prestorage-freeze-frame=false  # Event_Power_Path_081_Short_to_GND_Failure
  diagnostic event to trouble code uds mapping EventDtcMapPowerPath081ShortToGNDFailure: diagnostic-event=EventPowerPath081ShortToGNDFailure, trouble-code-uds=Power_Path_081_Short_to_GND_Failure  # Event_Dtc_Map_Power_Path_081_Short_to_GND_Failure
  diagnostic event to operation cycle mapping EventOperCycleMapPowerPath081ShortToGNDFailure: diagnostic-event=EventPowerPath081ShortToGNDFailure, operation-cycle=DefaultOperationCycle  # Event_Oper_Cycle_Map_Power_Path_081_Short_to_GND_Failure
  diagnostic event to debounce algorithm mapping EventDebounceMapPowerPath081ShortToGNDFailure: debounce-algorithm=time_based, diagnostic-event=EventPowerPath081ShortToGNDFailure  # EventDebounceMap_Power_Path_081_Short_to_GND_Failure
package /ZeC/DTC/DTC/Power_Path_080_Short_to_GND_Failure
  diagnostic trouble code uds Power_Path_080_Short_to_GND_Failure: dtc-props=Dtc_Props_486c8434, uds-dtc-value=0x005250
  diagnostic event EventPowerPath080ShortToGNDFailure: aging-allowed=true, event-kind=SWC, prestorage-freeze-frame=false  # Event_Power_Path_080_Short_to_GND_Failure
  diagnostic event to trouble code uds mapping EventDtcMapPowerPath080ShortToGNDFailure: diagnostic-event=EventPowerPath080ShortToGNDFailure, trouble-code-uds=Power_Path_080_Short_to_GND_Failure  # Event_Dtc_Map_Power_Path_080_Short_to_GND_Failure
  diagnostic event to operation cycle mapping EventOperCycleMapPowerPath080ShortToGNDFailure: diagnostic-event=EventPowerPath080ShortToGNDFailure, operation-cycle=DefaultOperationCycle  # Event_Oper_Cycle_Map_Power_Path_080_Short_to_GND_Failure
  diagnostic event to debounce algorithm mapping EventDebounceMapPowerPath080ShortToGNDFailure: debounce-algorithm=time_based, diagnostic-event=EventPowerPath080ShortToGNDFailure  # EventDebounceMap_Power_Path_080_Short_to_GND_Failure
package /ZeC/DTC/DTC/Power_Path_083_Short_to_GND_Failure
  diagnostic trouble code uds Power_Path_083_Short_to_GND_Failure: dtc-props=Dtc_Props_82479a7a, uds-dtc-value=0x005253
  diagnostic event EventPowerPath083ShortToGNDFailure: aging-allowed=true, event-kind=SWC, prestorage-freeze-frame=false  # Event_Power_Path_083_Short_to_GND_Failure
  diagnostic event to trouble code uds mapping EventDtcMapPowerPath083ShortToGNDFailure: diagnostic-event=EventPowerPath083ShortToGNDFailure, trouble-code-uds=Power_Path_083_Short_to_GND_Failure  # Event_Dtc_Map_Power_Path_083_Short_to_GND_Failure
  diagnostic event to operation cycle mapping EventOperCycleMapPowerPath083ShortToGNDFailure: diagnostic-event=EventPowerPath083ShortToGNDFailure, operation-cycle=DefaultOperationCycle  # Event_Oper_Cycle_Map_Power_Path_083_Short_to_GND_Failure
  diagnostic event to debounce algorithm mapping EventDebounceMapPowerPath083ShortToGNDFailure: debounce-algorithm=time_based, diagnostic-event=EventPowerPath083ShortToGNDFailure  # EventDebounceMap_Power_Path_083_Short_to_GND_Failure
package /ZeC/DTC/DTC/Power_Path_082_Short_to_GND_Failure
  diagnostic trouble code uds Power_Path_082_Short_to_GND_Failure: dtc-props=Dtc_Props_c45e9040, uds-dtc-value=0x005252
  diagnostic event EventPowerPath082ShortToGNDFailure: aging-allowed=true, event-kind=SWC, prestorage-freeze-frame=false  # Event_Power_Path_082_Short_to_GND_Failure
  diagnostic event to trouble code uds mapping EventDtcMapPowerPath082ShortToGNDFailure: diagnostic-event=EventPowerPath082ShortToGNDFailure, trouble-code-uds=Power_Path_082_Short_to_GND_Failure  # Event_Dtc_Map_Power_Path_082_Short_to_GND_Failure
  diagnostic event to operation cycle mapping EventOperCycleMapPowerPath082ShortToGNDFailure: diagnostic-event=EventPowerPath082ShortToGNDFailure, operation-cycle=DefaultOperationCycle  # Event_Oper_Cycle_Map_Power_Path_082_Short_to_GND_Failure
  diagnostic event to debounce algorithm mapping EventDebounceMapPowerPath082ShortToGNDFailure: debounce-algorithm=time_based, diagnostic-event=EventPowerPath082ShortToGNDFailure  # EventDebounceMap_Power_Path_082_Short_to_GND_Failure
package /ZeC/DTC/DTC/Power_Path_055_Short_to_GND_Failure
  diagnostic trouble code uds Power_Path_055_Short_to_GND_Failure: dtc-props=Dtc_Props_b97f3d80, uds-dtc-value=0x005237
  diagnostic event EventPowerPath055ShortToGNDFailure: aging-allowed=true, event-kind=SWC, prestorage-freeze-frame=false  # Event_Power_Path_055_Short_to_GND_Failure
  diagnostic event to trouble code uds mapping EventDtcMapPowerPath055ShortToGNDFailure: diagnostic-event=EventPowerPath055ShortToGNDFailure, trouble-code-uds=Power_Path_055_Short_to_GND_Failure  # Event_Dtc_Map_Power_Path_055_Short_to_GND_Failure
  diagnostic event to operation cycle mapping EventOperCycleMapPowerPath055ShortToGNDFailure: diagnostic-event=EventPowerPath055ShortToGNDFailure, operation-cycle=DefaultOperationCycle  # Event_Oper_Cycle_Map_Power_Path_055_Short_to_GND_Failure
  diagnostic event to debounce algorithm mapping EventDebounceMapPowerPath055ShortToGNDFailure: debounce-algorithm=time_based, diagnostic-event=EventPowerPath055ShortToGNDFailure  # EventDebounceMap_Power_Path_055_Short_to_GND_Failure
package /ZeC/DTC/DTC/Power_Path_054_Short_to_GND_Failure
  diagnostic trouble code uds Power_Path_054_Short_to_GND_Failure: dtc-props=Dtc_Props_ff6637ba, uds-dtc-value=0x005236
  diagnostic event EventPowerPath054ShortToGNDFailure: aging-allowed=true, event-kind=SWC, prestorage-freeze-frame=false  # Event_Power_Path_054_Short_to_GND_Failure
  diagnostic event to trouble code uds mapping EventDtcMapPowerPath054ShortToGNDFailure: diagnostic-event=EventPowerPath054ShortToGNDFailure, trouble-code-uds=Power_Path_054_Short_to_GND_Failure  # Event_Dtc_Map_Power_Path_054_Short_to_GND_Failure
  diagnostic event to operation cycle mapping EventOperCycleMapPowerPath054ShortToGNDFailure: diagnostic-event=EventPowerPath054ShortToGNDFailure, operation-cycle=DefaultOperationCycle  # Event_Oper_Cycle_Map_Power_Path_054_Short_to_GND_Failure
  diagnostic event to debounce algorithm mapping EventDebounceMapPowerPath054ShortToGNDFailure: debounce-algorithm=time_based, diagnostic-event=EventPowerPath054ShortToGNDFailure  # EventDebounceMap_Power_Path_054_Short_to_GND_Failure
package /ZeC/DTC/DTC/Power_Path_057_Short_to_GND_Failure
  diagnostic trouble code uds Power_Path_057_Short_to_GND_Failure: dtc-props=Dtc_Props_ab035c4e, uds-dtc-value=0x005239
  diagnostic event EventPowerPath057ShortToGNDFailure: aging-allowed=true, event-kind=SWC, prestorage-freeze-frame=false  # Event_Power_Path_057_Short_to_GND_Failure
  diagnostic event to trouble code uds mapping EventDtcMapPowerPath057ShortToGNDFailure: diagnostic-event=EventPowerPath057ShortToGNDFailure, trouble-code-uds=Power_Path_057_Short_to_GND_Failure  # Event_Dtc_Map_Power_Path_057_Short_to_GND_Failure
  diagnostic event to operation cycle mapping EventOperCycleMapPowerPath057ShortToGNDFailure: diagnostic-event=EventPowerPath057ShortToGNDFailure, operation-cycle=DefaultOperationCycle  # Event_Oper_Cycle_Map_Power_Path_057_Short_to_GND_Failure
  diagnostic event to debounce algorithm mapping EventDebounceMapPowerPath057ShortToGNDFailure: debounce-algorithm=time_based, diagnostic-event=EventPowerPath057ShortToGNDFailure  # EventDebounceMap_Power_Path_057_Short_to_GND_Failure
package /ZeC/DTC/DTC/Power_Path_056_Short_to_GND_Failure
  diagnostic trouble code uds Power_Path_056_Short_to_GND_Failure: dtc-props=Dtc_Props_ed1a5674, uds-dtc-value=0x005238
  diagnostic event EventPowerPath056ShortToGNDFailure: aging-allowed=true, event-kind=SWC, prestorage-freeze-frame=false  # Event_Power_Path_056_Short_to_GND_Failure
  diagnostic event to trouble code uds mapping EventDtcMapPowerPath056ShortToGNDFailure: diagnostic-event=EventPowerPath056ShortToGNDFailure, trouble-code-uds=Power_Path_056_Short_to_GND_Failure  # Event_Dtc_Map_Power_Path_056_Short_to_GND_Failure
  diagnostic event to operation cycle mapping EventOperCycleMapPowerPath056ShortToGNDFailure: diagnostic-event=EventPowerPath056ShortToGNDFailure, operation-cycle=DefaultOperationCycle  # Event_Oper_Cycle_Map_Power_Path_056_Short_to_GND_Failure
  diagnostic event to debounce algorithm mapping EventDebounceMapPowerPath056ShortToGNDFailure: debounce-algorithm=time_based, diagnostic-event=EventPowerPath056ShortToGNDFailure  # EventDebounceMap_Power_Path_056_Short_to_GND_Failure
package /ZeC/DTC/DTC/Power_Path_060_Short_to_GND_Failure
  diagnostic trouble code uds Power_Path_060_Short_to_GND_Failure: dtc-props=Dtc_Props_47957754, uds-dtc-value=0x00523c
  diagnostic event EventPowerPath060ShortToGNDFailure: aging-allowed=true, event-kind=SWC, prestorage-freeze-frame=false  # Event_Power_Path_060_Short_to_GND_Failure
  diagnostic event to trouble code uds mapping EventDtcMapPowerPath060ShortToGNDFailure: diagnostic-event=EventPowerPath060ShortToGNDFailure, trouble-code-uds=Power_Path_060_Short_to_GND_Failure  # Event_Dtc_Map_Power_Path_060_Short_to_GND_Failure
  diagnostic event to operation cycle mapping EventOperCycleMapPowerPath060ShortToGNDFailure: diagnostic-event=EventPowerPath060ShortToGNDFailure, operation-cycle=DefaultOperationCycle  # Event_Oper_Cycle_Map_Power_Path_060_Short_to_GND_Failure
  diagnostic event to debounce algorithm mapping EventDebounceMapPowerPath060ShortToGNDFailure: debounce-algorithm=time_based, diagnostic-event=EventPowerPath060ShortToGNDFailure  # EventDebounceMap_Power_Path_060_Short_to_GND_Failure
package /ZeC/DTC/DTC/Power_Path_059_Short_to_GND_Failure
  diagnostic trouble code uds Power_Path_059_Short_to_GND_Failure: dtc-props=Dtc_Props_18c7d6e, uds-dtc-value=0x00523b
  diagnostic event EventPowerPath059ShortToGNDFailure: aging-allowed=true, event-kind=SWC, prestorage-freeze-frame=false  # Event_Power_Path_059_Short_to_GND_Failure
  diagnostic event to trouble code uds mapping EventDtcMapPowerPath059ShortToGNDFailure: diagnostic-event=EventPowerPath059ShortToGNDFailure, trouble-code-uds=Power_Path_059_Short_to_GND_Failure  # Event_Dtc_Map_Power_Path_059_Short_to_GND_Failure
  diagnostic event to operation cycle mapping EventOperCycleMapPowerPath059ShortToGNDFailure: diagnostic-event=EventPowerPath059ShortToGNDFailure, operation-cycle=DefaultOperationCycle  # Event_Oper_Cycle_Map_Power_Path_059_Short_to_GND_Failure
  diagnostic event to debounce algorithm mapping EventDebounceMapPowerPath059ShortToGNDFailure: debounce-algorithm=time_based, diagnostic-event=EventPowerPath059ShortToGNDFailure  # EventDebounceMap_Power_Path_059_Short_to_GND_Failure
package /ZeC/DTC/DTC/Power_Path_062_Short_to_GND_Failure
  diagnostic trouble code uds Power_Path_062_Short_to_GND_Failure: dtc-props=Dtc_Props_8b24d89, uds-dtc-value=0x00523e
  diagnostic event EventPowerPath062ShortToGNDFailure: aging-allowed=true, event-kind=SWC, prestorage-freeze-frame=false  # Event_Power_Path_062_Short_to_GND_Failure
  diagnostic event to trouble code uds mapping EventDtcMapPowerPath062ShortToGNDFailure: diagnostic-event=EventPowerPath062ShortToGNDFailure, trouble-code-uds=Power_Path_062_Short_to_GND_Failure  # Event_Dtc_Map_Power_Path_062_Short_to_GND_Failure
  diagnostic event to operation cycle mapping EventOperCycleMapPowerPath062ShortToGNDFailure: diagnostic-event=EventPowerPath062ShortToGNDFailure, operation-cycle=DefaultOperationCycle  # Event_Oper_Cycle_Map_Power_Path_062_Short_to_GND_Failure
  diagnostic event to debounce algorithm mapping EventDebounceMapPowerPath062ShortToGNDFailure: debounce-algorithm=time_based, diagnostic-event=EventPowerPath062ShortToGNDFailure  # EventDebounceMap_Power_Path_062_Short_to_GND_Failure
package /ZeC/DTC/DTC/Power_Path_061_Short_to_GND_Failure
  diagnostic trouble code uds Power_Path_061_Short_to_GND_Failure: dtc-props=Dtc_Props_4eab47b3, uds-dtc-value=0x00523d
  diagnostic event EventPowerPath061ShortToGNDFailure: aging-allowed=true, event-kind=SWC, prestorage-freeze-frame=false  # Event_Power_Path_061_Short_to_GND_Failure
  diagnostic event to trouble code uds mapping EventDtcMapPowerPath061ShortToGNDFailure: diagnostic-event=EventPowerPath061ShortToGNDFailure, trouble-code-uds=Power_Path_061_Short_to_GND_Failure  # Event_Dtc_Map_Power_Path_061_Short_to_GND_Failure
  diagnostic event to operation cycle mapping EventOperCycleMapPowerPath061ShortToGNDFailure: diagnostic-event=EventPowerPath061ShortToGNDFailure, operation-cycle=DefaultOperationCycle  # Event_Oper_Cycle_Map_Power_Path_061_Short_to_GND_Failure
  diagnostic event to debounce algorithm mapping EventDebounceMapPowerPath061ShortToGNDFailure: debounce-algorithm=time_based, diagnostic-event=EventPowerPath061ShortToGNDFailure  # EventDebounceMap_Power_Path_061_Short_to_GND_Failure
package /ZeC/DTC/DTC/Power_Path_058_Short_to_GND_Failure
  diagnostic trouble code uds Power_Path_058_Short_to_GND_Failure: dtc-props=Dtc_Props_cba76320, uds-dtc-value=0x00523a
  diagnostic event EventPowerPath058ShortToGNDFailure: aging-allowed=true, event-kind=SWC, prestorage-freeze-frame=false  # Event_Power_Path_058_Short_to_GND_Failure
  diagnostic event to trouble code uds mapping EventDtcMapPowerPath058ShortToGNDFailure: diagnostic-event=EventPowerPath058ShortToGNDFailure, trouble-code-uds=Power_Path_058_Short_to_GND_Failure  # Event_Dtc_Map_Power_Path_058_Short_to_GND_Failure
  diagnostic event to operation cycle mapping EventOperCycleMapPowerPath058ShortToGNDFailure: diagnostic-event=EventPowerPath058ShortToGNDFailure, operation-cycle=DefaultOperationCycle  # Event_Oper_Cycle_Map_Power_Path_058_Short_to_GND_Failure
  diagnostic event to debounce algorithm mapping EventDebounceMapPowerPath058ShortToGNDFailure: debounce-algorithm=time_based, diagnostic-event=EventPowerPath058ShortToGNDFailure  # EventDebounceMap_Power_Path_058_Short_to_GND_Failure
package /ZeC/DTC/DTC/Power_Path_063_Short_to_GND_Failure
  diagnostic trouble code uds Power_Path_063_Short_to_GND_Failure: dtc-props=Dtc_Props_c29953c7, uds-dtc-value=0x00523f
  diagnostic event EventPowerPath063ShortToGNDFailure: aging-allowed=true, event-kind=SWC, prestorage-freeze-frame=false  # Event_Power_Path_063_Short_to_GND_Failure
  diagnostic event to trouble code uds mapping EventDtcMapPowerPath063ShortToGNDFailure: diagnostic-event=EventPowerPath063ShortToGNDFailure, trouble-code-uds=Power_Path_063_Short_to_GND_Failure  # Event_Dtc_Map_Power_Path_063_Short_to_GND_Failure
  diagnostic event to operation cycle mapping EventOperCycleMapPowerPath063ShortToGNDFailure: diagnostic-event=EventPowerPath063ShortToGNDFailure, operation-cycle=DefaultOperationCycle  # Event_Oper_Cycle_Map_Power_Path_063_Short_to_GND_Failure
  diagnostic event to debounce algorithm mapping EventDebounceMapPowerPath063ShortToGNDFailure: debounce-algorithm=time_based, diagnostic-event=EventPowerPath063ShortToGNDFailure  # EventDebounceMap_Power_Path_063_Short_to_GND_Failure
package /ZeC/DTC/DTC/Power_Path_068_Short_to_GND_Failure
  diagnostic trouble code uds Power_Path_068_Short_to_GND_Failure: dtc-props=Dtc_Props_4d336a25, uds-dtc-value=0x005244
  diagnostic event EventPowerPath068ShortToGNDFailure: aging-allowed=true, event-kind=SWC, prestorage-freeze-frame=false  # Event_Power_Path_068_Short_to_GND_Failure
  diagnostic event to trouble code uds mapping EventDtcMapPowerPath068ShortToGNDFailure: diagnostic-event=EventPowerPath068ShortToGNDFailure, trouble-code-uds=Power_Path_068_Short_to_GND_Failure  # Event_Dtc_Map_Power_Path_068_Short_to_GND_Failure
  diagnostic event to operation cycle mapping EventOperCycleMapPowerPath068ShortToGNDFailure: diagnostic-event=EventPowerPath068ShortToGNDFailure, operation-cycle=DefaultOperationCycle  # Event_Oper_Cycle_Map_Power_Path_068_Short_to_GND_Failure
  diagnostic event to debounce algorithm mapping EventDebounceMapPowerPath068ShortToGNDFailure: debounce-algorithm=time_based, diagnostic-event=EventPowerPath068ShortToGNDFailure  # EventDebounceMap_Power_Path_068_Short_to_GND_Failure
package /ZeC/DTC/DTC/Power_Path_067_Short_to_GND_Failure
  diagnostic trouble code uds Power_Path_067_Short_to_GND_Failure: dtc-props=Dtc_Props_440d5ac2, uds-dtc-value=0x005243
  diagnostic event EventPowerPath067ShortToGNDFailure: aging-allowed=true, event-kind=SWC, prestorage-freeze-frame=false  # Event_Power_Path_067_Short_to_GND_Failure
  diagnostic event to trouble code uds mapping EventDtcMapPowerPath067ShortToGNDFailure: diagnostic-event=EventPowerPath067ShortToGNDFailure, trouble-code-uds=Power_Path_067_Short_to_GND_Failure  # Event_Dtc_Map_Power_Path_067_Short_to_GND_Failure
  diagnostic event to operation cycle mapping EventOperCycleMapPowerPath067ShortToGNDFailure: diagnostic-event=EventPowerPath067ShortToGNDFailure, operation-cycle=DefaultOperationCycle  # Event_Oper_Cycle_Map_Power_Path_067_Short_to_GND_Failure
  diagnostic event to debounce algorithm mapping EventDebounceMapPowerPath067ShortToGNDFailure: debounce-algorithm=time_based, diagnostic-event=EventPowerPath067ShortToGNDFailure  # EventDebounceMap_Power_Path_067_Short_to_GND_Failure
package /ZeC/DTC/DTC/Power_Path_070_Short_to_GND_Failure
  diagnostic trouble code uds Power_Path_070_Short_to_GND_Failure: dtc-props=Dtc_Props_c1017e51, uds-dtc-value=0x005246
  diagnostic event EventPowerPath070ShortToGNDFailure: aging-allowed=true, event-kind=SWC, prestorage-freeze-frame=false  # Event_Power_Path_070_Short_to_GND_Failure
  diagnostic event to trouble code uds mapping EventDtcMapPowerPath070ShortToGNDFailure: diagnostic-event=EventPowerPath070ShortToGNDFailure, trouble-code-uds=Power_Path_070_Short_to_GND_Failure  # Event_Dtc_Map_Power_Path_070_Short_to_GND_Failure
  diagnostic event to operation cycle mapping EventOperCycleMapPowerPath070ShortToGNDFailure: diagnostic-event=EventPowerPath070ShortToGNDFailure, operation-cycle=DefaultOperationCycle  # Event_Oper_Cycle_Map_Power_Path_070_Short_to_GND_Failure
  diagnostic event to debounce algorithm mapping EventDebounceMapPowerPath070ShortToGNDFailure: debounce-algorithm=time_based, diagnostic-event=EventPowerPath070ShortToGNDFailure  # EventDebounceMap_Power_Path_070_Short_to_GND_Failure
package /ZeC/DTC/DTC/Power_Path_069_Short_to_GND_Failure
  diagnostic trouble code uds Power_Path_069_Short_to_GND_Failure: dtc-props=Dtc_Props_b2a601f, uds-dtc-value=0x005245
  diagnostic event EventPowerPath069ShortToGNDFailure: aging-allowed=true, event-kind=SWC, prestorage-freeze-frame=false  # Event_Power_Path_069_Short_to_GND_Failure
  diagnostic event to trouble code uds mapping EventDtcMapPowerPath069ShortToGNDFailure: diagnostic-event=EventPowerPath069ShortToGNDFailure, trouble-code-uds=Power_Path_069_Short_to_GND_Failure  # Event_Dtc_Map_Power_Path_069_Short_to_GND_Failure
  diagnostic event to operation cycle mapping EventOperCycleMapPowerPath069ShortToGNDFailure: diagnostic-event=EventPowerPath069ShortToGNDFailure, operation-cycle=DefaultOperationCycle  # Event_Oper_Cycle_Map_Power_Path_069_Short_to_GND_Failure
  diagnostic event to debounce algorithm mapping EventDebounceMapPowerPath069ShortToGNDFailure: debounce-algorithm=time_based, diagnostic-event=EventPowerPath069ShortToGNDFailure  # EventDebounceMap_Power_Path_069_Short_to_GND_Failure
package /ZeC/DTC/DTC/Power_Path_064_Short_to_GND_Failure
  diagnostic trouble code uds Power_Path_064_Short_to_GND_Failure: dtc-props=Dtc_Props_8e26448c, uds-dtc-value=0x005240
  diagnostic event EventPowerPath064ShortToGNDFailure: aging-allowed=true, event-kind=SWC, prestorage-freeze-frame=false  # Event_Power_Path_064_Short_to_GND_Failure
  diagnostic event to trouble code uds mapping EventDtcMapPowerPath064ShortToGNDFailure: diagnostic-event=EventPowerPath064ShortToGNDFailure, trouble-code-uds=Power_Path_064_Short_to_GND_Failure  # Event_Dtc_Map_Power_Path_064_Short_to_GND_Failure
  diagnostic event to operation cycle mapping EventOperCycleMapPowerPath064ShortToGNDFailure: diagnostic-event=EventPowerPath064ShortToGNDFailure, operation-cycle=DefaultOperationCycle  # Event_Oper_Cycle_Map_Power_Path_064_Short_to_GND_Failure
  diagnostic event to debounce algorithm mapping EventDebounceMapPowerPath064ShortToGNDFailure: debounce-algorithm=time_based, diagnostic-event=EventPowerPath064ShortToGNDFailure  # EventDebounceMap_Power_Path_064_Short_to_GND_Failure
package /ZeC/DTC/DTC/Power_Path_066_Short_to_GND_Failure
  diagnostic trouble code uds Power_Path_066_Short_to_GND_Failure: dtc-props=Dtc_Props_21450f8, uds-dtc-value=0x005242
  diagnostic event EventPowerPath066ShortToGNDFailure: aging-allowed=true, event-kind=SWC, prestorage-freeze-frame=false  # Event_Power_Path_066_Short_to_GND_Failure
  diagnostic event to trouble code uds mapping EventDtcMapPowerPath066ShortToGNDFailure: diagnostic-event=EventPowerPath066ShortToGNDFailure, trouble-code-uds=Power_Path_066_Short_to_GND_Failure  # Event_Dtc_Map_Power_Path_066_Short_to_GND_Failure
  diagnostic event to operation cycle mapping EventOperCycleMapPowerPath066ShortToGNDFailure: diagnostic-event=EventPowerPath066ShortToGNDFailure, operation-cycle=DefaultOperationCycle  # Event_Oper_Cycle_Map_Power_Path_066_Short_to_GND_Failure
  diagnostic event to debounce algorithm mapping EventDebounceMapPowerPath066ShortToGNDFailure: debounce-algorithm=time_based, diagnostic-event=EventPowerPath066ShortToGNDFailure  # EventDebounceMap_Power_Path_066_Short_to_GND_Failure
package /ZeC/DTC/DTC/Power_Path_065_Short_to_GND_Failure
  diagnostic trouble code uds Power_Path_065_Short_to_GND_Failure: dtc-props=Dtc_Props_c83f4eb6, uds-dtc-value=0x005241
  diagnostic event EventPowerPath065ShortToGNDFailure: aging-allowed=true, event-kind=SWC, prestorage-freeze-frame=false  # Event_Power_Path_065_Short_to_GND_Failure
  diagnostic event to trouble code uds mapping EventDtcMapPowerPath065ShortToGNDFailure: diagnostic-event=EventPowerPath065ShortToGNDFailure, trouble-code-uds=Power_Path_065_Short_to_GND_Failure  # Event_Dtc_Map_Power_Path_065_Short_to_GND_Failure
  diagnostic event to operation cycle mapping EventOperCycleMapPowerPath065ShortToGNDFailure: diagnostic-event=EventPowerPath065ShortToGNDFailure, operation-cycle=DefaultOperationCycle  # Event_Oper_Cycle_Map_Power_Path_065_Short_to_GND_Failure
  diagnostic event to debounce algorithm mapping EventDebounceMapPowerPath065ShortToGNDFailure: debounce-algorithm=time_based, diagnostic-event=EventPowerPath065ShortToGNDFailure  # EventDebounceMap_Power_Path_065_Short_to_GND_Failure
package /ZeC/DTC/DTC/CAN_08_ECU_1_No_Communication
  diagnostic trouble code uds CAN_08_ECU_1_No_Communication: dtc-props=Dtc_Props_14158306, uds-dtc-value=0x032805
  diagnostic event EventCAN08ECU1NoCommunication: aging-allowed=true, event-kind=SWC, prestorage-freeze-frame=false  # Event_CAN_08_ECU_1_No_Communication
  diagnostic event to trouble code uds mapping EventDtcMapCAN08ECU1NoCommunication: diagnostic-event=EventCAN08ECU1NoCommunication, trouble-code-uds=CAN_08_ECU_1_No_Communication  # Event_Dtc_Map_CAN_08_ECU_1_No_Communication
  diagnostic event to operation cycle mapping EventOperCycleMapCAN08ECU1NoCommunication: diagnostic-event=EventCAN08ECU1NoCommunication, operation-cycle=DefaultOperationCycle  # Event_Oper_Cycle_Map_CAN_08_ECU_1_No_Communication
  diagnostic event to debounce algorithm mapping EventDebounceMapCAN08ECU1NoCommunication: debounce-algorithm=counter_based, diagnostic-event=EventCAN08ECU1NoCommunication  # EventDebounceMap_CAN_08_ECU_1_No_Communication
package /ZeC/DTC/DTC/Power_Path_105_Not_Found_Failure
  diagnostic trouble code uds Power_Path_105_Not_Found_Failure: dtc-props=Dtc_Props_c2809294, uds-dtc-value=0x005669
  diagnostic event EventPowerPath105NotFoundFailure: aging-allowed=true, event-kind=SWC, prestorage-freeze-frame=false  # Event_Power_Path_105_Not_Found_Failure
  diagnostic event to trouble code uds mapping EventDtcMapPowerPath105NotFoundFailure: diagnostic-event=EventPowerPath105NotFoundFailure, trouble-code-uds=Power_Path_105_Not_Found_Failure  # Event_Dtc_Map_Power_Path_105_Not_Found_Failure
  diagnostic event to operation cycle mapping EventOperCycleMapPowerPath105NotFoundFailure: diagnostic-event=EventPowerPath105NotFoundFailure, operation-cycle=DefaultOperationCycle  # Event_Oper_Cycle_Map_Power_Path_105_Not_Found_Failure
  diagnostic event to debounce algorithm mapping EventDebounceMapPowerPath105NotFoundFailure: debounce-algorithm=time_based, diagnostic-event=EventPowerPath105NotFoundFailure  # EventDebounceMap_Power_Path_105_Not_Found_Failure
package /ZeC/DTC/DTC/CAN_08_ECU_2_No_Communication
  diagnostic trouble code uds CAN_08_ECU_2_No_Communication: dtc-props=Dtc_Props_14158306, uds-dtc-value=0x032806
  diagnostic event EventCAN08ECU2NoCommunication: aging-allowed=true, event-kind=SWC, prestorage-freeze-frame=false  # Event_CAN_08_ECU_2_No_Communication
  diagnostic event to trouble code uds mapping EventDtcMapCAN08ECU2NoCommunication: diagnostic-event=EventCAN08ECU2NoCommunication, trouble-code-uds=CAN_08_ECU_2_No_Communication  # Event_Dtc_Map_CAN_08_ECU_2_No_Communication
  diagnostic event to operation cycle mapping EventOperCycleMapCAN08ECU2NoCommunication: diagnostic-event=EventCAN08ECU2NoCommunication, operation-cycle=DefaultOperationCycle  # Event_Oper_Cycle_Map_CAN_08_ECU_2_No_Communication
  diagnostic event to debounce algorithm mapping EventDebounceMapCAN08ECU2NoCommunication: debounce-algorithm=counter_based, diagnostic-event=EventCAN08ECU2NoCommunication  # EventDebounceMap_CAN_08_ECU_2_No_Communication
package /ZeC/DTC/DTC/DB_CANFD_08_Single_Wire_Mode
  diagnostic trouble code uds DB_CANFD_08_Single_Wire_Mode: dtc-props=Dtc_Props_14158306, uds-dtc-value=0x032803
  diagnostic event EventDBCANFD08SingleWireMode: aging-allowed=true, event-kind=SWC, prestorage-freeze-frame=false  # Event_DB_CANFD_08_Single_Wire_Mode
  diagnostic event to trouble code uds mapping EventDtcMapDBCANFD08SingleWireMode: diagnostic-event=EventDBCANFD08SingleWireMode, trouble-code-uds=DB_CANFD_08_Single_Wire_Mode  # Event_Dtc_Map_DB_CANFD_08_Single_Wire_Mode
  diagnostic event to operation cycle mapping EventOperCycleMapDBCANFD08SingleWireMode: diagnostic-event=EventDBCANFD08SingleWireMode, operation-cycle=DefaultOperationCycle  # Event_Oper_Cycle_Map_DB_CANFD_08_Single_Wire_Mode
  diagnostic event to debounce algorithm mapping EventDebounceMapDBCANFD08SingleWireMode: debounce-algorithm=counter_based, diagnostic-event=EventDBCANFD08SingleWireMode  # EventDebounceMap_DB_CANFD_08_Single_Wire_Mode
package /ZeC/DTC/DTC/DB_CANFD_08_Error_Received_Value
  diagnostic trouble code uds DB_CANFD_08_Error_Received_Value: dtc-props=Dtc_Props_b618fb9, uds-dtc-value=0x032804
  diagnostic event EventDBCANFD08ErrorReceivedValue: aging-allowed=true, event-kind=SWC, prestorage-freeze-frame=false  # Event_DB_CANFD_08_Error_Received_Value
  diagnostic event to trouble code uds mapping EventDtcMapDBCANFD08ErrorReceivedValue: diagnostic-event=EventDBCANFD08ErrorReceivedValue, trouble-code-uds=DB_CANFD_08_Error_Received_Value  # Event_Dtc_Map_DB_CANFD_08_Error_Received_Value
  diagnostic event to operation cycle mapping EventOperCycleMapDBCANFD08ErrorReceivedValue: diagnostic-event=EventDBCANFD08ErrorReceivedValue, operation-cycle=DefaultOperationCycle  # Event_Oper_Cycle_Map_DB_CANFD_08_Error_Received_Value
  diagnostic event to debounce algorithm mapping EventDebounceMapDBCANFD08ErrorReceivedValue: debounce-algorithm=counter_based, diagnostic-event=EventDBCANFD08ErrorReceivedValue  # EventDebounceMap_DB_CANFD_08_Error_Received_Value
package /ZeC/DTC/DTC/Power_Path_102_Not_Found_Failure
  diagnostic trouble code uds Power_Path_102_Not_Found_Failure: dtc-props=Dtc_Props_96e5f960, uds-dtc-value=0x005666
  diagnostic event EventPowerPath102NotFoundFailure: aging-allowed=true, event-kind=SWC, prestorage-freeze-frame=false  # Event_Power_Path_102_Not_Found_Failure
  diagnostic event to trouble code uds mapping EventDtcMapPowerPath102NotFoundFailure: diagnostic-event=EventPowerPath102NotFoundFailure, trouble-code-uds=Power_Path_102_Not_Found_Failure  # Event_Dtc_Map_Power_Path_102_Not_Found_Failure
  diagnostic event to operation cycle mapping EventOperCycleMapPowerPath102NotFoundFailure: diagnostic-event=EventPowerPath102NotFoundFailure, operation-cycle=DefaultOperationCycle  # Event_Oper_Cycle_Map_Power_Path_102_Not_Found_Failure
  diagnostic event to debounce algorithm mapping EventDebounceMapPowerPath102NotFoundFailure: debounce-algorithm=time_based, diagnostic-event=EventPowerPath102NotFoundFailure  # EventDebounceMap_Power_Path_102_Not_Found_Failure
package /ZeC/DTC/DTC/DB_CANFD_08_Defect
  diagnostic trouble code uds DB_CANFD_08_Defect: dtc-props=Dtc_Props_14158306, uds-dtc-value=0x032801
  diagnostic event EventDBCANFD08Defect: aging-allowed=true, event-kind=SWC, prestorage-freeze-frame=false  # Event_DB_CANFD_08_Defect
  diagnostic event to trouble code uds mapping EventDtcMapDBCANFD08Defect: diagnostic-event=EventDBCANFD08Defect, trouble-code-uds=DB_CANFD_08_Defect  # Event_Dtc_Map_DB_CANFD_08_Defect
  diagnostic event to operation cycle mapping EventOperCycleMapDBCANFD08Defect: diagnostic-event=EventDBCANFD08Defect, operation-cycle=DefaultOperationCycle  # Event_Oper_Cycle_Map_DB_CANFD_08_Defect
  diagnostic event to debounce algorithm mapping EventDebounceMapDBCANFD08Defect: debounce-algorithm=counter_based, diagnostic-event=EventDBCANFD08Defect  # EventDebounceMap_DB_CANFD_08_Defect
package /ZeC/DTC/DTC/LIN_6_Local_Databus_Electrical_Failure
  diagnostic trouble code uds LIN_6_Local_Databus_Electrical_Failure: dtc-props=Dtc_Props_358996c7, uds-dtc-value=0x030621  # LIN 6 Local_Databus_Electrical_Failure
  diagnostic event EventLIN6LocalDatabusElectricalFailure: aging-allowed=true, event-kind=SWC, prestorage-freeze-frame=false  # Event_LIN 6 Local_Databus_Electrical_Failure
  diagnostic event to trouble code uds mapping EventDtcMapLIN6LocalDatabusElectricalFailure: diagnostic-event=EventLIN6LocalDatabusElectricalFailure, trouble-code-uds=LIN_6_Local_Databus_Electrical_Failure  # Event_Dtc_Map_LIN 6 Local_Databus_Electrical_Failure
  diagnostic event to operation cycle mapping EventOperCycleMapLIN6LocalDatabusElectricalFailure: diagnostic-event=EventLIN6LocalDatabusElectricalFailure, operation-cycle=DefaultOperationCycle  # Event_Oper_Cycle_Map_LIN 6 Local_Databus_Electrical_Failure
  diagnostic event to debounce algorithm mapping EventDebounceMapLIN6LocalDatabusElectricalFailure: debounce-algorithm=counter_based, diagnostic-event=EventLIN6LocalDatabusElectricalFailure  # EventDebounceMap_LIN 6 Local_Databus_Electrical_Failure
package /ZeC/DTC/DTC/Power_Path_101_Not_Found_Failure
  diagnostic trouble code uds Power_Path_101_Not_Found_Failure: dtc-props=Dtc_Props_5ccee72e, uds-dtc-value=0x005665
  diagnostic event EventPowerPath101NotFoundFailure: aging-allowed=true, event-kind=SWC, prestorage-freeze-frame=false  # Event_Power_Path_101_Not_Found_Failure
  diagnostic event to trouble code uds mapping EventDtcMapPowerPath101NotFoundFailure: diagnostic-event=EventPowerPath101NotFoundFailure, trouble-code-uds=Power_Path_101_Not_Found_Failure  # Event_Dtc_Map_Power_Path_101_Not_Found_Failure
  diagnostic event to operation cycle mapping EventOperCycleMapPowerPath101NotFoundFailure: diagnostic-event=EventPowerPath101NotFoundFailure, operation-cycle=DefaultOperationCycle  # Event_Oper_Cycle_Map_Power_Path_101_Not_Found_Failure
  diagnostic event to debounce algorithm mapping EventDebounceMapPowerPath101NotFoundFailure: debounce-algorithm=time_based, diagnostic-event=EventPowerPath101NotFoundFailure  # EventDebounceMap_Power_Path_101_Not_Found_Failure
package /ZeC/DTC/DTC/DB_CANFD_08_No_Communication
  diagnostic trouble code uds DB_CANFD_08_No_Communication: dtc-props=Dtc_Props_14158306, uds-dtc-value=0x032802
  diagnostic event EventDBCANFD08NoCommunication: aging-allowed=true, event-kind=SWC, prestorage-freeze-frame=false  # Event_DB_CANFD_08_No_Communication
  diagnostic event to trouble code uds mapping EventDtcMapDBCANFD08NoCommunication: diagnostic-event=EventDBCANFD08NoCommunication, trouble-code-uds=DB_CANFD_08_No_Communication  # Event_Dtc_Map_DB_CANFD_08_No_Communication
  diagnostic event to operation cycle mapping EventOperCycleMapDBCANFD08NoCommunication: diagnostic-event=EventDBCANFD08NoCommunication, operation-cycle=DefaultOperationCycle  # Event_Oper_Cycle_Map_DB_CANFD_08_No_Communication
  diagnostic event to debounce algorithm mapping EventDebounceMapDBCANFD08NoCommunication: debounce-algorithm=counter_based, diagnostic-event=EventDBCANFD08NoCommunication  # EventDebounceMap_DB_CANFD_08_No_Communication
package /ZeC/DTC/DTC/Power_Path_104_Not_Found_Failure
  diagnostic trouble code uds Power_Path_104_Not_Found_Failure: dtc-props=Dtc_Props_849998ae, uds-dtc-value=0x005668
  diagnostic event EventPowerPath104NotFoundFailure: aging-allowed=true, event-kind=SWC, prestorage-freeze-frame=false  # Event_Power_Path_104_Not_Found_Failure
  diagnostic event to trouble code uds mapping EventDtcMapPowerPath104NotFoundFailure: diagnostic-event=EventPowerPath104NotFoundFailure, trouble-code-uds=Power_Path_104_Not_Found_Failure  # Event_Dtc_Map_Power_Path_104_Not_Found_Failure
  diagnostic event to operation cycle mapping EventOperCycleMapPowerPath104NotFoundFailure: diagnostic-event=EventPowerPath104NotFoundFailure, operation-cycle=DefaultOperationCycle  # Event_Oper_Cycle_Map_Power_Path_104_Not_Found_Failure
  diagnostic event to debounce algorithm mapping EventDebounceMapPowerPath104NotFoundFailure: debounce-algorithm=time_based, diagnostic-event=EventPowerPath104NotFoundFailure  # EventDebounceMap_Power_Path_104_Not_Found_Failure
package /ZeC/DTC/DTC/Power_Path_103_Not_Found_Failure
  diagnostic trouble code uds Power_Path_103_Not_Found_Failure: dtc-props=Dtc_Props_d0fcf35a, uds-dtc-value=0x005667
  diagnostic event EventPowerPath103NotFoundFailure: aging-allowed=true, event-kind=SWC, prestorage-freeze-frame=false  # Event_Power_Path_103_Not_Found_Failure
  diagnostic event to trouble code uds mapping EventDtcMapPowerPath103NotFoundFailure: diagnostic-event=EventPowerPath103NotFoundFailure, trouble-code-uds=Power_Path_103_Not_Found_Failure  # Event_Dtc_Map_Power_Path_103_Not_Found_Failure
  diagnostic event to operation cycle mapping EventOperCycleMapPowerPath103NotFoundFailure: diagnostic-event=EventPowerPath103NotFoundFailure, operation-cycle=DefaultOperationCycle  # Event_Oper_Cycle_Map_Power_Path_103_Not_Found_Failure
  diagnostic event to debounce algorithm mapping EventDebounceMapPowerPath103NotFoundFailure: debounce-algorithm=time_based, diagnostic-event=EventPowerPath103NotFoundFailure  # EventDebounceMap_Power_Path_103_Not_Found_Failure
package /ZeC/DTC/DTC/Power_Path_107_Not_Found_Failure
  diagnostic trouble code uds Power_Path_107_Not_Found_Failure: dtc-props=Dtc_Props_680fb3b4, uds-dtc-value=0x00566b
  diagnostic event EventPowerPath107NotFoundFailure: aging-allowed=true, event-kind=SWC, prestorage-freeze-frame=false  # Event_Power_Path_107_Not_Found_Failure
  diagnostic event to trouble code uds mapping EventDtcMapPowerPath107NotFoundFailure: diagnostic-event=EventPowerPath107NotFoundFailure, trouble-code-uds=Power_Path_107_Not_Found_Failure  # Event_Dtc_Map_Power_Path_107_Not_Found_Failure
  diagnostic event to operation cycle mapping EventOperCycleMapPowerPath107NotFoundFailure: diagnostic-event=EventPowerPath107NotFoundFailure, operation-cycle=DefaultOperationCycle  # Event_Oper_Cycle_Map_Power_Path_107_Not_Found_Failure
  diagnostic event to debounce algorithm mapping EventDebounceMapPowerPath107NotFoundFailure: debounce-algorithm=time_based, diagnostic-event=EventPowerPath107NotFoundFailure  # EventDebounceMap_Power_Path_107_Not_Found_Failure
package /ZeC/DTC/DTC/Power_Path_106_Not_Found_Failure
  diagnostic trouble code uds Power_Path_106_Not_Found_Failure: dtc-props=Dtc_Props_a224adfa, uds-dtc-value=0x00566a
  diagnostic event EventPowerPath106NotFoundFailure: aging-allowed=true, event-kind=SWC, prestorage-freeze-frame=false  # Event_Power_Path_106_Not_Found_Failure
  diagnostic event to trouble code uds mapping EventDtcMapPowerPath106NotFoundFailure: diagnostic-event=EventPowerPath106NotFoundFailure, trouble-code-uds=Power_Path_106_Not_Found_Failure  # Event_Dtc_Map_Power_Path_106_Not_Found_Failure
  diagnostic event to operation cycle mapping EventOperCycleMapPowerPath106NotFoundFailure: diagnostic-event=EventPowerPath106NotFoundFailure, operation-cycle=DefaultOperationCycle  # Event_Oper_Cycle_Map_Power_Path_106_Not_Found_Failure
  diagnostic event to debounce algorithm mapping EventDebounceMapPowerPath106NotFoundFailure: debounce-algorithm=time_based, diagnostic-event=EventPowerPath106NotFoundFailure  # EventDebounceMap_Power_Path_106_Not_Found_Failure
package /ZeC/DTC/DTC/LIN_6_Databus_No_Comm
  diagnostic trouble code uds LIN_6_Databus_No_Comm: dtc-props=Dtc_Props_358996c7, uds-dtc-value=0x030620  # LIN 6 Databus_No_Comm
  diagnostic event EventLIN6DatabusNoComm: aging-allowed=true, event-kind=SWC, prestorage-freeze-frame=false  # Event_LIN 6 Databus_No_Comm
  diagnostic event to trouble code uds mapping EventDtcMapLIN6DatabusNoComm: diagnostic-event=EventLIN6DatabusNoComm, trouble-code-uds=LIN_6_Databus_No_Comm  # Event_Dtc_Map_LIN 6 Databus_No_Comm
  diagnostic event to operation cycle mapping EventOperCycleMapLIN6DatabusNoComm: diagnostic-event=EventLIN6DatabusNoComm, operation-cycle=DefaultOperationCycle  # Event_Oper_Cycle_Map_LIN 6 Databus_No_Comm
  diagnostic event to debounce algorithm mapping EventDebounceMapLIN6DatabusNoComm: debounce-algorithm=counter_based, diagnostic-event=EventLIN6DatabusNoComm  # EventDebounceMap_LIN 6 Databus_No_Comm
package /ZeC/DTC/DTC/Power_Path_109_Not_Found_Failure
  diagnostic trouble code uds Power_Path_109_Not_Found_Failure: dtc-props=Dtc_Props_27288969, uds-dtc-value=0x00566d
  diagnostic event EventPowerPath109NotFoundFailure: aging-allowed=true, event-kind=SWC, prestorage-freeze-frame=false  # Event_Power_Path_109_Not_Found_Failure
  diagnostic event to trouble code uds mapping EventDtcMapPowerPath109NotFoundFailure: diagnostic-event=EventPowerPath109NotFoundFailure, trouble-code-uds=Power_Path_109_Not_Found_Failure  # Event_Dtc_Map_Power_Path_109_Not_Found_Failure
  diagnostic event to operation cycle mapping EventOperCycleMapPowerPath109NotFoundFailure: diagnostic-event=EventPowerPath109NotFoundFailure, operation-cycle=DefaultOperationCycle  # Event_Oper_Cycle_Map_Power_Path_109_Not_Found_Failure
  diagnostic event to debounce algorithm mapping EventDebounceMapPowerPath109NotFoundFailure: debounce-algorithm=time_based, diagnostic-event=EventPowerPath109NotFoundFailure  # EventDebounceMap_Power_Path_109_Not_Found_Failure
package /ZeC/DTC/DTC/Power_Path_108_Not_Found_Failure
  diagnostic trouble code uds Power_Path_108_Not_Found_Failure: dtc-props=Dtc_Props_2e16b98e, uds-dtc-value=0x00566c
  diagnostic event EventPowerPath108NotFoundFailure: aging-allowed=true, event-kind=SWC, prestorage-freeze-frame=false  # Event_Power_Path_108_Not_Found_Failure
  diagnostic event to trouble code uds mapping EventDtcMapPowerPath108NotFoundFailure: diagnostic-event=EventPowerPath108NotFoundFailure, trouble-code-uds=Power_Path_108_Not_Found_Failure  # Event_Dtc_Map_Power_Path_108_Not_Found_Failure
  diagnostic event to operation cycle mapping EventOperCycleMapPowerPath108NotFoundFailure: diagnostic-event=EventPowerPath108NotFoundFailure, operation-cycle=DefaultOperationCycle  # Event_Oper_Cycle_Map_Power_Path_108_Not_Found_Failure
  diagnostic event to debounce algorithm mapping EventDebounceMapPowerPath108NotFoundFailure: debounce-algorithm=time_based, diagnostic-event=EventPowerPath108NotFoundFailure  # EventDebounceMap_Power_Path_108_Not_Found_Failure
package /ZeC/DTC/DTC/Power_Path_111_Not_Found_Failure
  diagnostic trouble code uds Power_Path_111_Not_Found_Failure: dtc-props=Dtc_Props_ab1a9d1d, uds-dtc-value=0x00566f
  diagnostic event EventPowerPath111NotFoundFailure: aging-allowed=true, event-kind=SWC, prestorage-freeze-frame=false  # Event_Power_Path_111_Not_Found_Failure
  diagnostic event to trouble code uds mapping EventDtcMapPowerPath111NotFoundFailure: diagnostic-event=EventPowerPath111NotFoundFailure, trouble-code-uds=Power_Path_111_Not_Found_Failure  # Event_Dtc_Map_Power_Path_111_Not_Found_Failure
  diagnostic event to operation cycle mapping EventOperCycleMapPowerPath111NotFoundFailure: diagnostic-event=EventPowerPath111NotFoundFailure, operation-cycle=DefaultOperationCycle  # Event_Oper_Cycle_Map_Power_Path_111_Not_Found_Failure
  diagnostic event to debounce algorithm mapping EventDebounceMapPowerPath111NotFoundFailure: debounce-algorithm=time_based, diagnostic-event=EventPowerPath111NotFoundFailure  # EventDebounceMap_Power_Path_111_Not_Found_Failure
package /ZeC/DTC/DTC/Power_Path_110_Not_Found_Failure
  diagnostic trouble code uds Power_Path_110_Not_Found_Failure: dtc-props=Dtc_Props_61318353, uds-dtc-value=0x00566e
  diagnostic event EventPowerPath110NotFoundFailure: aging-allowed=true, event-kind=SWC, prestorage-freeze-frame=false  # Event_Power_Path_110_Not_Found_Failure
  diagnostic event to trouble code uds mapping EventDtcMapPowerPath110NotFoundFailure: diagnostic-event=EventPowerPath110NotFoundFailure, trouble-code-uds=Power_Path_110_Not_Found_Failure  # Event_Dtc_Map_Power_Path_110_Not_Found_Failure
  diagnostic event to operation cycle mapping EventOperCycleMapPowerPath110NotFoundFailure: diagnostic-event=EventPowerPath110NotFoundFailure, operation-cycle=DefaultOperationCycle  # Event_Oper_Cycle_Map_Power_Path_110_Not_Found_Failure
  diagnostic event to debounce algorithm mapping EventDebounceMapPowerPath110NotFoundFailure: debounce-algorithm=time_based, diagnostic-event=EventPowerPath110NotFoundFailure  # EventDebounceMap_Power_Path_110_Not_Found_Failure
package /ZeC/DTC/DTC/Power_Path_115_Not_Found_Failure
  diagnostic trouble code uds Power_Path_115_Not_Found_Failure: dtc-props=Dtc_Props_d5a31d4b, uds-dtc-value=0x005673
  diagnostic event EventPowerPath115NotFoundFailure: aging-allowed=true, event-kind=SWC, prestorage-freeze-frame=false  # Event_Power_Path_115_Not_Found_Failure
  diagnostic event to trouble code uds mapping EventDtcMapPowerPath115NotFoundFailure: diagnostic-event=EventPowerPath115NotFoundFailure, trouble-code-uds=Power_Path_115_Not_Found_Failure  # Event_Dtc_Map_Power_Path_115_Not_Found_Failure
  diagnostic event to operation cycle mapping EventOperCycleMapPowerPath115NotFoundFailure: diagnostic-event=EventPowerPath115NotFoundFailure, operation-cycle=DefaultOperationCycle  # Event_Oper_Cycle_Map_Power_Path_115_Not_Found_Failure
  diagnostic event to debounce algorithm mapping EventDebounceMapPowerPath115NotFoundFailure: debounce-algorithm=time_based, diagnostic-event=EventPowerPath115NotFoundFailure  # EventDebounceMap_Power_Path_115_Not_Found_Failure
package /ZeC/DTC/DTC/Power_Path_114_Not_Found_Failure
  diagnostic trouble code uds Power_Path_114_Not_Found_Failure: dtc-props=Dtc_Props_93ba1771, uds-dtc-value=0x005672
  diagnostic event EventPowerPath114NotFoundFailure: aging-allowed=true, event-kind=SWC, prestorage-freeze-frame=false  # Event_Power_Path_114_Not_Found_Failure
  diagnostic event to trouble code uds mapping EventDtcMapPowerPath114NotFoundFailure: diagnostic-event=EventPowerPath114NotFoundFailure, trouble-code-uds=Power_Path_114_Not_Found_Failure  # Event_Dtc_Map_Power_Path_114_Not_Found_Failure
  diagnostic event to operation cycle mapping EventOperCycleMapPowerPath114NotFoundFailure: diagnostic-event=EventPowerPath114NotFoundFailure, operation-cycle=DefaultOperationCycle  # Event_Oper_Cycle_Map_Power_Path_114_Not_Found_Failure
  diagnostic event to debounce algorithm mapping EventDebounceMapPowerPath114NotFoundFailure: debounce-algorithm=time_based, diagnostic-event=EventPowerPath114NotFoundFailure  # EventDebounceMap_Power_Path_114_Not_Found_Failure
package /ZeC/DTC/DTC/Power_Path_117_Not_Found_Failure
  diagnostic trouble code uds Power_Path_117_Not_Found_Failure: dtc-props=Dtc_Props_9a842796, uds-dtc-value=0x005675
  diagnostic event EventPowerPath117NotFoundFailure: aging-allowed=true, event-kind=SWC, prestorage-freeze-frame=false  # Event_Power_Path_117_Not_Found_Failure
  diagnostic event to trouble code uds mapping EventDtcMapPowerPath117NotFoundFailure: diagnostic-event=EventPowerPath117NotFoundFailure, trouble-code-uds=Power_Path_117_Not_Found_Failure  # Event_Dtc_Map_Power_Path_117_Not_Found_Failure
  diagnostic event to operation cycle mapping EventOperCycleMapPowerPath117NotFoundFailure: diagnostic-event=EventPowerPath117NotFoundFailure, operation-cycle=DefaultOperationCycle  # Event_Oper_Cycle_Map_Power_Path_117_Not_Found_Failure
  diagnostic event to debounce algorithm mapping EventDebounceMapPowerPath117NotFoundFailure: debounce-algorithm=time_based, diagnostic-event=EventPowerPath117NotFoundFailure  # EventDebounceMap_Power_Path_117_Not_Found_Failure
package /ZeC/DTC/DTC/Power_Path_116_Not_Found_Failure
  diagnostic trouble code uds Power_Path_116_Not_Found_Failure: dtc-props=Dtc_Props_dc9d2dac, uds-dtc-value=0x005674
  diagnostic event EventPowerPath116NotFoundFailure: aging-allowed=true, event-kind=SWC, prestorage-freeze-frame=false  # Event_Power_Path_116_Not_Found_Failure
  diagnostic event to trouble code uds mapping EventDtcMapPowerPath116NotFoundFailure: diagnostic-event=EventPowerPath116NotFoundFailure, trouble-code-uds=Power_Path_116_Not_Found_Failure  # Event_Dtc_Map_Power_Path_116_Not_Found_Failure
  diagnostic event to operation cycle mapping EventOperCycleMapPowerPath116NotFoundFailure: diagnostic-event=EventPowerPath116NotFoundFailure, operation-cycle=DefaultOperationCycle  # Event_Oper_Cycle_Map_Power_Path_116_Not_Found_Failure
  diagnostic event to debounce algorithm mapping EventDebounceMapPowerPath116NotFoundFailure: debounce-algorithm=time_based, diagnostic-event=EventPowerPath116NotFoundFailure  # EventDebounceMap_Power_Path_116_Not_Found_Failure
package /ZeC/DTC/DTC/CAN_08_ECU_5_No_Communication
  diagnostic trouble code uds CAN_08_ECU_5_No_Communication: dtc-props=Dtc_Props_14158306, uds-dtc-value=0x032809
  diagnostic event EventCAN08ECU5NoCommunication: aging-allowed=true, event-kind=SWC, prestorage-freeze-frame=false  # Event_CAN_08_ECU_5_No_Communication
  diagnostic event to trouble code uds mapping EventDtcMapCAN08ECU5NoCommunication: diagnostic-event=EventCAN08ECU5NoCommunication, trouble-code-uds=CAN_08_ECU_5_No_Communication  # Event_Dtc_Map_CAN_08_ECU_5_No_Communication
  diagnostic event to operation cycle mapping EventOperCycleMapCAN08ECU5NoCommunication: diagnostic-event=EventCAN08ECU5NoCommunication, operation-cycle=DefaultOperationCycle  # Event_Oper_Cycle_Map_CAN_08_ECU_5_No_Communication
  diagnostic event to debounce algorithm mapping EventDebounceMapCAN08ECU5NoCommunication: debounce-algorithm=counter_based, diagnostic-event=EventCAN08ECU5NoCommunication  # EventDebounceMap_CAN_08_ECU_5_No_Communication
package /ZeC/DTC/DTC/Power_Path_113_Not_Found_Failure
  diagnostic trouble code uds Power_Path_113_Not_Found_Failure: dtc-props=Dtc_Props_5991093f, uds-dtc-value=0x005671
  diagnostic event EventPowerPath113NotFoundFailure: aging-allowed=true, event-kind=SWC, prestorage-freeze-frame=false  # Event_Power_Path_113_Not_Found_Failure
  diagnostic event to trouble code uds mapping EventDtcMapPowerPath113NotFoundFailure: diagnostic-event=EventPowerPath113NotFoundFailure, trouble-code-uds=Power_Path_113_Not_Found_Failure  # Event_Dtc_Map_Power_Path_113_Not_Found_Failure
  diagnostic event to operation cycle mapping EventOperCycleMapPowerPath113NotFoundFailure: diagnostic-event=EventPowerPath113NotFoundFailure, operation-cycle=DefaultOperationCycle  # Event_Oper_Cycle_Map_Power_Path_113_Not_Found_Failure
  diagnostic event to debounce algorithm mapping EventDebounceMapPowerPath113NotFoundFailure: debounce-algorithm=time_based, diagnostic-event=EventPowerPath113NotFoundFailure  # EventDebounceMap_Power_Path_113_Not_Found_Failure
package /ZeC/DTC/DTC/CAN_08_ECU_3_No_Communication
  diagnostic trouble code uds CAN_08_ECU_3_No_Communication: dtc-props=Dtc_Props_14158306, uds-dtc-value=0x032807
  diagnostic event EventCAN08ECU3NoCommunication: aging-allowed=true, event-kind=SWC, prestorage-freeze-frame=false  # Event_CAN_08_ECU_3_No_Communication
  diagnostic event to trouble code uds mapping EventDtcMapCAN08ECU3NoCommunication: diagnostic-event=EventCAN08ECU3NoCommunication, trouble-code-uds=CAN_08_ECU_3_No_Communication  # Event_Dtc_Map_CAN_08_ECU_3_No_Communication
  diagnostic event to operation cycle mapping EventOperCycleMapCAN08ECU3NoCommunication: diagnostic-event=EventCAN08ECU3NoCommunication, operation-cycle=DefaultOperationCycle  # Event_Oper_Cycle_Map_CAN_08_ECU_3_No_Communication
  diagnostic event to debounce algorithm mapping EventDebounceMapCAN08ECU3NoCommunication: debounce-algorithm=counter_based, diagnostic-event=EventCAN08ECU3NoCommunication  # EventDebounceMap_CAN_08_ECU_3_No_Communication
package /ZeC/DTC/DTC/Power_Path_112_Not_Found_Failure
  diagnostic trouble code uds Power_Path_112_Not_Found_Failure: dtc-props=Dtc_Props_1f880305, uds-dtc-value=0x005670
  diagnostic event EventPowerPath112NotFoundFailure: aging-allowed=true, event-kind=SWC, prestorage-freeze-frame=false  # Event_Power_Path_112_Not_Found_Failure
  diagnostic event to trouble code uds mapping EventDtcMapPowerPath112NotFoundFailure: diagnostic-event=EventPowerPath112NotFoundFailure, trouble-code-uds=Power_Path_112_Not_Found_Failure  # Event_Dtc_Map_Power_Path_112_Not_Found_Failure
  diagnostic event to operation cycle mapping EventOperCycleMapPowerPath112NotFoundFailure: diagnostic-event=EventPowerPath112NotFoundFailure, operation-cycle=DefaultOperationCycle  # Event_Oper_Cycle_Map_Power_Path_112_Not_Found_Failure
  diagnostic event to debounce algorithm mapping EventDebounceMapPowerPath112NotFoundFailure: debounce-algorithm=time_based, diagnostic-event=EventPowerPath112NotFoundFailure  # EventDebounceMap_Power_Path_112_Not_Found_Failure
package /ZeC/DTC/DTC/CAN_08_ECU_4_No_Communication
  diagnostic trouble code uds CAN_08_ECU_4_No_Communication: dtc-props=Dtc_Props_14158306, uds-dtc-value=0x032808
  diagnostic event EventCAN08ECU4NoCommunication: aging-allowed=true, event-kind=SWC, prestorage-freeze-frame=false  # Event_CAN_08_ECU_4_No_Communication
  diagnostic event to trouble code uds mapping EventDtcMapCAN08ECU4NoCommunication: diagnostic-event=EventCAN08ECU4NoCommunication, trouble-code-uds=CAN_08_ECU_4_No_Communication  # Event_Dtc_Map_CAN_08_ECU_4_No_Communication
  diagnostic event to operation cycle mapping EventOperCycleMapCAN08ECU4NoCommunication: diagnostic-event=EventCAN08ECU4NoCommunication, operation-cycle=DefaultOperationCycle  # Event_Oper_Cycle_Map_CAN_08_ECU_4_No_Communication
  diagnostic event to debounce algorithm mapping EventDebounceMapCAN08ECU4NoCommunication: debounce-algorithm=counter_based, diagnostic-event=EventCAN08ECU4NoCommunication  # EventDebounceMap_CAN_08_ECU_4_No_Communication
package /ZeC/DTC/DTC/Power_Path_089_Not_Found_Failure
  diagnostic trouble code uds Power_Path_089_Not_Found_Failure: dtc-props=Dtc_Props_532ed51d, uds-dtc-value=0x005659
  diagnostic event EventPowerPath089NotFoundFailure: aging-allowed=true, event-kind=SWC, prestorage-freeze-frame=false  # Event_Power_Path_089_Not_Found_Failure
  diagnostic event to trouble code uds mapping EventDtcMapPowerPath089NotFoundFailure: diagnostic-event=EventPowerPath089NotFoundFailure, trouble-code-uds=Power_Path_089_Not_Found_Failure  # Event_Dtc_Map_Power_Path_089_Not_Found_Failure
  diagnostic event to operation cycle mapping EventOperCycleMapPowerPath089NotFoundFailure: diagnostic-event=EventPowerPath089NotFoundFailure, operation-cycle=DefaultOperationCycle  # Event_Oper_Cycle_Map_Power_Path_089_Not_Found_Failure
  diagnostic event to debounce algorithm mapping EventDebounceMapPowerPath089NotFoundFailure: debounce-algorithm=time_based, diagnostic-event=EventPowerPath089NotFoundFailure  # EventDebounceMap_Power_Path_089_Not_Found_Failure
package /ZeC/DTC/DTC/Power_Path_088_Not_Found_Failure
  diagnostic trouble code uds Power_Path_088_Not_Found_Failure: dtc-props=Dtc_Props_1537df27, uds-dtc-value=0x005658
  diagnostic event EventPowerPath088NotFoundFailure: aging-allowed=true, event-kind=SWC, prestorage-freeze-frame=false  # Event_Power_Path_088_Not_Found_Failure
  diagnostic event to trouble code uds mapping EventDtcMapPowerPath088NotFoundFailure: diagnostic-event=EventPowerPath088NotFoundFailure, trouble-code-uds=Power_Path_088_Not_Found_Failure  # Event_Dtc_Map_Power_Path_088_Not_Found_Failure
  diagnostic event to operation cycle mapping EventOperCycleMapPowerPath088NotFoundFailure: diagnostic-event=EventPowerPath088NotFoundFailure, operation-cycle=DefaultOperationCycle  # Event_Oper_Cycle_Map_Power_Path_088_Not_Found_Failure
  diagnostic event to debounce algorithm mapping EventDebounceMapPowerPath088NotFoundFailure: debounce-algorithm=time_based, diagnostic-event=EventPowerPath088NotFoundFailure  # EventDebounceMap_Power_Path_088_Not_Found_Failure
package /ZeC/DTC/DTC/Power_Path_085_Not_Found_Failure
  diagnostic trouble code uds Power_Path_085_Not_Found_Failure: dtc-props=Dtc_Props_cd60a0a7, uds-dtc-value=0x005655
  diagnostic event EventPowerPath085NotFoundFailure: aging-allowed=true, event-kind=SWC, prestorage-freeze-frame=false  # Event_Power_Path_085_Not_Found_Failure
  diagnostic event to trouble code uds mapping EventDtcMapPowerPath085NotFoundFailure: diagnostic-event=EventPowerPath085NotFoundFailure, trouble-code-uds=Power_Path_085_Not_Found_Failure  # Event_Dtc_Map_Power_Path_085_Not_Found_Failure
  diagnostic event to operation cycle mapping EventOperCycleMapPowerPath085NotFoundFailure: diagnostic-event=EventPowerPath085NotFoundFailure, operation-cycle=DefaultOperationCycle  # Event_Oper_Cycle_Map_Power_Path_085_Not_Found_Failure
  diagnostic event to debounce algorithm mapping EventDebounceMapPowerPath085NotFoundFailure: debounce-algorithm=time_based, diagnostic-event=EventPowerPath085NotFoundFailure  # EventDebounceMap_Power_Path_085_Not_Found_Failure
package /ZeC/DTC/DTC/Power_Path_084_Not_Found_Failure
  diagnostic trouble code uds Power_Path_084_Not_Found_Failure: dtc-props=Dtc_Props_8b79aa9d, uds-dtc-value=0x005654
  diagnostic event EventPowerPath084NotFoundFailure: aging-allowed=true, event-kind=SWC, prestorage-freeze-frame=false  # Event_Power_Path_084_Not_Found_Failure
  diagnostic event to trouble code uds mapping EventDtcMapPowerPath084NotFoundFailure: diagnostic-event=EventPowerPath084NotFoundFailure, trouble-code-uds=Power_Path_084_Not_Found_Failure  # Event_Dtc_Map_Power_Path_084_Not_Found_Failure
  diagnostic event to operation cycle mapping EventOperCycleMapPowerPath084NotFoundFailure: diagnostic-event=EventPowerPath084NotFoundFailure, operation-cycle=DefaultOperationCycle  # Event_Oper_Cycle_Map_Power_Path_084_Not_Found_Failure
  diagnostic event to debounce algorithm mapping EventDebounceMapPowerPath084NotFoundFailure: debounce-algorithm=time_based, diagnostic-event=EventPowerPath084NotFoundFailure  # EventDebounceMap_Power_Path_084_Not_Found_Failure
package /ZeC/DTC/DTC/Power_Path_087_Not_Found_Failure
  diagnostic trouble code uds Power_Path_087_Not_Found_Failure: dtc-props=Dtc_Props_4152b4d3, uds-dtc-value=0x005657
  diagnostic event EventPowerPath087NotFoundFailure: aging-allowed=true, event-kind=SWC, prestorage-freeze-frame=false  # Event_Power_Path_087_Not_Found_Failure
  diagnostic event to trouble code uds mapping EventDtcMapPowerPath087NotFoundFailure: diagnostic-event=EventPowerPath087NotFoundFailure, trouble-code-uds=Power_Path_087_Not_Found_Failure  # Event_Dtc_Map_Power_Path_087_Not_Found_Failure
  diagnostic event to operation cycle mapping EventOperCycleMapPowerPath087NotFoundFailure: diagnostic-event=EventPowerPath087NotFoundFailure, operation-cycle=DefaultOperationCycle  # Event_Oper_Cycle_Map_Power_Path_087_Not_Found_Failure
  diagnostic event to debounce algorithm mapping EventDebounceMapPowerPath087NotFoundFailure: debounce-algorithm=time_based, diagnostic-event=EventPowerPath087NotFoundFailure  # EventDebounceMap_Power_Path_087_Not_Found_Failure
package /ZeC/DTC/DTC/CAN_08_ECU_6_No_Communication
  diagnostic trouble code uds CAN_08_ECU_6_No_Communication: dtc-props=Dtc_Props_14158306, uds-dtc-value=0x032810
  diagnostic event EventCAN08ECU6NoCommunication: aging-allowed=true, event-kind=SWC, prestorage-freeze-frame=false  # Event_CAN_08_ECU_6_No_Communication
  diagnostic event to trouble code uds mapping EventDtcMapCAN08ECU6NoCommunication: diagnostic-event=EventCAN08ECU6NoCommunication, trouble-code-uds=CAN_08_ECU_6_No_Communication  # Event_Dtc_Map_CAN_08_ECU_6_No_Communication
  diagnostic event to operation cycle mapping EventOperCycleMapCAN08ECU6NoCommunication: diagnostic-event=EventCAN08ECU6NoCommunication, operation-cycle=DefaultOperationCycle  # Event_Oper_Cycle_Map_CAN_08_ECU_6_No_Communication
  diagnostic event to debounce algorithm mapping EventDebounceMapCAN08ECU6NoCommunication: debounce-algorithm=counter_based, diagnostic-event=EventCAN08ECU6NoCommunication  # EventDebounceMap_CAN_08_ECU_6_No_Communication
package /ZeC/DTC/DTC/Power_Path_086_Not_Found_Failure
  diagnostic trouble code uds Power_Path_086_Not_Found_Failure: dtc-props=Dtc_Props_74bbee9, uds-dtc-value=0x005656
  diagnostic event EventPowerPath086NotFoundFailure: aging-allowed=true, event-kind=SWC, prestorage-freeze-frame=false  # Event_Power_Path_086_Not_Found_Failure
  diagnostic event to trouble code uds mapping EventDtcMapPowerPath086NotFoundFailure: diagnostic-event=EventPowerPath086NotFoundFailure, trouble-code-uds=Power_Path_086_Not_Found_Failure  # Event_Dtc_Map_Power_Path_086_Not_Found_Failure
  diagnostic event to operation cycle mapping EventOperCycleMapPowerPath086NotFoundFailure: diagnostic-event=EventPowerPath086NotFoundFailure, operation-cycle=DefaultOperationCycle  # Event_Oper_Cycle_Map_Power_Path_086_Not_Found_Failure
  diagnostic event to debounce algorithm mapping EventDebounceMapPowerPath086NotFoundFailure: debounce-algorithm=time_based, diagnostic-event=EventPowerPath086NotFoundFailure  # EventDebounceMap_Power_Path_086_Not_Found_Failure
package /ZeC/DTC/DTC/Power_Path_090_Not_Found_Failure
  diagnostic trouble code uds Power_Path_090_Not_Found_Failure: dtc-props=Dtc_Props_338aea73, uds-dtc-value=0x00565a
  diagnostic event EventPowerPath090NotFoundFailure: aging-allowed=true, event-kind=SWC, prestorage-freeze-frame=false  # Event_Power_Path_090_Not_Found_Failure
  diagnostic event to trouble code uds mapping EventDtcMapPowerPath090NotFoundFailure: diagnostic-event=EventPowerPath090NotFoundFailure, trouble-code-uds=Power_Path_090_Not_Found_Failure  # Event_Dtc_Map_Power_Path_090_Not_Found_Failure
  diagnostic event to operation cycle mapping EventOperCycleMapPowerPath090NotFoundFailure: diagnostic-event=EventPowerPath090NotFoundFailure, operation-cycle=DefaultOperationCycle  # Event_Oper_Cycle_Map_Power_Path_090_Not_Found_Failure
  diagnostic event to debounce algorithm mapping EventDebounceMapPowerPath090NotFoundFailure: debounce-algorithm=time_based, diagnostic-event=EventPowerPath090NotFoundFailure  # EventDebounceMap_Power_Path_090_Not_Found_Failure
package /ZeC/DTC/DTC/Power_Path_092_Not_Found_Failure
  diagnostic trouble code uds Power_Path_092_Not_Found_Failure: dtc-props=Dtc_Props_bfb8fe07, uds-dtc-value=0x00565c
  diagnostic event EventPowerPath092NotFoundFailure: aging-allowed=true, event-kind=SWC, prestorage-freeze-frame=false  # Event_Power_Path_092_Not_Found_Failure
  diagnostic event to trouble code uds mapping EventDtcMapPowerPath092NotFoundFailure: diagnostic-event=EventPowerPath092NotFoundFailure, trouble-code-uds=Power_Path_092_Not_Found_Failure  # Event_Dtc_Map_Power_Path_092_Not_Found_Failure
  diagnostic event to operation cycle mapping EventOperCycleMapPowerPath092NotFoundFailure: diagnostic-event=EventPowerPath092NotFoundFailure, operation-cycle=DefaultOperationCycle  # Event_Oper_Cycle_Map_Power_Path_092_Not_Found_Failure
  diagnostic event to debounce algorithm mapping EventDebounceMapPowerPath092NotFoundFailure: debounce-algorithm=time_based, diagnostic-event=EventPowerPath092NotFoundFailure  # EventDebounceMap_Power_Path_092_Not_Found_Failure
package /ZeC/DTC/DTC/Power_Path_091_Not_Found_Failure
  diagnostic trouble code uds Power_Path_091_Not_Found_Failure: dtc-props=Dtc_Props_f9a1f43d, uds-dtc-value=0x00565b
  diagnostic event EventPowerPath091NotFoundFailure: aging-allowed=true, event-kind=SWC, prestorage-freeze-frame=false  # Event_Power_Path_091_Not_Found_Failure
  diagnostic event to trouble code uds mapping EventDtcMapPowerPath091NotFoundFailure: diagnostic-event=EventPowerPath091NotFoundFailure, trouble-code-uds=Power_Path_091_Not_Found_Failure  # Event_Dtc_Map_Power_Path_091_Not_Found_Failure
  diagnostic event to operation cycle mapping EventOperCycleMapPowerPath091NotFoundFailure: diagnostic-event=EventPowerPath091NotFoundFailure, operation-cycle=DefaultOperationCycle  # Event_Oper_Cycle_Map_Power_Path_091_Not_Found_Failure
  diagnostic event to debounce algorithm mapping EventDebounceMapPowerPath091NotFoundFailure: debounce-algorithm=time_based, diagnostic-event=EventPowerPath091NotFoundFailure  # EventDebounceMap_Power_Path_091_Not_Found_Failure
package /ZeC/DTC/DTC/Power_Path_094_Not_Found_Failure
  diagnostic trouble code uds Power_Path_094_Not_Found_Failure: dtc-props=Dtc_Props_f09fc4da, uds-dtc-value=0x00565e
  diagnostic event EventPowerPath094NotFoundFailure: aging-allowed=true, event-kind=SWC, prestorage-freeze-frame=false  # Event_Power_Path_094_Not_Found_Failure
  diagnostic event to trouble code uds mapping EventDtcMapPowerPath094NotFoundFailure: diagnostic-event=EventPowerPath094NotFoundFailure, trouble-code-uds=Power_Path_094_Not_Found_Failure  # Event_Dtc_Map_Power_Path_094_Not_Found_Failure
  diagnostic event to operation cycle mapping EventOperCycleMapPowerPath094NotFoundFailure: diagnostic-event=EventPowerPath094NotFoundFailure, operation-cycle=DefaultOperationCycle  # Event_Oper_Cycle_Map_Power_Path_094_Not_Found_Failure
  diagnostic event to debounce algorithm mapping EventDebounceMapPowerPath094NotFoundFailure: debounce-algorithm=time_based, diagnostic-event=EventPowerPath094NotFoundFailure  # EventDebounceMap_Power_Path_094_Not_Found_Failure
package /ZeC/DTC/DTC/Power_Path_093_Not_Found_Failure
  diagnostic trouble code uds Power_Path_093_Not_Found_Failure: dtc-props=Dtc_Props_b686cee0, uds-dtc-value=0x00565d
  diagnostic event EventPowerPath093NotFoundFailure: aging-allowed=true, event-kind=SWC, prestorage-freeze-frame=false  # Event_Power_Path_093_Not_Found_Failure
  diagnostic event to trouble code uds mapping EventDtcMapPowerPath093NotFoundFailure: diagnostic-event=EventPowerPath093NotFoundFailure, trouble-code-uds=Power_Path_093_Not_Found_Failure  # Event_Dtc_Map_Power_Path_093_Not_Found_Failure
  diagnostic event to operation cycle mapping EventOperCycleMapPowerPath093NotFoundFailure: diagnostic-event=EventPowerPath093NotFoundFailure, operation-cycle=DefaultOperationCycle  # Event_Oper_Cycle_Map_Power_Path_093_Not_Found_Failure
  diagnostic event to debounce algorithm mapping EventDebounceMapPowerPath093NotFoundFailure: debounce-algorithm=time_based, diagnostic-event=EventPowerPath093NotFoundFailure  # EventDebounceMap_Power_Path_093_Not_Found_Failure
package /ZeC/DTC/DTC/Power_Path_095_Not_Found_Failure
  diagnostic trouble code uds Power_Path_095_Not_Found_Failure: dtc-props=Dtc_Props_3ab4da94, uds-dtc-value=0x00565f
  diagnostic event EventPowerPath095NotFoundFailure: aging-allowed=true, event-kind=SWC, prestorage-freeze-frame=false  # Event_Power_Path_095_Not_Found_Failure
  diagnostic event to trouble code uds mapping EventDtcMapPowerPath095NotFoundFailure: diagnostic-event=EventPowerPath095NotFoundFailure, trouble-code-uds=Power_Path_095_Not_Found_Failure  # Event_Dtc_Map_Power_Path_095_Not_Found_Failure
  diagnostic event to operation cycle mapping EventOperCycleMapPowerPath095NotFoundFailure: diagnostic-event=EventPowerPath095NotFoundFailure, operation-cycle=DefaultOperationCycle  # Event_Oper_Cycle_Map_Power_Path_095_Not_Found_Failure
  diagnostic event to debounce algorithm mapping EventDebounceMapPowerPath095NotFoundFailure: debounce-algorithm=time_based, diagnostic-event=EventPowerPath095NotFoundFailure  # EventDebounceMap_Power_Path_095_Not_Found_Failure
package /ZeC/DTC/DTC/Power_Path_098_Not_Found_Failure
  diagnostic trouble code uds Power_Path_098_Not_Found_Failure: dtc-props=Dtc_Props_55f0d7c9, uds-dtc-value=0x005662
  diagnostic event EventPowerPath098NotFoundFailure: aging-allowed=true, event-kind=SWC, prestorage-freeze-frame=false  # Event_Power_Path_098_Not_Found_Failure
  diagnostic event to trouble code uds mapping EventDtcMapPowerPath098NotFoundFailure: diagnostic-event=EventPowerPath098NotFoundFailure, trouble-code-uds=Power_Path_098_Not_Found_Failure  # Event_Dtc_Map_Power_Path_098_Not_Found_Failure
  diagnostic event to operation cycle mapping EventOperCycleMapPowerPath098NotFoundFailure: diagnostic-event=EventPowerPath098NotFoundFailure, operation-cycle=DefaultOperationCycle  # Event_Oper_Cycle_Map_Power_Path_098_Not_Found_Failure
  diagnostic event to debounce algorithm mapping EventDebounceMapPowerPath098NotFoundFailure: debounce-algorithm=time_based, diagnostic-event=EventPowerPath098NotFoundFailure  # EventDebounceMap_Power_Path_098_Not_Found_Failure
package /ZeC/DTC/DTC/Power_Path_097_Not_Found_Failure
  diagnostic trouble code uds Power_Path_097_Not_Found_Failure: dtc-props=Dtc_Props_9fdbc987, uds-dtc-value=0x005661
  diagnostic event EventPowerPath097NotFoundFailure: aging-allowed=true, event-kind=SWC, prestorage-freeze-frame=false  # Event_Power_Path_097_Not_Found_Failure
  diagnostic event to trouble code uds mapping EventDtcMapPowerPath097NotFoundFailure: diagnostic-event=EventPowerPath097NotFoundFailure, trouble-code-uds=Power_Path_097_Not_Found_Failure  # Event_Dtc_Map_Power_Path_097_Not_Found_Failure
  diagnostic event to operation cycle mapping EventOperCycleMapPowerPath097NotFoundFailure: diagnostic-event=EventPowerPath097NotFoundFailure, operation-cycle=DefaultOperationCycle  # Event_Oper_Cycle_Map_Power_Path_097_Not_Found_Failure
  diagnostic event to debounce algorithm mapping EventDebounceMapPowerPath097NotFoundFailure: debounce-algorithm=time_based, diagnostic-event=EventPowerPath097NotFoundFailure  # EventDebounceMap_Power_Path_097_Not_Found_Failure
package /ZeC/DTC/DTC/Power_Path_100_Not_Found_Failure
  diagnostic trouble code uds Power_Path_100_Not_Found_Failure: dtc-props=Dtc_Props_1ad7ed14, uds-dtc-value=0x005664
  diagnostic event EventPowerPath100NotFoundFailure: aging-allowed=true, event-kind=SWC, prestorage-freeze-frame=false  # Event_Power_Path_100_Not_Found_Failure
  diagnostic event to trouble code uds mapping EventDtcMapPowerPath100NotFoundFailure: diagnostic-event=EventPowerPath100NotFoundFailure, trouble-code-uds=Power_Path_100_Not_Found_Failure  # Event_Dtc_Map_Power_Path_100_Not_Found_Failure
  diagnostic event to operation cycle mapping EventOperCycleMapPowerPath100NotFoundFailure: diagnostic-event=EventPowerPath100NotFoundFailure, operation-cycle=DefaultOperationCycle  # Event_Oper_Cycle_Map_Power_Path_100_Not_Found_Failure
  diagnostic event to debounce algorithm mapping EventDebounceMapPowerPath100NotFoundFailure: debounce-algorithm=time_based, diagnostic-event=EventPowerPath100NotFoundFailure  # EventDebounceMap_Power_Path_100_Not_Found_Failure
package /ZeC/DTC/DTC/Power_Path_099_Not_Found_Failure
  diagnostic trouble code uds Power_Path_099_Not_Found_Failure: dtc-props=Dtc_Props_13e9ddf3, uds-dtc-value=0x005663
  diagnostic event EventPowerPath099NotFoundFailure: aging-allowed=true, event-kind=SWC, prestorage-freeze-frame=false  # Event_Power_Path_099_Not_Found_Failure
  diagnostic event to trouble code uds mapping EventDtcMapPowerPath099NotFoundFailure: diagnostic-event=EventPowerPath099NotFoundFailure, trouble-code-uds=Power_Path_099_Not_Found_Failure  # Event_Dtc_Map_Power_Path_099_Not_Found_Failure
  diagnostic event to operation cycle mapping EventOperCycleMapPowerPath099NotFoundFailure: diagnostic-event=EventPowerPath099NotFoundFailure, operation-cycle=DefaultOperationCycle  # Event_Oper_Cycle_Map_Power_Path_099_Not_Found_Failure
  diagnostic event to debounce algorithm mapping EventDebounceMapPowerPath099NotFoundFailure: debounce-algorithm=time_based, diagnostic-event=EventPowerPath099NotFoundFailure  # EventDebounceMap_Power_Path_099_Not_Found_Failure
package /ZeC/DTC/DTC/Power_Path_096_Not_Found_Failure
  diagnostic trouble code uds Power_Path_096_Not_Found_Failure: dtc-props=Dtc_Props_d9c2c3bd, uds-dtc-value=0x005660
  diagnostic event EventPowerPath096NotFoundFailure: aging-allowed=true, event-kind=SWC, prestorage-freeze-frame=false  # Event_Power_Path_096_Not_Found_Failure
  diagnostic event to trouble code uds mapping EventDtcMapPowerPath096NotFoundFailure: diagnostic-event=EventPowerPath096NotFoundFailure, trouble-code-uds=Power_Path_096_Not_Found_Failure  # Event_Dtc_Map_Power_Path_096_Not_Found_Failure
  diagnostic event to operation cycle mapping EventOperCycleMapPowerPath096NotFoundFailure: diagnostic-event=EventPowerPath096NotFoundFailure, operation-cycle=DefaultOperationCycle  # Event_Oper_Cycle_Map_Power_Path_096_Not_Found_Failure
  diagnostic event to debounce algorithm mapping EventDebounceMapPowerPath096NotFoundFailure: debounce-algorithm=time_based, diagnostic-event=EventPowerPath096NotFoundFailure  # EventDebounceMap_Power_Path_096_Not_Found_Failure
package /ZeC/DTC/DTC/LIN_6_Slave_4_Defect
  diagnostic trouble code uds LIN_6_Slave_4_Defect: dtc-props=Dtc_Props_358996c7, uds-dtc-value=0x030604  # LIN 6 Slave 4_Defect
  diagnostic event EventLIN6Slave4Defect: aging-allowed=true, event-kind=SWC, prestorage-freeze-frame=false  # Event_LIN 6 Slave 4_Defect
  diagnostic event to trouble code uds mapping EventDtcMapLIN6Slave4Defect: diagnostic-event=EventLIN6Slave4Defect, trouble-code-uds=LIN_6_Slave_4_Defect  # Event_Dtc_Map_LIN 6 Slave 4_Defect
  diagnostic event to operation cycle mapping EventOperCycleMapLIN6Slave4Defect: diagnostic-event=EventLIN6Slave4Defect, operation-cycle=DefaultOperationCycle  # Event_Oper_Cycle_Map_LIN 6 Slave 4_Defect
  diagnostic event to debounce algorithm mapping EventDebounceMapLIN6Slave4Defect: debounce-algorithm=counter_based, diagnostic-event=EventLIN6Slave4Defect  # EventDebounceMap_LIN 6 Slave 4_Defect
package /ZeC/DTC/DTC/Power_Path_008_Short_to_GND_Failure
  diagnostic trouble code uds Power_Path_008_Short_to_GND_Failure: dtc-props=Dtc_Props_7cb411fd, uds-dtc-value=0x005208
  diagnostic event EventPowerPath008ShortToGNDFailure: aging-allowed=true, event-kind=SWC, prestorage-freeze-frame=false  # Event_Power_Path_008_Short_to_GND_Failure
  diagnostic event to trouble code uds mapping EventDtcMapPowerPath008ShortToGNDFailure: diagnostic-event=EventPowerPath008ShortToGNDFailure, trouble-code-uds=Power_Path_008_Short_to_GND_Failure  # Event_Dtc_Map_Power_Path_008_Short_to_GND_Failure
  diagnostic event to operation cycle mapping EventOperCycleMapPowerPath008ShortToGNDFailure: diagnostic-event=EventPowerPath008ShortToGNDFailure, operation-cycle=DefaultOperationCycle  # Event_Oper_Cycle_Map_Power_Path_008_Short_to_GND_Failure
  diagnostic event to debounce algorithm mapping EventDebounceMapPowerPath008ShortToGNDFailure: debounce-algorithm=time_based, diagnostic-event=EventPowerPath008ShortToGNDFailure  # EventDebounceMap_Power_Path_008_Short_to_GND_Failure
package /ZeC/DTC/DTC/LIN_6_Slave_3_NoCommunication
  diagnostic trouble code uds LIN_6_Slave_3_NoCommunication: dtc-props=Dtc_Props_358996c7, uds-dtc-value=0x030603  # LIN 6 Slave 3_NoCommunication
  diagnostic event EventLIN6Slave3NoCommunication: aging-allowed=true, event-kind=SWC, prestorage-freeze-frame=false  # Event_LIN 6 Slave 3_NoCommunication
  diagnostic event to trouble code uds mapping EventDtcMapLIN6Slave3NoCommunication: diagnostic-event=EventLIN6Slave3NoCommunication, trouble-code-uds=LIN_6_Slave_3_NoCommunication  # Event_Dtc_Map_LIN 6 Slave 3_NoCommunication
  diagnostic event to operation cycle mapping EventOperCycleMapLIN6Slave3NoCommunication: diagnostic-event=EventLIN6Slave3NoCommunication, operation-cycle=DefaultOperationCycle  # Event_Oper_Cycle_Map_LIN 6 Slave 3_NoCommunication
  diagnostic event to debounce algorithm mapping EventDebounceMapLIN6Slave3NoCommunication: debounce-algorithm=counter_based, diagnostic-event=EventLIN6Slave3NoCommunication  # EventDebounceMap_LIN 6 Slave 3_NoCommunication
package /ZeC/DTC/DTC/Power_Path_007_Short_to_GND_Failure
  diagnostic trouble code uds Power_Path_007_Short_to_GND_Failure: dtc-props=Dtc_Props_28d17a09, uds-dtc-value=0x005207
  diagnostic event EventPowerPath007ShortToGNDFailure: aging-allowed=true, event-kind=SWC, prestorage-freeze-frame=false  # Event_Power_Path_007_Short_to_GND_Failure
  diagnostic event to trouble code uds mapping EventDtcMapPowerPath007ShortToGNDFailure: diagnostic-event=EventPowerPath007ShortToGNDFailure, trouble-code-uds=Power_Path_007_Short_to_GND_Failure  # Event_Dtc_Map_Power_Path_007_Short_to_GND_Failure
  diagnostic event to operation cycle mapping EventOperCycleMapPowerPath007ShortToGNDFailure: diagnostic-event=EventPowerPath007ShortToGNDFailure, operation-cycle=DefaultOperationCycle  # Event_Oper_Cycle_Map_Power_Path_007_Short_to_GND_Failure
  diagnostic event to debounce algorithm mapping EventDebounceMapPowerPath007ShortToGNDFailure: debounce-algorithm=time_based, diagnostic-event=EventPowerPath007ShortToGNDFailure  # EventDebounceMap_Power_Path_007_Short_to_GND_Failure
package /ZeC/DTC/DTC/LIN_6_Slave_5_Defect
  diagnostic trouble code uds LIN_6_Slave_5_Defect: dtc-props=Dtc_Props_358996c7, uds-dtc-value=0x030606  # LIN 6 Slave 5_Defect
  diagnostic event EventLIN6Slave5Defect: aging-allowed=true, event-kind=SWC, prestorage-freeze-frame=false  # Event_LIN 6 Slave 5_Defect
  diagnostic event to trouble code uds mapping EventDtcMapLIN6Slave5Defect: diagnostic-event=EventLIN6Slave5Defect, trouble-code-uds=LIN_6_Slave_5_Defect  # Event_Dtc_Map_LIN 6 Slave 5_Defect
  diagnostic event to operation cycle mapping EventOperCycleMapLIN6Slave5Defect: diagnostic-event=EventLIN6Slave5Defect, operation-cycle=DefaultOperationCycle  # Event_Oper_Cycle_Map_LIN 6 Slave 5_Defect
  diagnostic event to debounce algorithm mapping EventDebounceMapLIN6Slave5Defect: debounce-algorithm=counter_based, diagnostic-event=EventLIN6Slave5Defect  # EventDebounceMap_LIN 6 Slave 5_Defect
package /ZeC/DTC/DTC/LIN_6_Slave_4_NoCommunication
  diagnostic trouble code uds LIN_6_Slave_4_NoCommunication: dtc-props=Dtc_Props_358996c7, uds-dtc-value=0x030605  # LIN 6 Slave 4_NoCommunication
  diagnostic event EventLIN6Slave4NoCommunication: aging-allowed=true, event-kind=SWC, prestorage-freeze-frame=false  # Event_LIN 6 Slave 4_NoCommunication
  diagnostic event to trouble code uds mapping EventDtcMapLIN6Slave4NoCommunication: diagnostic-event=EventLIN6Slave4NoCommunication, trouble-code-uds=LIN_6_Slave_4_NoCommunication  # Event_Dtc_Map_LIN 6 Slave 4_NoCommunication
  diagnostic event to operation cycle mapping EventOperCycleMapLIN6Slave4NoCommunication: diagnostic-event=EventLIN6Slave4NoCommunication, operation-cycle=DefaultOperationCycle  # Event_Oper_Cycle_Map_LIN 6 Slave 4_NoCommunication
  diagnostic event to debounce algorithm mapping EventDebounceMapLIN6Slave4NoCommunication: debounce-algorithm=counter_based, diagnostic-event=EventLIN6Slave4NoCommunication  # EventDebounceMap_LIN 6 Slave 4_NoCommunication
package /ZeC/DTC/DTC/Power_Path_009_Short_to_GND_Failure
  diagnostic trouble code uds Power_Path_009_Short_to_GND_Failure: dtc-props=Dtc_Props_3aad1bc7, uds-dtc-value=0x005209
  diagnostic event EventPowerPath009ShortToGNDFailure: aging-allowed=true, event-kind=SWC, prestorage-freeze-frame=false  # Event_Power_Path_009_Short_to_GND_Failure
  diagnostic event to trouble code uds mapping EventDtcMapPowerPath009ShortToGNDFailure: diagnostic-event=EventPowerPath009ShortToGNDFailure, trouble-code-uds=Power_Path_009_Short_to_GND_Failure  # Event_Dtc_Map_Power_Path_009_Short_to_GND_Failure
  diagnostic event to operation cycle mapping EventOperCycleMapPowerPath009ShortToGNDFailure: diagnostic-event=EventPowerPath009ShortToGNDFailure, operation-cycle=DefaultOperationCycle  # Event_Oper_Cycle_Map_Power_Path_009_Short_to_GND_Failure
  diagnostic event to debounce algorithm mapping EventDebounceMapPowerPath009ShortToGNDFailure: debounce-algorithm=time_based, diagnostic-event=EventPowerPath009ShortToGNDFailure  # EventDebounceMap_Power_Path_009_Short_to_GND_Failure
package /ZeC/DTC/DTC/Power_Path_004_Short_to_GND_Failure
  diagnostic trouble code uds Power_Path_004_Short_to_GND_Failure: dtc-props=Dtc_Props_e2fa6447, uds-dtc-value=0x005204
  diagnostic event EventPowerPath004ShortToGNDFailure: aging-allowed=true, event-kind=SWC, prestorage-freeze-frame=false  # Event_Power_Path_004_Short_to_GND_Failure
  diagnostic event to trouble code uds mapping EventDtcMapPowerPath004ShortToGNDFailure: diagnostic-event=EventPowerPath004ShortToGNDFailure, trouble-code-uds=Power_Path_004_Short_to_GND_Failure  # Event_Dtc_Map_Power_Path_004_Short_to_GND_Failure
  diagnostic event to operation cycle mapping EventOperCycleMapPowerPath004ShortToGNDFailure: diagnostic-event=EventPowerPath004ShortToGNDFailure, operation-cycle=DefaultOperationCycle  # Event_Oper_Cycle_Map_Power_Path_004_Short_to_GND_Failure
  diagnostic event to debounce algorithm mapping EventDebounceMapPowerPath004ShortToGNDFailure: debounce-algorithm=time_based, diagnostic-event=EventPowerPath004ShortToGNDFailure  # EventDebounceMap_Power_Path_004_Short_to_GND_Failure
package /ZeC/DTC/DTC/Power_Path_136_Not_Found_Failure
  diagnostic trouble code uds Power_Path_136_Not_Found_Failure: dtc-props=Dtc_Props_f8570b78, uds-dtc-value=0x005688
  diagnostic event EventPowerPath136NotFoundFailure: aging-allowed=true, event-kind=SWC, prestorage-freeze-frame=false  # Event_Power_Path_136_Not_Found_Failure
  diagnostic event to trouble code uds mapping EventDtcMapPowerPath136NotFoundFailure: diagnostic-event=EventPowerPath136NotFoundFailure, trouble-code-uds=Power_Path_136_Not_Found_Failure  # Event_Dtc_Map_Power_Path_136_Not_Found_Failure
  diagnostic event to operation cycle mapping EventOperCycleMapPowerPath136NotFoundFailure: diagnostic-event=EventPowerPath136NotFoundFailure, operation-cycle=DefaultOperationCycle  # Event_Oper_Cycle_Map_Power_Path_136_Not_Found_Failure
  diagnostic event to debounce algorithm mapping EventDebounceMapPowerPath136NotFoundFailure: debounce-algorithm=time_based, diagnostic-event=EventPowerPath136NotFoundFailure  # EventDebounceMap_Power_Path_136_Not_Found_Failure
package /ZeC/DTC/DTC/Power_Path_003_Short_to_GND_Failure
  diagnostic trouble code uds Power_Path_003_Short_to_GND_Failure: dtc-props=Dtc_Props_ebc454a0, uds-dtc-value=0x005203
  diagnostic event EventPowerPath003ShortToGNDFailure: aging-allowed=true, event-kind=SWC, prestorage-freeze-frame=false  # Event_Power_Path_003_Short_to_GND_Failure
  diagnostic event to trouble code uds mapping EventDtcMapPowerPath003ShortToGNDFailure: diagnostic-event=EventPowerPath003ShortToGNDFailure, trouble-code-uds=Power_Path_003_Short_to_GND_Failure  # Event_Dtc_Map_Power_Path_003_Short_to_GND_Failure
  diagnostic event to operation cycle mapping EventOperCycleMapPowerPath003ShortToGNDFailure: diagnostic-event=EventPowerPath003ShortToGNDFailure, operation-cycle=DefaultOperationCycle  # Event_Oper_Cycle_Map_Power_Path_003_Short_to_GND_Failure
  diagnostic event to debounce algorithm mapping EventDebounceMapPowerPath003ShortToGNDFailure: debounce-algorithm=time_based, diagnostic-event=EventPowerPath003ShortToGNDFailure  # EventDebounceMap_Power_Path_003_Short_to_GND_Failure
package /ZeC/DTC/DTC/Power_Path_135_Not_Found_Failure
  diagnostic trouble code uds Power_Path_135_Not_Found_Failure: dtc-props=Dtc_Props_ac32608c, uds-dtc-value=0x005687
  diagnostic event EventPowerPath135NotFoundFailure: aging-allowed=true, event-kind=SWC, prestorage-freeze-frame=false  # Event_Power_Path_135_Not_Found_Failure
  diagnostic event to trouble code uds mapping EventDtcMapPowerPath135NotFoundFailure: diagnostic-event=EventPowerPath135NotFoundFailure, trouble-code-uds=Power_Path_135_Not_Found_Failure  # Event_Dtc_Map_Power_Path_135_Not_Found_Failure
  diagnostic event to operation cycle mapping EventOperCycleMapPowerPath135NotFoundFailure: diagnostic-event=EventPowerPath135NotFoundFailure, operation-cycle=DefaultOperationCycle  # Event_Oper_Cycle_Map_Power_Path_135_Not_Found_Failure
  diagnostic event to debounce algorithm mapping EventDebounceMapPowerPath135NotFoundFailure: debounce-algorithm=time_based, diagnostic-event=EventPowerPath135NotFoundFailure  # EventDebounceMap_Power_Path_135_Not_Found_Failure
package /ZeC/DTC/DTC/LIN_6_Slave_3_Defect
  diagnostic trouble code uds LIN_6_Slave_3_Defect: dtc-props=Dtc_Props_358996c7, uds-dtc-value=0x030602  # LIN 6 Slave 3_Defect
  diagnostic event EventLIN6Slave3Defect: aging-allowed=true, event-kind=SWC, prestorage-freeze-frame=false  # Event_LIN 6 Slave 3_Defect
  diagnostic event to trouble code uds mapping EventDtcMapLIN6Slave3Defect: diagnostic-event=EventLIN6Slave3Defect, trouble-code-uds=LIN_6_Slave_3_Defect  # Event_Dtc_Map_LIN 6 Slave 3_Defect
  diagnostic event to operation cycle mapping EventOperCycleMapLIN6Slave3Defect: diagnostic-event=EventLIN6Slave3Defect, operation-cycle=DefaultOperationCycle  # Event_Oper_Cycle_Map_LIN 6 Slave 3_Defect
  diagnostic event to debounce algorithm mapping EventDebounceMapLIN6Slave3Defect: debounce-algorithm=counter_based, diagnostic-event=EventLIN6Slave3Defect  # EventDebounceMap_LIN 6 Slave 3_Defect
package /ZeC/DTC/DTC/Power_Path_006_Short_to_GND_Failure
  diagnostic trouble code uds Power_Path_006_Short_to_GND_Failure: dtc-props=Dtc_Props_6ec87033, uds-dtc-value=0x005206
  diagnostic event EventPowerPath006ShortToGNDFailure: aging-allowed=true, event-kind=SWC, prestorage-freeze-frame=false  # Event_Power_Path_006_Short_to_GND_Failure
  diagnostic event to trouble code uds mapping EventDtcMapPowerPath006ShortToGNDFailure: diagnostic-event=EventPowerPath006ShortToGNDFailure, trouble-code-uds=Power_Path_006_Short_to_GND_Failure  # Event_Dtc_Map_Power_Path_006_Short_to_GND_Failure
  diagnostic event to operation cycle mapping EventOperCycleMapPowerPath006ShortToGNDFailure: diagnostic-event=EventPowerPath006ShortToGNDFailure, operation-cycle=DefaultOperationCycle  # Event_Oper_Cycle_Map_Power_Path_006_Short_to_GND_Failure
  diagnostic event to debounce algorithm mapping EventDebounceMapPowerPath006ShortToGNDFailure: debounce-algorithm=time_based, diagnostic-event=EventPowerPath006ShortToGNDFailure  # EventDebounceMap_Power_Path_006_Short_to_GND_Failure
package /ZeC/DTC/DTC/LIN_6_Slave_2_NoCommunication
  diagnostic trouble code uds LIN_6_Slave_2_NoCommunication: dtc-props=Dtc_Props_358996c7, uds-dtc-value=0x030601  # LIN 6 Slave 2_NoCommunication
  diagnostic event EventLIN6Slave2NoCommunication: aging-allowed=true, event-kind=SWC, prestorage-freeze-frame=false  # Event_LIN 6 Slave 2_NoCommunication
  diagnostic event to trouble code uds mapping EventDtcMapLIN6Slave2NoCommunication: diagnostic-event=EventLIN6Slave2NoCommunication, trouble-code-uds=LIN_6_Slave_2_NoCommunication  # Event_Dtc_Map_LIN 6 Slave 2_NoCommunication
  diagnostic event to operation cycle mapping EventOperCycleMapLIN6Slave2NoCommunication: diagnostic-event=EventLIN6Slave2NoCommunication, operation-cycle=DefaultOperationCycle  # Event_Oper_Cycle_Map_LIN 6 Slave 2_NoCommunication
  diagnostic event to debounce algorithm mapping EventDebounceMapLIN6Slave2NoCommunication: debounce-algorithm=counter_based, diagnostic-event=EventLIN6Slave2NoCommunication  # EventDebounceMap_LIN 6 Slave 2_NoCommunication
package /ZeC/DTC/DTC/Power_Path_005_Short_to_GND_Failure
  diagnostic trouble code uds Power_Path_005_Short_to_GND_Failure: dtc-props=Dtc_Props_a4e36e7d, uds-dtc-value=0x005205
  diagnostic event EventPowerPath005ShortToGNDFailure: aging-allowed=true, event-kind=SWC, prestorage-freeze-frame=false  # Event_Power_Path_005_Short_to_GND_Failure
  diagnostic event to trouble code uds mapping EventDtcMapPowerPath005ShortToGNDFailure: diagnostic-event=EventPowerPath005ShortToGNDFailure, trouble-code-uds=Power_Path_005_Short_to_GND_Failure  # Event_Dtc_Map_Power_Path_005_Short_to_GND_Failure
  diagnostic event to operation cycle mapping EventOperCycleMapPowerPath005ShortToGNDFailure: diagnostic-event=EventPowerPath005ShortToGNDFailure, operation-cycle=DefaultOperationCycle  # Event_Oper_Cycle_Map_Power_Path_005_Short_to_GND_Failure
  diagnostic event to debounce algorithm mapping EventDebounceMapPowerPath005ShortToGNDFailure: debounce-algorithm=time_based, diagnostic-event=EventPowerPath005ShortToGNDFailure  # EventDebounceMap_Power_Path_005_Short_to_GND_Failure
package /ZeC/DTC/DTC/Power_Path_137_Not_Found_Failure
  diagnostic trouble code uds Power_Path_137_Not_Found_Failure: dtc-props=Dtc_Props_be4e0142, uds-dtc-value=0x005689
  diagnostic event EventPowerPath137NotFoundFailure: aging-allowed=true, event-kind=SWC, prestorage-freeze-frame=false  # Event_Power_Path_137_Not_Found_Failure
  diagnostic event to trouble code uds mapping EventDtcMapPowerPath137NotFoundFailure: diagnostic-event=EventPowerPath137NotFoundFailure, trouble-code-uds=Power_Path_137_Not_Found_Failure  # Event_Dtc_Map_Power_Path_137_Not_Found_Failure
  diagnostic event to operation cycle mapping EventOperCycleMapPowerPath137NotFoundFailure: diagnostic-event=EventPowerPath137NotFoundFailure, operation-cycle=DefaultOperationCycle  # Event_Oper_Cycle_Map_Power_Path_137_Not_Found_Failure
  diagnostic event to debounce algorithm mapping EventDebounceMapPowerPath137NotFoundFailure: debounce-algorithm=time_based, diagnostic-event=EventPowerPath137NotFoundFailure  # EventDebounceMap_Power_Path_137_Not_Found_Failure
package /ZeC/DTC/DTC/Power_Path_141_Not_Found_Failure
  diagnostic trouble code uds Power_Path_141_Not_Found_Failure: dtc-props=Dtc_Props_5be61abf, uds-dtc-value=0x00568d
  diagnostic event EventPowerPath141NotFoundFailure: aging-allowed=true, event-kind=SWC, prestorage-freeze-frame=false  # Event_Power_Path_141_Not_Found_Failure
  diagnostic event to trouble code uds mapping EventDtcMapPowerPath141NotFoundFailure: diagnostic-event=EventPowerPath141NotFoundFailure, trouble-code-uds=Power_Path_141_Not_Found_Failure  # Event_Dtc_Map_Power_Path_141_Not_Found_Failure
  diagnostic event to operation cycle mapping EventOperCycleMapPowerPath141NotFoundFailure: diagnostic-event=EventPowerPath141NotFoundFailure, operation-cycle=DefaultOperationCycle  # Event_Oper_Cycle_Map_Power_Path_141_Not_Found_Failure
  diagnostic event to debounce algorithm mapping EventDebounceMapPowerPath141NotFoundFailure: debounce-algorithm=time_based, diagnostic-event=EventPowerPath141NotFoundFailure  # EventDebounceMap_Power_Path_141_Not_Found_Failure
package /ZeC/DTC/DTC/Power_Path_140_Not_Found_Failure
  diagnostic trouble code uds Power_Path_140_Not_Found_Failure: dtc-props=Dtc_Props_52d82a58, uds-dtc-value=0x00568c
  diagnostic event EventPowerPath140NotFoundFailure: aging-allowed=true, event-kind=SWC, prestorage-freeze-frame=false  # Event_Power_Path_140_Not_Found_Failure
  diagnostic event to trouble code uds mapping EventDtcMapPowerPath140NotFoundFailure: diagnostic-event=EventPowerPath140NotFoundFailure, trouble-code-uds=Power_Path_140_Not_Found_Failure  # Event_Dtc_Map_Power_Path_140_Not_Found_Failure
  diagnostic event to operation cycle mapping EventOperCycleMapPowerPath140NotFoundFailure: diagnostic-event=EventPowerPath140NotFoundFailure, operation-cycle=DefaultOperationCycle  # Event_Oper_Cycle_Map_Power_Path_140_Not_Found_Failure
  diagnostic event to debounce algorithm mapping EventDebounceMapPowerPath140NotFoundFailure: debounce-algorithm=time_based, diagnostic-event=EventPowerPath140NotFoundFailure  # EventDebounceMap_Power_Path_140_Not_Found_Failure
package /ZeC/DTC/DTC/Power_Path_143_Not_Found_Failure
  diagnostic trouble code uds Power_Path_143_Not_Found_Failure: dtc-props=Dtc_Props_d7d40ecb, uds-dtc-value=0x00568f
  diagnostic event EventPowerPath143NotFoundFailure: aging-allowed=true, event-kind=SWC, prestorage-freeze-frame=false  # Event_Power_Path_143_Not_Found_Failure
  diagnostic event to trouble code uds mapping EventDtcMapPowerPath143NotFoundFailure: diagnostic-event=EventPowerPath143NotFoundFailure, trouble-code-uds=Power_Path_143_Not_Found_Failure  # Event_Dtc_Map_Power_Path_143_Not_Found_Failure
  diagnostic event to operation cycle mapping EventOperCycleMapPowerPath143NotFoundFailure: diagnostic-event=EventPowerPath143NotFoundFailure, operation-cycle=DefaultOperationCycle  # Event_Oper_Cycle_Map_Power_Path_143_Not_Found_Failure
  diagnostic event to debounce algorithm mapping EventDebounceMapPowerPath143NotFoundFailure: debounce-algorithm=time_based, diagnostic-event=EventPowerPath143NotFoundFailure  # EventDebounceMap_Power_Path_143_Not_Found_Failure
package /ZeC/DTC/DTC/Power_Path_011_Short_to_GND_Failure
  diagnostic trouble code uds Power_Path_011_Short_to_GND_Failure: dtc-props=Dtc_Props_90223ae7, uds-dtc-value=0x00520b
  diagnostic event EventPowerPath011ShortToGNDFailure: aging-allowed=true, event-kind=SWC, prestorage-freeze-frame=false  # Event_Power_Path_011_Short_to_GND_Failure
  diagnostic event to trouble code uds mapping EventDtcMapPowerPath011ShortToGNDFailure: diagnostic-event=EventPowerPath011ShortToGNDFailure, trouble-code-uds=Power_Path_011_Short_to_GND_Failure  # Event_Dtc_Map_Power_Path_011_Short_to_GND_Failure
  diagnostic event to operation cycle mapping EventOperCycleMapPowerPath011ShortToGNDFailure: diagnostic-event=EventPowerPath011ShortToGNDFailure, operation-cycle=DefaultOperationCycle  # Event_Oper_Cycle_Map_Power_Path_011_Short_to_GND_Failure
  diagnostic event to debounce algorithm mapping EventDebounceMapPowerPath011ShortToGNDFailure: debounce-algorithm=time_based, diagnostic-event=EventPowerPath011ShortToGNDFailure  # EventDebounceMap_Power_Path_011_Short_to_GND_Failure
package /ZeC/DTC/DTC/Power_Path_142_Not_Found_Failure
  diagnostic trouble code uds Power_Path_142_Not_Found_Failure: dtc-props=Dtc_Props_1dff1085, uds-dtc-value=0x00568e
  diagnostic event EventPowerPath142NotFoundFailure: aging-allowed=true, event-kind=SWC, prestorage-freeze-frame=false  # Event_Power_Path_142_Not_Found_Failure
  diagnostic event to trouble code uds mapping EventDtcMapPowerPath142NotFoundFailure: diagnostic-event=EventPowerPath142NotFoundFailure, trouble-code-uds=Power_Path_142_Not_Found_Failure  # Event_Dtc_Map_Power_Path_142_Not_Found_Failure
  diagnostic event to operation cycle mapping EventOperCycleMapPowerPath142NotFoundFailure: diagnostic-event=EventPowerPath142NotFoundFailure, operation-cycle=DefaultOperationCycle  # Event_Oper_Cycle_Map_Power_Path_142_Not_Found_Failure
  diagnostic event to debounce algorithm mapping EventDebounceMapPowerPath142NotFoundFailure: debounce-algorithm=time_based, diagnostic-event=EventPowerPath142NotFoundFailure  # EventDebounceMap_Power_Path_142_Not_Found_Failure
package /ZeC/DTC/DTC/Power_Path_010_Short_to_GND_Failure
  diagnostic trouble code uds Power_Path_010_Short_to_GND_Failure: dtc-props=Dtc_Props_5a0924a9, uds-dtc-value=0x00520a
  diagnostic event EventPowerPath010ShortToGNDFailure: aging-allowed=true, event-kind=SWC, prestorage-freeze-frame=false  # Event_Power_Path_010_Short_to_GND_Failure
  diagnostic event to trouble code uds mapping EventDtcMapPowerPath010ShortToGNDFailure: diagnostic-event=EventPowerPath010ShortToGNDFailure, trouble-code-uds=Power_Path_010_Short_to_GND_Failure  # Event_Dtc_Map_Power_Path_010_Short_to_GND_Failure
  diagnostic event to operation cycle mapping EventOperCycleMapPowerPath010ShortToGNDFailure: diagnostic-event=EventPowerPath010ShortToGNDFailure, operation-cycle=DefaultOperationCycle  # Event_Oper_Cycle_Map_Power_Path_010_Short_to_GND_Failure
  diagnostic event to debounce algorithm mapping EventDebounceMapPowerPath010ShortToGNDFailure: debounce-algorithm=time_based, diagnostic-event=EventPowerPath010ShortToGNDFailure  # EventDebounceMap_Power_Path_010_Short_to_GND_Failure
package /ZeC/DTC/DTC/Power_Path_139_Not_Found_Failure
  diagnostic trouble code uds Power_Path_139_Not_Found_Failure: dtc-props=Dtc_Props_14c12062, uds-dtc-value=0x00568b
  diagnostic event EventPowerPath139NotFoundFailure: aging-allowed=true, event-kind=SWC, prestorage-freeze-frame=false  # Event_Power_Path_139_Not_Found_Failure
  diagnostic event to trouble code uds mapping EventDtcMapPowerPath139NotFoundFailure: diagnostic-event=EventPowerPath139NotFoundFailure, trouble-code-uds=Power_Path_139_Not_Found_Failure  # Event_Dtc_Map_Power_Path_139_Not_Found_Failure
  diagnostic event to operation cycle mapping EventOperCycleMapPowerPath139NotFoundFailure: diagnostic-event=EventPowerPath139NotFoundFailure, operation-cycle=DefaultOperationCycle  # Event_Oper_Cycle_Map_Power_Path_139_Not_Found_Failure
  diagnostic event to debounce algorithm mapping EventDebounceMapPowerPath139NotFoundFailure: debounce-algorithm=time_based, diagnostic-event=EventPowerPath139NotFoundFailure  # EventDebounceMap_Power_Path_139_Not_Found_Failure
package /ZeC/DTC/DTC/Power_Path_138_Not_Found_Failure
  diagnostic trouble code uds Power_Path_138_Not_Found_Failure: dtc-props=Dtc_Props_deea3e2c, uds-dtc-value=0x00568a
  diagnostic event EventPowerPath138NotFoundFailure: aging-allowed=true, event-kind=SWC, prestorage-freeze-frame=false  # Event_Power_Path_138_Not_Found_Failure
  diagnostic event to trouble code uds mapping EventDtcMapPowerPath138NotFoundFailure: diagnostic-event=EventPowerPath138NotFoundFailure, trouble-code-uds=Power_Path_138_Not_Found_Failure  # Event_Dtc_Map_Power_Path_138_Not_Found_Failure
  diagnostic event to operation cycle mapping EventOperCycleMapPowerPath138NotFoundFailure: diagnostic-event=EventPowerPath138NotFoundFailure, operation-cycle=DefaultOperationCycle  # Event_Oper_Cycle_Map_Power_Path_138_Not_Found_Failure
  diagnostic event to debounce algorithm mapping EventDebounceMapPowerPath138NotFoundFailure: debounce-algorithm=time_based, diagnostic-event=EventPowerPath138NotFoundFailure  # EventDebounceMap_Power_Path_138_Not_Found_Failure
package /ZeC/DTC/DTC/LIN_6_Slave_8_NoCommunication
  diagnostic trouble code uds LIN_6_Slave_8_NoCommunication: dtc-props=Dtc_Props_358996c7, uds-dtc-value=0x03060d  # LIN 6 Slave 8_NoCommunication
  diagnostic event EventLIN6Slave8NoCommunication: aging-allowed=true, event-kind=SWC, prestorage-freeze-frame=false  # Event_LIN 6 Slave 8_NoCommunication
  diagnostic event to trouble code uds mapping EventDtcMapLIN6Slave8NoCommunication: diagnostic-event=EventLIN6Slave8NoCommunication, trouble-code-uds=LIN_6_Slave_8_NoCommunication  # Event_Dtc_Map_LIN 6 Slave 8_NoCommunication
  diagnostic event to operation cycle mapping EventOperCycleMapLIN6Slave8NoCommunication: diagnostic-event=EventLIN6Slave8NoCommunication, operation-cycle=DefaultOperationCycle  # Event_Oper_Cycle_Map_LIN 6 Slave 8_NoCommunication
  diagnostic event to debounce algorithm mapping EventDebounceMapLIN6Slave8NoCommunication: debounce-algorithm=counter_based, diagnostic-event=EventLIN6Slave8NoCommunication  # EventDebounceMap_LIN 6 Slave 8_NoCommunication
package /ZeC/DTC/DTC/LIN_6_Slave_8_Defect
  diagnostic trouble code uds LIN_6_Slave_8_Defect: dtc-props=Dtc_Props_358996c7, uds-dtc-value=0x03060c  # LIN 6 Slave 8_Defect
  diagnostic event EventLIN6Slave8Defect: aging-allowed=true, event-kind=SWC, prestorage-freeze-frame=false  # Event_LIN 6 Slave 8_Defect
  diagnostic event to trouble code uds mapping EventDtcMapLIN6Slave8Defect: diagnostic-event=EventLIN6Slave8Defect, trouble-code-uds=LIN_6_Slave_8_Defect  # Event_Dtc_Map_LIN 6 Slave 8_Defect
  diagnostic event to operation cycle mapping EventOperCycleMapLIN6Slave8Defect: diagnostic-event=EventLIN6Slave8Defect, operation-cycle=DefaultOperationCycle  # Event_Oper_Cycle_Map_LIN 6 Slave 8_Defect
  diagnostic event to debounce algorithm mapping EventDebounceMapLIN6Slave8Defect: debounce-algorithm=counter_based, diagnostic-event=EventLIN6Slave8Defect  # EventDebounceMap_LIN 6 Slave 8_Defect
package /ZeC/DTC/DTC/LIN_6_Slave_9_NoCommunication
  diagnostic trouble code uds LIN_6_Slave_9_NoCommunication: dtc-props=Dtc_Props_358996c7, uds-dtc-value=0x03060f  # LIN 6 Slave 9_NoCommunication
  diagnostic event EventLIN6Slave9NoCommunication: aging-allowed=true, event-kind=SWC, prestorage-freeze-frame=false  # Event_LIN 6 Slave 9_NoCommunication
  diagnostic event to trouble code uds mapping EventDtcMapLIN6Slave9NoCommunication: diagnostic-event=EventLIN6Slave9NoCommunication, trouble-code-uds=LIN_6_Slave_9_NoCommunication  # Event_Dtc_Map_LIN 6 Slave 9_NoCommunication
  diagnostic event to operation cycle mapping EventOperCycleMapLIN6Slave9NoCommunication: diagnostic-event=EventLIN6Slave9NoCommunication, operation-cycle=DefaultOperationCycle  # Event_Oper_Cycle_Map_LIN 6 Slave 9_NoCommunication
  diagnostic event to debounce algorithm mapping EventDebounceMapLIN6Slave9NoCommunication: debounce-algorithm=counter_based, diagnostic-event=EventLIN6Slave9NoCommunication  # EventDebounceMap_LIN 6 Slave 9_NoCommunication
package /ZeC/DTC/DTC/LIN_6_Slave_9_Defect
  diagnostic trouble code uds LIN_6_Slave_9_Defect: dtc-props=Dtc_Props_358996c7, uds-dtc-value=0x03060e  # LIN 6 Slave 9_Defect
  diagnostic event EventLIN6Slave9Defect: aging-allowed=true, event-kind=SWC, prestorage-freeze-frame=false  # Event_LIN 6 Slave 9_Defect
  diagnostic event to trouble code uds mapping EventDtcMapLIN6Slave9Defect: diagnostic-event=EventLIN6Slave9Defect, trouble-code-uds=LIN_6_Slave_9_Defect  # Event_Dtc_Map_LIN 6 Slave 9_Defect
  diagnostic event to operation cycle mapping EventOperCycleMapLIN6Slave9Defect: diagnostic-event=EventLIN6Slave9Defect, operation-cycle=DefaultOperationCycle  # Event_Oper_Cycle_Map_LIN 6 Slave 9_Defect
  diagnostic event to debounce algorithm mapping EventDebounceMapLIN6Slave9Defect: debounce-algorithm=counter_based, diagnostic-event=EventLIN6Slave9Defect  # EventDebounceMap_LIN 6 Slave 9_Defect
package /ZeC/DTC/DTC/Power_Path_013_Short_to_GND_Failure
  diagnostic trouble code uds Power_Path_013_Short_to_GND_Failure: dtc-props=Dtc_Props_df05003a, uds-dtc-value=0x00520d
  diagnostic event EventPowerPath013ShortToGNDFailure: aging-allowed=true, event-kind=SWC, prestorage-freeze-frame=false  # Event_Power_Path_013_Short_to_GND_Failure
  diagnostic event to trouble code uds mapping EventDtcMapPowerPath013ShortToGNDFailure: diagnostic-event=EventPowerPath013ShortToGNDFailure, trouble-code-uds=Power_Path_013_Short_to_GND_Failure  # Event_Dtc_Map_Power_Path_013_Short_to_GND_Failure
  diagnostic event to operation cycle mapping EventOperCycleMapPowerPath013ShortToGNDFailure: diagnostic-event=EventPowerPath013ShortToGNDFailure, operation-cycle=DefaultOperationCycle  # Event_Oper_Cycle_Map_Power_Path_013_Short_to_GND_Failure
  diagnostic event to debounce algorithm mapping EventDebounceMapPowerPath013ShortToGNDFailure: debounce-algorithm=time_based, diagnostic-event=EventPowerPath013ShortToGNDFailure  # EventDebounceMap_Power_Path_013_Short_to_GND_Failure
package /ZeC/DTC/DTC/Power_Path_012_Short_to_GND_Failure
  diagnostic trouble code uds Power_Path_012_Short_to_GND_Failure: dtc-props=Dtc_Props_d63b30dd, uds-dtc-value=0x00520c
  diagnostic event EventPowerPath012ShortToGNDFailure: aging-allowed=true, event-kind=SWC, prestorage-freeze-frame=false  # Event_Power_Path_012_Short_to_GND_Failure
  diagnostic event to trouble code uds mapping EventDtcMapPowerPath012ShortToGNDFailure: diagnostic-event=EventPowerPath012ShortToGNDFailure, trouble-code-uds=Power_Path_012_Short_to_GND_Failure  # Event_Dtc_Map_Power_Path_012_Short_to_GND_Failure
  diagnostic event to operation cycle mapping EventOperCycleMapPowerPath012ShortToGNDFailure: diagnostic-event=EventPowerPath012ShortToGNDFailure, operation-cycle=DefaultOperationCycle  # Event_Oper_Cycle_Map_Power_Path_012_Short_to_GND_Failure
  diagnostic event to debounce algorithm mapping EventDebounceMapPowerPath012ShortToGNDFailure: debounce-algorithm=time_based, diagnostic-event=EventPowerPath012ShortToGNDFailure  # EventDebounceMap_Power_Path_012_Short_to_GND_Failure
package /ZeC/DTC/DTC/LIN_6_Slave_7_NoCommunication
  diagnostic trouble code uds LIN_6_Slave_7_NoCommunication: dtc-props=Dtc_Props_358996c7, uds-dtc-value=0x03060b  # LIN 6 Slave 7_NoCommunication
  diagnostic event EventLIN6Slave7NoCommunication: aging-allowed=true, event-kind=SWC, prestorage-freeze-frame=false  # Event_LIN 6 Slave 7_NoCommunication
  diagnostic event to trouble code uds mapping EventDtcMapLIN6Slave7NoCommunication: diagnostic-event=EventLIN6Slave7NoCommunication, trouble-code-uds=LIN_6_Slave_7_NoCommunication  # Event_Dtc_Map_LIN 6 Slave 7_NoCommunication
  diagnostic event to operation cycle mapping EventOperCycleMapLIN6Slave7NoCommunication: diagnostic-event=EventLIN6Slave7NoCommunication, operation-cycle=DefaultOperationCycle  # Event_Oper_Cycle_Map_LIN 6 Slave 7_NoCommunication
  diagnostic event to debounce algorithm mapping EventDebounceMapLIN6Slave7NoCommunication: debounce-algorithm=counter_based, diagnostic-event=EventLIN6Slave7NoCommunication  # EventDebounceMap_LIN 6 Slave 7_NoCommunication
package /ZeC/DTC/DTC/Power_Path_015_Short_to_GND_Failure
  diagnostic trouble code uds Power_Path_015_Short_to_GND_Failure: dtc-props=Dtc_Props_5337144e, uds-dtc-value=0x00520f
  diagnostic event EventPowerPath015ShortToGNDFailure: aging-allowed=true, event-kind=SWC, prestorage-freeze-frame=false  # Event_Power_Path_015_Short_to_GND_Failure
  diagnostic event to trouble code uds mapping EventDtcMapPowerPath015ShortToGNDFailure: diagnostic-event=EventPowerPath015ShortToGNDFailure, trouble-code-uds=Power_Path_015_Short_to_GND_Failure  # Event_Dtc_Map_Power_Path_015_Short_to_GND_Failure
  diagnostic event to operation cycle mapping EventOperCycleMapPowerPath015ShortToGNDFailure: diagnostic-event=EventPowerPath015ShortToGNDFailure, operation-cycle=DefaultOperationCycle  # Event_Oper_Cycle_Map_Power_Path_015_Short_to_GND_Failure
  diagnostic event to debounce algorithm mapping EventDebounceMapPowerPath015ShortToGNDFailure: debounce-algorithm=time_based, diagnostic-event=EventPowerPath015ShortToGNDFailure  # EventDebounceMap_Power_Path_015_Short_to_GND_Failure
package /ZeC/DTC/DTC/LIN_6_Slave_7_Defect
  diagnostic trouble code uds LIN_6_Slave_7_Defect: dtc-props=Dtc_Props_358996c7, uds-dtc-value=0x03060a  # LIN 6 Slave 7_Defect
  diagnostic event EventLIN6Slave7Defect: aging-allowed=true, event-kind=SWC, prestorage-freeze-frame=false  # Event_LIN 6 Slave 7_Defect
  diagnostic event to trouble code uds mapping EventDtcMapLIN6Slave7Defect: diagnostic-event=EventLIN6Slave7Defect, trouble-code-uds=LIN_6_Slave_7_Defect  # Event_Dtc_Map_LIN 6 Slave 7_Defect
  diagnostic event to operation cycle mapping EventOperCycleMapLIN6Slave7Defect: diagnostic-event=EventLIN6Slave7Defect, operation-cycle=DefaultOperationCycle  # Event_Oper_Cycle_Map_LIN 6 Slave 7_Defect
  diagnostic event to debounce algorithm mapping EventDebounceMapLIN6Slave7Defect: debounce-algorithm=counter_based, diagnostic-event=EventLIN6Slave7Defect  # EventDebounceMap_LIN 6 Slave 7_Defect
package /ZeC/DTC/DTC/Power_Path_014_Short_to_GND_Failure
  diagnostic trouble code uds Power_Path_014_Short_to_GND_Failure: dtc-props=Dtc_Props_991c0a00, uds-dtc-value=0x00520e
  diagnostic event EventPowerPath014ShortToGNDFailure: aging-allowed=true, event-kind=SWC, prestorage-freeze-frame=false  # Event_Power_Path_014_Short_to_GND_Failure
  diagnostic event to trouble code uds mapping EventDtcMapPowerPath014ShortToGNDFailure: diagnostic-event=EventPowerPath014ShortToGNDFailure, trouble-code-uds=Power_Path_014_Short_to_GND_Failure  # Event_Dtc_Map_Power_Path_014_Short_to_GND_Failure
  diagnostic event to operation cycle mapping EventOperCycleMapPowerPath014ShortToGNDFailure: diagnostic-event=EventPowerPath014ShortToGNDFailure, operation-cycle=DefaultOperationCycle  # Event_Oper_Cycle_Map_Power_Path_014_Short_to_GND_Failure
  diagnostic event to debounce algorithm mapping EventDebounceMapPowerPath014ShortToGNDFailure: debounce-algorithm=time_based, diagnostic-event=EventPowerPath014ShortToGNDFailure  # EventDebounceMap_Power_Path_014_Short_to_GND_Failure
package /ZeC/DTC/DTC/Power_Path_149_Not_Found_Failure
  diagnostic trouble code uds Power_Path_149_Not_Found_Failure: dtc-props=Dtc_Props_e64ab440, uds-dtc-value=0x005695
  diagnostic event EventPowerPath149NotFoundFailure: aging-allowed=true, event-kind=SWC, prestorage-freeze-frame=false  # Event_Power_Path_149_Not_Found_Failure
  diagnostic event to trouble code uds mapping EventDtcMapPowerPath149NotFoundFailure: diagnostic-event=EventPowerPath149NotFoundFailure, trouble-code-uds=Power_Path_149_Not_Found_Failure  # Event_Dtc_Map_Power_Path_149_Not_Found_Failure
  diagnostic event to operation cycle mapping EventOperCycleMapPowerPath149NotFoundFailure: diagnostic-event=EventPowerPath149NotFoundFailure, operation-cycle=DefaultOperationCycle  # Event_Oper_Cycle_Map_Power_Path_149_Not_Found_Failure
  diagnostic event to debounce algorithm mapping EventDebounceMapPowerPath149NotFoundFailure: debounce-algorithm=time_based, diagnostic-event=EventPowerPath149NotFoundFailure  # EventDebounceMap_Power_Path_149_Not_Found_Failure
package /ZeC/DTC/DTC/Power_Path_017_Short_to_GND_Failure
  diagnostic trouble code uds Power_Path_017_Short_to_GND_Failure: dtc-props=Dtc_Props_a1bc806c, uds-dtc-value=0x005211
  diagnostic event EventPowerPath017ShortToGNDFailure: aging-allowed=true, event-kind=SWC, prestorage-freeze-frame=false  # Event_Power_Path_017_Short_to_GND_Failure
  diagnostic event to trouble code uds mapping EventDtcMapPowerPath017ShortToGNDFailure: diagnostic-event=EventPowerPath017ShortToGNDFailure, trouble-code-uds=Power_Path_017_Short_to_GND_Failure  # Event_Dtc_Map_Power_Path_017_Short_to_GND_Failure
  diagnostic event to operation cycle mapping EventOperCycleMapPowerPath017ShortToGNDFailure: diagnostic-event=EventPowerPath017ShortToGNDFailure, operation-cycle=DefaultOperationCycle  # Event_Oper_Cycle_Map_Power_Path_017_Short_to_GND_Failure
  diagnostic event to debounce algorithm mapping EventDebounceMapPowerPath017ShortToGNDFailure: debounce-algorithm=time_based, diagnostic-event=EventPowerPath017ShortToGNDFailure  # EventDebounceMap_Power_Path_017_Short_to_GND_Failure
package /ZeC/DTC/DTC/Power_Path_148_Not_Found_Failure
  diagnostic trouble code uds Power_Path_148_Not_Found_Failure: dtc-props=Dtc_Props_a053be7a, uds-dtc-value=0x005694
  diagnostic event EventPowerPath148NotFoundFailure: aging-allowed=true, event-kind=SWC, prestorage-freeze-frame=false  # Event_Power_Path_148_Not_Found_Failure
  diagnostic event to trouble code uds mapping EventDtcMapPowerPath148NotFoundFailure: diagnostic-event=EventPowerPath148NotFoundFailure, trouble-code-uds=Power_Path_148_Not_Found_Failure  # Event_Dtc_Map_Power_Path_148_Not_Found_Failure
  diagnostic event to operation cycle mapping EventOperCycleMapPowerPath148NotFoundFailure: diagnostic-event=EventPowerPath148NotFoundFailure, operation-cycle=DefaultOperationCycle  # Event_Oper_Cycle_Map_Power_Path_148_Not_Found_Failure
  diagnostic event to debounce algorithm mapping EventDebounceMapPowerPath148NotFoundFailure: debounce-algorithm=time_based, diagnostic-event=EventPowerPath148NotFoundFailure  # EventDebounceMap_Power_Path_148_Not_Found_Failure
package /ZeC/DTC/DTC/Power_Path_016_Short_to_GND_Failure
  diagnostic trouble code uds Power_Path_016_Short_to_GND_Failure: dtc-props=Dtc_Props_e7a58a56, uds-dtc-value=0x005210
  diagnostic event EventPowerPath016ShortToGNDFailure: aging-allowed=true, event-kind=SWC, prestorage-freeze-frame=false  # Event_Power_Path_016_Short_to_GND_Failure
  diagnostic event to trouble code uds mapping EventDtcMapPowerPath016ShortToGNDFailure: diagnostic-event=EventPowerPath016ShortToGNDFailure, trouble-code-uds=Power_Path_016_Short_to_GND_Failure  # Event_Dtc_Map_Power_Path_016_Short_to_GND_Failure
  diagnostic event to operation cycle mapping EventOperCycleMapPowerPath016ShortToGNDFailure: diagnostic-event=EventPowerPath016ShortToGNDFailure, operation-cycle=DefaultOperationCycle  # Event_Oper_Cycle_Map_Power_Path_016_Short_to_GND_Failure
  diagnostic event to debounce algorithm mapping EventDebounceMapPowerPath016ShortToGNDFailure: debounce-algorithm=time_based, diagnostic-event=EventPowerPath016ShortToGNDFailure  # EventDebounceMap_Power_Path_016_Short_to_GND_Failure
package /ZeC/DTC/DTC/Power_Path_019_Short_to_GND_Failure
  diagnostic trouble code uds Power_Path_019_Short_to_GND_Failure: dtc-props=Dtc_Props_2d8e9418, uds-dtc-value=0x005213
  diagnostic event EventPowerPath019ShortToGNDFailure: aging-allowed=true, event-kind=SWC, prestorage-freeze-frame=false  # Event_Power_Path_019_Short_to_GND_Failure
  diagnostic event to trouble code uds mapping EventDtcMapPowerPath019ShortToGNDFailure: diagnostic-event=EventPowerPath019ShortToGNDFailure, trouble-code-uds=Power_Path_019_Short_to_GND_Failure  # Event_Dtc_Map_Power_Path_019_Short_to_GND_Failure
  diagnostic event to operation cycle mapping EventOperCycleMapPowerPath019ShortToGNDFailure: diagnostic-event=EventPowerPath019ShortToGNDFailure, operation-cycle=DefaultOperationCycle  # Event_Oper_Cycle_Map_Power_Path_019_Short_to_GND_Failure
  diagnostic event to debounce algorithm mapping EventDebounceMapPowerPath019ShortToGNDFailure: debounce-algorithm=time_based, diagnostic-event=EventPowerPath019ShortToGNDFailure  # EventDebounceMap_Power_Path_019_Short_to_GND_Failure
package /ZeC/DTC/DTC/Power_Path_151_Not_Found_Failure
  diagnostic trouble code uds Power_Path_151_Not_Found_Failure: dtc-props=Dtc_Props_6a78a034, uds-dtc-value=0x005697
  diagnostic event EventPowerPath151NotFoundFailure: aging-allowed=true, event-kind=SWC, prestorage-freeze-frame=false  # Event_Power_Path_151_Not_Found_Failure
  diagnostic event to trouble code uds mapping EventDtcMapPowerPath151NotFoundFailure: diagnostic-event=EventPowerPath151NotFoundFailure, trouble-code-uds=Power_Path_151_Not_Found_Failure  # Event_Dtc_Map_Power_Path_151_Not_Found_Failure
  diagnostic event to operation cycle mapping EventOperCycleMapPowerPath151NotFoundFailure: diagnostic-event=EventPowerPath151NotFoundFailure, operation-cycle=DefaultOperationCycle  # Event_Oper_Cycle_Map_Power_Path_151_Not_Found_Failure
  diagnostic event to debounce algorithm mapping EventDebounceMapPowerPath151NotFoundFailure: debounce-algorithm=time_based, diagnostic-event=EventPowerPath151NotFoundFailure  # EventDebounceMap_Power_Path_151_Not_Found_Failure
package /ZeC/DTC/DTC/Power_Path_150_Not_Found_Failure
  diagnostic trouble code uds Power_Path_150_Not_Found_Failure: dtc-props=Dtc_Props_2c61aa0e, uds-dtc-value=0x005696
  diagnostic event EventPowerPath150NotFoundFailure: aging-allowed=true, event-kind=SWC, prestorage-freeze-frame=false  # Event_Power_Path_150_Not_Found_Failure
  diagnostic event to trouble code uds mapping EventDtcMapPowerPath150NotFoundFailure: diagnostic-event=EventPowerPath150NotFoundFailure, trouble-code-uds=Power_Path_150_Not_Found_Failure  # Event_Dtc_Map_Power_Path_150_Not_Found_Failure
  diagnostic event to operation cycle mapping EventOperCycleMapPowerPath150NotFoundFailure: diagnostic-event=EventPowerPath150NotFoundFailure, operation-cycle=DefaultOperationCycle  # Event_Oper_Cycle_Map_Power_Path_150_Not_Found_Failure
  diagnostic event to debounce algorithm mapping EventDebounceMapPowerPath150NotFoundFailure: debounce-algorithm=time_based, diagnostic-event=EventPowerPath150NotFoundFailure  # EventDebounceMap_Power_Path_150_Not_Found_Failure
package /ZeC/DTC/DTC/Power_Path_018_Short_to_GND_Failure
  diagnostic trouble code uds Power_Path_018_Short_to_GND_Failure: dtc-props=Dtc_Props_6b979e22, uds-dtc-value=0x005212
  diagnostic event EventPowerPath018ShortToGNDFailure: aging-allowed=true, event-kind=SWC, prestorage-freeze-frame=false  # Event_Power_Path_018_Short_to_GND_Failure
  diagnostic event to trouble code uds mapping EventDtcMapPowerPath018ShortToGNDFailure: diagnostic-event=EventPowerPath018ShortToGNDFailure, trouble-code-uds=Power_Path_018_Short_to_GND_Failure  # Event_Dtc_Map_Power_Path_018_Short_to_GND_Failure
  diagnostic event to operation cycle mapping EventOperCycleMapPowerPath018ShortToGNDFailure: diagnostic-event=EventPowerPath018ShortToGNDFailure, operation-cycle=DefaultOperationCycle  # Event_Oper_Cycle_Map_Power_Path_018_Short_to_GND_Failure
  diagnostic event to debounce algorithm mapping EventDebounceMapPowerPath018ShortToGNDFailure: debounce-algorithm=time_based, diagnostic-event=EventPowerPath018ShortToGNDFailure  # EventDebounceMap_Power_Path_018_Short_to_GND_Failure
package /ZeC/DTC/DTC/LIN_6_Slave_6_Defect
  diagnostic trouble code uds LIN_6_Slave_6_Defect: dtc-props=Dtc_Props_358996c7, uds-dtc-value=0x030608  # LIN 6 Slave 6_Defect
  diagnostic event EventLIN6Slave6Defect: aging-allowed=true, event-kind=SWC, prestorage-freeze-frame=false  # Event_LIN 6 Slave 6_Defect
  diagnostic event to trouble code uds mapping EventDtcMapLIN6Slave6Defect: diagnostic-event=EventLIN6Slave6Defect, trouble-code-uds=LIN_6_Slave_6_Defect  # Event_Dtc_Map_LIN 6 Slave 6_Defect
  diagnostic event to operation cycle mapping EventOperCycleMapLIN6Slave6Defect: diagnostic-event=EventLIN6Slave6Defect, operation-cycle=DefaultOperationCycle  # Event_Oper_Cycle_Map_LIN 6 Slave 6_Defect
  diagnostic event to debounce algorithm mapping EventDebounceMapLIN6Slave6Defect: debounce-algorithm=counter_based, diagnostic-event=EventLIN6Slave6Defect  # EventDebounceMap_LIN 6 Slave 6_Defect
package /ZeC/DTC/DTC/Power_Path_145_Not_Found_Failure
  diagnostic trouble code uds Power_Path_145_Not_Found_Failure: dtc-props=Dtc_Props_255f9ae9, uds-dtc-value=0x005691
  diagnostic event EventPowerPath145NotFoundFailure: aging-allowed=true, event-kind=SWC, prestorage-freeze-frame=false  # Event_Power_Path_145_Not_Found_Failure
  diagnostic event to trouble code uds mapping EventDtcMapPowerPath145NotFoundFailure: diagnostic-event=EventPowerPath145NotFoundFailure, trouble-code-uds=Power_Path_145_Not_Found_Failure  # Event_Dtc_Map_Power_Path_145_Not_Found_Failure
  diagnostic event to operation cycle mapping EventOperCycleMapPowerPath145NotFoundFailure: diagnostic-event=EventPowerPath145NotFoundFailure, operation-cycle=DefaultOperationCycle  # Event_Oper_Cycle_Map_Power_Path_145_Not_Found_Failure
  diagnostic event to debounce algorithm mapping EventDebounceMapPowerPath145NotFoundFailure: debounce-algorithm=time_based, diagnostic-event=EventPowerPath145NotFoundFailure  # EventDebounceMap_Power_Path_145_Not_Found_Failure
package /ZeC/DTC/DTC/LIN_6_Slave_5_NoCommunication
  diagnostic trouble code uds LIN_6_Slave_5_NoCommunication: dtc-props=Dtc_Props_358996c7, uds-dtc-value=0x030607  # LIN 6 Slave 5_NoCommunication
  diagnostic event EventLIN6Slave5NoCommunication: aging-allowed=true, event-kind=SWC, prestorage-freeze-frame=false  # Event_LIN 6 Slave 5_NoCommunication
  diagnostic event to trouble code uds mapping EventDtcMapLIN6Slave5NoCommunication: diagnostic-event=EventLIN6Slave5NoCommunication, trouble-code-uds=LIN_6_Slave_5_NoCommunication  # Event_Dtc_Map_LIN 6 Slave 5_NoCommunication
  diagnostic event to operation cycle mapping EventOperCycleMapLIN6Slave5NoCommunication: diagnostic-event=EventLIN6Slave5NoCommunication, operation-cycle=DefaultOperationCycle  # Event_Oper_Cycle_Map_LIN 6 Slave 5_NoCommunication
  diagnostic event to debounce algorithm mapping EventDebounceMapLIN6Slave5NoCommunication: debounce-algorithm=counter_based, diagnostic-event=EventLIN6Slave5NoCommunication  # EventDebounceMap_LIN 6 Slave 5_NoCommunication
package /ZeC/DTC/DTC/Power_Path_144_Not_Found_Failure
  diagnostic trouble code uds Power_Path_144_Not_Found_Failure: dtc-props=Dtc_Props_634690d3, uds-dtc-value=0x005690
  diagnostic event EventPowerPath144NotFoundFailure: aging-allowed=true, event-kind=SWC, prestorage-freeze-frame=false  # Event_Power_Path_144_Not_Found_Failure
  diagnostic event to trouble code uds mapping EventDtcMapPowerPath144NotFoundFailure: diagnostic-event=EventPowerPath144NotFoundFailure, trouble-code-uds=Power_Path_144_Not_Found_Failure  # Event_Dtc_Map_Power_Path_144_Not_Found_Failure
  diagnostic event to operation cycle mapping EventOperCycleMapPowerPath144NotFoundFailure: diagnostic-event=EventPowerPath144NotFoundFailure, operation-cycle=DefaultOperationCycle  # Event_Oper_Cycle_Map_Power_Path_144_Not_Found_Failure
  diagnostic event to debounce algorithm mapping EventDebounceMapPowerPath144NotFoundFailure: debounce-algorithm=time_based, diagnostic-event=EventPowerPath144NotFoundFailure  # EventDebounceMap_Power_Path_144_Not_Found_Failure
package /ZeC/DTC/DTC/Power_Path_147_Not_Found_Failure
  diagnostic trouble code uds Power_Path_147_Not_Found_Failure: dtc-props=Dtc_Props_a96d8e9d, uds-dtc-value=0x005693
  diagnostic event EventPowerPath147NotFoundFailure: aging-allowed=true, event-kind=SWC, prestorage-freeze-frame=false  # Event_Power_Path_147_Not_Found_Failure
  diagnostic event to trouble code uds mapping EventDtcMapPowerPath147NotFoundFailure: diagnostic-event=EventPowerPath147NotFoundFailure, trouble-code-uds=Power_Path_147_Not_Found_Failure  # Event_Dtc_Map_Power_Path_147_Not_Found_Failure
  diagnostic event to operation cycle mapping EventOperCycleMapPowerPath147NotFoundFailure: diagnostic-event=EventPowerPath147NotFoundFailure, operation-cycle=DefaultOperationCycle  # Event_Oper_Cycle_Map_Power_Path_147_Not_Found_Failure
  diagnostic event to debounce algorithm mapping EventDebounceMapPowerPath147NotFoundFailure: debounce-algorithm=time_based, diagnostic-event=EventPowerPath147NotFoundFailure  # EventDebounceMap_Power_Path_147_Not_Found_Failure
package /ZeC/DTC/DTC/LIN_6_Slave_6_NoCommunication
  diagnostic trouble code uds LIN_6_Slave_6_NoCommunication: dtc-props=Dtc_Props_358996c7, uds-dtc-value=0x030609  # LIN 6 Slave 6_NoCommunication
  diagnostic event EventLIN6Slave6NoCommunication: aging-allowed=true, event-kind=SWC, prestorage-freeze-frame=false  # Event_LIN 6 Slave 6_NoCommunication
  diagnostic event to trouble code uds mapping EventDtcMapLIN6Slave6NoCommunication: diagnostic-event=EventLIN6Slave6NoCommunication, trouble-code-uds=LIN_6_Slave_6_NoCommunication  # Event_Dtc_Map_LIN 6 Slave 6_NoCommunication
  diagnostic event to operation cycle mapping EventOperCycleMapLIN6Slave6NoCommunication: diagnostic-event=EventLIN6Slave6NoCommunication, operation-cycle=DefaultOperationCycle  # Event_Oper_Cycle_Map_LIN 6 Slave 6_NoCommunication
  diagnostic event to debounce algorithm mapping EventDebounceMapLIN6Slave6NoCommunication: debounce-algorithm=counter_based, diagnostic-event=EventLIN6Slave6NoCommunication  # EventDebounceMap_LIN 6 Slave 6_NoCommunication
package /ZeC/DTC/DTC/Power_Path_146_Not_Found_Failure
  diagnostic trouble code uds Power_Path_146_Not_Found_Failure: dtc-props=Dtc_Props_ef7484a7, uds-dtc-value=0x005692
  diagnostic event EventPowerPath146NotFoundFailure: aging-allowed=true, event-kind=SWC, prestorage-freeze-frame=false  # Event_Power_Path_146_Not_Found_Failure
  diagnostic event to trouble code uds mapping EventDtcMapPowerPath146NotFoundFailure: diagnostic-event=EventPowerPath146NotFoundFailure, trouble-code-uds=Power_Path_146_Not_Found_Failure  # Event_Dtc_Map_Power_Path_146_Not_Found_Failure
  diagnostic event to operation cycle mapping EventOperCycleMapPowerPath146NotFoundFailure: diagnostic-event=EventPowerPath146NotFoundFailure, operation-cycle=DefaultOperationCycle  # Event_Oper_Cycle_Map_Power_Path_146_Not_Found_Failure
  diagnostic event to debounce algorithm mapping EventDebounceMapPowerPath146NotFoundFailure: debounce-algorithm=time_based, diagnostic-event=EventPowerPath146NotFoundFailure  # EventDebounceMap_Power_Path_146_Not_Found_Failure
package /ZeC/DTC/DTC/LIN_6_Slave_11_NoCommunication
  diagnostic trouble code uds LIN_6_Slave_11_NoCommunication: dtc-props=Dtc_Props_358996c7, uds-dtc-value=0x030615  # LIN 6 Slave 11_NoCommunication
  diagnostic event EventLIN6Slave11NoCommunication: aging-allowed=true, event-kind=SWC, prestorage-freeze-frame=false  # Event_LIN 6 Slave 11_NoCommunication
  diagnostic event to trouble code uds mapping EventDtcMapLIN6Slave11NoCommunication: diagnostic-event=EventLIN6Slave11NoCommunication, trouble-code-uds=LIN_6_Slave_11_NoCommunication  # Event_Dtc_Map_LIN 6 Slave 11_NoCommunication
  diagnostic event to operation cycle mapping EventOperCycleMapLIN6Slave11NoCommunication: diagnostic-event=EventLIN6Slave11NoCommunication, operation-cycle=DefaultOperationCycle  # Event_Oper_Cycle_Map_LIN 6 Slave 11_NoCommunication
  diagnostic event to debounce algorithm mapping EventDebounceMapLIN6Slave11NoCommunication: debounce-algorithm=counter_based, diagnostic-event=EventLIN6Slave11NoCommunication  # EventDebounceMap_LIN 6 Slave 11_NoCommunication
package /ZeC/DTC/DTC/LIN_6_Slave_11_Defect
  diagnostic trouble code uds LIN_6_Slave_11_Defect: dtc-props=Dtc_Props_358996c7, uds-dtc-value=0x030614  # LIN 6 Slave 11_Defect
  diagnostic event EventLIN6Slave11Defect: aging-allowed=true, event-kind=SWC, prestorage-freeze-frame=false  # Event_LIN 6 Slave 11_Defect
  diagnostic event to trouble code uds mapping EventDtcMapLIN6Slave11Defect: diagnostic-event=EventLIN6Slave11Defect, trouble-code-uds=LIN_6_Slave_11_Defect  # Event_Dtc_Map_LIN 6 Slave 11_Defect
  diagnostic event to operation cycle mapping EventOperCycleMapLIN6Slave11Defect: diagnostic-event=EventLIN6Slave11Defect, operation-cycle=DefaultOperationCycle  # Event_Oper_Cycle_Map_LIN 6 Slave 11_Defect
  diagnostic event to debounce algorithm mapping EventDebounceMapLIN6Slave11Defect: debounce-algorithm=counter_based, diagnostic-event=EventLIN6Slave11Defect  # EventDebounceMap_LIN 6 Slave 11_Defect
package /ZeC/DTC/DTC/LIN_6_Slave_12_NoCommunication
  diagnostic trouble code uds LIN_6_Slave_12_NoCommunication: dtc-props=Dtc_Props_358996c7, uds-dtc-value=0x030617  # LIN 6 Slave 12_NoCommunication
  diagnostic event EventLIN6Slave12NoCommunication: aging-allowed=true, event-kind=SWC, prestorage-freeze-frame=false  # Event_LIN 6 Slave 12_NoCommunication
  diagnostic event to trouble code uds mapping EventDtcMapLIN6Slave12NoCommunication: diagnostic-event=EventLIN6Slave12NoCommunication, trouble-code-uds=LIN_6_Slave_12_NoCommunication  # Event_Dtc_Map_LIN 6 Slave 12_NoCommunication
  diagnostic event to operation cycle mapping EventOperCycleMapLIN6Slave12NoCommunication: diagnostic-event=EventLIN6Slave12NoCommunication, operation-cycle=DefaultOperationCycle  # Event_Oper_Cycle_Map_LIN 6 Slave 12_NoCommunication
  diagnostic event to debounce algorithm mapping EventDebounceMapLIN6Slave12NoCommunication: debounce-algorithm=counter_based, diagnostic-event=EventLIN6Slave12NoCommunication  # EventDebounceMap_LIN 6 Slave 12_NoCommunication
package /ZeC/DTC/DTC/LIN_6_Slave_12_Defect
  diagnostic trouble code uds LIN_6_Slave_12_Defect: dtc-props=Dtc_Props_358996c7, uds-dtc-value=0x030616  # LIN 6 Slave 12_Defect
  diagnostic event EventLIN6Slave12Defect: aging-allowed=true, event-kind=SWC, prestorage-freeze-frame=false  # Event_LIN 6 Slave 12_Defect
  diagnostic event to trouble code uds mapping EventDtcMapLIN6Slave12Defect: diagnostic-event=EventLIN6Slave12Defect, trouble-code-uds=LIN_6_Slave_12_Defect  # Event_Dtc_Map_LIN 6 Slave 12_Defect
  diagnostic event to operation cycle mapping EventOperCycleMapLIN6Slave12Defect: diagnostic-event=EventLIN6Slave12Defect, operation-cycle=DefaultOperationCycle  # Event_Oper_Cycle_Map_LIN 6 Slave 12_Defect
  diagnostic event to debounce algorithm mapping EventDebounceMapLIN6Slave12Defect: debounce-algorithm=counter_based, diagnostic-event=EventLIN6Slave12Defect  # EventDebounceMap_LIN 6 Slave 12_Defect
package /ZeC/DTC/DTC/LIN_6_Slave_1_NoCommunication
  diagnostic trouble code uds LIN_6_Slave_1_NoCommunication: dtc-props=Dtc_Props_358996c7, uds-dtc-value=0x030611  # LIN 6 Slave 1_NoCommunication
  diagnostic event EventLIN6Slave1NoCommunication: aging-allowed=true, event-kind=SWC, prestorage-freeze-frame=false  # Event_LIN 6 Slave 1_NoCommunication
  diagnostic event to trouble code uds mapping EventDtcMapLIN6Slave1NoCommunication: diagnostic-event=EventLIN6Slave1NoCommunication, trouble-code-uds=LIN_6_Slave_1_NoCommunication  # Event_Dtc_Map_LIN 6 Slave 1_NoCommunication
  diagnostic event to operation cycle mapping EventOperCycleMapLIN6Slave1NoCommunication: diagnostic-event=EventLIN6Slave1NoCommunication, operation-cycle=DefaultOperationCycle  # Event_Oper_Cycle_Map_LIN 6 Slave 1_NoCommunication
  diagnostic event to debounce algorithm mapping EventDebounceMapLIN6Slave1NoCommunication: debounce-algorithm=counter_based, diagnostic-event=EventLIN6Slave1NoCommunication  # EventDebounceMap_LIN 6 Slave 1_NoCommunication
package /ZeC/DTC/DTC/Power_Path_119_Not_Found_Failure
  diagnostic trouble code uds Power_Path_119_Not_Found_Failure: dtc-props=Dtc_Props_16b633e2, uds-dtc-value=0x005677
  diagnostic event EventPowerPath119NotFoundFailure: aging-allowed=true, event-kind=SWC, prestorage-freeze-frame=false  # Event_Power_Path_119_Not_Found_Failure
  diagnostic event to trouble code uds mapping EventDtcMapPowerPath119NotFoundFailure: diagnostic-event=EventPowerPath119NotFoundFailure, trouble-code-uds=Power_Path_119_Not_Found_Failure  # Event_Dtc_Map_Power_Path_119_Not_Found_Failure
  diagnostic event to operation cycle mapping EventOperCycleMapPowerPath119NotFoundFailure: diagnostic-event=EventPowerPath119NotFoundFailure, operation-cycle=DefaultOperationCycle  # Event_Oper_Cycle_Map_Power_Path_119_Not_Found_Failure
  diagnostic event to debounce algorithm mapping EventDebounceMapPowerPath119NotFoundFailure: debounce-algorithm=time_based, diagnostic-event=EventPowerPath119NotFoundFailure  # EventDebounceMap_Power_Path_119_Not_Found_Failure
package /ZeC/DTC/DTC/LIN_6_Slave_1_Defect
  diagnostic trouble code uds LIN_6_Slave_1_Defect: dtc-props=Dtc_Props_358996c7, uds-dtc-value=0x030610  # LIN 6 Slave 1_Defect
  diagnostic event EventLIN6Slave1Defect: aging-allowed=true, event-kind=SWC, prestorage-freeze-frame=false  # Event_LIN 6 Slave 1_Defect
  diagnostic event to trouble code uds mapping EventDtcMapLIN6Slave1Defect: diagnostic-event=EventLIN6Slave1Defect, trouble-code-uds=LIN_6_Slave_1_Defect  # Event_Dtc_Map_LIN 6 Slave 1_Defect
  diagnostic event to operation cycle mapping EventOperCycleMapLIN6Slave1Defect: diagnostic-event=EventLIN6Slave1Defect, operation-cycle=DefaultOperationCycle  # Event_Oper_Cycle_Map_LIN 6 Slave 1_Defect
  diagnostic event to debounce algorithm mapping EventDebounceMapLIN6Slave1Defect: debounce-algorithm=counter_based, diagnostic-event=EventLIN6Slave1Defect  # EventDebounceMap_LIN 6 Slave 1_Defect
package /ZeC/DTC/DTC/Power_Path_118_Not_Found_Failure
  diagnostic trouble code uds Power_Path_118_Not_Found_Failure: dtc-props=Dtc_Props_50af39d8, uds-dtc-value=0x005676
  diagnostic event EventPowerPath118NotFoundFailure: aging-allowed=true, event-kind=SWC, prestorage-freeze-frame=false  # Event_Power_Path_118_Not_Found_Failure
  diagnostic event to trouble code uds mapping EventDtcMapPowerPath118NotFoundFailure: diagnostic-event=EventPowerPath118NotFoundFailure, trouble-code-uds=Power_Path_118_Not_Found_Failure  # Event_Dtc_Map_Power_Path_118_Not_Found_Failure
  diagnostic event to operation cycle mapping EventOperCycleMapPowerPath118NotFoundFailure: diagnostic-event=EventPowerPath118NotFoundFailure, operation-cycle=DefaultOperationCycle  # Event_Oper_Cycle_Map_Power_Path_118_Not_Found_Failure
  diagnostic event to debounce algorithm mapping EventDebounceMapPowerPath118NotFoundFailure: debounce-algorithm=time_based, diagnostic-event=EventPowerPath118NotFoundFailure  # EventDebounceMap_Power_Path_118_Not_Found_Failure
package /ZeC/DTC/DTC/LIN_6_Slave_10_NoCommunication
  diagnostic trouble code uds LIN_6_Slave_10_NoCommunication: dtc-props=Dtc_Props_358996c7, uds-dtc-value=0x030613  # LIN 6 Slave 10_NoCommunication
  diagnostic event EventLIN6Slave10NoCommunication: aging-allowed=true, event-kind=SWC, prestorage-freeze-frame=false  # Event_LIN 6 Slave 10_NoCommunication
  diagnostic event to trouble code uds mapping EventDtcMapLIN6Slave10NoCommunication: diagnostic-event=EventLIN6Slave10NoCommunication, trouble-code-uds=LIN_6_Slave_10_NoCommunication  # Event_Dtc_Map_LIN 6 Slave 10_NoCommunication
  diagnostic event to operation cycle mapping EventOperCycleMapLIN6Slave10NoCommunication: diagnostic-event=EventLIN6Slave10NoCommunication, operation-cycle=DefaultOperationCycle  # Event_Oper_Cycle_Map_LIN 6 Slave 10_NoCommunication
  diagnostic event to debounce algorithm mapping EventDebounceMapLIN6Slave10NoCommunication: debounce-algorithm=counter_based, diagnostic-event=EventLIN6Slave10NoCommunication  # EventDebounceMap_LIN 6 Slave 10_NoCommunication
package /ZeC/DTC/DTC/Power_Path_121_Not_Found_Failure
  diagnostic trouble code uds Power_Path_121_Not_Found_Failure: dtc-props=Dtc_Props_4ca522c, uds-dtc-value=0x005679
  diagnostic event EventPowerPath121NotFoundFailure: aging-allowed=true, event-kind=SWC, prestorage-freeze-frame=false  # Event_Power_Path_121_Not_Found_Failure
  diagnostic event to trouble code uds mapping EventDtcMapPowerPath121NotFoundFailure: diagnostic-event=EventPowerPath121NotFoundFailure, trouble-code-uds=Power_Path_121_Not_Found_Failure  # Event_Dtc_Map_Power_Path_121_Not_Found_Failure
  diagnostic event to operation cycle mapping EventOperCycleMapPowerPath121NotFoundFailure: diagnostic-event=EventPowerPath121NotFoundFailure, operation-cycle=DefaultOperationCycle  # Event_Oper_Cycle_Map_Power_Path_121_Not_Found_Failure
  diagnostic event to debounce algorithm mapping EventDebounceMapPowerPath121NotFoundFailure: debounce-algorithm=time_based, diagnostic-event=EventPowerPath121NotFoundFailure  # EventDebounceMap_Power_Path_121_Not_Found_Failure
package /ZeC/DTC/DTC/LIN_6_Slave_10_Defect
  diagnostic trouble code uds LIN_6_Slave_10_Defect: dtc-props=Dtc_Props_358996c7, uds-dtc-value=0x030612  # LIN 6 Slave 10_Defect
  diagnostic event EventLIN6Slave10Defect: aging-allowed=true, event-kind=SWC, prestorage-freeze-frame=false  # Event_LIN 6 Slave 10_Defect
  diagnostic event to trouble code uds mapping EventDtcMapLIN6Slave10Defect: diagnostic-event=EventLIN6Slave10Defect, trouble-code-uds=LIN_6_Slave_10_Defect  # Event_Dtc_Map_LIN 6 Slave 10_Defect
  diagnostic event to operation cycle mapping EventOperCycleMapLIN6Slave10Defect: diagnostic-event=EventLIN6Slave10Defect, operation-cycle=DefaultOperationCycle  # Event_Oper_Cycle_Map_LIN 6 Slave 10_Defect
  diagnostic event to debounce algorithm mapping EventDebounceMapLIN6Slave10Defect: debounce-algorithm=counter_based, diagnostic-event=EventLIN6Slave10Defect  # EventDebounceMap_LIN 6 Slave 10_Defect
