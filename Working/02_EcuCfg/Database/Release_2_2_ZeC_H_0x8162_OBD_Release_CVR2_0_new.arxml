[part 18 of 19: packages /ZeC/DTC/DTC/LIN_23_Slave_10_NoCommunication to /ZeC/Routine/Reset_protection_of_vehicle_diagnosis]
AUTOSAR XML (schema 00047)
package /ZeC/DTC/DTC/LIN_23_Slave_10_NoCommunication
  diagnostic trouble code uds LIN_23_Slave_10_NoCommunication: dtc-props=Dtc_Props_358996c7, uds-dtc-value=0x031813  # LIN 23 Slave 10_NoCommunication
  diagnostic event EventLIN23Slave10NoCommunication: aging-allowed=true, event-kind=SWC, prestorage-freeze-frame=false  # Event_LIN 23 Slave 10_NoCommunication
  diagnostic event to trouble code uds mapping EventDtcMapLIN23Slave10NoCommunication: diagnostic-event=EventLIN23Slave10NoCommunication, trouble-code-uds=LIN_23_Slave_10_NoCommunication  # Event_Dtc_Map_LIN 23 Slave 10_NoCommunication
  diagnostic event to operation cycle mapping EventOperCycleMapLIN23Slave10NoCommunication: diagnostic-event=EventLIN23Slave10NoCommunication, operation-cycle=DefaultOperationCycle  # Event_Oper_Cycle_Map_LIN 23 Slave 10_NoCommunication
  diagnostic event to debounce algorithm mapping EventDebounceMapLIN23Slave10NoCommunication: debounce-algorithm=counter_based, diagnostic-event=EventLIN23Slave10NoCommunication  # EventDebounceMap_LIN 23 Slave 10_NoCommunication
package /ZeC/DTC/DTC/LIN_23_Slave_11_Defect
  diagnostic trouble code uds LIN_23_Slave_11_Defect: dtc-props=Dtc_Props_358996c7, uds-dtc-value=0x031814  # LIN 23 Slave 11_Defect
  diagnostic event EventLIN23Slave11Defect: aging-allowed=true, event-kind=SWC, prestorage-freeze-frame=false  # Event_LIN 23 Slave 11_Defect
  diagnostic event to trouble code uds mapping EventDtcMapLIN23Slave11Defect: diagnostic-event=EventLIN23Slave11Defect, trouble-code-uds=LIN_23_Slave_11_Defect  # Event_Dtc_Map_LIN 23 Slave 11_Defect
  diagnostic event to operation cycle mapping EventOperCycleMapLIN23Slave11Defect: diagnostic-event=EventLIN23Slave11Defect, operation-cycle=DefaultOperationCycle  # Event_Oper_Cycle_Map_LIN 23 Slave 11_Defect
  diagnostic event to debounce algorithm mapping EventDebounceMapLIN23Slave11Defect: debounce-algorithm=counter_based, diagnostic-event=EventLIN23Slave11Defect  # EventDebounceMap_LIN 23 Slave 11_Defect
package /ZeC/DTC/DTC/LIN_23_Slave_1_NoCommunication
  diagnostic trouble code uds LIN_23_Slave_1_NoCommunication: dtc-props=Dtc_Props_358996c7, uds-dtc-value=0x031811  # LIN 23 Slave 1_NoCommunication
  diagnostic event EventLIN23Slave1NoCommunication: aging-allowed=true, event-kind=SWC, prestorage-freeze-frame=false  # Event_LIN 23 Slave 1_NoCommunication
  diagnostic event to trouble code uds mapping EventDtcMapLIN23Slave1NoCommunication: diagnostic-event=EventLIN23Slave1NoCommunication, trouble-code-uds=LIN_23_Slave_1_NoCommunication  # Event_Dtc_Map_LIN 23 Slave 1_NoCommunication
  diagnostic event to operation cycle mapping EventOperCycleMapLIN23Slave1NoCommunication: diagnostic-event=EventLIN23Slave1NoCommunication, operation-cycle=DefaultOperationCycle  # Event_Oper_Cycle_Map_LIN 23 Slave 1_NoCommunication
  diagnostic event to debounce algorithm mapping EventDebounceMapLIN23Slave1NoCommunication: debounce-algorithm=counter_based, diagnostic-event=EventLIN23Slave1NoCommunication  # EventDebounceMap_LIN 23 Slave 1_NoCommunication
package /ZeC/DTC/DTC/Power_Path_103_Over_Load_Failure
  diagnostic trouble code uds Power_Path_103_Over_Load_Failure: dtc-props=Dtc_Props_d0fcf35a, uds-dtc-value=0x005567
  diagnostic event EventPowerPath103OverLoadFailure: aging-allowed=true, event-kind=SWC, prestorage-freeze-frame=false  # Event_Power_Path_103_Over_Load_Failure
  diagnostic event to trouble code uds mapping EventDtcMapPowerPath103OverLoadFailure: diagnostic-event=EventPowerPath103OverLoadFailure, trouble-code-uds=Power_Path_103_Over_Load_Failure  # Event_Dtc_Map_Power_Path_103_Over_Load_Failure
  diagnostic event to operation cycle mapping EventOperCycleMapPowerPath103OverLoadFailure: diagnostic-event=EventPowerPath103OverLoadFailure, operation-cycle=DefaultOperationCycle  # Event_Oper_Cycle_Map_Power_Path_103_Over_Load_Failure
  diagnostic event to debounce algorithm mapping EventDebounceMapPowerPath103OverLoadFailure: debounce-algorithm=time_based, diagnostic-event=EventPowerPath103OverLoadFailure  # EventDebounceMap_Power_Path_103_Over_Load_Failure
package /ZeC/DTC/DTC/LIN_23_Slave_10_Defect
  diagnostic trouble code uds LIN_23_Slave_10_Defect: dtc-props=Dtc_Props_358996c7, uds-dtc-value=0x031812  # LIN 23 Slave 10_Defect
  diagnostic event EventLIN23Slave10Defect: aging-allowed=true, event-kind=SWC, prestorage-freeze-frame=false  # Event_LIN 23 Slave 10_Defect
  diagnostic event to trouble code uds mapping EventDtcMapLIN23Slave10Defect: diagnostic-event=EventLIN23Slave10Defect, trouble-code-uds=LIN_23_Slave_10_Defect  # Event_Dtc_Map_LIN 23 Slave 10_Defect
  diagnostic event to operation cycle mapping EventOperCycleMapLIN23Slave10Defect: diagnostic-event=EventLIN23Slave10Defect, operation-cycle=DefaultOperationCycle  # Event_Oper_Cycle_Map_LIN 23 Slave 10_Defect
  diagnostic event to debounce algorithm mapping EventDebounceMapLIN23Slave10Defect: debounce-algorithm=counter_based, diagnostic-event=EventLIN23Slave10Defect  # EventDebounceMap_LIN 23 Slave 10_Defect
package /ZeC/DTC/DTC/Power_Path_102_Over_Load_Failure
  diagnostic trouble code uds Power_Path_102_Over_Load_Failure: dtc-props=Dtc_Props_96e5f960, uds-dtc-value=0x005566
  diagnostic event EventPowerPath102OverLoadFailure: aging-allowed=true, event-kind=SWC, prestorage-freeze-frame=false  # Event_Power_Path_102_Over_Load_Failure
  diagnostic event to trouble code uds mapping EventDtcMapPowerPath102OverLoadFailure: diagnostic-event=EventPowerPath102OverLoadFailure, trouble-code-uds=Power_Path_102_Over_Load_Failure  # Event_Dtc_Map_Power_Path_102_Over_Load_Failure
  diagnostic event to operation cycle mapping EventOperCycleMapPowerPath102OverLoadFailure: diagnostic-event=EventPowerPath102OverLoadFailure, operation-cycle=DefaultOperationCycle  # Event_Oper_Cycle_Map_Power_Path_102_Over_Load_Failure
  diagnostic event to debounce algorithm mapping EventDebounceMapPowerPath102OverLoadFailure: debounce-algorithm=time_based, diagnostic-event=EventPowerPath102OverLoadFailure  # EventDebounceMap_Power_Path_102_Over_Load_Failure
package /ZeC/DTC/DTC/Power_Path_105_Over_Load_Failure
  diagnostic trouble code uds Power_Path_105_Over_Load_Failure: dtc-props=Dtc_Props_c2809294, uds-dtc-value=0x005569
  diagnostic event EventPowerPath105OverLoadFailure: aging-allowed=true, event-kind=SWC, prestorage-freeze-frame=false  # Event_Power_Path_105_Over_Load_Failure
  diagnostic event to trouble code uds mapping EventDtcMapPowerPath105OverLoadFailure: diagnostic-event=EventPowerPath105OverLoadFailure, trouble-code-uds=Power_Path_105_Over_Load_Failure  # Event_Dtc_Map_Power_Path_105_Over_Load_Failure
  diagnostic event to operation cycle mapping EventOperCycleMapPowerPath105OverLoadFailure: diagnostic-event=EventPowerPath105OverLoadFailure, operation-cycle=DefaultOperationCycle  # Event_Oper_Cycle_Map_Power_Path_105_Over_Load_Failure
  diagnostic event to debounce algorithm mapping EventDebounceMapPowerPath105OverLoadFailure: debounce-algorithm=time_based, diagnostic-event=EventPowerPath105OverLoadFailure  # EventDebounceMap_Power_Path_105_Over_Load_Failure
package /ZeC/DTC/DTC/LIN_23_Slave_1_Defect
  diagnostic trouble code uds LIN_23_Slave_1_Defect: dtc-props=Dtc_Props_358996c7, uds-dtc-value=0x031810  # LIN 23 Slave 1_Defect
  diagnostic event EventLIN23Slave1Defect: aging-allowed=true, event-kind=SWC, prestorage-freeze-frame=false  # Event_LIN 23 Slave 1_Defect
  diagnostic event to trouble code uds mapping EventDtcMapLIN23Slave1Defect: diagnostic-event=EventLIN23Slave1Defect, trouble-code-uds=LIN_23_Slave_1_Defect  # Event_Dtc_Map_LIN 23 Slave 1_Defect
  diagnostic event to operation cycle mapping EventOperCycleMapLIN23Slave1Defect: diagnostic-event=EventLIN23Slave1Defect, operation-cycle=DefaultOperationCycle  # Event_Oper_Cycle_Map_LIN 23 Slave 1_Defect
  diagnostic event to debounce algorithm mapping EventDebounceMapLIN23Slave1Defect: debounce-algorithm=counter_based, diagnostic-event=EventLIN23Slave1Defect  # EventDebounceMap_LIN 23 Slave 1_Defect
package /ZeC/DTC/DTC/Power_Path_104_Over_Load_Failure
  diagnostic trouble code uds Power_Path_104_Over_Load_Failure: dtc-props=Dtc_Props_849998ae, uds-dtc-value=0x005568
  diagnostic event EventPowerPath104OverLoadFailure: aging-allowed=true, event-kind=SWC, prestorage-freeze-frame=false  # Event_Power_Path_104_Over_Load_Failure
  diagnostic event to trouble code uds mapping EventDtcMapPowerPath104OverLoadFailure: diagnostic-event=EventPowerPath104OverLoadFailure, trouble-code-uds=Power_Path_104_Over_Load_Failure  # Event_Dtc_Map_Power_Path_104_Over_Load_Failure
  diagnostic event to operation cycle mapping EventOperCycleMapPowerPath104OverLoadFailure: diagnostic-event=EventPowerPath104OverLoadFailure, operation-cycle=DefaultOperationCycle  # Event_Oper_Cycle_Map_Power_Path_104_Over_Load_Failure
  diagnostic event to debounce algorithm mapping EventDebounceMapPowerPath104OverLoadFailure: debounce-algorithm=time_based, diagnostic-event=EventPowerPath104OverLoadFailure  # EventDebounceMap_Power_Path_104_Over_Load_Failure
package /ZeC/DTC/DTC/Power_Path_108_Over_Load_Failure
  diagnostic trouble code uds Power_Path_108_Over_Load_Failure: dtc-props=Dtc_Props_2e16b98e, uds-dtc-value=0x00556c
  diagnostic event EventPowerPath108OverLoadFailure: aging-allowed=true, event-kind=SWC, prestorage-freeze-frame=false  # Event_Power_Path_108_Over_Load_Failure
  diagnostic event to trouble code uds mapping EventDtcMapPowerPath108OverLoadFailure: diagnostic-event=EventPowerPath108OverLoadFailure, trouble-code-uds=Power_Path_108_Over_Load_Failure  # Event_Dtc_Map_Power_Path_108_Over_Load_Failure
  diagnostic event to operation cycle mapping EventOperCycleMapPowerPath108OverLoadFailure: diagnostic-event=EventPowerPath108OverLoadFailure, operation-cycle=DefaultOperationCycle  # Event_Oper_Cycle_Map_Power_Path_108_Over_Load_Failure
  diagnostic event to debounce algorithm mapping EventDebounceMapPowerPath108OverLoadFailure: debounce-algorithm=time_based, diagnostic-event=EventPowerPath108OverLoadFailure  # EventDebounceMap_Power_Path_108_Over_Load_Failure
package /ZeC/DTC/DTC/Power_Path_107_Over_Load_Failure
  diagnostic trouble code uds Power_Path_107_Over_Load_Failure: dtc-props=Dtc_Props_680fb3b4, uds-dtc-value=0x00556b
  diagnostic event EventPowerPath107OverLoadFailure: aging-allowed=true, event-kind=SWC, prestorage-freeze-frame=false  # Event_Power_Path_107_Over_Load_Failure
  diagnostic event to trouble code uds mapping EventDtcMapPowerPath107OverLoadFailure: diagnostic-event=EventPowerPath107OverLoadFailure, trouble-code-uds=Power_Path_107_Over_Load_Failure  # Event_Dtc_Map_Power_Path_107_Over_Load_Failure
  diagnostic event to operation cycle mapping EventOperCycleMapPowerPath107OverLoadFailure: diagnostic-event=EventPowerPath107OverLoadFailure, operation-cycle=DefaultOperationCycle  # Event_Oper_Cycle_Map_Power_Path_107_Over_Load_Failure
  diagnostic event to debounce algorithm mapping EventDebounceMapPowerPath107OverLoadFailure: debounce-algorithm=time_based, diagnostic-event=EventPowerPath107OverLoadFailure  # EventDebounceMap_Power_Path_107_Over_Load_Failure
package /ZeC/DTC/DTC/Power_Path_110_Over_Load_Failure
  diagnostic trouble code uds Power_Path_110_Over_Load_Failure: dtc-props=Dtc_Props_61318353, uds-dtc-value=0x00556e
  diagnostic event EventPowerPath110OverLoadFailure: aging-allowed=true, event-kind=SWC, prestorage-freeze-frame=false  # Event_Power_Path_110_Over_Load_Failure
  diagnostic event to trouble code uds mapping EventDtcMapPowerPath110OverLoadFailure: diagnostic-event=EventPowerPath110OverLoadFailure, trouble-code-uds=Power_Path_110_Over_Load_Failure  # Event_Dtc_Map_Power_Path_110_Over_Load_Failure
  diagnostic event to operation cycle mapping EventOperCycleMapPowerPath110OverLoadFailure: diagnostic-event=EventPowerPath110OverLoadFailure, operation-cycle=DefaultOperationCycle  # Event_Oper_Cycle_Map_Power_Path_110_Over_Load_Failure
  diagnostic event to debounce algorithm mapping EventDebounceMapPowerPath110OverLoadFailure: debounce-algorithm=time_based, diagnostic-event=EventPowerPath110OverLoadFailure  # EventDebounceMap_Power_Path_110_Over_Load_Failure
package /ZeC/DTC/DTC/Power_Path_109_Over_Load_Failure
  diagnostic trouble code uds Power_Path_109_Over_Load_Failure: dtc-props=Dtc_Props_27288969, uds-dtc-value=0x00556d
  diagnostic event EventPowerPath109OverLoadFailure: aging-allowed=true, event-kind=SWC, prestorage-freeze-frame=false  # Event_Power_Path_109_Over_Load_Failure
  diagnostic event to trouble code uds mapping EventDtcMapPowerPath109OverLoadFailure: diagnostic-event=EventPowerPath109OverLoadFailure, trouble-code-uds=Power_Path_109_Over_Load_Failure  # Event_Dtc_Map_Power_Path_109_Over_Load_Failure
  diagnostic event to operation cycle mapping EventOperCycleMapPowerPath109OverLoadFailure: diagnostic-event=EventPowerPath109OverLoadFailure, operation-cycle=DefaultOperationCycle  # Event_Oper_Cycle_Map_Power_Path_109_Over_Load_Failure
  diagnostic event to debounce algorithm mapping EventDebounceMapPowerPath109OverLoadFailure: debounce-algorithm=time_based, diagnostic-event=EventPowerPath109OverLoadFailure  # EventDebounceMap_Power_Path_109_Over_Load_Failure
package /ZeC/DTC/DTC/LIN_23_Slave_9_NoCommunication
  diagnostic trouble code uds LIN_23_Slave_9_NoCommunication: dtc-props=Dtc_Props_358996c7, uds-dtc-value=0x03180f  # LIN 23 Slave 9_NoCommunication
  diagnostic event EventLIN23Slave9NoCommunication: aging-allowed=true, event-kind=SWC, prestorage-freeze-frame=false  # Event_LIN 23 Slave 9_NoCommunication
  diagnostic event to trouble code uds mapping EventDtcMapLIN23Slave9NoCommunication: diagnostic-event=EventLIN23Slave9NoCommunication, trouble-code-uds=LIN_23_Slave_9_NoCommunication  # Event_Dtc_Map_LIN 23 Slave 9_NoCommunication
  diagnostic event to operation cycle mapping EventOperCycleMapLIN23Slave9NoCommunication: diagnostic-event=EventLIN23Slave9NoCommunication, operation-cycle=DefaultOperationCycle  # Event_Oper_Cycle_Map_LIN 23 Slave 9_NoCommunication
  diagnostic event to debounce algorithm mapping EventDebounceMapLIN23Slave9NoCommunication: debounce-algorithm=counter_based, diagnostic-event=EventLIN23Slave9NoCommunication  # EventDebounceMap_LIN 23 Slave 9_NoCommunication
package /ZeC/DTC/DTC/Power_Path_106_Over_Load_Failure
  diagnostic trouble code uds Power_Path_106_Over_Load_Failure: dtc-props=Dtc_Props_a224adfa, uds-dtc-value=0x00556a
  diagnostic event EventPowerPath106OverLoadFailure: aging-allowed=true, event-kind=SWC, prestorage-freeze-frame=false  # Event_Power_Path_106_Over_Load_Failure
  diagnostic event to trouble code uds mapping EventDtcMapPowerPath106OverLoadFailure: diagnostic-event=EventPowerPath106OverLoadFailure, trouble-code-uds=Power_Path_106_Over_Load_Failure  # Event_Dtc_Map_Power_Path_106_Over_Load_Failure
  diagnostic event to operation cycle mapping EventOperCycleMapPowerPath106OverLoadFailure: diagnostic-event=EventPowerPath106OverLoadFailure, operation-cycle=DefaultOperationCycle  # Event_Oper_Cycle_Map_Power_Path_106_Over_Load_Failure
  diagnostic event to debounce algorithm mapping EventDebounceMapPowerPath106OverLoadFailure: debounce-algorithm=time_based, diagnostic-event=EventPowerPath106OverLoadFailure  # EventDebounceMap_Power_Path_106_Over_Load_Failure
package /ZeC/DTC/DTC/LIN_23_Slave_2_Defect
  diagnostic trouble code uds LIN_23_Slave_2_Defect: dtc-props=Dtc_Props_358996c7, uds-dtc-value=0x03181e  # LIN 23 Slave 2_Defect
  diagnostic event EventLIN23Slave2Defect: aging-allowed=true, event-kind=SWC, prestorage-freeze-frame=false  # Event_LIN 23 Slave 2_Defect
  diagnostic event to trouble code uds mapping EventDtcMapLIN23Slave2Defect: diagnostic-event=EventLIN23Slave2Defect, trouble-code-uds=LIN_23_Slave_2_Defect  # Event_Dtc_Map_LIN 23 Slave 2_Defect
  diagnostic event to operation cycle mapping EventOperCycleMapLIN23Slave2Defect: diagnostic-event=EventLIN23Slave2Defect, operation-cycle=DefaultOperationCycle  # Event_Oper_Cycle_Map_LIN 23 Slave 2_Defect
  diagnostic event to debounce algorithm mapping EventDebounceMapLIN23Slave2Defect: debounce-algorithm=counter_based, diagnostic-event=EventLIN23Slave2Defect  # EventDebounceMap_LIN 23 Slave 2_Defect
package /ZeC/DTC/DTC/LIN_15_Slave_6_NoCommunication
  diagnostic trouble code uds LIN_15_Slave_6_NoCommunication: dtc-props=Dtc_Props_358996c7, uds-dtc-value=0x030f05  # LIN 15 Slave 6_NoCommunication
  diagnostic event EventLIN15Slave6NoCommunication: aging-allowed=true, event-kind=SWC, prestorage-freeze-frame=false  # Event_LIN 15 Slave 6_NoCommunication
  diagnostic event to trouble code uds mapping EventDtcMapLIN15Slave6NoCommunication: diagnostic-event=EventLIN15Slave6NoCommunication, trouble-code-uds=LIN_15_Slave_6_NoCommunication  # Event_Dtc_Map_LIN 15 Slave 6_NoCommunication
  diagnostic event to operation cycle mapping EventOperCycleMapLIN15Slave6NoCommunication: diagnostic-event=EventLIN15Slave6NoCommunication, operation-cycle=DefaultOperationCycle  # Event_Oper_Cycle_Map_LIN 15 Slave 6_NoCommunication
  diagnostic event to debounce algorithm mapping EventDebounceMapLIN15Slave6NoCommunication: debounce-algorithm=counter_based, diagnostic-event=EventLIN15Slave6NoCommunication  # EventDebounceMap_LIN 15 Slave 6_NoCommunication
package /ZeC/DTC/DTC/LIN_15_Slave_7_Defect
  diagnostic trouble code uds LIN_15_Slave_7_Defect: dtc-props=Dtc_Props_358996c7, uds-dtc-value=0x030f06  # LIN 15 Slave 7_Defect
  diagnostic event EventLIN15Slave7Defect: aging-allowed=true, event-kind=SWC, prestorage-freeze-frame=false  # Event_LIN 15 Slave 7_Defect
  diagnostic event to trouble code uds mapping EventDtcMapLIN15Slave7Defect: diagnostic-event=EventLIN15Slave7Defect, trouble-code-uds=LIN_15_Slave_7_Defect  # Event_Dtc_Map_LIN 15 Slave 7_Defect
  diagnostic event to operation cycle mapping EventOperCycleMapLIN15Slave7Defect: diagnostic-event=EventLIN15Slave7Defect, operation-cycle=DefaultOperationCycle  # Event_Oper_Cycle_Map_LIN 15 Slave 7_Defect
  diagnostic event to debounce algorithm mapping EventDebounceMapLIN15Slave7Defect: debounce-algorithm=counter_based, diagnostic-event=EventLIN15Slave7Defect  # EventDebounceMap_LIN 15 Slave 7_Defect
package /ZeC/DTC/DTC/LIN_23_Slave_15_Defect
  diagnostic trouble code uds LIN_23_Slave_15_Defect: dtc-props=Dtc_Props_358996c7, uds-dtc-value=0x03181c  # LIN 23 Slave 15_Defect
  diagnostic event EventLIN23Slave15Defect: aging-allowed=true, event-kind=SWC, prestorage-freeze-frame=false  # Event_LIN 23 Slave 15_Defect
  diagnostic event to trouble code uds mapping EventDtcMapLIN23Slave15Defect: diagnostic-event=EventLIN23Slave15Defect, trouble-code-uds=LIN_23_Slave_15_Defect  # Event_Dtc_Map_LIN 23 Slave 15_Defect
  diagnostic event to operation cycle mapping EventOperCycleMapLIN23Slave15Defect: diagnostic-event=EventLIN23Slave15Defect, operation-cycle=DefaultOperationCycle  # Event_Oper_Cycle_Map_LIN 23 Slave 15_Defect
  diagnostic event to debounce algorithm mapping EventDebounceMapLIN23Slave15Defect: debounce-algorithm=counter_based, diagnostic-event=EventLIN23Slave15Defect  # EventDebounceMap_LIN 23 Slave 15_Defect
package /ZeC/DTC/DTC/LIN_15_Slave_5_NoCommunication
  diagnostic trouble code uds LIN_15_Slave_5_NoCommunication: dtc-props=Dtc_Props_358996c7, uds-dtc-value=0x030f03  # LIN 15 Slave 5_NoCommunication
  diagnostic event EventLIN15Slave5NoCommunication: aging-allowed=true, event-kind=SWC, prestorage-freeze-frame=false  # Event_LIN 15 Slave 5_NoCommunication
  diagnostic event to trouble code uds mapping EventDtcMapLIN15Slave5NoCommunication: diagnostic-event=EventLIN15Slave5NoCommunication, trouble-code-uds=LIN_15_Slave_5_NoCommunication  # Event_Dtc_Map_LIN 15 Slave 5_NoCommunication
  diagnostic event to operation cycle mapping EventOperCycleMapLIN15Slave5NoCommunication: diagnostic-event=EventLIN15Slave5NoCommunication, operation-cycle=DefaultOperationCycle  # Event_Oper_Cycle_Map_LIN 15 Slave 5_NoCommunication
  diagnostic event to debounce algorithm mapping EventDebounceMapLIN15Slave5NoCommunication: debounce-algorithm=counter_based, diagnostic-event=EventLIN15Slave5NoCommunication  # EventDebounceMap_LIN 15 Slave 5_NoCommunication
package /ZeC/DTC/DTC/LIN_23_Slave_15_NoCommunication
  diagnostic trouble code uds LIN_23_Slave_15_NoCommunication: dtc-props=Dtc_Props_358996c7, uds-dtc-value=0x03181d  # LIN 23 Slave 15_NoCommunication
  diagnostic event EventLIN23Slave15NoCommunication: aging-allowed=true, event-kind=SWC, prestorage-freeze-frame=false  # Event_LIN 23 Slave 15_NoCommunication
  diagnostic event to trouble code uds mapping EventDtcMapLIN23Slave15NoCommunication: diagnostic-event=EventLIN23Slave15NoCommunication, trouble-code-uds=LIN_23_Slave_15_NoCommunication  # Event_Dtc_Map_LIN 23 Slave 15_NoCommunication
  diagnostic event to operation cycle mapping EventOperCycleMapLIN23Slave15NoCommunication: diagnostic-event=EventLIN23Slave15NoCommunication, operation-cycle=DefaultOperationCycle  # Event_Oper_Cycle_Map_LIN 23 Slave 15_NoCommunication
  diagnostic event to debounce algorithm mapping EventDebounceMapLIN23Slave15NoCommunication: debounce-algorithm=counter_based, diagnostic-event=EventLIN23Slave15NoCommunication  # EventDebounceMap_LIN 23 Slave 15_NoCommunication
package /ZeC/DTC/DTC/LIN_15_Slave_6_Defect
  diagnostic trouble code uds LIN_15_Slave_6_Defect: dtc-props=Dtc_Props_358996c7, uds-dtc-value=0x030f04  # LIN 15 Slave 6_Defect
  diagnostic event EventLIN15Slave6Defect: aging-allowed=true, event-kind=SWC, prestorage-freeze-frame=false  # Event_LIN 15 Slave 6_Defect
  diagnostic event to trouble code uds mapping EventDtcMapLIN15Slave6Defect: diagnostic-event=EventLIN15Slave6Defect, trouble-code-uds=LIN_15_Slave_6_Defect  # Event_Dtc_Map_LIN 15 Slave 6_Defect
  diagnostic event to operation cycle mapping EventOperCycleMapLIN15Slave6Defect: diagnostic-event=EventLIN15Slave6Defect, operation-cycle=DefaultOperationCycle  # Event_Oper_Cycle_Map_LIN 15 Slave 6_Defect
  diagnostic event to debounce algorithm mapping EventDebounceMapLIN15Slave6Defect: debounce-algorithm=counter_based, diagnostic-event=EventLIN15Slave6Defect  # EventDebounceMap_LIN 15 Slave 6_Defect
package /ZeC/DTC/DTC/LIN_23_Slave_14_Defect
  diagnostic trouble code uds LIN_23_Slave_14_Defect: dtc-props=Dtc_Props_358996c7, uds-dtc-value=0x03181a  # LIN 23 Slave 14_Defect
  diagnostic event EventLIN23Slave14Defect: aging-allowed=true, event-kind=SWC, prestorage-freeze-frame=false  # Event_LIN 23 Slave 14_Defect
  diagnostic event to trouble code uds mapping EventDtcMapLIN23Slave14Defect: diagnostic-event=EventLIN23Slave14Defect, trouble-code-uds=LIN_23_Slave_14_Defect  # Event_Dtc_Map_LIN 23 Slave 14_Defect
  diagnostic event to operation cycle mapping EventOperCycleMapLIN23Slave14Defect: diagnostic-event=EventLIN23Slave14Defect, operation-cycle=DefaultOperationCycle  # Event_Oper_Cycle_Map_LIN 23 Slave 14_Defect
  diagnostic event to debounce algorithm mapping EventDebounceMapLIN23Slave14Defect: debounce-algorithm=counter_based, diagnostic-event=EventLIN23Slave14Defect  # EventDebounceMap_LIN 23 Slave 14_Defect
package /ZeC/DTC/DTC/LIN_15_Slave_4_NoCommunication
  diagnostic trouble code uds LIN_15_Slave_4_NoCommunication: dtc-props=Dtc_Props_358996c7, uds-dtc-value=0x030f01  # LIN 15 Slave 4_NoCommunication
  diagnostic event EventLIN15Slave4NoCommunication: aging-allowed=true, event-kind=SWC, prestorage-freeze-frame=false  # Event_LIN 15 Slave 4_NoCommunication
  diagnostic event to trouble code uds mapping EventDtcMapLIN15Slave4NoCommunication: diagnostic-event=EventLIN15Slave4NoCommunication, trouble-code-uds=LIN_15_Slave_4_NoCommunication  # Event_Dtc_Map_LIN 15 Slave 4_NoCommunication
  diagnostic event to operation cycle mapping EventOperCycleMapLIN15Slave4NoCommunication: diagnostic-event=EventLIN15Slave4NoCommunication, operation-cycle=DefaultOperationCycle  # Event_Oper_Cycle_Map_LIN 15 Slave 4_NoCommunication
  diagnostic event to debounce algorithm mapping EventDebounceMapLIN15Slave4NoCommunication: debounce-algorithm=counter_based, diagnostic-event=EventLIN15Slave4NoCommunication  # EventDebounceMap_LIN 15 Slave 4_NoCommunication
package /ZeC/DTC/DTC/LIN_23_Slave_14_NoCommunication
  diagnostic trouble code uds LIN_23_Slave_14_NoCommunication: dtc-props=Dtc_Props_358996c7, uds-dtc-value=0x03181b  # LIN 23 Slave 14_NoCommunication
  diagnostic event EventLIN23Slave14NoCommunication: aging-allowed=true, event-kind=SWC, prestorage-freeze-frame=false  # Event_LIN 23 Slave 14_NoCommunication
  diagnostic event to trouble code uds mapping EventDtcMapLIN23Slave14NoCommunication: diagnostic-event=EventLIN23Slave14NoCommunication, trouble-code-uds=LIN_23_Slave_14_NoCommunication  # Event_Dtc_Map_LIN 23 Slave 14_NoCommunication
  diagnostic event to operation cycle mapping EventOperCycleMapLIN23Slave14NoCommunication: diagnostic-event=EventLIN23Slave14NoCommunication, operation-cycle=DefaultOperationCycle  # Event_Oper_Cycle_Map_LIN 23 Slave 14_NoCommunication
  diagnostic event to debounce algorithm mapping EventDebounceMapLIN23Slave14NoCommunication: debounce-algorithm=counter_based, diagnostic-event=EventLIN23Slave14NoCommunication  # EventDebounceMap_LIN 23 Slave 14_NoCommunication
package /ZeC/DTC/DTC/LIN_15_Slave_5_Defect
  diagnostic trouble code uds LIN_15_Slave_5_Defect: dtc-props=Dtc_Props_358996c7, uds-dtc-value=0x030f02  # LIN 15 Slave 5_Defect
  diagnostic event EventLIN15Slave5Defect: aging-allowed=true, event-kind=SWC, prestorage-freeze-frame=false  # Event_LIN 15 Slave 5_Defect
  diagnostic event to trouble code uds mapping EventDtcMapLIN15Slave5Defect: diagnostic-event=EventLIN15Slave5Defect, trouble-code-uds=LIN_15_Slave_5_Defect  # Event_Dtc_Map_LIN 15 Slave 5_Defect
  diagnostic event to operation cycle mapping EventOperCycleMapLIN15Slave5Defect: diagnostic-event=EventLIN15Slave5Defect, operation-cycle=DefaultOperationCycle  # Event_Oper_Cycle_Map_LIN 15 Slave 5_Defect
  diagnostic event to debounce algorithm mapping EventDebounceMapLIN15Slave5Defect: debounce-algorithm=counter_based, diagnostic-event=EventLIN15Slave5Defect  # EventDebounceMap_LIN 15 Slave 5_Defect
package /ZeC/DTC/DTC/Power_Path_111_Over_Load_Failure
  diagnostic trouble code uds Power_Path_111_Over_Load_Failure: dtc-props=Dtc_Props_ab1a9d1d, uds-dtc-value=0x00556f
  diagnostic event EventPowerPath111OverLoadFailure: aging-allowed=true, event-kind=SWC, prestorage-freeze-frame=false  # Event_Power_Path_111_Over_Load_Failure
  diagnostic event to trouble code uds mapping EventDtcMapPowerPath111OverLoadFailure: diagnostic-event=EventPowerPath111OverLoadFailure, trouble-code-uds=Power_Path_111_Over_Load_Failure  # Event_Dtc_Map_Power_Path_111_Over_Load_Failure
  diagnostic event to operation cycle mapping EventOperCycleMapPowerPath111OverLoadFailure: diagnostic-event=EventPowerPath111OverLoadFailure, operation-cycle=DefaultOperationCycle  # Event_Oper_Cycle_Map_Power_Path_111_Over_Load_Failure
  diagnostic event to debounce algorithm mapping EventDebounceMapPowerPath111OverLoadFailure: debounce-algorithm=time_based, diagnostic-event=EventPowerPath111OverLoadFailure  # EventDebounceMap_Power_Path_111_Over_Load_Failure
package /ZeC/DTC/DTC/Power_Path_116_Over_Load_Failure
  diagnostic trouble code uds Power_Path_116_Over_Load_Failure: dtc-props=Dtc_Props_dc9d2dac, uds-dtc-value=0x005574
  diagnostic event EventPowerPath116OverLoadFailure: aging-allowed=true, event-kind=SWC, prestorage-freeze-frame=false  # Event_Power_Path_116_Over_Load_Failure
  diagnostic event to trouble code uds mapping EventDtcMapPowerPath116OverLoadFailure: diagnostic-event=EventPowerPath116OverLoadFailure, trouble-code-uds=Power_Path_116_Over_Load_Failure  # Event_Dtc_Map_Power_Path_116_Over_Load_Failure
  diagnostic event to operation cycle mapping EventOperCycleMapPowerPath116OverLoadFailure: diagnostic-event=EventPowerPath116OverLoadFailure, operation-cycle=DefaultOperationCycle  # Event_Oper_Cycle_Map_Power_Path_116_Over_Load_Failure
  diagnostic event to debounce algorithm mapping EventDebounceMapPowerPath116OverLoadFailure: debounce-algorithm=time_based, diagnostic-event=EventPowerPath116OverLoadFailure  # EventDebounceMap_Power_Path_116_Over_Load_Failure
package /ZeC/DTC/DTC/Power_Path_115_Over_Load_Failure
  diagnostic trouble code uds Power_Path_115_Over_Load_Failure: dtc-props=Dtc_Props_d5a31d4b, uds-dtc-value=0x005573
  diagnostic event EventPowerPath115OverLoadFailure: aging-allowed=true, event-kind=SWC, prestorage-freeze-frame=false  # Event_Power_Path_115_Over_Load_Failure
  diagnostic event to trouble code uds mapping EventDtcMapPowerPath115OverLoadFailure: diagnostic-event=EventPowerPath115OverLoadFailure, trouble-code-uds=Power_Path_115_Over_Load_Failure  # Event_Dtc_Map_Power_Path_115_Over_Load_Failure
  diagnostic event to operation cycle mapping EventOperCycleMapPowerPath115OverLoadFailure: diagnostic-event=EventPowerPath115OverLoadFailure, operation-cycle=DefaultOperationCycle  # Event_Oper_Cycle_Map_Power_Path_115_Over_Load_Failure
  diagnostic event to debounce algorithm mapping EventDebounceMapPowerPath115OverLoadFailure: debounce-algorithm=time_based, diagnostic-event=EventPowerPath115OverLoadFailure  # EventDebounceMap_Power_Path_115_Over_Load_Failure
package /ZeC/DTC/DTC/Power_Path_118_Over_Load_Failure
  diagnostic trouble code uds Power_Path_118_Over_Load_Failure: dtc-props=Dtc_Props_50af39d8, uds-dtc-value=0x005576
  diagnostic event EventPowerPath118OverLoadFailure: aging-allowed=true, event-kind=SWC, prestorage-freeze-frame=false  # Event_Power_Path_118_Over_Load_Failure
  diagnostic event to trouble code uds mapping EventDtcMapPowerPath118OverLoadFailure: diagnostic-event=EventPowerPath118OverLoadFailure, trouble-code-uds=Power_Path_118_Over_Load_Failure  # Event_Dtc_Map_Power_Path_118_Over_Load_Failure
  diagnostic event to operation cycle mapping EventOperCycleMapPowerPath118OverLoadFailure: diagnostic-event=EventPowerPath118OverLoadFailure, operation-cycle=DefaultOperationCycle  # Event_Oper_Cycle_Map_Power_Path_118_Over_Load_Failure
  diagnostic event to debounce algorithm mapping EventDebounceMapPowerPath118OverLoadFailure: debounce-algorithm=time_based, diagnostic-event=EventPowerPath118OverLoadFailure  # EventDebounceMap_Power_Path_118_Over_Load_Failure
package /ZeC/DTC/DTC/Power_Path_117_Over_Load_Failure
  diagnostic trouble code uds Power_Path_117_Over_Load_Failure: dtc-props=Dtc_Props_9a842796, uds-dtc-value=0x005575
  diagnostic event EventPowerPath117OverLoadFailure: aging-allowed=true, event-kind=SWC, prestorage-freeze-frame=false  # Event_Power_Path_117_Over_Load_Failure
  diagnostic event to trouble code uds mapping EventDtcMapPowerPath117OverLoadFailure: diagnostic-event=EventPowerPath117OverLoadFailure, trouble-code-uds=Power_Path_117_Over_Load_Failure  # Event_Dtc_Map_Power_Path_117_Over_Load_Failure
  diagnostic event to operation cycle mapping EventOperCycleMapPowerPath117OverLoadFailure: diagnostic-event=EventPowerPath117OverLoadFailure, operation-cycle=DefaultOperationCycle  # Event_Oper_Cycle_Map_Power_Path_117_Over_Load_Failure
  diagnostic event to debounce algorithm mapping EventDebounceMapPowerPath117OverLoadFailure: debounce-algorithm=time_based, diagnostic-event=EventPowerPath117OverLoadFailure  # EventDebounceMap_Power_Path_117_Over_Load_Failure
package /ZeC/DTC/DTC/LIN_23_Slave_13_NoCommunication
  diagnostic trouble code uds LIN_23_Slave_13_NoCommunication: dtc-props=Dtc_Props_358996c7, uds-dtc-value=0x031819  # LIN 23 Slave 13_NoCommunication
  diagnostic event EventLIN23Slave13NoCommunication: aging-allowed=true, event-kind=SWC, prestorage-freeze-frame=false  # Event_LIN 23 Slave 13_NoCommunication
  diagnostic event to trouble code uds mapping EventDtcMapLIN23Slave13NoCommunication: diagnostic-event=EventLIN23Slave13NoCommunication, trouble-code-uds=LIN_23_Slave_13_NoCommunication  # Event_Dtc_Map_LIN 23 Slave 13_NoCommunication
  diagnostic event to operation cycle mapping EventOperCycleMapLIN23Slave13NoCommunication: diagnostic-event=EventLIN23Slave13NoCommunication, operation-cycle=DefaultOperationCycle  # Event_Oper_Cycle_Map_LIN 23 Slave 13_NoCommunication
  diagnostic event to debounce algorithm mapping EventDebounceMapLIN23Slave13NoCommunication: debounce-algorithm=counter_based, diagnostic-event=EventLIN23Slave13NoCommunication  # EventDebounceMap_LIN 23 Slave 13_NoCommunication
package /ZeC/DTC/DTC/Power_Path_112_Over_Load_Failure
  diagnostic trouble code uds Power_Path_112_Over_Load_Failure: dtc-props=Dtc_Props_1f880305, uds-dtc-value=0x005570
  diagnostic event EventPowerPath112OverLoadFailure: aging-allowed=true, event-kind=SWC, prestorage-freeze-frame=false  # Event_Power_Path_112_Over_Load_Failure
  diagnostic event to trouble code uds mapping EventDtcMapPowerPath112OverLoadFailure: diagnostic-event=EventPowerPath112OverLoadFailure, trouble-code-uds=Power_Path_112_Over_Load_Failure  # Event_Dtc_Map_Power_Path_112_Over_Load_Failure
  diagnostic event to operation cycle mapping EventOperCycleMapPowerPath112OverLoadFailure: diagnostic-event=EventPowerPath112OverLoadFailure, operation-cycle=DefaultOperationCycle  # Event_Oper_Cycle_Map_Power_Path_112_Over_Load_Failure
  diagnostic event to debounce algorithm mapping EventDebounceMapPowerPath112OverLoadFailure: debounce-algorithm=time_based, diagnostic-event=EventPowerPath112OverLoadFailure  # EventDebounceMap_Power_Path_112_Over_Load_Failure
package /ZeC/DTC/DTC/LIN_23_Slave_12_NoCommunication
  diagnostic trouble code uds LIN_23_Slave_12_NoCommunication: dtc-props=Dtc_Props_358996c7, uds-dtc-value=0x031817  # LIN 23 Slave 12_NoCommunication
  diagnostic event EventLIN23Slave12NoCommunication: aging-allowed=true, event-kind=SWC, prestorage-freeze-frame=false  # Event_LIN 23 Slave 12_NoCommunication
  diagnostic event to trouble code uds mapping EventDtcMapLIN23Slave12NoCommunication: diagnostic-event=EventLIN23Slave12NoCommunication, trouble-code-uds=LIN_23_Slave_12_NoCommunication  # Event_Dtc_Map_LIN 23 Slave 12_NoCommunication
  diagnostic event to operation cycle mapping EventOperCycleMapLIN23Slave12NoCommunication: diagnostic-event=EventLIN23Slave12NoCommunication, operation-cycle=DefaultOperationCycle  # Event_Oper_Cycle_Map_LIN 23 Slave 12_NoCommunication
  diagnostic event to debounce algorithm mapping EventDebounceMapLIN23Slave12NoCommunication: debounce-algorithm=counter_based, diagnostic-event=EventLIN23Slave12NoCommunication  # EventDebounceMap_LIN 23 Slave 12_NoCommunication
package /ZeC/DTC/DTC/Power_Path_114_Over_Load_Failure
  diagnostic trouble code uds Power_Path_114_Over_Load_Failure: dtc-props=Dtc_Props_93ba1771, uds-dtc-value=0x005572
  diagnostic event EventPowerPath114OverLoadFailure: aging-allowed=true, event-kind=SWC, prestorage-freeze-frame=false  # Event_Power_Path_114_Over_Load_Failure
  diagnostic event to trouble code uds mapping EventDtcMapPowerPath114OverLoadFailure: diagnostic-event=EventPowerPath114OverLoadFailure, trouble-code-uds=Power_Path_114_Over_Load_Failure  # Event_Dtc_Map_Power_Path_114_Over_Load_Failure
  diagnostic event to operation cycle mapping EventOperCycleMapPowerPath114OverLoadFailure: diagnostic-event=EventPowerPath114OverLoadFailure, operation-cycle=DefaultOperationCycle  # Event_Oper_Cycle_Map_Power_Path_114_Over_Load_Failure
  diagnostic event to debounce algorithm mapping EventDebounceMapPowerPath114OverLoadFailure: debounce-algorithm=time_based, diagnostic-event=EventPowerPath114OverLoadFailure  # EventDebounceMap_Power_Path_114_Over_Load_Failure
package /ZeC/DTC/DTC/LIN_23_Slave_13_Defect
  diagnostic trouble code uds LIN_23_Slave_13_Defect: dtc-props=Dtc_Props_358996c7, uds-dtc-value=0x031818  # LIN 23 Slave 13_Defect
  diagnostic event EventLIN23Slave13Defect: aging-allowed=true, event-kind=SWC, prestorage-freeze-frame=false  # Event_LIN 23 Slave 13_Defect
  diagnostic event to trouble code uds mapping EventDtcMapLIN23Slave13Defect: diagnostic-event=EventLIN23Slave13Defect, trouble-code-uds=LIN_23_Slave_13_Defect  # Event_Dtc_Map_LIN 23 Slave 13_Defect
  diagnostic event to operation cycle mapping EventOperCycleMapLIN23Slave13Defect: diagnostic-event=EventLIN23Slave13Defect, operation-cycle=DefaultOperationCycle  # Event_Oper_Cycle_Map_LIN 23 Slave 13_Defect
  diagnostic event to debounce algorithm mapping EventDebounceMapLIN23Slave13Defect: debounce-algorithm=counter_based, diagnostic-event=EventLIN23Slave13Defect  # EventDebounceMap_LIN 23 Slave 13_Defect
package /ZeC/DTC/DTC/Power_Path_113_Over_Load_Failure
  diagnostic trouble code uds Power_Path_113_Over_Load_Failure: dtc-props=Dtc_Props_5991093f, uds-dtc-value=0x005571
  diagnostic event EventPowerPath113OverLoadFailure: aging-allowed=true, event-kind=SWC, prestorage-freeze-frame=false  # Event_Power_Path_113_Over_Load_Failure
  diagnostic event to trouble code uds mapping EventDtcMapPowerPath113OverLoadFailure: diagnostic-event=EventPowerPath113OverLoadFailure, trouble-code-uds=Power_Path_113_Over_Load_Failure  # Event_Dtc_Map_Power_Path_113_Over_Load_Failure
  diagnostic event to operation cycle mapping EventOperCycleMapPowerPath113OverLoadFailure: diagnostic-event=EventPowerPath113OverLoadFailure, operation-cycle=DefaultOperationCycle  # Event_Oper_Cycle_Map_Power_Path_113_Over_Load_Failure
  diagnostic event to debounce algorithm mapping EventDebounceMapPowerPath113OverLoadFailure: debounce-algorithm=time_based, diagnostic-event=EventPowerPath113OverLoadFailure  # EventDebounceMap_Power_Path_113_Over_Load_Failure
package /ZeC/DTC/DTC/LIN_15_Slave_10_Defect
  diagnostic trouble code uds LIN_15_Slave_10_Defect: dtc-props=Dtc_Props_358996c7, uds-dtc-value=0x030f0e  # LIN 15 Slave 10_Defect
  diagnostic event EventLIN15Slave10Defect: aging-allowed=true, event-kind=SWC, prestorage-freeze-frame=false  # Event_LIN 15 Slave 10_Defect
  diagnostic event to trouble code uds mapping EventDtcMapLIN15Slave10Defect: diagnostic-event=EventLIN15Slave10Defect, trouble-code-uds=LIN_15_Slave_10_Defect  # Event_Dtc_Map_LIN 15 Slave 10_Defect
  diagnostic event to operation cycle mapping EventOperCycleMapLIN15Slave10Defect: diagnostic-event=EventLIN15Slave10Defect, operation-cycle=DefaultOperationCycle  # Event_Oper_Cycle_Map_LIN 15 Slave 10_Defect
  diagnostic event to debounce algorithm mapping EventDebounceMapLIN15Slave10Defect: debounce-algorithm=counter_based, diagnostic-event=EventLIN15Slave10Defect  # EventDebounceMap_LIN 15 Slave 10_Defect
package /ZeC/DTC/DTC/LIN_15_Slave_10_NoCommunication
  diagnostic trouble code uds LIN_15_Slave_10_NoCommunication: dtc-props=Dtc_Props_358996c7, uds-dtc-value=0x030f0f  # LIN 15 Slave 10_NoCommunication
  diagnostic event EventLIN15Slave10NoCommunication: aging-allowed=true, event-kind=SWC, prestorage-freeze-frame=false  # Event_LIN 15 Slave 10_NoCommunication
  diagnostic event to trouble code uds mapping EventDtcMapLIN15Slave10NoCommunication: diagnostic-event=EventLIN15Slave10NoCommunication, trouble-code-uds=LIN_15_Slave_10_NoCommunication  # Event_Dtc_Map_LIN 15 Slave 10_NoCommunication
  diagnostic event to operation cycle mapping EventOperCycleMapLIN15Slave10NoCommunication: diagnostic-event=EventLIN15Slave10NoCommunication, operation-cycle=DefaultOperationCycle  # Event_Oper_Cycle_Map_LIN 15 Slave 10_NoCommunication
  diagnostic event to debounce algorithm mapping EventDebounceMapLIN15Slave10NoCommunication: debounce-algorithm=counter_based, diagnostic-event=EventLIN15Slave10NoCommunication  # EventDebounceMap_LIN 15 Slave 10_NoCommunication
package /ZeC/DTC/DTC/Power_Path_089_Over_Load_Failure
  diagnostic trouble code uds Power_Path_089_Over_Load_Failure: dtc-props=Dtc_Props_532ed51d, uds-dtc-value=0x005559
  diagnostic event EventPowerPath089OverLoadFailure: aging-allowed=true, event-kind=SWC, prestorage-freeze-frame=false  # Event_Power_Path_089_Over_Load_Failure
  diagnostic event to trouble code uds mapping EventDtcMapPowerPath089OverLoadFailure: diagnostic-event=EventPowerPath089OverLoadFailure, trouble-code-uds=Power_Path_089_Over_Load_Failure  # Event_Dtc_Map_Power_Path_089_Over_Load_Failure
  diagnostic event to operation cycle mapping EventOperCycleMapPowerPath089OverLoadFailure: diagnostic-event=EventPowerPath089OverLoadFailure, operation-cycle=DefaultOperationCycle  # Event_Oper_Cycle_Map_Power_Path_089_Over_Load_Failure
  diagnostic event to debounce algorithm mapping EventDebounceMapPowerPath089OverLoadFailure: debounce-algorithm=time_based, diagnostic-event=EventPowerPath089OverLoadFailure  # EventDebounceMap_Power_Path_089_Over_Load_Failure
package /ZeC/DTC/DTC/LIN_15_Slave_1_Defect
  diagnostic trouble code uds LIN_15_Slave_1_Defect: dtc-props=Dtc_Props_358996c7, uds-dtc-value=0x030f0c  # LIN 15 Slave 1_Defect
  diagnostic event EventLIN15Slave1Defect: aging-allowed=true, event-kind=SWC, prestorage-freeze-frame=false  # Event_LIN 15 Slave 1_Defect
  diagnostic event to trouble code uds mapping EventDtcMapLIN15Slave1Defect: diagnostic-event=EventLIN15Slave1Defect, trouble-code-uds=LIN_15_Slave_1_Defect  # Event_Dtc_Map_LIN 15 Slave 1_Defect
  diagnostic event to operation cycle mapping EventOperCycleMapLIN15Slave1Defect: diagnostic-event=EventLIN15Slave1Defect, operation-cycle=DefaultOperationCycle  # Event_Oper_Cycle_Map_LIN 15 Slave 1_Defect
  diagnostic event to debounce algorithm mapping EventDebounceMapLIN15Slave1Defect: debounce-algorithm=counter_based, diagnostic-event=EventLIN15Slave1Defect  # EventDebounceMap_LIN 15 Slave 1_Defect
package /ZeC/DTC/DTC/LIN_15_Slave_1_NoCommunication
  diagnostic trouble code uds LIN_15_Slave_1_NoCommunication: dtc-props=Dtc_Props_358996c7, uds-dtc-value=0x030f0d  # LIN 15 Slave 1_NoCommunication
  diagnostic event EventLIN15Slave1NoCommunication: aging-allowed=true, event-kind=SWC, prestorage-freeze-frame=false  # Event_LIN 15 Slave 1_NoCommunication
  diagnostic event to trouble code uds mapping EventDtcMapLIN15Slave1NoCommunication: diagnostic-event=EventLIN15Slave1NoCommunication, trouble-code-uds=LIN_15_Slave_1_NoCommunication  # Event_Dtc_Map_LIN 15 Slave 1_NoCommunication
  diagnostic event to operation cycle mapping EventOperCycleMapLIN15Slave1NoCommunication: diagnostic-event=EventLIN15Slave1NoCommunication, operation-cycle=DefaultOperationCycle  # Event_Oper_Cycle_Map_LIN 15 Slave 1_NoCommunication
  diagnostic event to debounce algorithm mapping EventDebounceMapLIN15Slave1NoCommunication: debounce-algorithm=counter_based, diagnostic-event=EventLIN15Slave1NoCommunication  # EventDebounceMap_LIN 15 Slave 1_NoCommunication
package /ZeC/DTC/DTC/LIN_15_Slave_9_Defect
  diagnostic trouble code uds LIN_15_Slave_9_Defect: dtc-props=Dtc_Props_358996c7, uds-dtc-value=0x030f0a  # LIN 15 Slave 9_Defect
  diagnostic event EventLIN15Slave9Defect: aging-allowed=true, event-kind=SWC, prestorage-freeze-frame=false  # Event_LIN 15 Slave 9_Defect
  diagnostic event to trouble code uds mapping EventDtcMapLIN15Slave9Defect: diagnostic-event=EventLIN15Slave9Defect, trouble-code-uds=LIN_15_Slave_9_Defect  # Event_Dtc_Map_LIN 15 Slave 9_Defect
  diagnostic event to operation cycle mapping EventOperCycleMapLIN15Slave9Defect: diagnostic-event=EventLIN15Slave9Defect, operation-cycle=DefaultOperationCycle  # Event_Oper_Cycle_Map_LIN 15 Slave 9_Defect
  diagnostic event to debounce algorithm mapping EventDebounceMapLIN15Slave9Defect: debounce-algorithm=counter_based, diagnostic-event=EventLIN15Slave9Defect  # EventDebounceMap_LIN 15 Slave 9_Defect
package /ZeC/DTC/DTC/Power_Path_086_Over_Load_Failure
  diagnostic trouble code uds Power_Path_086_Over_Load_Failure: dtc-props=Dtc_Props_74bbee9, uds-dtc-value=0x005556
  diagnostic event EventPowerPath086OverLoadFailure: aging-allowed=true, event-kind=SWC, prestorage-freeze-frame=false  # Event_Power_Path_086_Over_Load_Failure
  diagnostic event to trouble code uds mapping EventDtcMapPowerPath086OverLoadFailure: diagnostic-event=EventPowerPath086OverLoadFailure, trouble-code-uds=Power_Path_086_Over_Load_Failure  # Event_Dtc_Map_Power_Path_086_Over_Load_Failure
  diagnostic event to operation cycle mapping EventOperCycleMapPowerPath086OverLoadFailure: diagnostic-event=EventPowerPath086OverLoadFailure, operation-cycle=DefaultOperationCycle  # Event_Oper_Cycle_Map_Power_Path_086_Over_Load_Failure
  diagnostic event to debounce algorithm mapping EventDebounceMapPowerPath086OverLoadFailure: debounce-algorithm=time_based, diagnostic-event=EventPowerPath086OverLoadFailure  # EventDebounceMap_Power_Path_086_Over_Load_Failure
package /ZeC/DTC/DTC/LIN_15_Slave_9_NoCommunication
  diagnostic trouble code uds LIN_15_Slave_9_NoCommunication: dtc-props=Dtc_Props_358996c7, uds-dtc-value=0x030f0b  # LIN 15 Slave 9_NoCommunication
  diagnostic event EventLIN15Slave9NoCommunication: aging-allowed=true, event-kind=SWC, prestorage-freeze-frame=false  # Event_LIN 15 Slave 9_NoCommunication
  diagnostic event to trouble code uds mapping EventDtcMapLIN15Slave9NoCommunication: diagnostic-event=EventLIN15Slave9NoCommunication, trouble-code-uds=LIN_15_Slave_9_NoCommunication  # Event_Dtc_Map_LIN 15 Slave 9_NoCommunication
  diagnostic event to operation cycle mapping EventOperCycleMapLIN15Slave9NoCommunication: diagnostic-event=EventLIN15Slave9NoCommunication, operation-cycle=DefaultOperationCycle  # Event_Oper_Cycle_Map_LIN 15 Slave 9_NoCommunication
  diagnostic event to debounce algorithm mapping EventDebounceMapLIN15Slave9NoCommunication: debounce-algorithm=counter_based, diagnostic-event=EventLIN15Slave9NoCommunication  # EventDebounceMap_LIN 15 Slave 9_NoCommunication
package /ZeC/DTC/DTC/Power_Path_085_Over_Load_Failure
  diagnostic trouble code uds Power_Path_085_Over_Load_Failure: dtc-props=Dtc_Props_cd60a0a7, uds-dtc-value=0x005555
  diagnostic event EventPowerPath085OverLoadFailure: aging-allowed=true, event-kind=SWC, prestorage-freeze-frame=false  # Event_Power_Path_085_Over_Load_Failure
  diagnostic event to trouble code uds mapping EventDtcMapPowerPath085OverLoadFailure: diagnostic-event=EventPowerPath085OverLoadFailure, trouble-code-uds=Power_Path_085_Over_Load_Failure  # Event_Dtc_Map_Power_Path_085_Over_Load_Failure
  diagnostic event to operation cycle mapping EventOperCycleMapPowerPath085OverLoadFailure: diagnostic-event=EventPowerPath085OverLoadFailure, operation-cycle=DefaultOperationCycle  # Event_Oper_Cycle_Map_Power_Path_085_Over_Load_Failure
  diagnostic event to debounce algorithm mapping EventDebounceMapPowerPath085OverLoadFailure: debounce-algorithm=time_based, diagnostic-event=EventPowerPath085OverLoadFailure  # EventDebounceMap_Power_Path_085_Over_Load_Failure
package /ZeC/DTC/DTC/LIN_23_Databus_No_Comm
  diagnostic trouble code uds LIN_23_Databus_No_Comm: dtc-props=Dtc_Props_358996c7, uds-dtc-value=0x031820  # LIN 23 Databus_No_Comm
  diagnostic event EventLIN23DatabusNoComm: aging-allowed=true, event-kind=SWC, prestorage-freeze-frame=false  # Event_LIN 23 Databus_No_Comm
  diagnostic event to trouble code uds mapping EventDtcMapLIN23DatabusNoComm: diagnostic-event=EventLIN23DatabusNoComm, trouble-code-uds=LIN_23_Databus_No_Comm  # Event_Dtc_Map_LIN 23 Databus_No_Comm
  diagnostic event to operation cycle mapping EventOperCycleMapLIN23DatabusNoComm: diagnostic-event=EventLIN23DatabusNoComm, operation-cycle=DefaultOperationCycle  # Event_Oper_Cycle_Map_LIN 23 Databus_No_Comm
  diagnostic event to debounce algorithm mapping EventDebounceMapLIN23DatabusNoComm: debounce-algorithm=counter_based, diagnostic-event=EventLIN23DatabusNoComm  # EventDebounceMap_LIN 23 Databus_No_Comm
package /ZeC/DTC/DTC/Power_Path_088_Over_Load_Failure
  diagnostic trouble code uds Power_Path_088_Over_Load_Failure: dtc-props=Dtc_Props_1537df27, uds-dtc-value=0x005558
  diagnostic event EventPowerPath088OverLoadFailure: aging-allowed=true, event-kind=SWC, prestorage-freeze-frame=false  # Event_Power_Path_088_Over_Load_Failure
  diagnostic event to trouble code uds mapping EventDtcMapPowerPath088OverLoadFailure: diagnostic-event=EventPowerPath088OverLoadFailure, trouble-code-uds=Power_Path_088_Over_Load_Failure  # Event_Dtc_Map_Power_Path_088_Over_Load_Failure
  diagnostic event to operation cycle mapping EventOperCycleMapPowerPath088OverLoadFailure: diagnostic-event=EventPowerPath088OverLoadFailure, operation-cycle=DefaultOperationCycle  # Event_Oper_Cycle_Map_Power_Path_088_Over_Load_Failure
  diagnostic event to debounce algorithm mapping EventDebounceMapPowerPath088OverLoadFailure: debounce-algorithm=time_based, diagnostic-event=EventPowerPath088OverLoadFailure  # EventDebounceMap_Power_Path_088_Over_Load_Failure
package /ZeC/DTC/DTC/LIN_23_Local_Databus_Electrical_Failure
  diagnostic trouble code uds LIN_23_Local_Databus_Electrical_Failure: dtc-props=Dtc_Props_358996c7, uds-dtc-value=0x031821  # LIN 23 Local_Databus_Electrical_Failure
  diagnostic event EventLIN23LocalDatabusElectricalFailure: aging-allowed=true, event-kind=SWC, prestorage-freeze-frame=false  # Event_LIN 23 Local_Databus_Electrical_Failure
  diagnostic event to trouble code uds mapping EventDtcMapLIN23LocalDatabusElectricalFailure: diagnostic-event=EventLIN23LocalDatabusElectricalFailure, trouble-code-uds=LIN_23_Local_Databus_Electrical_Failure  # Event_Dtc_Map_LIN 23 Local_Databus_Electrical_Failure
  diagnostic event to operation cycle mapping EventOperCycleMapLIN23LocalDatabusElectricalFailure: diagnostic-event=EventLIN23LocalDatabusElectricalFailure, operation-cycle=DefaultOperationCycle  # Event_Oper_Cycle_Map_LIN 23 Local_Databus_Electrical_Failure
  diagnostic event to debounce algorithm mapping EventDebounceMapLIN23LocalDatabusElectricalFailure: debounce-algorithm=counter_based, diagnostic-event=EventLIN23LocalDatabusElectricalFailure  # EventDebounceMap_LIN 23 Local_Databus_Electrical_Failure
package /ZeC/DTC/DTC/Power_Path_087_Over_Load_Failure
  diagnostic trouble code uds Power_Path_087_Over_Load_Failure: dtc-props=Dtc_Props_4152b4d3, uds-dtc-value=0x005557
  diagnostic event EventPowerPath087OverLoadFailure: aging-allowed=true, event-kind=SWC, prestorage-freeze-frame=false  # Event_Power_Path_087_Over_Load_Failure
  diagnostic event to trouble code uds mapping EventDtcMapPowerPath087OverLoadFailure: diagnostic-event=EventPowerPath087OverLoadFailure, trouble-code-uds=Power_Path_087_Over_Load_Failure  # Event_Dtc_Map_Power_Path_087_Over_Load_Failure
  diagnostic event to operation cycle mapping EventOperCycleMapPowerPath087OverLoadFailure: diagnostic-event=EventPowerPath087OverLoadFailure, operation-cycle=DefaultOperationCycle  # Event_Oper_Cycle_Map_Power_Path_087_Over_Load_Failure
  diagnostic event to debounce algorithm mapping EventDebounceMapPowerPath087OverLoadFailure: debounce-algorithm=time_based, diagnostic-event=EventPowerPath087OverLoadFailure  # EventDebounceMap_Power_Path_087_Over_Load_Failure
package /ZeC/DTC/DTC/Power_Path_091_Over_Load_Failure
  diagnostic trouble code uds Power_Path_091_Over_Load_Failure: dtc-props=Dtc_Props_f9a1f43d, uds-dtc-value=0x00555b
  diagnostic event EventPowerPath091OverLoadFailure: aging-allowed=true, event-kind=SWC, prestorage-freeze-frame=false  # Event_Power_Path_091_Over_Load_Failure
  diagnostic event to trouble code uds mapping EventDtcMapPowerPath091OverLoadFailure: diagnostic-event=EventPowerPath091OverLoadFailure, trouble-code-uds=Power_Path_091_Over_Load_Failure  # Event_Dtc_Map_Power_Path_091_Over_Load_Failure
  diagnostic event to operation cycle mapping EventOperCycleMapPowerPath091OverLoadFailure: diagnostic-event=EventPowerPath091OverLoadFailure, operation-cycle=DefaultOperationCycle  # Event_Oper_Cycle_Map_Power_Path_091_Over_Load_Failure
  diagnostic event to debounce algorithm mapping EventDebounceMapPowerPath091OverLoadFailure: debounce-algorithm=time_based, diagnostic-event=EventPowerPath091OverLoadFailure  # EventDebounceMap_Power_Path_091_Over_Load_Failure
package /ZeC/DTC/DTC/Power_Path_090_Over_Load_Failure
  diagnostic trouble code uds Power_Path_090_Over_Load_Failure: dtc-props=Dtc_Props_338aea73, uds-dtc-value=0x00555a
  diagnostic event EventPowerPath090OverLoadFailure: aging-allowed=true, event-kind=SWC, prestorage-freeze-frame=false  # Event_Power_Path_090_Over_Load_Failure
  diagnostic event to trouble code uds mapping EventDtcMapPowerPath090OverLoadFailure: diagnostic-event=EventPowerPath090OverLoadFailure, trouble-code-uds=Power_Path_090_Over_Load_Failure  # Event_Dtc_Map_Power_Path_090_Over_Load_Failure
  diagnostic event to operation cycle mapping EventOperCycleMapPowerPath090OverLoadFailure: diagnostic-event=EventPowerPath090OverLoadFailure, operation-cycle=DefaultOperationCycle  # Event_Oper_Cycle_Map_Power_Path_090_Over_Load_Failure
  diagnostic event to debounce algorithm mapping EventDebounceMapPowerPath090OverLoadFailure: debounce-algorithm=time_based, diagnostic-event=EventPowerPath090OverLoadFailure  # EventDebounceMap_Power_Path_090_Over_Load_Failure
package /ZeC/DTC/DTC/Power_Path_093_Over_Load_Failure
  diagnostic trouble code uds Power_Path_093_Over_Load_Failure: dtc-props=Dtc_Props_b686cee0, uds-dtc-value=0x00555d
  diagnostic event EventPowerPath093OverLoadFailure: aging-allowed=true, event-kind=SWC, prestorage-freeze-frame=false  # Event_Power_Path_093_Over_Load_Failure
  diagnostic event to trouble code uds mapping EventDtcMapPowerPath093OverLoadFailure: diagnostic-event=EventPowerPath093OverLoadFailure, trouble-code-uds=Power_Path_093_Over_Load_Failure  # Event_Dtc_Map_Power_Path_093_Over_Load_Failure
  diagnostic event to operation cycle mapping EventOperCycleMapPowerPath093OverLoadFailure: diagnostic-event=EventPowerPath093OverLoadFailure, operation-cycle=DefaultOperationCycle  # Event_Oper_Cycle_Map_Power_Path_093_Over_Load_Failure
  diagnostic event to debounce algorithm mapping EventDebounceMapPowerPath093OverLoadFailure: debounce-algorithm=time_based, diagnostic-event=EventPowerPath093OverLoadFailure  # EventDebounceMap_Power_Path_093_Over_Load_Failure
package /ZeC/DTC/DTC/Power_Path_092_Over_Load_Failure
  diagnostic trouble code uds Power_Path_092_Over_Load_Failure: dtc-props=Dtc_Props_bfb8fe07, uds-dtc-value=0x00555c
  diagnostic event EventPowerPath092OverLoadFailure: aging-allowed=true, event-kind=SWC, prestorage-freeze-frame=false  # Event_Power_Path_092_Over_Load_Failure
  diagnostic event to trouble code uds mapping EventDtcMapPowerPath092OverLoadFailure: diagnostic-event=EventPowerPath092OverLoadFailure, trouble-code-uds=Power_Path_092_Over_Load_Failure  # Event_Dtc_Map_Power_Path_092_Over_Load_Failure
  diagnostic event to operation cycle mapping EventOperCycleMapPowerPath092OverLoadFailure: diagnostic-event=EventPowerPath092OverLoadFailure, operation-cycle=DefaultOperationCycle  # Event_Oper_Cycle_Map_Power_Path_092_Over_Load_Failure
  diagnostic event to debounce algorithm mapping EventDebounceMapPowerPath092OverLoadFailure: debounce-algorithm=time_based, diagnostic-event=EventPowerPath092OverLoadFailure  # EventDebounceMap_Power_Path_092_Over_Load_Failure
package /ZeC/DTC/DTC/LIN_15_Slave_8_NoCommunication
  diagnostic trouble code uds LIN_15_Slave_8_NoCommunication: dtc-props=Dtc_Props_358996c7, uds-dtc-value=0x030f09  # LIN 15 Slave 8_NoCommunication
  diagnostic event EventLIN15Slave8NoCommunication: aging-allowed=true, event-kind=SWC, prestorage-freeze-frame=false  # Event_LIN 15 Slave 8_NoCommunication
  diagnostic event to trouble code uds mapping EventDtcMapLIN15Slave8NoCommunication: diagnostic-event=EventLIN15Slave8NoCommunication, trouble-code-uds=LIN_15_Slave_8_NoCommunication  # Event_Dtc_Map_LIN 15 Slave 8_NoCommunication
  diagnostic event to operation cycle mapping EventOperCycleMapLIN15Slave8NoCommunication: diagnostic-event=EventLIN15Slave8NoCommunication, operation-cycle=DefaultOperationCycle  # Event_Oper_Cycle_Map_LIN 15 Slave 8_NoCommunication
  diagnostic event to debounce algorithm mapping EventDebounceMapLIN15Slave8NoCommunication: debounce-algorithm=counter_based, diagnostic-event=EventLIN15Slave8NoCommunication  # EventDebounceMap_LIN 15 Slave 8_NoCommunication
package /ZeC/DTC/DTC/LIN_15_Slave_7_NoCommunication
  diagnostic trouble code uds LIN_15_Slave_7_NoCommunication: dtc-props=Dtc_Props_358996c7, uds-dtc-value=0x030f07  # LIN 15 Slave 7_NoCommunication
  diagnostic event EventLIN15Slave7NoCommunication: aging-allowed=true, event-kind=SWC, prestorage-freeze-frame=false  # Event_LIN 15 Slave 7_NoCommunication
  diagnostic event to trouble code uds mapping EventDtcMapLIN15Slave7NoCommunication: diagnostic-event=EventLIN15Slave7NoCommunication, trouble-code-uds=LIN_15_Slave_7_NoCommunication  # Event_Dtc_Map_LIN 15 Slave 7_NoCommunication
  diagnostic event to operation cycle mapping EventOperCycleMapLIN15Slave7NoCommunication: diagnostic-event=EventLIN15Slave7NoCommunication, operation-cycle=DefaultOperationCycle  # Event_Oper_Cycle_Map_LIN 15 Slave 7_NoCommunication
  diagnostic event to debounce algorithm mapping EventDebounceMapLIN15Slave7NoCommunication: debounce-algorithm=counter_based, diagnostic-event=EventLIN15Slave7NoCommunication  # EventDebounceMap_LIN 15 Slave 7_NoCommunication
package /ZeC/DTC/DTC/LIN_15_Slave_8_Defect
  diagnostic trouble code uds LIN_15_Slave_8_Defect: dtc-props=Dtc_Props_358996c7, uds-dtc-value=0x030f08  # LIN 15 Slave 8_Defect
  diagnostic event EventLIN15Slave8Defect: aging-allowed=true, event-kind=SWC, prestorage-freeze-frame=false  # Event_LIN 15 Slave 8_Defect
  diagnostic event to trouble code uds mapping EventDtcMapLIN15Slave8Defect: diagnostic-event=EventLIN15Slave8Defect, trouble-code-uds=LIN_15_Slave_8_Defect  # Event_Dtc_Map_LIN 15 Slave 8_Defect
  diagnostic event to operation cycle mapping EventOperCycleMapLIN15Slave8Defect: diagnostic-event=EventLIN15Slave8Defect, operation-cycle=DefaultOperationCycle  # Event_Oper_Cycle_Map_LIN 15 Slave 8_Defect
  diagnostic event to debounce algorithm mapping EventDebounceMapLIN15Slave8Defect: debounce-algorithm=counter_based, diagnostic-event=EventLIN15Slave8Defect  # EventDebounceMap_LIN 15 Slave 8_Defect
package /ZeC/DTC/DTC/LIN_15_Slave_14_Defect
  diagnostic trouble code uds LIN_15_Slave_14_Defect: dtc-props=Dtc_Props_358996c7, uds-dtc-value=0x030f16  # LIN 15 Slave 14_Defect
  diagnostic event EventLIN15Slave14Defect: aging-allowed=true, event-kind=SWC, prestorage-freeze-frame=false  # Event_LIN 15 Slave 14_Defect
  diagnostic event to trouble code uds mapping EventDtcMapLIN15Slave14Defect: diagnostic-event=EventLIN15Slave14Defect, trouble-code-uds=LIN_15_Slave_14_Defect  # Event_Dtc_Map_LIN 15 Slave 14_Defect
  diagnostic event to operation cycle mapping EventOperCycleMapLIN15Slave14Defect: diagnostic-event=EventLIN15Slave14Defect, operation-cycle=DefaultOperationCycle  # Event_Oper_Cycle_Map_LIN 15 Slave 14_Defect
  diagnostic event to debounce algorithm mapping EventDebounceMapLIN15Slave14Defect: debounce-algorithm=counter_based, diagnostic-event=EventLIN15Slave14Defect  # EventDebounceMap_LIN 15 Slave 14_Defect
package /ZeC/DTC/DTC/LIN_15_Slave_14_NoCommunication
  diagnostic trouble code uds LIN_15_Slave_14_NoCommunication: dtc-props=Dtc_Props_358996c7, uds-dtc-value=0x030f17  # LIN 15 Slave 14_NoCommunication
  diagnostic event EventLIN15Slave14NoCommunication: aging-allowed=true, event-kind=SWC, prestorage-freeze-frame=false  # Event_LIN 15 Slave 14_NoCommunication
  diagnostic event to trouble code uds mapping EventDtcMapLIN15Slave14NoCommunication: diagnostic-event=EventLIN15Slave14NoCommunication, trouble-code-uds=LIN_15_Slave_14_NoCommunication  # Event_Dtc_Map_LIN 15 Slave 14_NoCommunication
  diagnostic event to operation cycle mapping EventOperCycleMapLIN15Slave14NoCommunication: diagnostic-event=EventLIN15Slave14NoCommunication, operation-cycle=DefaultOperationCycle  # Event_Oper_Cycle_Map_LIN 15 Slave 14_NoCommunication
  diagnostic event to debounce algorithm mapping EventDebounceMapLIN15Slave14NoCommunication: debounce-algorithm=counter_based, diagnostic-event=EventLIN15Slave14NoCommunication  # EventDebounceMap_LIN 15 Slave 14_NoCommunication
package /ZeC/DTC/DTC/LIN_15_Slave_13_Defect
  diagnostic trouble code uds LIN_15_Slave_13_Defect: dtc-props=Dtc_Props_358996c7, uds-dtc-value=0x030f14  # LIN 15 Slave 13_Defect
  diagnostic event EventLIN15Slave13Defect: aging-allowed=true, event-kind=SWC, prestorage-freeze-frame=false  # Event_LIN 15 Slave 13_Defect
  diagnostic event to trouble code uds mapping EventDtcMapLIN15Slave13Defect: diagnostic-event=EventLIN15Slave13Defect, trouble-code-uds=LIN_15_Slave_13_Defect  # Event_Dtc_Map_LIN 15 Slave 13_Defect
  diagnostic event to operation cycle mapping EventOperCycleMapLIN15Slave13Defect: diagnostic-event=EventLIN15Slave13Defect, operation-cycle=DefaultOperationCycle  # Event_Oper_Cycle_Map_LIN 15 Slave 13_Defect
  diagnostic event to debounce algorithm mapping EventDebounceMapLIN15Slave13Defect: debounce-algorithm=counter_based, diagnostic-event=EventLIN15Slave13Defect  # EventDebounceMap_LIN 15 Slave 13_Defect
package /ZeC/DTC/DTC/LIN_15_Slave_13_NoCommunication
  diagnostic trouble code uds LIN_15_Slave_13_NoCommunication: dtc-props=Dtc_Props_358996c7, uds-dtc-value=0x030f15  # LIN 15 Slave 13_NoCommunication
  diagnostic event EventLIN15Slave13NoCommunication: aging-allowed=true, event-kind=SWC, prestorage-freeze-frame=false  # Event_LIN 15 Slave 13_NoCommunication
  diagnostic event to trouble code uds mapping EventDtcMapLIN15Slave13NoCommunication: diagnostic-event=EventLIN15Slave13NoCommunication, trouble-code-uds=LIN_15_Slave_13_NoCommunication  # Event_Dtc_Map_LIN 15 Slave 13_NoCommunication
  diagnostic event to operation cycle mapping EventOperCycleMapLIN15Slave13NoCommunication: diagnostic-event=EventLIN15Slave13NoCommunication, operation-cycle=DefaultOperationCycle  # Event_Oper_Cycle_Map_LIN 15 Slave 13_NoCommunication
  diagnostic event to debounce algorithm mapping EventDebounceMapLIN15Slave13NoCommunication: debounce-algorithm=counter_based, diagnostic-event=EventLIN15Slave13NoCommunication  # EventDebounceMap_LIN 15 Slave 13_NoCommunication
package /ZeC/DTC/DTC/LIN_15_Slave_12_Defect
  diagnostic trouble code uds LIN_15_Slave_12_Defect: dtc-props=Dtc_Props_358996c7, uds-dtc-value=0x030f12  # LIN 15 Slave 12_Defect
  diagnostic event EventLIN15Slave12Defect: aging-allowed=true, event-kind=SWC, prestorage-freeze-frame=false  # Event_LIN 15 Slave 12_Defect
  diagnostic event to trouble code uds mapping EventDtcMapLIN15Slave12Defect: diagnostic-event=EventLIN15Slave12Defect, trouble-code-uds=LIN_15_Slave_12_Defect  # Event_Dtc_Map_LIN 15 Slave 12_Defect
  diagnostic event to operation cycle mapping EventOperCycleMapLIN15Slave12Defect: diagnostic-event=EventLIN15Slave12Defect, operation-cycle=DefaultOperationCycle  # Event_Oper_Cycle_Map_LIN 15 Slave 12_Defect
  diagnostic event to debounce algorithm mapping EventDebounceMapLIN15Slave12Defect: debounce-algorithm=counter_based, diagnostic-event=EventLIN15Slave12Defect  # EventDebounceMap_LIN 15 Slave 12_Defect
package /ZeC/DTC/DTC/Power_Path_095_Over_Load_Failure
  diagnostic trouble code uds Power_Path_095_Over_Load_Failure: dtc-props=Dtc_Props_3ab4da94, uds-dtc-value=0x00555f
  diagnostic event EventPowerPath095OverLoadFailure: aging-allowed=true, event-kind=SWC, prestorage-freeze-frame=false  # Event_Power_Path_095_Over_Load_Failure
  diagnostic event to trouble code uds mapping EventDtcMapPowerPath095OverLoadFailure: diagnostic-event=EventPowerPath095OverLoadFailure, trouble-code-uds=Power_Path_095_Over_Load_Failure  # Event_Dtc_Map_Power_Path_095_Over_Load_Failure
  diagnostic event to operation cycle mapping EventOperCycleMapPowerPath095OverLoadFailure: diagnostic-event=EventPowerPath095OverLoadFailure, operation-cycle=DefaultOperationCycle  # Event_Oper_Cycle_Map_Power_Path_095_Over_Load_Failure
  diagnostic event to debounce algorithm mapping EventDebounceMapPowerPath095OverLoadFailure: debounce-algorithm=time_based, diagnostic-event=EventPowerPath095OverLoadFailure  # EventDebounceMap_Power_Path_095_Over_Load_Failure
package /ZeC/DTC/DTC/LIN_15_Slave_12_NoCommunication
  diagnostic trouble code uds LIN_15_Slave_12_NoCommunication: dtc-props=Dtc_Props_358996c7, uds-dtc-value=0x030f13  # LIN 15 Slave 12_NoCommunication
  diagnostic event EventLIN15Slave12NoCommunication: aging-allowed=true, event-kind=SWC, prestorage-freeze-frame=false  # Event_LIN 15 Slave 12_NoCommunication
  diagnostic event to trouble code uds mapping EventDtcMapLIN15Slave12NoCommunication: diagnostic-event=EventLIN15Slave12NoCommunication, trouble-code-uds=LIN_15_Slave_12_NoCommunication  # Event_Dtc_Map_LIN 15 Slave 12_NoCommunication
  diagnostic event to operation cycle mapping EventOperCycleMapLIN15Slave12NoCommunication: diagnostic-event=EventLIN15Slave12NoCommunication, operation-cycle=DefaultOperationCycle  # Event_Oper_Cycle_Map_LIN 15 Slave 12_NoCommunication
  diagnostic event to debounce algorithm mapping EventDebounceMapLIN15Slave12NoCommunication: debounce-algorithm=counter_based, diagnostic-event=EventLIN15Slave12NoCommunication  # EventDebounceMap_LIN 15 Slave 12_NoCommunication
package /ZeC/DTC/DTC/Power_Path_094_Over_Load_Failure
  diagnostic trouble code uds Power_Path_094_Over_Load_Failure: dtc-props=Dtc_Props_f09fc4da, uds-dtc-value=0x00555e
  diagnostic event EventPowerPath094OverLoadFailure: aging-allowed=true, event-kind=SWC, prestorage-freeze-frame=false  # Event_Power_Path_094_Over_Load_Failure
  diagnostic event to trouble code uds mapping EventDtcMapPowerPath094OverLoadFailure: diagnostic-event=EventPowerPath094OverLoadFailure, trouble-code-uds=Power_Path_094_Over_Load_Failure  # Event_Dtc_Map_Power_Path_094_Over_Load_Failure
  diagnostic event to operation cycle mapping EventOperCycleMapPowerPath094OverLoadFailure: diagnostic-event=EventPowerPath094OverLoadFailure, operation-cycle=DefaultOperationCycle  # Event_Oper_Cycle_Map_Power_Path_094_Over_Load_Failure
  diagnostic event to debounce algorithm mapping EventDebounceMapPowerPath094OverLoadFailure: debounce-algorithm=time_based, diagnostic-event=EventPowerPath094OverLoadFailure  # EventDebounceMap_Power_Path_094_Over_Load_Failure
package /ZeC/DTC/DTC/LIN_15_Slave_11_Defect
  diagnostic trouble code uds LIN_15_Slave_11_Defect: dtc-props=Dtc_Props_358996c7, uds-dtc-value=0x030f10  # LIN 15 Slave 11_Defect
  diagnostic event EventLIN15Slave11Defect: aging-allowed=true, event-kind=SWC, prestorage-freeze-frame=false  # Event_LIN 15 Slave 11_Defect
  diagnostic event to trouble code uds mapping EventDtcMapLIN15Slave11Defect: diagnostic-event=EventLIN15Slave11Defect, trouble-code-uds=LIN_15_Slave_11_Defect  # Event_Dtc_Map_LIN 15 Slave 11_Defect
  diagnostic event to operation cycle mapping EventOperCycleMapLIN15Slave11Defect: diagnostic-event=EventLIN15Slave11Defect, operation-cycle=DefaultOperationCycle  # Event_Oper_Cycle_Map_LIN 15 Slave 11_Defect
  diagnostic event to debounce algorithm mapping EventDebounceMapLIN15Slave11Defect: debounce-algorithm=counter_based, diagnostic-event=EventLIN15Slave11Defect  # EventDebounceMap_LIN 15 Slave 11_Defect
package /ZeC/DTC/DTC/LIN_15_Slave_11_NoCommunication
  diagnostic trouble code uds LIN_15_Slave_11_NoCommunication: dtc-props=Dtc_Props_358996c7, uds-dtc-value=0x030f11  # LIN 15 Slave 11_NoCommunication
  diagnostic event EventLIN15Slave11NoCommunication: aging-allowed=true, event-kind=SWC, prestorage-freeze-frame=false  # Event_LIN 15 Slave 11_NoCommunication
  diagnostic event to trouble code uds mapping EventDtcMapLIN15Slave11NoCommunication: diagnostic-event=EventLIN15Slave11NoCommunication, trouble-code-uds=LIN_15_Slave_11_NoCommunication  # Event_Dtc_Map_LIN 15 Slave 11_NoCommunication
  diagnostic event to operation cycle mapping EventOperCycleMapLIN15Slave11NoCommunication: diagnostic-event=EventLIN15Slave11NoCommunication, operation-cycle=DefaultOperationCycle  # Event_Oper_Cycle_Map_LIN 15 Slave 11_NoCommunication
  diagnostic event to debounce algorithm mapping EventDebounceMapLIN15Slave11NoCommunication: debounce-algorithm=counter_based, diagnostic-event=EventLIN15Slave11NoCommunication  # EventDebounceMap_LIN 15 Slave 11_NoCommunication
package /ZeC/DTC/DTC/Power_Path_099_Over_Load_Failure
  diagnostic trouble code uds Power_Path_099_Over_Load_Failure: dtc-props=Dtc_Props_13e9ddf3, uds-dtc-value=0x005563
  diagnostic event EventPowerPath099OverLoadFailure: aging-allowed=true, event-kind=SWC, prestorage-freeze-frame=false  # Event_Power_Path_099_Over_Load_Failure
  diagnostic event to trouble code uds mapping EventDtcMapPowerPath099OverLoadFailure: diagnostic-event=EventPowerPath099OverLoadFailure, trouble-code-uds=Power_Path_099_Over_Load_Failure  # Event_Dtc_Map_Power_Path_099_Over_Load_Failure
  diagnostic event to operation cycle mapping EventOperCycleMapPowerPath099OverLoadFailure: diagnostic-event=EventPowerPath099OverLoadFailure, operation-cycle=DefaultOperationCycle  # Event_Oper_Cycle_Map_Power_Path_099_Over_Load_Failure
  diagnostic event to debounce algorithm mapping EventDebounceMapPowerPath099OverLoadFailure: debounce-algorithm=time_based, diagnostic-event=EventPowerPath099OverLoadFailure  # EventDebounceMap_Power_Path_099_Over_Load_Failure
package /ZeC/DTC/DTC/Power_Path_098_Over_Load_Failure
  diagnostic trouble code uds Power_Path_098_Over_Load_Failure: dtc-props=Dtc_Props_55f0d7c9, uds-dtc-value=0x005562
  diagnostic event EventPowerPath098OverLoadFailure: aging-allowed=true, event-kind=SWC, prestorage-freeze-frame=false  # Event_Power_Path_098_Over_Load_Failure
  diagnostic event to trouble code uds mapping EventDtcMapPowerPath098OverLoadFailure: diagnostic-event=EventPowerPath098OverLoadFailure, trouble-code-uds=Power_Path_098_Over_Load_Failure  # Event_Dtc_Map_Power_Path_098_Over_Load_Failure
  diagnostic event to operation cycle mapping EventOperCycleMapPowerPath098OverLoadFailure: diagnostic-event=EventPowerPath098OverLoadFailure, operation-cycle=DefaultOperationCycle  # Event_Oper_Cycle_Map_Power_Path_098_Over_Load_Failure
  diagnostic event to debounce algorithm mapping EventDebounceMapPowerPath098OverLoadFailure: debounce-algorithm=time_based, diagnostic-event=EventPowerPath098OverLoadFailure  # EventDebounceMap_Power_Path_098_Over_Load_Failure
package /ZeC/DTC/DTC/Power_Path_101_Over_Load_Failure
  diagnostic trouble code uds Power_Path_101_Over_Load_Failure: dtc-props=Dtc_Props_5ccee72e, uds-dtc-value=0x005565
  diagnostic event EventPowerPath101OverLoadFailure: aging-allowed=true, event-kind=SWC, prestorage-freeze-frame=false  # Event_Power_Path_101_Over_Load_Failure
  diagnostic event to trouble code uds mapping EventDtcMapPowerPath101OverLoadFailure: diagnostic-event=EventPowerPath101OverLoadFailure, trouble-code-uds=Power_Path_101_Over_Load_Failure  # Event_Dtc_Map_Power_Path_101_Over_Load_Failure
  diagnostic event to operation cycle mapping EventOperCycleMapPowerPath101OverLoadFailure: diagnostic-event=EventPowerPath101OverLoadFailure, operation-cycle=DefaultOperationCycle  # Event_Oper_Cycle_Map_Power_Path_101_Over_Load_Failure
  diagnostic event to debounce algorithm mapping EventDebounceMapPowerPath101OverLoadFailure: debounce-algorithm=time_based, diagnostic-event=EventPowerPath101OverLoadFailure  # EventDebounceMap_Power_Path_101_Over_Load_Failure
package /ZeC/DTC/DTC/Power_Path_100_Over_Load_Failure
  diagnostic trouble code uds Power_Path_100_Over_Load_Failure: dtc-props=Dtc_Props_1ad7ed14, uds-dtc-value=0x005564
  diagnostic event EventPowerPath100OverLoadFailure: aging-allowed=true, event-kind=SWC, prestorage-freeze-frame=false  # Event_Power_Path_100_Over_Load_Failure
  diagnostic event to trouble code uds mapping EventDtcMapPowerPath100OverLoadFailure: diagnostic-event=EventPowerPath100OverLoadFailure, trouble-code-uds=Power_Path_100_Over_Load_Failure  # Event_Dtc_Map_Power_Path_100_Over_Load_Failure
  diagnostic event to operation cycle mapping EventOperCycleMapPowerPath100OverLoadFailure: diagnostic-event=EventPowerPath100OverLoadFailure, operation-cycle=DefaultOperationCycle  # Event_Oper_Cycle_Map_Power_Path_100_Over_Load_Failure
  diagnostic event to debounce algorithm mapping EventDebounceMapPowerPath100OverLoadFailure: debounce-algorithm=time_based, diagnostic-event=EventPowerPath100OverLoadFailure  # EventDebounceMap_Power_Path_100_Over_Load_Failure
package /ZeC/DTC/DTC/Power_Path_097_Over_Load_Failure
  diagnostic trouble code uds Power_Path_097_Over_Load_Failure: dtc-props=Dtc_Props_9fdbc987, uds-dtc-value=0x005561
  diagnostic event EventPowerPath097OverLoadFailure: aging-allowed=true, event-kind=SWC, prestorage-freeze-frame=false  # Event_Power_Path_097_Over_Load_Failure
  diagnostic event to trouble code uds mapping EventDtcMapPowerPath097OverLoadFailure: diagnostic-event=EventPowerPath097OverLoadFailure, trouble-code-uds=Power_Path_097_Over_Load_Failure  # Event_Dtc_Map_Power_Path_097_Over_Load_Failure
  diagnostic event to operation cycle mapping EventOperCycleMapPowerPath097OverLoadFailure: diagnostic-event=EventPowerPath097OverLoadFailure, operation-cycle=DefaultOperationCycle  # Event_Oper_Cycle_Map_Power_Path_097_Over_Load_Failure
  diagnostic event to debounce algorithm mapping EventDebounceMapPowerPath097OverLoadFailure: debounce-algorithm=time_based, diagnostic-event=EventPowerPath097OverLoadFailure  # EventDebounceMap_Power_Path_097_Over_Load_Failure
package /ZeC/DTC/DTC/Power_Path_096_Over_Load_Failure
  diagnostic trouble code uds Power_Path_096_Over_Load_Failure: dtc-props=Dtc_Props_d9c2c3bd, uds-dtc-value=0x005560
  diagnostic event EventPowerPath096OverLoadFailure: aging-allowed=true, event-kind=SWC, prestorage-freeze-frame=false  # Event_Power_Path_096_Over_Load_Failure
  diagnostic event to trouble code uds mapping EventDtcMapPowerPath096OverLoadFailure: diagnostic-event=EventPowerPath096OverLoadFailure, trouble-code-uds=Power_Path_096_Over_Load_Failure  # Event_Dtc_Map_Power_Path_096_Over_Load_Failure
  diagnostic event to operation cycle mapping EventOperCycleMapPowerPath096OverLoadFailure: diagnostic-event=EventPowerPath096OverLoadFailure, operation-cycle=DefaultOperationCycle  # Event_Oper_Cycle_Map_Power_Path_096_Over_Load_Failure
  diagnostic event to debounce algorithm mapping EventDebounceMapPowerPath096OverLoadFailure: debounce-algorithm=time_based, diagnostic-event=EventPowerPath096OverLoadFailure  # EventDebounceMap_Power_Path_096_Over_Load_Failure
package /ZeC/DTC/DtcProps
  168 x diagnostic trouble code props, all with aging=DefaultAging, memory-destination=Primary:
    Dtc_Props_358996c7: extended-data-records=[StandardDTCInformation, StandFreezeFrame], priority=2  # priority: 2 / aging: /ZeC/DTC/DefaultAging / extended data records: /ZeC/DTC/ExtendedDataRecords/StandardDTCInformation /ZeC/DTC/ExtendedDataRecords/StandFreezeFrame / no value for freeze frame content / no value for freeze frame identifier / no value for number of freeze frames / memory selections: /ZeC/DTC/Primary
    Dtc_Props_76c48c34: extended-data-records=[StandardDTCInformation, StandFreezeFrame, Record8], priority=6  # priority: 6 / aging: /ZeC/DTC/DefaultAging / extended data records: /ZeC/DTC/ExtendedDataRecords/StandardDTCInformation /ZeC/DTC/ExtendedDataRecords/StandFreezeFrame /ZeC/DTC/ExtendedDataRecords/Record8 / no value for freeze frame content / no value for freeze frame identifier / no value for number of freeze frames / memory selections: /ZeC/DTC/Primary
    Dtc_Props_deea3e2c: extended-data-records=[StandardDTCInformation, StandFreezeFrame], freeze-frame-content=DataIdentifierSet0x798a, max-number-freeze-frame-records=6, priority=4  # priority: 4 / aging: /ZeC/DTC/DefaultAging / extended data records: /ZeC/DTC/ExtendedDataRecords/StandardDTCInformation /ZeC/DTC/ExtendedDataRecords/StandFreezeFrame / freeze frame content: /ZeC/DTC/FreezeFrames/DataIdentifierSet0x798a / no value for freeze frame identifier / number of freeze frames: 6 / memory selections: /ZeC/DTC/Primary
    Dtc_Props_d7d40ecb: extended-data-records=[StandardDTCInformation, StandFreezeFrame], freeze-frame-content=DataIdentifierSet0x798f, max-number-freeze-frame-records=6, priority=4  # priority: 4 / aging: /ZeC/DTC/DefaultAging / extended data records: /ZeC/DTC/ExtendedDataRecords/StandardDTCInformation /ZeC/DTC/ExtendedDataRecords/StandFreezeFrame / freeze frame content: /ZeC/DTC/FreezeFrames/DataIdentifierSet0x798f / no value for freeze frame identifier / number of freeze frames: 6 / memory selections: /ZeC/DTC/Primary
    Dtc_Props_52d82a58: extended-data-records=[StandardDTCInformation, StandFreezeFrame], freeze-frame-content=DataIdentifierSet0x798c, max-number-freeze-frame-records=6, priority=4  # priority: 4 / aging: /ZeC/DTC/DefaultAging / extended data records: /ZeC/DTC/ExtendedDataRecords/StandardDTCInformation /ZeC/DTC/ExtendedDataRecords/StandFreezeFrame / freeze frame content: /ZeC/DTC/FreezeFrames/DataIdentifierSet0x798c / no value for freeze frame identifier / number of freeze frames: 6 / memory selections: /ZeC/DTC/Primary
    Dtc_Props_14c12062: extended-data-records=[StandardDTCInformation, StandFreezeFrame], freeze-frame-content=DataIdentifierSet0x798b, max-number-freeze-frame-records=6, priority=4  # priority: 4 / aging: /ZeC/DTC/DefaultAging / extended data records: /ZeC/DTC/ExtendedDataRecords/StandardDTCInformation /ZeC/DTC/ExtendedDataRecords/StandFreezeFrame / freeze frame content: /ZeC/DTC/FreezeFrames/DataIdentifierSet0x798b / no value for freeze frame identifier / number of freeze frames: 6 / memory selections: /ZeC/DTC/Primary
    Dtc_Props_1dff1085: extended-data-records=[StandardDTCInformation, StandFreezeFrame], freeze-frame-content=DataIdentifierSet0x798e, max-number-freeze-frame-records=6, priority=4  # priority: 4 / aging: /ZeC/DTC/DefaultAging / extended data records: /ZeC/DTC/ExtendedDataRecords/StandardDTCInformation /ZeC/DTC/ExtendedDataRecords/StandFreezeFrame / freeze frame content: /ZeC/DTC/FreezeFrames/DataIdentifierSet0x798e / no value for freeze frame identifier / number of freeze frames: 6 / memory selections: /ZeC/DTC/Primary
    Dtc_Props_5be61abf: extended-data-records=[StandardDTCInformation, StandFreezeFrame], freeze-frame-content=DataIdentifierSet0x798d, max-number-freeze-frame-records=6, priority=4  # priority: 4 / aging: /ZeC/DTC/DefaultAging / extended data records: /ZeC/DTC/ExtendedDataRecords/StandardDTCInformation /ZeC/DTC/ExtendedDataRecords/StandFreezeFrame / freeze frame content: /ZeC/DTC/FreezeFrames/DataIdentifierSet0x798d / no value for freeze frame identifier / number of freeze frames: 6 / memory selections: /ZeC/DTC/Primary
    Dtc_Props_634690d3: extended-data-records=[StandardDTCInformation, StandFreezeFrame], freeze-frame-content=DataIdentifierSet0x7990, max-number-freeze-frame-records=6, priority=4  # priority: 4 / aging: /ZeC/DTC/DefaultAging / extended data records: /ZeC/DTC/ExtendedDataRecords/StandardDTCInformation /ZeC/DTC/ExtendedDataRecords/StandFreezeFrame / freeze frame content: /ZeC/DTC/FreezeFrames/DataIdentifierSet0x7990 / no value for freeze frame identifier / number of freeze frames: 6 / memory selections: /ZeC/DTC/Primary
    Dtc_Props_ef7484a7: extended-data-records=[StandardDTCInformation, StandFreezeFrame], freeze-frame-content=DataIdentifierSet0x7992, max-number-freeze-frame-records=6, priority=4  # priority: 4 / aging: /ZeC/DTC/DefaultAging / extended data records: /ZeC/DTC/ExtendedDataRecords/StandardDTCInformation /ZeC/DTC/ExtendedDataRecords/StandFreezeFrame / freeze frame content: /ZeC/DTC/FreezeFrames/DataIdentifierSet0x7992 / no value for freeze frame identifier / number of freeze frames: 6 / memory selections: /ZeC/DTC/Primary
    Dtc_Props_255f9ae9: extended-data-records=[StandardDTCInformation, StandFreezeFrame], freeze-frame-content=DataIdentifierSet0x7991, max-number-freeze-frame-records=6, priority=4  # priority: 4 / aging: /ZeC/DTC/DefaultAging / extended data records: /ZeC/DTC/ExtendedDataRecords/StandardDTCInformation /ZeC/DTC/ExtendedDataRecords/StandFreezeFrame / freeze frame content: /ZeC/DTC/FreezeFrames/DataIdentifierSet0x7991 / no value for freeze frame identifier / number of freeze frames: 6 / memory selections: /ZeC/DTC/Primary
    Dtc_Props_c92c78b3: extended-data-records=[StandardDTCInformation, StandFreezeFrame], freeze-frame-content=DataIdentifierSet0x79a0, max-number-freeze-frame-records=6, priority=4  # priority: 4 / aging: /ZeC/DTC/DefaultAging / extended data records: /ZeC/DTC/ExtendedDataRecords/StandardDTCInformation /ZeC/DTC/ExtendedDataRecords/StandFreezeFrame / freeze frame content: /ZeC/DTC/FreezeFrames/DataIdentifierSet0x79a0 / no value for freeze frame identifier / number of freeze frames: 6 / memory selections: /ZeC/DTC/Primary
    Dtc_Props_3e1dcbc0: extended-data-records=[StandardDTCInformation, StandFreezeFrame], freeze-frame-content=DataIdentifierSet0x7998, max-number-freeze-frame-records=6, priority=4  # priority: 4 / aging: /ZeC/DTC/DefaultAging / extended data records: /ZeC/DTC/ExtendedDataRecords/StandardDTCInformation /ZeC/DTC/ExtendedDataRecords/StandFreezeFrame / freeze frame content: /ZeC/DTC/FreezeFrames/DataIdentifierSet0x7998 / no value for freeze frame identifier / number of freeze frames: 6 / memory selections: /ZeC/DTC/Primary
    Dtc_Props_6a78a034: extended-data-records=[StandardDTCInformation, StandFreezeFrame], freeze-frame-content=DataIdentifierSet0x7997, max-number-freeze-frame-records=6, priority=4  # priority: 4 / aging: /ZeC/DTC/DefaultAging / extended data records: /ZeC/DTC/ExtendedDataRecords/StandardDTCInformation /ZeC/DTC/ExtendedDataRecords/StandFreezeFrame / freeze frame content: /ZeC/DTC/FreezeFrames/DataIdentifierSet0x7997 / no value for freeze frame identifier / number of freeze frames: 6 / memory selections: /ZeC/DTC/Primary
    Dtc_Props_7804c1fa: extended-data-records=[StandardDTCInformation, StandFreezeFrame], freeze-frame-content=DataIdentifierSet0x7999, max-number-freeze-frame-records=6, priority=4  # priority: 4 / aging: /ZeC/DTC/DefaultAging / extended data records: /ZeC/DTC/ExtendedDataRecords/StandardDTCInformation /ZeC/DTC/ExtendedDataRecords/StandFreezeFrame / freeze frame content: /ZeC/DTC/FreezeFrames/DataIdentifierSet0x7999 / no value for freeze frame identifier / number of freeze frames: 6 / memory selections: /ZeC/DTC/Primary
    Dtc_Props_a053be7a: extended-data-records=[StandardDTCInformation, StandFreezeFrame], freeze-frame-content=DataIdentifierSet0x7994, max-number-freeze-frame-records=6, priority=4  # priority: 4 / aging: /ZeC/DTC/DefaultAging / extended data records: /ZeC/DTC/ExtendedDataRecords/StandardDTCInformation /ZeC/DTC/ExtendedDataRecords/StandFreezeFrame / freeze frame content: /ZeC/DTC/FreezeFrames/DataIdentifierSet0x7994 / no value for freeze frame identifier / number of freeze frames: 6 / memory selections: /ZeC/DTC/Primary
    Dtc_Props_a96d8e9d: extended-data-records=[StandardDTCInformation, StandFreezeFrame], freeze-frame-content=DataIdentifierSet0x7993, max-number-freeze-frame-records=6, priority=4  # priority: 4 / aging: /ZeC/DTC/DefaultAging / extended data records: /ZeC/DTC/ExtendedDataRecords/StandardDTCInformation /ZeC/DTC/ExtendedDataRecords/StandFreezeFrame / freeze frame content: /ZeC/DTC/FreezeFrames/DataIdentifierSet0x7993 / no value for freeze frame identifier / number of freeze frames: 6 / memory selections: /ZeC/DTC/Primary
    Dtc_Props_2c61aa0e: extended-data-records=[StandardDTCInformation, StandFreezeFrame], freeze-frame-content=DataIdentifierSet0x7996, max-number-freeze-frame-records=6, priority=4  # priority: 4 / aging: /ZeC/DTC/DefaultAging / extended data records: /ZeC/DTC/ExtendedDataRecords/StandardDTCInformation /ZeC/DTC/ExtendedDataRecords/StandFreezeFrame / freeze frame content: /ZeC/DTC/FreezeFrames/DataIdentifierSet0x7996 / no value for freeze frame identifier / number of freeze frames: 6 / memory selections: /ZeC/DTC/Primary
    Dtc_Props_e64ab440: extended-data-records=[StandardDTCInformation, StandFreezeFrame], freeze-frame-content=DataIdentifierSet0x7995, max-number-freeze-frame-records=6, priority=4  # priority: 4 / aging: /ZeC/DTC/DefaultAging / extended data records: /ZeC/DTC/ExtendedDataRecords/StandardDTCInformation /ZeC/DTC/ExtendedDataRecords/StandFreezeFrame / freeze frame content: /ZeC/DTC/FreezeFrames/DataIdentifierSet0x7995 / no value for freeze frame identifier / number of freeze frames: 6 / memory selections: /ZeC/DTC/Primary
    Dtc_Props_4ca522c: extended-data-records=[StandardDTCInformation, StandFreezeFrame], freeze-frame-content=DataIdentifierSet0x7979, max-number-freeze-frame-records=6, priority=4  # priority: 4 / aging: /ZeC/DTC/DefaultAging / extended data records: /ZeC/DTC/ExtendedDataRecords/StandardDTCInformation /ZeC/DTC/ExtendedDataRecords/StandFreezeFrame / freeze frame content: /ZeC/DTC/FreezeFrames/DataIdentifierSet0x7979 / no value for freeze frame identifier / number of freeze frames: 6 / memory selections: /ZeC/DTC/Primary
    Dtc_Props_6d505da5: extended-data-records=[StandardDTCInformation, StandFreezeFrame], freeze-frame-content=DataIdentifierSet0x797f, max-number-freeze-frame-records=6, priority=4  # priority: 4 / aging: /ZeC/DTC/DefaultAging / extended data records: /ZeC/DTC/ExtendedDataRecords/StandardDTCInformation /ZeC/DTC/ExtendedDataRecords/StandFreezeFrame / freeze frame content: /ZeC/DTC/FreezeFrames/DataIdentifierSet0x797f / no value for freeze frame identifier / number of freeze frames: 6 / memory selections: /ZeC/DTC/Primary
    Dtc_Props_a77b43eb: extended-data-records=[StandardDTCInformation, StandFreezeFrame], freeze-frame-content=DataIdentifierSet0x797e, max-number-freeze-frame-records=6, priority=4  # priority: 4 / aging: /ZeC/DTC/DefaultAging / extended data records: /ZeC/DTC/ExtendedDataRecords/StandardDTCInformation /ZeC/DTC/ExtendedDataRecords/StandFreezeFrame / freeze frame content: /ZeC/DTC/FreezeFrames/DataIdentifierSet0x797e / no value for freeze frame identifier / number of freeze frames: 6 / memory selections: /ZeC/DTC/Primary
    Dtc_Props_ae45730c: extended-data-records=[StandardDTCInformation, StandFreezeFrame], freeze-frame-content=DataIdentifierSet0x797b, max-number-freeze-frame-records=6, priority=4  # priority: 4 / aging: /ZeC/DTC/DefaultAging / extended data records: /ZeC/DTC/ExtendedDataRecords/StandardDTCInformation /ZeC/DTC/ExtendedDataRecords/StandFreezeFrame / freeze frame content: /ZeC/DTC/FreezeFrames/DataIdentifierSet0x797b / no value for freeze frame identifier / number of freeze frames: 6 / memory selections: /ZeC/DTC/Primary
    Dtc_Props_646e6d42: extended-data-records=[StandardDTCInformation, StandFreezeFrame], freeze-frame-content=DataIdentifierSet0x797a, max-number-freeze-frame-records=6, priority=4  # priority: 4 / aging: /ZeC/DTC/DefaultAging / extended data records: /ZeC/DTC/ExtendedDataRecords/StandardDTCInformation /ZeC/DTC/ExtendedDataRecords/StandFreezeFrame / freeze frame content: /ZeC/DTC/FreezeFrames/DataIdentifierSet0x797a / no value for freeze frame identifier / number of freeze frames: 6 / memory selections: /ZeC/DTC/Primary
    Dtc_Props_e16249d1: extended-data-records=[StandardDTCInformation, StandFreezeFrame], freeze-frame-content=DataIdentifierSet0x797d, max-number-freeze-frame-records=6, priority=4  # priority: 4 / aging: /ZeC/DTC/DefaultAging / extended data records: /ZeC/DTC/ExtendedDataRecords/StandardDTCInformation /ZeC/DTC/ExtendedDataRecords/StandFreezeFrame / freeze frame content: /ZeC/DTC/FreezeFrames/DataIdentifierSet0x797d / no value for freeze frame identifier / number of freeze frames: 6 / memory selections: /ZeC/DTC/Primary
    Dtc_Props_e85c7936: extended-data-records=[StandardDTCInformation, StandFreezeFrame], freeze-frame-content=DataIdentifierSet0x797c, max-number-freeze-frame-records=6, priority=4  # priority: 4 / aging: /ZeC/DTC/DefaultAging / extended data records: /ZeC/DTC/ExtendedDataRecords/StandardDTCInformation /ZeC/DTC/ExtendedDataRecords/StandFreezeFrame / freeze frame content: /ZeC/DTC/FreezeFrames/DataIdentifierSet0x797c / no value for freeze frame identifier / number of freeze frames: 6 / memory selections: /ZeC/DTC/Primary
    Dtc_Props_e3155a51: extended-data-records=[StandardDTCInformation, StandFreezeFrame], freeze-frame-content=DataIdentifierSet0x7981, max-number-freeze-frame-records=6, priority=4  # priority: 4 / aging: /ZeC/DTC/DefaultAging / extended data records: /ZeC/DTC/ExtendedDataRecords/StandardDTCInformation /ZeC/DTC/ExtendedDataRecords/StandFreezeFrame / freeze frame content: /ZeC/DTC/FreezeFrames/DataIdentifierSet0x7981 / no value for freeze frame identifier / number of freeze frames: 6 / memory selections: /ZeC/DTC/Primary
    Dtc_Props_a50c506b: extended-data-records=[StandardDTCInformation, StandFreezeFrame], freeze-frame-content=DataIdentifierSet0x7980, max-number-freeze-frame-records=6, priority=4  # priority: 4 / aging: /ZeC/DTC/DefaultAging / extended data records: /ZeC/DTC/ExtendedDataRecords/StandardDTCInformation /ZeC/DTC/ExtendedDataRecords/StandFreezeFrame / freeze frame content: /ZeC/DTC/FreezeFrames/DataIdentifierSet0x7980 / no value for freeze frame identifier / number of freeze frames: 6 / memory selections: /ZeC/DTC/Primary
    Dtc_Props_ac32608c: extended-data-records=[StandardDTCInformation, StandFreezeFrame], freeze-frame-content=DataIdentifierSet0x7987, max-number-freeze-frame-records=6, priority=4  # priority: 4 / aging: /ZeC/DTC/DefaultAging / extended data records: /ZeC/DTC/ExtendedDataRecords/StandardDTCInformation /ZeC/DTC/ExtendedDataRecords/StandFreezeFrame / freeze frame content: /ZeC/DTC/FreezeFrames/DataIdentifierSet0x7987 / no value for freeze frame identifier / number of freeze frames: 6 / memory selections: /ZeC/DTC/Primary
    Dtc_Props_ea2b6ab6: extended-data-records=[StandardDTCInformation, StandFreezeFrame], freeze-frame-content=DataIdentifierSet0x7986, max-number-freeze-frame-records=6, priority=4  # priority: 4 / aging: /ZeC/DTC/DefaultAging / extended data records: /ZeC/DTC/ExtendedDataRecords/StandardDTCInformation /ZeC/DTC/ExtendedDataRecords/StandFreezeFrame / freeze frame content: /ZeC/DTC/FreezeFrames/DataIdentifierSet0x7986 / no value for freeze frame identifier / number of freeze frames: 6 / memory selections: /ZeC/DTC/Primary
    Dtc_Props_be4e0142: extended-data-records=[StandardDTCInformation, StandFreezeFrame], freeze-frame-content=DataIdentifierSet0x7989, max-number-freeze-frame-records=6, priority=4  # priority: 4 / aging: /ZeC/DTC/DefaultAging / extended data records: /ZeC/DTC/ExtendedDataRecords/StandardDTCInformation /ZeC/DTC/ExtendedDataRecords/StandFreezeFrame / freeze frame content: /ZeC/DTC/FreezeFrames/DataIdentifierSet0x7989 / no value for freeze frame identifier / number of freeze frames: 6 / memory selections: /ZeC/DTC/Primary
    Dtc_Props_f8570b78: extended-data-records=[StandardDTCInformation, StandFreezeFrame], freeze-frame-content=DataIdentifierSet0x7988, max-number-freeze-frame-records=6, priority=4  # priority: 4 / aging: /ZeC/DTC/DefaultAging / extended data records: /ZeC/DTC/ExtendedDataRecords/StandardDTCInformation /ZeC/DTC/ExtendedDataRecords/StandFreezeFrame / freeze frame content: /ZeC/DTC/FreezeFrames/DataIdentifierSet0x7988 / no value for freeze frame identifier / number of freeze frames: 6 / memory selections: /ZeC/DTC/Primary
    Dtc_Props_6f274e25: extended-data-records=[StandardDTCInformation, StandFreezeFrame], freeze-frame-content=DataIdentifierSet0x7983, max-number-freeze-frame-records=6, priority=4  # priority: 4 / aging: /ZeC/DTC/DefaultAging / extended data records: /ZeC/DTC/ExtendedDataRecords/StandardDTCInformation /ZeC/DTC/ExtendedDataRecords/StandFreezeFrame / freeze frame content: /ZeC/DTC/FreezeFrames/DataIdentifierSet0x7983 / no value for freeze frame identifier / number of freeze frames: 6 / memory selections: /ZeC/DTC/Primary
    Dtc_Props_293e441f: extended-data-records=[StandardDTCInformation, StandFreezeFrame], freeze-frame-content=DataIdentifierSet0x7982, max-number-freeze-frame-records=6, priority=4  # priority: 4 / aging: /ZeC/DTC/DefaultAging / extended data records: /ZeC/DTC/ExtendedDataRecords/StandardDTCInformation /ZeC/DTC/ExtendedDataRecords/StandFreezeFrame / freeze frame content: /ZeC/DTC/FreezeFrames/DataIdentifierSet0x7982 / no value for freeze frame identifier / number of freeze frames: 6 / memory selections: /ZeC/DTC/Primary
    Dtc_Props_200074f8: extended-data-records=[StandardDTCInformation, StandFreezeFrame], freeze-frame-content=DataIdentifierSet0x7985, max-number-freeze-frame-records=6, priority=4  # priority: 4 / aging: /ZeC/DTC/DefaultAging / extended data records: /ZeC/DTC/ExtendedDataRecords/StandardDTCInformation /ZeC/DTC/ExtendedDataRecords/StandFreezeFrame / freeze frame content: /ZeC/DTC/FreezeFrames/DataIdentifierSet0x7985 / no value for freeze frame identifier / number of freeze frames: 6 / memory selections: /ZeC/DTC/Primary
    Dtc_Props_66197ec2: extended-data-records=[StandardDTCInformation, StandFreezeFrame], freeze-frame-content=DataIdentifierSet0x7984, max-number-freeze-frame-records=6, priority=4  # priority: 4 / aging: /ZeC/DTC/DefaultAging / extended data records: /ZeC/DTC/ExtendedDataRecords/StandardDTCInformation /ZeC/DTC/ExtendedDataRecords/StandFreezeFrame / freeze frame content: /ZeC/DTC/FreezeFrames/DataIdentifierSet0x7984 / no value for freeze frame identifier / number of freeze frames: 6 / memory selections: /ZeC/DTC/Primary
    Dtc_Props_14158306: extended-data-records=[StandardDTCInformation, StandFreezeFrame], priority=4  # priority: 4 / aging: /ZeC/DTC/DefaultAging / extended data records: /ZeC/DTC/ExtendedDataRecords/StandardDTCInformation /ZeC/DTC/ExtendedDataRecords/StandFreezeFrame / no value for freeze frame content / no value for freeze frame identifier / no value for number of freeze frames / memory selections: /ZeC/DTC/Primary
    Dtc_Props_b618fb9: extended-data-records=[StandardDTCInformation, StandFreezeFrame], priority=6  # priority: 6 / aging: /ZeC/DTC/DefaultAging / extended data records: /ZeC/DTC/ExtendedDataRecords/StandardDTCInformation /ZeC/DTC/ExtendedDataRecords/StandFreezeFrame / no value for freeze frame content / no value for freeze frame identifier / no value for number of freeze frames / memory selections: /ZeC/DTC/Primary
    Dtc_Props_d28be0da: extended-data-records=[StandardDTCInformation, StandFreezeFrame], freeze-frame-content=DataIdentifierSet0x799b, max-number-freeze-frame-records=6, priority=4  # priority: 4 / aging: /ZeC/DTC/DefaultAging / extended data records: /ZeC/DTC/ExtendedDataRecords/StandardDTCInformation /ZeC/DTC/ExtendedDataRecords/StandFreezeFrame / freeze frame content: /ZeC/DTC/FreezeFrames/DataIdentifierSet0x799b / no value for freeze frame identifier / number of freeze frames: 6 / memory selections: /ZeC/DTC/Primary
    Dtc_Props_18a0fe94: extended-data-records=[StandardDTCInformation, StandFreezeFrame], freeze-frame-content=DataIdentifierSet0x799a, max-number-freeze-frame-records=6, priority=4  # priority: 4 / aging: /ZeC/DTC/DefaultAging / extended data records: /ZeC/DTC/ExtendedDataRecords/StandardDTCInformation /ZeC/DTC/ExtendedDataRecords/StandFreezeFrame / freeze frame content: /ZeC/DTC/FreezeFrames/DataIdentifierSet0x799a / no value for freeze frame identifier / number of freeze frames: 6 / memory selections: /ZeC/DTC/Primary
    Dtc_Props_9dacda07: extended-data-records=[StandardDTCInformation, StandFreezeFrame], freeze-frame-content=DataIdentifierSet0x799d, max-number-freeze-frame-records=6, priority=4  # priority: 4 / aging: /ZeC/DTC/DefaultAging / extended data records: /ZeC/DTC/ExtendedDataRecords/StandardDTCInformation /ZeC/DTC/ExtendedDataRecords/StandFreezeFrame / freeze frame content: /ZeC/DTC/FreezeFrames/DataIdentifierSet0x799d / no value for freeze frame identifier / number of freeze frames: 6 / memory selections: /ZeC/DTC/Primary
    Dtc_Props_9492eae0: extended-data-records=[StandardDTCInformation, StandFreezeFrame], freeze-frame-content=DataIdentifierSet0x799c, max-number-freeze-frame-records=6, priority=4  # priority: 4 / aging: /ZeC/DTC/DefaultAging / extended data records: /ZeC/DTC/ExtendedDataRecords/StandardDTCInformation /ZeC/DTC/ExtendedDataRecords/StandFreezeFrame / freeze frame content: /ZeC/DTC/FreezeFrames/DataIdentifierSet0x799c / no value for freeze frame identifier / number of freeze frames: 6 / memory selections: /ZeC/DTC/Primary
    Dtc_Props_119ece73: extended-data-records=[StandardDTCInformation, StandFreezeFrame], freeze-frame-content=DataIdentifierSet0x799f, max-number-freeze-frame-records=6, priority=4  # priority: 4 / aging: /ZeC/DTC/DefaultAging / extended data records: /ZeC/DTC/ExtendedDataRecords/StandardDTCInformation /ZeC/DTC/ExtendedDataRecords/StandFreezeFrame / freeze frame content: /ZeC/DTC/FreezeFrames/DataIdentifierSet0x799f / no value for freeze frame identifier / number of freeze frames: 6 / memory selections: /ZeC/DTC/Primary
    Dtc_Props_dbb5d03d: extended-data-records=[StandardDTCInformation, StandFreezeFrame], freeze-frame-content=DataIdentifierSet0x799e, max-number-freeze-frame-records=6, priority=4  # priority: 4 / aging: /ZeC/DTC/DefaultAging / extended data records: /ZeC/DTC/ExtendedDataRecords/StandardDTCInformation /ZeC/DTC/ExtendedDataRecords/StandFreezeFrame / freeze frame content: /ZeC/DTC/FreezeFrames/DataIdentifierSet0x799e / no value for freeze frame identifier / number of freeze frames: 6 / memory selections: /ZeC/DTC/Primary
    Dtc_Props_addd5e9a: extended-data-records=[StandardDTCInformation, StandFreezeFrame], freeze-frame-content=DataIdentifierSet0x7902, max-number-freeze-frame-records=6, priority=4  # priority: 4 / aging: /ZeC/DTC/DefaultAging / extended data records: /ZeC/DTC/ExtendedDataRecords/StandardDTCInformation /ZeC/DTC/ExtendedDataRecords/StandFreezeFrame / freeze frame content: /ZeC/DTC/FreezeFrames/DataIdentifierSet0x7902 / no value for freeze frame identifier / number of freeze frames: 6 / memory selections: /ZeC/DTC/Primary
    Dtc_Props_67f640d4: extended-data-records=[StandardDTCInformation, StandFreezeFrame], freeze-frame-content=DataIdentifierSet0x7901, max-number-freeze-frame-records=6, priority=4  # priority: 4 / aging: /ZeC/DTC/DefaultAging / extended data records: /ZeC/DTC/ExtendedDataRecords/StandardDTCInformation /ZeC/DTC/ExtendedDataRecords/StandFreezeFrame / freeze frame content: /ZeC/DTC/FreezeFrames/DataIdentifierSet0x7901 / no value for freeze frame identifier / number of freeze frames: 6 / memory selections: /ZeC/DTC/Primary
    Dtc_Props_e2fa6447: extended-data-records=[StandardDTCInformation, StandFreezeFrame], freeze-frame-content=DataIdentifierSet0x7904, max-number-freeze-frame-records=6, priority=4  # priority: 4 / aging: /ZeC/DTC/DefaultAging / extended data records: /ZeC/DTC/ExtendedDataRecords/StandardDTCInformation /ZeC/DTC/ExtendedDataRecords/StandFreezeFrame / freeze frame content: /ZeC/DTC/FreezeFrames/DataIdentifierSet0x7904 / no value for freeze frame identifier / number of freeze frames: 6 / memory selections: /ZeC/DTC/Primary
    Dtc_Props_ebc454a0: extended-data-records=[StandardDTCInformation, StandFreezeFrame], freeze-frame-content=DataIdentifierSet0x7903, max-number-freeze-frame-records=6, priority=4  # priority: 4 / aging: /ZeC/DTC/DefaultAging / extended data records: /ZeC/DTC/ExtendedDataRecords/StandardDTCInformation /ZeC/DTC/ExtendedDataRecords/StandFreezeFrame / freeze frame content: /ZeC/DTC/FreezeFrames/DataIdentifierSet0x7903 / no value for freeze frame identifier / number of freeze frames: 6 / memory selections: /ZeC/DTC/Primary
    Dtc_Props_3aad1bc7: extended-data-records=[StandardDTCInformation, StandFreezeFrame], freeze-frame-content=DataIdentifierSet0x7909, max-number-freeze-frame-records=6, priority=4  # priority: 4 / aging: /ZeC/DTC/DefaultAging / extended data records: /ZeC/DTC/ExtendedDataRecords/StandardDTCInformation /ZeC/DTC/ExtendedDataRecords/StandFreezeFrame / freeze frame content: /ZeC/DTC/FreezeFrames/DataIdentifierSet0x7909 / no value for freeze frame identifier / number of freeze frames: 6 / memory selections: /ZeC/DTC/Primary
    Dtc_Props_6ec87033: extended-data-records=[StandardDTCInformation, StandFreezeFrame], freeze-frame-content=DataIdentifierSet0x7906, max-number-freeze-frame-records=6, priority=4  # priority: 4 / aging: /ZeC/DTC/DefaultAging / extended data records: /ZeC/DTC/ExtendedDataRecords/StandardDTCInformation /ZeC/DTC/ExtendedDataRecords/StandFreezeFrame / freeze frame content: /ZeC/DTC/FreezeFrames/DataIdentifierSet0x7906 / no value for freeze frame identifier / number of freeze frames: 6 / memory selections: /ZeC/DTC/Primary
    Dtc_Props_7cb411fd: extended-data-records=[StandardDTCInformation, StandFreezeFrame], freeze-frame-content=DataIdentifierSet0x7908, max-number-freeze-frame-records=6, priority=4  # priority: 4 / aging: /ZeC/DTC/DefaultAging / extended data records: /ZeC/DTC/ExtendedDataRecords/StandardDTCInformation /ZeC/DTC/ExtendedDataRecords/StandFreezeFrame / freeze frame content: /ZeC/DTC/FreezeFrames/DataIdentifierSet0x7908 / no value for freeze frame identifier / number of freeze frames: 6 / memory selections: /ZeC/DTC/Primary
    Dtc_Props_28d17a09: extended-data-records=[StandardDTCInformation, StandFreezeFrame], freeze-frame-content=DataIdentifierSet0x7907, max-number-freeze-frame-records=6, priority=4  # priority: 4 / aging: /ZeC/DTC/DefaultAging / extended data records: /ZeC/DTC/ExtendedDataRecords/StandardDTCInformation /ZeC/DTC/ExtendedDataRecords/StandFreezeFrame / freeze frame content: /ZeC/DTC/FreezeFrames/DataIdentifierSet0x7907 / no value for freeze frame identifier / number of freeze frames: 6 / memory selections: /ZeC/DTC/Primary
    Dtc_Props_90223ae7: extended-data-records=[StandardDTCInformation, StandFreezeFrame], freeze-frame-content=DataIdentifierSet0x790b, max-number-freeze-frame-records=6, priority=4  # priority: 4 / aging: /ZeC/DTC/DefaultAging / extended data records: /ZeC/DTC/ExtendedDataRecords/StandardDTCInformation /ZeC/DTC/ExtendedDataRecords/StandFreezeFrame / freeze frame content: /ZeC/DTC/FreezeFrames/DataIdentifierSet0x790b / no value for freeze frame identifier / number of freeze frames: 6 / memory selections: /ZeC/DTC/Primary
    Dtc_Props_5a0924a9: extended-data-records=[StandardDTCInformation, StandFreezeFrame], freeze-frame-content=DataIdentifierSet0x790a, max-number-freeze-frame-records=6, priority=4  # priority: 4 / aging: /ZeC/DTC/DefaultAging / extended data records: /ZeC/DTC/ExtendedDataRecords/StandardDTCInformation /ZeC/DTC/ExtendedDataRecords/StandFreezeFrame / freeze frame content: /ZeC/DTC/FreezeFrames/DataIdentifierSet0x790a / no value for freeze frame identifier / number of freeze frames: 6 / memory selections: /ZeC/DTC/Primary
    Dtc_Props_df05003a: extended-data-records=[StandardDTCInformation, StandFreezeFrame], freeze-frame-content=DataIdentifierSet0x790d, max-number-freeze-frame-records=6, priority=4  # priority: 4 / aging: /ZeC/DTC/DefaultAging / extended data records: /ZeC/DTC/ExtendedDataRecords/StandardDTCInformation /ZeC/DTC/ExtendedDataRecords/StandFreezeFrame / freeze frame content: /ZeC/DTC/FreezeFrames/DataIdentifierSet0x790d / no value for freeze frame identifier / number of freeze frames: 6 / memory selections: /ZeC/DTC/Primary
    Dtc_Props_d63b30dd: extended-data-records=[StandardDTCInformation, StandFreezeFrame], freeze-frame-content=DataIdentifierSet0x790c, max-number-freeze-frame-records=6, priority=4  # priority: 4 / aging: /ZeC/DTC/DefaultAging / extended data records: /ZeC/DTC/ExtendedDataRecords/StandardDTCInformation /ZeC/DTC/ExtendedDataRecords/StandFreezeFrame / freeze frame content: /ZeC/DTC/FreezeFrames/DataIdentifierSet0x790c / no value for freeze frame identifier / number of freeze frames: 6 / memory selections: /ZeC/DTC/Primary
    Dtc_Props_5337144e: extended-data-records=[StandardDTCInformation, StandFreezeFrame], freeze-frame-content=DataIdentifierSet0x790f, max-number-freeze-frame-records=6, priority=4  # priority: 4 / aging: /ZeC/DTC/DefaultAging / extended data records: /ZeC/DTC/ExtendedDataRecords/StandardDTCInformation /ZeC/DTC/ExtendedDataRecords/StandFreezeFrame / freeze frame content: /ZeC/DTC/FreezeFrames/DataIdentifierSet0x790f / no value for freeze frame identifier / number of freeze frames: 6 / memory selections: /ZeC/DTC/Primary
    Dtc_Props_991c0a00: extended-data-records=[StandardDTCInformation, StandFreezeFrame], freeze-frame-content=DataIdentifierSet0x790e, max-number-freeze-frame-records=6, priority=4  # priority: 4 / aging: /ZeC/DTC/DefaultAging / extended data records: /ZeC/DTC/ExtendedDataRecords/StandardDTCInformation /ZeC/DTC/ExtendedDataRecords/StandFreezeFrame / freeze frame content: /ZeC/DTC/FreezeFrames/DataIdentifierSet0x790e / no value for freeze frame identifier / number of freeze frames: 6 / memory selections: /ZeC/DTC/Primary
    Dtc_Props_849998ae: extended-data-records=[StandardDTCInformation, StandFreezeFrame], freeze-frame-content=DataIdentifierSet0x7968, max-number-freeze-frame-records=6, priority=4  # priority: 4 / aging: /ZeC/DTC/DefaultAging / extended data records: /ZeC/DTC/ExtendedDataRecords/StandardDTCInformation /ZeC/DTC/ExtendedDataRecords/StandFreezeFrame / freeze frame content: /ZeC/DTC/FreezeFrames/DataIdentifierSet0x7968 / no value for freeze frame identifier / number of freeze frames: 6 / memory selections: /ZeC/DTC/Primary
    Dtc_Props_d0fcf35a: extended-data-records=[StandardDTCInformation, StandFreezeFrame], freeze-frame-content=DataIdentifierSet0x7967, max-number-freeze-frame-records=6, priority=4  # priority: 4 / aging: /ZeC/DTC/DefaultAging / extended data records: /ZeC/DTC/ExtendedDataRecords/StandardDTCInformation /ZeC/DTC/ExtendedDataRecords/StandFreezeFrame / freeze frame content: /ZeC/DTC/FreezeFrames/DataIdentifierSet0x7967 / no value for freeze frame identifier / number of freeze frames: 6 / memory selections: /ZeC/DTC/Primary
    Dtc_Props_c2809294: extended-data-records=[StandardDTCInformation, StandFreezeFrame], freeze-frame-content=DataIdentifierSet0x7969, max-number-freeze-frame-records=6, priority=4  # priority: 4 / aging: /ZeC/DTC/DefaultAging / extended data records: /ZeC/DTC/ExtendedDataRecords/StandardDTCInformation /ZeC/DTC/ExtendedDataRecords/StandFreezeFrame / freeze frame content: /ZeC/DTC/FreezeFrames/DataIdentifierSet0x7969 / no value for freeze frame identifier / number of freeze frames: 6 / memory selections: /ZeC/DTC/Primary
    Dtc_Props_1ad7ed14: extended-data-records=[StandardDTCInformation, StandFreezeFrame], freeze-frame-content=DataIdentifierSet0x7964, max-number-freeze-frame-records=6, priority=4  # priority: 4 / aging: /ZeC/DTC/DefaultAging / extended data records: /ZeC/DTC/ExtendedDataRecords/StandardDTCInformation /ZeC/DTC/ExtendedDataRecords/StandFreezeFrame / freeze frame content: /ZeC/DTC/FreezeFrames/DataIdentifierSet0x7964 / no value for freeze frame identifier / number of freeze frames: 6 / memory selections: /ZeC/DTC/Primary
    Dtc_Props_13e9ddf3: extended-data-records=[StandardDTCInformation, StandFreezeFrame], freeze-frame-content=DataIdentifierSet0x7963, max-number-freeze-frame-records=6, priority=4  # priority: 4 / aging: /ZeC/DTC/DefaultAging / extended data records: /ZeC/DTC/ExtendedDataRecords/StandardDTCInformation /ZeC/DTC/ExtendedDataRecords/StandFreezeFrame / freeze frame content: /ZeC/DTC/FreezeFrames/DataIdentifierSet0x7963 / no value for freeze frame identifier / number of freeze frames: 6 / memory selections: /ZeC/DTC/Primary
    Dtc_Props_96e5f960: extended-data-records=[StandardDTCInformation, StandFreezeFrame], freeze-frame-content=DataIdentifierSet0x7966, max-number-freeze-frame-records=6, priority=4  # priority: 4 / aging: /ZeC/DTC/DefaultAging / extended data records: /ZeC/DTC/ExtendedDataRecords/StandardDTCInformation /ZeC/DTC/ExtendedDataRecords/StandFreezeFrame / freeze frame content: /ZeC/DTC/FreezeFrames/DataIdentifierSet0x7966 / no value for freeze frame identifier / number of freeze frames: 6 / memory selections: /ZeC/DTC/Primary
    Dtc_Props_5ccee72e: extended-data-records=[StandardDTCInformation, StandFreezeFrame], freeze-frame-content=DataIdentifierSet0x7965, max-number-freeze-frame-records=6, priority=4  # priority: 4 / aging: /ZeC/DTC/DefaultAging / extended data records: /ZeC/DTC/ExtendedDataRecords/StandardDTCInformation /ZeC/DTC/ExtendedDataRecords/StandFreezeFrame / freeze frame content: /ZeC/DTC/FreezeFrames/DataIdentifierSet0x7965 / no value for freeze frame identifier / number of freeze frames: 6 / memory selections: /ZeC/DTC/Primary
    Dtc_Props_680fb3b4: extended-data-records=[StandardDTCInformation, StandFreezeFrame], freeze-frame-content=DataIdentifierSet0x796b, max-number-freeze-frame-records=6, priority=4  # priority: 4 / aging: /ZeC/DTC/DefaultAging / extended data records: /ZeC/DTC/ExtendedDataRecords/StandardDTCInformation /ZeC/DTC/ExtendedDataRecords/StandFreezeFrame / freeze frame content: /ZeC/DTC/FreezeFrames/DataIdentifierSet0x796b / no value for freeze frame identifier / number of freeze frames: 6 / memory selections: /ZeC/DTC/Primary
    Dtc_Props_a224adfa: extended-data-records=[StandardDTCInformation, StandFreezeFrame], freeze-frame-content=DataIdentifierSet0x796a, max-number-freeze-frame-records=6, priority=4  # priority: 4 / aging: /ZeC/DTC/DefaultAging / extended data records: /ZeC/DTC/ExtendedDataRecords/StandardDTCInformation /ZeC/DTC/ExtendedDataRecords/StandFreezeFrame / freeze frame content: /ZeC/DTC/FreezeFrames/DataIdentifierSet0x796a / no value for freeze frame identifier / number of freeze frames: 6 / memory selections: /ZeC/DTC/Primary
    Dtc_Props_27288969: extended-data-records=[StandardDTCInformation, StandFreezeFrame], freeze-frame-content=DataIdentifierSet0x796d, max-number-freeze-frame-records=6, priority=4  # priority: 4 / aging: /ZeC/DTC/DefaultAging / extended data records: /ZeC/DTC/ExtendedDataRecords/StandardDTCInformation /ZeC/DTC/ExtendedDataRecords/StandFreezeFrame / freeze frame content: /ZeC/DTC/FreezeFrames/DataIdentifierSet0x796d / no value for freeze frame identifier / number of freeze frames: 6 / memory selections: /ZeC/DTC/Primary
    Dtc_Props_2e16b98e: extended-data-records=[StandardDTCInformation, StandFreezeFrame], freeze-frame-content=DataIdentifierSet0x796c, max-number-freeze-frame-records=6, priority=4  # priority: 4 / aging: /ZeC/DTC/DefaultAging / extended data records: /ZeC/DTC/ExtendedDataRecords/StandardDTCInformation /ZeC/DTC/ExtendedDataRecords/StandFreezeFrame / freeze frame content: /ZeC/DTC/FreezeFrames/DataIdentifierSet0x796c / no value for freeze frame identifier / number of freeze frames: 6 / memory selections: /ZeC/DTC/Primary
    Dtc_Props_ab1a9d1d: extended-data-records=[StandardDTCInformation, StandFreezeFrame], freeze-frame-content=DataIdentifierSet0x796f, max-number-freeze-frame-records=6, priority=4  # priority: 4 / aging: /ZeC/DTC/DefaultAging / extended data records: /ZeC/DTC/ExtendedDataRecords/StandardDTCInformation /ZeC/DTC/ExtendedDataRecords/StandFreezeFrame / freeze frame content: /ZeC/DTC/FreezeFrames/DataIdentifierSet0x796f / no value for freeze frame identifier / number of freeze frames: 6 / memory selections: /ZeC/DTC/Primary
    Dtc_Props_61318353: extended-data-records=[StandardDTCInformation, StandFreezeFrame], freeze-frame-content=DataIdentifierSet0x796e, max-number-freeze-frame-records=6, priority=4  # priority: 4 / aging: /ZeC/DTC/DefaultAging / extended data records: /ZeC/DTC/ExtendedDataRecords/StandardDTCInformation /ZeC/DTC/ExtendedDataRecords/StandFreezeFrame / freeze frame content: /ZeC/DTC/FreezeFrames/DataIdentifierSet0x796e / no value for freeze frame identifier / number of freeze frames: 6 / memory selections: /ZeC/DTC/Primary
    Dtc_Props_5991093f: extended-data-records=[StandardDTCInformation, StandFreezeFrame], freeze-frame-content=DataIdentifierSet0x7971, max-number-freeze-frame-records=6, priority=4  # priority: 4 / aging: /ZeC/DTC/DefaultAging / extended data records: /ZeC/DTC/ExtendedDataRecords/StandardDTCInformation /ZeC/DTC/ExtendedDataRecords/StandFreezeFrame / freeze frame content: /ZeC/DTC/FreezeFrames/DataIdentifierSet0x7971 / no value for freeze frame identifier / number of freeze frames: 6 / memory selections: /ZeC/DTC/Primary
    Dtc_Props_d78b13b8: extended-data-records=[StandardDTCInformation, StandFreezeFrame], priority=3  # priority: 3 / aging: /ZeC/DTC/DefaultAging / extended data records: /ZeC/DTC/ExtendedDataRecords/StandardDTCInformation /ZeC/DTC/ExtendedDataRecords/StandFreezeFrame / no value for freeze frame content / no value for freeze frame identifier / no value for number of freeze frames / memory selections: /ZeC/DTC/Primary
    Dtc_Props_1f880305: extended-data-records=[StandardDTCInformation, StandFreezeFrame], freeze-frame-content=DataIdentifierSet0x7970, max-number-freeze-frame-records=6, priority=4  # priority: 4 / aging: /ZeC/DTC/DefaultAging / extended data records: /ZeC/DTC/ExtendedDataRecords/StandardDTCInformation /ZeC/DTC/ExtendedDataRecords/StandFreezeFrame / freeze frame content: /ZeC/DTC/FreezeFrames/DataIdentifierSet0x7970 / no value for freeze frame identifier / number of freeze frames: 6 / memory selections: /ZeC/DTC/Primary
    Dtc_Props_d5a31d4b: extended-data-records=[StandardDTCInformation, StandFreezeFrame], freeze-frame-content=DataIdentifierSet0x7973, max-number-freeze-frame-records=6, priority=4  # priority: 4 / aging: /ZeC/DTC/DefaultAging / extended data records: /ZeC/DTC/ExtendedDataRecords/StandardDTCInformation /ZeC/DTC/ExtendedDataRecords/StandFreezeFrame / freeze frame content: /ZeC/DTC/FreezeFrames/DataIdentifierSet0x7973 / no value for freeze frame identifier / number of freeze frames: 6 / memory selections: /ZeC/DTC/Primary
    Dtc_Props_93ba1771: extended-data-records=[StandardDTCInformation, StandFreezeFrame], freeze-frame-content=DataIdentifierSet0x7972, max-number-freeze-frame-records=6, priority=4  # priority: 4 / aging: /ZeC/DTC/DefaultAging / extended data records: /ZeC/DTC/ExtendedDataRecords/StandardDTCInformation /ZeC/DTC/ExtendedDataRecords/StandFreezeFrame / freeze frame content: /ZeC/DTC/FreezeFrames/DataIdentifierSet0x7972 / no value for freeze frame identifier / number of freeze frames: 6 / memory selections: /ZeC/DTC/Primary
    Dtc_Props_c8ff1f07: extended-data-records=[StandardDTCInformation, StandFreezeFrame], priority=1  # priority: 1 / aging: /ZeC/DTC/DefaultAging / extended data records: /ZeC/DTC/ExtendedDataRecords/StandardDTCInformation /ZeC/DTC/ExtendedDataRecords/StandFreezeFrame / no value for freeze frame content / no value for freeze frame identifier / no value for number of freeze frames / memory selections: /ZeC/DTC/Primary
    Dtc_Props_4152b4d3: extended-data-records=[StandardDTCInformation, StandFreezeFrame], freeze-frame-content=DataIdentifierSet0x7957, max-number-freeze-frame-records=6, priority=4  # priority: 4 / aging: /ZeC/DTC/DefaultAging / extended data records: /ZeC/DTC/ExtendedDataRecords/StandardDTCInformation /ZeC/DTC/ExtendedDataRecords/StandFreezeFrame / freeze frame content: /ZeC/DTC/FreezeFrames/DataIdentifierSet0x7957 / no value for freeze frame identifier / number of freeze frames: 6 / memory selections: /ZeC/DTC/Primary
    Dtc_Props_74bbee9: extended-data-records=[StandardDTCInformation, StandFreezeFrame], freeze-frame-content=DataIdentifierSet0x7956, max-number-freeze-frame-records=6, priority=4  # priority: 4 / aging: /ZeC/DTC/DefaultAging / extended data records: /ZeC/DTC/ExtendedDataRecords/StandardDTCInformation /ZeC/DTC/ExtendedDataRecords/StandFreezeFrame / freeze frame content: /ZeC/DTC/FreezeFrames/DataIdentifierSet0x7956 / no value for freeze frame identifier / number of freeze frames: 6 / memory selections: /ZeC/DTC/Primary
    Dtc_Props_532ed51d: extended-data-records=[StandardDTCInformation, StandFreezeFrame], freeze-frame-content=DataIdentifierSet0x7959, max-number-freeze-frame-records=6, priority=4  # priority: 4 / aging: /ZeC/DTC/DefaultAging / extended data records: /ZeC/DTC/ExtendedDataRecords/StandardDTCInformation /ZeC/DTC/ExtendedDataRecords/StandFreezeFrame / freeze frame content: /ZeC/DTC/FreezeFrames/DataIdentifierSet0x7959 / no value for freeze frame identifier / number of freeze frames: 6 / memory selections: /ZeC/DTC/Primary
    Dtc_Props_1537df27: extended-data-records=[StandardDTCInformation, StandFreezeFrame], freeze-frame-content=DataIdentifierSet0x7958, max-number-freeze-frame-records=6, priority=4  # priority: 4 / aging: /ZeC/DTC/DefaultAging / extended data records: /ZeC/DTC/ExtendedDataRecords/StandardDTCInformation /ZeC/DTC/ExtendedDataRecords/StandFreezeFrame / freeze frame content: /ZeC/DTC/FreezeFrames/DataIdentifierSet0x7958 / no value for freeze frame identifier / number of freeze frames: 6 / memory selections: /ZeC/DTC/Primary
    Dtc_Props_82479a7a: extended-data-records=[StandardDTCInformation, StandFreezeFrame], freeze-frame-content=DataIdentifierSet0x7953, max-number-freeze-frame-records=6, priority=4  # priority: 4 / aging: /ZeC/DTC/DefaultAging / extended data records: /ZeC/DTC/ExtendedDataRecords/StandardDTCInformation /ZeC/DTC/ExtendedDataRecords/StandFreezeFrame / freeze frame content: /ZeC/DTC/FreezeFrames/DataIdentifierSet0x7953 / no value for freeze frame identifier / number of freeze frames: 6 / memory selections: /ZeC/DTC/Primary
    Dtc_Props_c45e9040: extended-data-records=[StandardDTCInformation, StandFreezeFrame], freeze-frame-content=DataIdentifierSet0x7952, max-number-freeze-frame-records=6, priority=4  # priority: 4 / aging: /ZeC/DTC/DefaultAging / extended data records: /ZeC/DTC/ExtendedDataRecords/StandardDTCInformation /ZeC/DTC/ExtendedDataRecords/StandFreezeFrame / freeze frame content: /ZeC/DTC/FreezeFrames/DataIdentifierSet0x7952 / no value for freeze frame identifier / number of freeze frames: 6 / memory selections: /ZeC/DTC/Primary
    Dtc_Props_cd60a0a7: extended-data-records=[StandardDTCInformation, StandFreezeFrame], freeze-frame-content=DataIdentifierSet0x7955, max-number-freeze-frame-records=6, priority=4  # priority: 4 / aging: /ZeC/DTC/DefaultAging / extended data records: /ZeC/DTC/ExtendedDataRecords/StandardDTCInformation /ZeC/DTC/ExtendedDataRecords/StandFreezeFrame / freeze frame content: /ZeC/DTC/FreezeFrames/DataIdentifierSet0x7955 / no value for freeze frame identifier / number of freeze frames: 6 / memory selections: /ZeC/DTC/Primary
    Dtc_Props_8b79aa9d: extended-data-records=[StandardDTCInformation, StandFreezeFrame], freeze-frame-content=DataIdentifierSet0x7954, max-number-freeze-frame-records=6, priority=4  # priority: 4 / aging: /ZeC/DTC/DefaultAging / extended data records: /ZeC/DTC/ExtendedDataRecords/StandardDTCInformation /ZeC/DTC/ExtendedDataRecords/StandFreezeFrame / freeze frame content: /ZeC/DTC/FreezeFrames/DataIdentifierSet0x7954 / no value for freeze frame identifier / number of freeze frames: 6 / memory selections: /ZeC/DTC/Primary
    Dtc_Props_338aea73: extended-data-records=[StandardDTCInformation, StandFreezeFrame], freeze-frame-content=DataIdentifierSet0x795a, max-number-freeze-frame-records=6, priority=4  # priority: 4 / aging: /ZeC/DTC/DefaultAging / extended data records: /ZeC/DTC/ExtendedDataRecords/StandardDTCInformation /ZeC/DTC/ExtendedDataRecords/StandFreezeFrame / freeze frame content: /ZeC/DTC/FreezeFrames/DataIdentifierSet0x795a / no value for freeze frame identifier / number of freeze frames: 6 / memory selections: /ZeC/DTC/Primary
    Dtc_Props_3ab4da94: extended-data-records=[StandardDTCInformation, StandFreezeFrame], freeze-frame-content=DataIdentifierSet0x795f, max-number-freeze-frame-records=6, priority=4  # priority: 4 / aging: /ZeC/DTC/DefaultAging / extended data records: /ZeC/DTC/ExtendedDataRecords/StandardDTCInformation /ZeC/DTC/ExtendedDataRecords/StandFreezeFrame / freeze frame content: /ZeC/DTC/FreezeFrames/DataIdentifierSet0x795f / no value for freeze frame identifier / number of freeze frames: 6 / memory selections: /ZeC/DTC/Primary
    Dtc_Props_bfb8fe07: extended-data-records=[StandardDTCInformation, StandFreezeFrame], freeze-frame-content=DataIdentifierSet0x795c, max-number-freeze-frame-records=6, priority=4  # priority: 4 / aging: /ZeC/DTC/DefaultAging / extended data records: /ZeC/DTC/ExtendedDataRecords/StandardDTCInformation /ZeC/DTC/ExtendedDataRecords/StandFreezeFrame / freeze frame content: /ZeC/DTC/FreezeFrames/DataIdentifierSet0x795c / no value for freeze frame identifier / number of freeze frames: 6 / memory selections: /ZeC/DTC/Primary
    Dtc_Props_f9a1f43d: extended-data-records=[StandardDTCInformation, StandFreezeFrame], freeze-frame-content=DataIdentifierSet0x795b, max-number-freeze-frame-records=6, priority=4  # priority: 4 / aging: /ZeC/DTC/DefaultAging / extended data records: /ZeC/DTC/ExtendedDataRecords/StandardDTCInformation /ZeC/DTC/ExtendedDataRecords/StandFreezeFrame / freeze frame content: /ZeC/DTC/FreezeFrames/DataIdentifierSet0x795b / no value for freeze frame identifier / number of freeze frames: 6 / memory selections: /ZeC/DTC/Primary
    Dtc_Props_f09fc4da: extended-data-records=[StandardDTCInformation, StandFreezeFrame], freeze-frame-content=DataIdentifierSet0x795e, max-number-freeze-frame-records=6, priority=4  # priority: 4 / aging: /ZeC/DTC/DefaultAging / extended data records: /ZeC/DTC/ExtendedDataRecords/StandardDTCInformation /ZeC/DTC/ExtendedDataRecords/StandFreezeFrame / freeze frame content: /ZeC/DTC/FreezeFrames/DataIdentifierSet0x795e / no value for freeze frame identifier / number of freeze frames: 6 / memory selections: /ZeC/DTC/Primary
    Dtc_Props_b686cee0: extended-data-records=[StandardDTCInformation, StandFreezeFrame], freeze-frame-content=DataIdentifierSet0x795d, max-number-freeze-frame-records=6, priority=4  # priority: 4 / aging: /ZeC/DTC/DefaultAging / extended data records: /ZeC/DTC/ExtendedDataRecords/StandardDTCInformation /ZeC/DTC/ExtendedDataRecords/StandFreezeFrame / freeze frame content: /ZeC/DTC/FreezeFrames/DataIdentifierSet0x795d / no value for freeze frame identifier / number of freeze frames: 6 / memory selections: /ZeC/DTC/Primary
    Dtc_Props_d9c2c3bd: extended-data-records=[StandardDTCInformation, StandFreezeFrame], freeze-frame-content=DataIdentifierSet0x7960, max-number-freeze-frame-records=6, priority=4  # priority: 4 / aging: /ZeC/DTC/DefaultAging / extended data records: /ZeC/DTC/ExtendedDataRecords/StandardDTCInformation /ZeC/DTC/ExtendedDataRecords/StandFreezeFrame / freeze frame content: /ZeC/DTC/FreezeFrames/DataIdentifierSet0x7960 / no value for freeze frame identifier / number of freeze frames: 6 / memory selections: /ZeC/DTC/Primary
    Dtc_Props_55f0d7c9: extended-data-records=[StandardDTCInformation, StandFreezeFrame], freeze-frame-content=DataIdentifierSet0x7962, max-number-freeze-frame-records=6, priority=4  # priority: 4 / aging: /ZeC/DTC/DefaultAging / extended data records: /ZeC/DTC/ExtendedDataRecords/StandardDTCInformation /ZeC/DTC/ExtendedDataRecords/StandFreezeFrame / freeze frame content: /ZeC/DTC/FreezeFrames/DataIdentifierSet0x7962 / no value for freeze frame identifier / number of freeze frames: 6 / memory selections: /ZeC/DTC/Primary
    Dtc_Props_9fdbc987: extended-data-records=[StandardDTCInformation, StandFreezeFrame], freeze-frame-content=DataIdentifierSet0x7961, max-number-freeze-frame-records=6, priority=4  # priority: 4 / aging: /ZeC/DTC/DefaultAging / extended data records: /ZeC/DTC/ExtendedDataRecords/StandardDTCInformation /ZeC/DTC/ExtendedDataRecords/StandFreezeFrame / freeze frame content: /ZeC/DTC/FreezeFrames/DataIdentifierSet0x7961 / no value for freeze frame identifier / number of freeze frames: 6 / memory selections: /ZeC/DTC/Primary
    Dtc_Props_a4e36e7d: extended-data-records=[StandardDTCInformation, StandFreezeFrame], freeze-frame-content=DataIdentifierSet0x7905, max-number-freeze-frame-records=6, priority=4  # priority: 4 / aging: /ZeC/DTC/DefaultAging / extended data records: /ZeC/DTC/ExtendedDataRecords/StandardDTCInformation /ZeC/DTC/ExtendedDataRecords/StandFreezeFrame / freeze frame content: /ZeC/DTC/FreezeFrames/DataIdentifierSet0x7905 / no value for freeze frame identifier / number of freeze frames: 6 / memory selections: /ZeC/DTC/Primary
    Dtc_Props_a1bc806c: extended-data-records=[StandardDTCInformation, StandFreezeFrame], freeze-frame-content=DataIdentifierSet0x7911, max-number-freeze-frame-records=6, priority=4  # priority: 4 / aging: /ZeC/DTC/DefaultAging / extended data records: /ZeC/DTC/ExtendedDataRecords/StandardDTCInformation /ZeC/DTC/ExtendedDataRecords/StandFreezeFrame / freeze frame content: /ZeC/DTC/FreezeFrames/DataIdentifierSet0x7911 / no value for freeze frame identifier / number of freeze frames: 6 / memory selections: /ZeC/DTC/Primary
    Dtc_Props_e7a58a56: extended-data-records=[StandardDTCInformation, StandFreezeFrame], freeze-frame-content=DataIdentifierSet0x7910, max-number-freeze-frame-records=6, priority=4  # priority: 4 / aging: /ZeC/DTC/DefaultAging / extended data records: /ZeC/DTC/ExtendedDataRecords/StandardDTCInformation /ZeC/DTC/ExtendedDataRecords/StandFreezeFrame / freeze frame content: /ZeC/DTC/FreezeFrames/DataIdentifierSet0x7910 / no value for freeze frame identifier / number of freeze frames: 6 / memory selections: /ZeC/DTC/Primary
    Dtc_Props_42d35816: extended-data-records=[StandardDTCInformation, StandFreezeFrame], freeze-frame-content=DataIdentifierSet0x7978, max-number-freeze-frame-records=6, priority=4  # priority: 4 / aging: /ZeC/DTC/DefaultAging / extended data records: /ZeC/DTC/ExtendedDataRecords/StandardDTCInformation /ZeC/DTC/ExtendedDataRecords/StandFreezeFrame / freeze frame content: /ZeC/DTC/FreezeFrames/DataIdentifierSet0x7978 / no value for freeze frame identifier / number of freeze frames: 6 / memory selections: /ZeC/DTC/Primary
    Dtc_Props_9a842796: extended-data-records=[StandardDTCInformation, StandFreezeFrame], freeze-frame-content=DataIdentifierSet0x7975, max-number-freeze-frame-records=6, priority=4  # priority: 4 / aging: /ZeC/DTC/DefaultAging / extended data records: /ZeC/DTC/ExtendedDataRecords/StandardDTCInformation /ZeC/DTC/ExtendedDataRecords/StandFreezeFrame / freeze frame content: /ZeC/DTC/FreezeFrames/DataIdentifierSet0x7975 / no value for freeze frame identifier / number of freeze frames: 6 / memory selections: /ZeC/DTC/Primary
    Dtc_Props_dc9d2dac: extended-data-records=[StandardDTCInformation, StandFreezeFrame], freeze-frame-content=DataIdentifierSet0x7974, max-number-freeze-frame-records=6, priority=4  # priority: 4 / aging: /ZeC/DTC/DefaultAging / extended data records: /ZeC/DTC/ExtendedDataRecords/StandardDTCInformation /ZeC/DTC/ExtendedDataRecords/StandFreezeFrame / freeze frame content: /ZeC/DTC/FreezeFrames/DataIdentifierSet0x7974 / no value for freeze frame identifier / number of freeze frames: 6 / memory selections: /ZeC/DTC/Primary
    Dtc_Props_16b633e2: extended-data-records=[StandardDTCInformation, StandFreezeFrame], freeze-frame-content=DataIdentifierSet0x7977, max-number-freeze-frame-records=6, priority=4  # priority: 4 / aging: /ZeC/DTC/DefaultAging / extended data records: /ZeC/DTC/ExtendedDataRecords/StandardDTCInformation /ZeC/DTC/ExtendedDataRecords/StandFreezeFrame / freeze frame content: /ZeC/DTC/FreezeFrames/DataIdentifierSet0x7977 / no value for freeze frame identifier / number of freeze frames: 6 / memory selections: /ZeC/DTC/Primary
    Dtc_Props_50af39d8: extended-data-records=[StandardDTCInformation, StandFreezeFrame], freeze-frame-content=DataIdentifierSet0x7976, max-number-freeze-frame-records=6, priority=4  # priority: 4 / aging: /ZeC/DTC/DefaultAging / extended data records: /ZeC/DTC/ExtendedDataRecords/StandardDTCInformation /ZeC/DTC/ExtendedDataRecords/StandFreezeFrame / freeze frame content: /ZeC/DTC/FreezeFrames/DataIdentifierSet0x7976 / no value for freeze frame identifier / number of freeze frames: 6 / memory selections: /ZeC/DTC/Primary
    Dtc_Props_b51ee376: extended-data-records=[StandardDTCInformation, StandFreezeFrame], freeze-frame-content=DataIdentifierSet0x7924, max-number-freeze-frame-records=6, priority=4  # priority: 4 / aging: /ZeC/DTC/DefaultAging / extended data records: /ZeC/DTC/ExtendedDataRecords/StandardDTCInformation /ZeC/DTC/ExtendedDataRecords/StandFreezeFrame / freeze frame content: /ZeC/DTC/FreezeFrames/DataIdentifierSet0x7924 / no value for freeze frame identifier / number of freeze frames: 6 / memory selections: /ZeC/DTC/Primary
    Dtc_Props_bc20d391: extended-data-records=[StandardDTCInformation, StandFreezeFrame], freeze-frame-content=DataIdentifierSet0x7923, max-number-freeze-frame-records=6, priority=4  # priority: 4 / aging: /ZeC/DTC/DefaultAging / extended data records: /ZeC/DTC/ExtendedDataRecords/StandardDTCInformation /ZeC/DTC/ExtendedDataRecords/StandFreezeFrame / freeze frame content: /ZeC/DTC/FreezeFrames/DataIdentifierSet0x7923 / no value for freeze frame identifier / number of freeze frames: 6 / memory selections: /ZeC/DTC/Primary
    Dtc_Props_392cf702: extended-data-records=[StandardDTCInformation, StandFreezeFrame], freeze-frame-content=DataIdentifierSet0x7926, max-number-freeze-frame-records=6, priority=4  # priority: 4 / aging: /ZeC/DTC/DefaultAging / extended data records: /ZeC/DTC/ExtendedDataRecords/StandardDTCInformation /ZeC/DTC/ExtendedDataRecords/StandFreezeFrame / freeze frame content: /ZeC/DTC/FreezeFrames/DataIdentifierSet0x7926 / no value for freeze frame identifier / number of freeze frames: 6 / memory selections: /ZeC/DTC/Primary
    Dtc_Props_f307e94c: extended-data-records=[StandardDTCInformation, StandFreezeFrame], freeze-frame-content=DataIdentifierSet0x7925, max-number-freeze-frame-records=6, priority=4  # priority: 4 / aging: /ZeC/DTC/DefaultAging / extended data records: /ZeC/DTC/ExtendedDataRecords/StandardDTCInformation /ZeC/DTC/ExtendedDataRecords/StandFreezeFrame / freeze frame content: /ZeC/DTC/FreezeFrames/DataIdentifierSet0x7925 / no value for freeze frame identifier / number of freeze frames: 6 / memory selections: /ZeC/DTC/Primary
    Dtc_Props_760bcddf: extended-data-records=[StandardDTCInformation, StandFreezeFrame], freeze-frame-content=DataIdentifierSet0x7920, max-number-freeze-frame-records=6, priority=4  # priority: 4 / aging: /ZeC/DTC/DefaultAging / extended data records: /ZeC/DTC/ExtendedDataRecords/StandardDTCInformation /ZeC/DTC/ExtendedDataRecords/StandFreezeFrame / freeze frame content: /ZeC/DTC/FreezeFrames/DataIdentifierSet0x7920 / no value for freeze frame identifier / number of freeze frames: 6 / memory selections: /ZeC/DTC/Primary
    Dtc_Props_fa39d9ab: extended-data-records=[StandardDTCInformation, StandFreezeFrame], freeze-frame-content=DataIdentifierSet0x7922, max-number-freeze-frame-records=6, priority=4  # priority: 4 / aging: /ZeC/DTC/DefaultAging / extended data records: /ZeC/DTC/ExtendedDataRecords/StandardDTCInformation /ZeC/DTC/ExtendedDataRecords/StandFreezeFrame / freeze frame content: /ZeC/DTC/FreezeFrames/DataIdentifierSet0x7922 / no value for freeze frame identifier / number of freeze frames: 6 / memory selections: /ZeC/DTC/Primary
    Dtc_Props_3012c7e5: extended-data-records=[StandardDTCInformation, StandFreezeFrame], freeze-frame-content=DataIdentifierSet0x7921, max-number-freeze-frame-records=6, priority=4  # priority: 4 / aging: /ZeC/DTC/DefaultAging / extended data records: /ZeC/DTC/ExtendedDataRecords/StandardDTCInformation /ZeC/DTC/ExtendedDataRecords/StandFreezeFrame / freeze frame content: /ZeC/DTC/FreezeFrames/DataIdentifierSet0x7921 / no value for freeze frame identifier / number of freeze frames: 6 / memory selections: /ZeC/DTC/Primary
    Dtc_Props_2b5096cc: extended-data-records=[StandardDTCInformation, StandFreezeFrame], freeze-frame-content=DataIdentifierSet0x7928, max-number-freeze-frame-records=6, priority=4  # priority: 4 / aging: /ZeC/DTC/DefaultAging / extended data records: /ZeC/DTC/ExtendedDataRecords/StandardDTCInformation /ZeC/DTC/ExtendedDataRecords/StandFreezeFrame / freeze frame content: /ZeC/DTC/FreezeFrames/DataIdentifierSet0x7928 / no value for freeze frame identifier / number of freeze frames: 6 / memory selections: /ZeC/DTC/Primary
    Dtc_Props_7f35fd38: extended-data-records=[StandardDTCInformation, StandFreezeFrame], freeze-frame-content=DataIdentifierSet0x7927, max-number-freeze-frame-records=6, priority=4  # priority: 4 / aging: /ZeC/DTC/DefaultAging / extended data records: /ZeC/DTC/ExtendedDataRecords/StandardDTCInformation /ZeC/DTC/ExtendedDataRecords/StandFreezeFrame / freeze frame content: /ZeC/DTC/FreezeFrames/DataIdentifierSet0x7927 / no value for freeze frame identifier / number of freeze frames: 6 / memory selections: /ZeC/DTC/Primary
    Dtc_Props_6d499cf6: extended-data-records=[StandardDTCInformation, StandFreezeFrame], freeze-frame-content=DataIdentifierSet0x7929, max-number-freeze-frame-records=6, priority=4  # priority: 4 / aging: /ZeC/DTC/DefaultAging / extended data records: /ZeC/DTC/ExtendedDataRecords/StandardDTCInformation /ZeC/DTC/ExtendedDataRecords/StandFreezeFrame / freeze frame content: /ZeC/DTC/FreezeFrames/DataIdentifierSet0x7929 / no value for freeze frame identifier / number of freeze frames: 6 / memory selections: /ZeC/DTC/Primary
    Dtc_Props_88e1870b: extended-data-records=[StandardDTCInformation, StandFreezeFrame], freeze-frame-content=DataIdentifierSet0x792d, max-number-freeze-frame-records=6, priority=4  # priority: 4 / aging: /ZeC/DTC/DefaultAging / extended data records: /ZeC/DTC/ExtendedDataRecords/StandardDTCInformation /ZeC/DTC/ExtendedDataRecords/StandFreezeFrame / freeze frame content: /ZeC/DTC/FreezeFrames/DataIdentifierSet0x792d / no value for freeze frame identifier / number of freeze frames: 6 / memory selections: /ZeC/DTC/Primary
    Dtc_Props_81dfb7ec: extended-data-records=[StandardDTCInformation, StandFreezeFrame], freeze-frame-content=DataIdentifierSet0x792c, max-number-freeze-frame-records=6, priority=4  # priority: 4 / aging: /ZeC/DTC/DefaultAging / extended data records: /ZeC/DTC/ExtendedDataRecords/StandardDTCInformation /ZeC/DTC/ExtendedDataRecords/StandFreezeFrame / freeze frame content: /ZeC/DTC/FreezeFrames/DataIdentifierSet0x792c / no value for freeze frame identifier / number of freeze frames: 6 / memory selections: /ZeC/DTC/Primary
    Dtc_Props_4d3937f: extended-data-records=[StandardDTCInformation, StandFreezeFrame], freeze-frame-content=DataIdentifierSet0x792f, max-number-freeze-frame-records=6, priority=4  # priority: 4 / aging: /ZeC/DTC/DefaultAging / extended data records: /ZeC/DTC/ExtendedDataRecords/StandardDTCInformation /ZeC/DTC/ExtendedDataRecords/StandFreezeFrame / freeze frame content: /ZeC/DTC/FreezeFrames/DataIdentifierSet0x792f / no value for freeze frame identifier / number of freeze frames: 6 / memory selections: /ZeC/DTC/Primary
    Dtc_Props_cef88d31: extended-data-records=[StandardDTCInformation, StandFreezeFrame], freeze-frame-content=DataIdentifierSet0x792e, max-number-freeze-frame-records=6, priority=4  # priority: 4 / aging: /ZeC/DTC/DefaultAging / extended data records: /ZeC/DTC/ExtendedDataRecords/StandardDTCInformation /ZeC/DTC/ExtendedDataRecords/StandFreezeFrame / freeze frame content: /ZeC/DTC/FreezeFrames/DataIdentifierSet0x792e / no value for freeze frame identifier / number of freeze frames: 6 / memory selections: /ZeC/DTC/Primary
    Dtc_Props_c7c6bdd6: extended-data-records=[StandardDTCInformation, StandFreezeFrame], freeze-frame-content=DataIdentifierSet0x792b, max-number-freeze-frame-records=6, priority=4  # priority: 4 / aging: /ZeC/DTC/DefaultAging / extended data records: /ZeC/DTC/ExtendedDataRecords/StandardDTCInformation /ZeC/DTC/ExtendedDataRecords/StandFreezeFrame / freeze frame content: /ZeC/DTC/FreezeFrames/DataIdentifierSet0x792b / no value for freeze frame identifier / number of freeze frames: 6 / memory selections: /ZeC/DTC/Primary
    Dtc_Props_deda398: extended-data-records=[StandardDTCInformation, StandFreezeFrame], freeze-frame-content=DataIdentifierSet0x792a, max-number-freeze-frame-records=6, priority=4  # priority: 4 / aging: /ZeC/DTC/DefaultAging / extended data records: /ZeC/DTC/ExtendedDataRecords/StandardDTCInformation /ZeC/DTC/ExtendedDataRecords/StandFreezeFrame / freeze frame content: /ZeC/DTC/FreezeFrames/DataIdentifierSet0x792a / no value for freeze frame identifier / number of freeze frames: 6 / memory selections: /ZeC/DTC/Primary
    Dtc_Props_2d8e9418: extended-data-records=[StandardDTCInformation, StandFreezeFrame], freeze-frame-content=DataIdentifierSet0x7913, max-number-freeze-frame-records=6, priority=4  # priority: 4 / aging: /ZeC/DTC/DefaultAging / extended data records: /ZeC/DTC/ExtendedDataRecords/StandardDTCInformation /ZeC/DTC/ExtendedDataRecords/StandFreezeFrame / freeze frame content: /ZeC/DTC/FreezeFrames/DataIdentifierSet0x7913 / no value for freeze frame identifier / number of freeze frames: 6 / memory selections: /ZeC/DTC/Primary
    Dtc_Props_6b979e22: extended-data-records=[StandardDTCInformation, StandFreezeFrame], freeze-frame-content=DataIdentifierSet0x7912, max-number-freeze-frame-records=6, priority=4  # priority: 4 / aging: /ZeC/DTC/DefaultAging / extended data records: /ZeC/DTC/ExtendedDataRecords/StandardDTCInformation /ZeC/DTC/ExtendedDataRecords/StandFreezeFrame / freeze frame content: /ZeC/DTC/FreezeFrames/DataIdentifierSet0x7912 / no value for freeze frame identifier / number of freeze frames: 6 / memory selections: /ZeC/DTC/Primary
    Dtc_Props_62a9aec5: extended-data-records=[StandardDTCInformation, StandFreezeFrame], freeze-frame-content=DataIdentifierSet0x7915, max-number-freeze-frame-records=6, priority=4  # priority: 4 / aging: /ZeC/DTC/DefaultAging / extended data records: /ZeC/DTC/ExtendedDataRecords/StandardDTCInformation /ZeC/DTC/ExtendedDataRecords/StandFreezeFrame / freeze frame content: /ZeC/DTC/FreezeFrames/DataIdentifierSet0x7915 / no value for freeze frame identifier / number of freeze frames: 6 / memory selections: /ZeC/DTC/Primary
    Dtc_Props_24b0a4ff: extended-data-records=[StandardDTCInformation, StandFreezeFrame], freeze-frame-content=DataIdentifierSet0x7914, max-number-freeze-frame-records=6, priority=4  # priority: 4 / aging: /ZeC/DTC/DefaultAging / extended data records: /ZeC/DTC/ExtendedDataRecords/StandardDTCInformation /ZeC/DTC/ExtendedDataRecords/StandFreezeFrame / freeze frame content: /ZeC/DTC/FreezeFrames/DataIdentifierSet0x7914 / no value for freeze frame identifier / number of freeze frames: 6 / memory selections: /ZeC/DTC/Primary
    Dtc_Props_ee9bbab1: extended-data-records=[StandardDTCInformation, StandFreezeFrame], freeze-frame-content=DataIdentifierSet0x7917, max-number-freeze-frame-records=6, priority=4  # priority: 4 / aging: /ZeC/DTC/DefaultAging / extended data records: /ZeC/DTC/ExtendedDataRecords/StandardDTCInformation /ZeC/DTC/ExtendedDataRecords/StandFreezeFrame / freeze frame content: /ZeC/DTC/FreezeFrames/DataIdentifierSet0x7917 / no value for freeze frame identifier / number of freeze frames: 6 / memory selections: /ZeC/DTC/Primary
    Dtc_Props_a882b08b: extended-data-records=[StandardDTCInformation, StandFreezeFrame], freeze-frame-content=DataIdentifierSet0x7916, max-number-freeze-frame-records=6, priority=4  # priority: 4 / aging: /ZeC/DTC/DefaultAging / extended data records: /ZeC/DTC/ExtendedDataRecords/StandardDTCInformation /ZeC/DTC/ExtendedDataRecords/StandFreezeFrame / freeze frame content: /ZeC/DTC/FreezeFrames/DataIdentifierSet0x7916 / no value for freeze frame identifier / number of freeze frames: 6 / memory selections: /ZeC/DTC/Primary
    Dtc_Props_fce7db7f: extended-data-records=[StandardDTCInformation, StandFreezeFrame], freeze-frame-content=DataIdentifierSet0x7919, max-number-freeze-frame-records=6, priority=4  # priority: 4 / aging: /ZeC/DTC/DefaultAging / extended data records: /ZeC/DTC/ExtendedDataRecords/StandardDTCInformation /ZeC/DTC/ExtendedDataRecords/StandFreezeFrame / freeze frame content: /ZeC/DTC/FreezeFrames/DataIdentifierSet0x7919 / no value for freeze frame identifier / number of freeze frames: 6 / memory selections: /ZeC/DTC/Primary
    Dtc_Props_bafed145: extended-data-records=[StandardDTCInformation, StandFreezeFrame], freeze-frame-content=DataIdentifierSet0x7918, max-number-freeze-frame-records=6, priority=4  # priority: 4 / aging: /ZeC/DTC/DefaultAging / extended data records: /ZeC/DTC/ExtendedDataRecords/StandardDTCInformation /ZeC/DTC/ExtendedDataRecords/StandFreezeFrame / freeze frame content: /ZeC/DTC/FreezeFrames/DataIdentifierSet0x7918 / no value for freeze frame identifier / number of freeze frames: 6 / memory selections: /ZeC/DTC/Primary
    Dtc_Props_1071f065: extended-data-records=[StandardDTCInformation, StandFreezeFrame], freeze-frame-content=DataIdentifierSet0x791c, max-number-freeze-frame-records=6, priority=4  # priority: 4 / aging: /ZeC/DTC/DefaultAging / extended data records: /ZeC/DTC/ExtendedDataRecords/StandardDTCInformation /ZeC/DTC/ExtendedDataRecords/StandFreezeFrame / freeze frame content: /ZeC/DTC/FreezeFrames/DataIdentifierSet0x791c / no value for freeze frame identifier / number of freeze frames: 6 / memory selections: /ZeC/DTC/Primary
    Dtc_Props_5668fa5f: extended-data-records=[StandardDTCInformation, StandFreezeFrame], freeze-frame-content=DataIdentifierSet0x791b, max-number-freeze-frame-records=6, priority=4  # priority: 4 / aging: /ZeC/DTC/DefaultAging / extended data records: /ZeC/DTC/ExtendedDataRecords/StandardDTCInformation /ZeC/DTC/ExtendedDataRecords/StandFreezeFrame / freeze frame content: /ZeC/DTC/FreezeFrames/DataIdentifierSet0x791b / no value for freeze frame identifier / number of freeze frames: 6 / memory selections: /ZeC/DTC/Primary
    Dtc_Props_5f56cab8: extended-data-records=[StandardDTCInformation, StandFreezeFrame], freeze-frame-content=DataIdentifierSet0x791e, max-number-freeze-frame-records=6, priority=4  # priority: 4 / aging: /ZeC/DTC/DefaultAging / extended data records: /ZeC/DTC/ExtendedDataRecords/StandardDTCInformation /ZeC/DTC/ExtendedDataRecords/StandFreezeFrame / freeze frame content: /ZeC/DTC/FreezeFrames/DataIdentifierSet0x791e / no value for freeze frame identifier / number of freeze frames: 6 / memory selections: /ZeC/DTC/Primary
    Dtc_Props_194fc082: extended-data-records=[StandardDTCInformation, StandFreezeFrame], freeze-frame-content=DataIdentifierSet0x791d, max-number-freeze-frame-records=6, priority=4  # priority: 4 / aging: /ZeC/DTC/DefaultAging / extended data records: /ZeC/DTC/ExtendedDataRecords/StandardDTCInformation /ZeC/DTC/ExtendedDataRecords/StandFreezeFrame / freeze frame content: /ZeC/DTC/FreezeFrames/DataIdentifierSet0x791d / no value for freeze frame identifier / number of freeze frames: 6 / memory selections: /ZeC/DTC/Primary
    Dtc_Props_9c43e411: extended-data-records=[StandardDTCInformation, StandFreezeFrame], freeze-frame-content=DataIdentifierSet0x791a, max-number-freeze-frame-records=6, priority=4  # priority: 4 / aging: /ZeC/DTC/DefaultAging / extended data records: /ZeC/DTC/ExtendedDataRecords/StandardDTCInformation /ZeC/DTC/ExtendedDataRecords/StandFreezeFrame / freeze frame content: /ZeC/DTC/FreezeFrames/DataIdentifierSet0x791a / no value for freeze frame identifier / number of freeze frames: 6 / memory selections: /ZeC/DTC/Primary
    Dtc_Props_957dd4f6: extended-data-records=[StandardDTCInformation, StandFreezeFrame], freeze-frame-content=DataIdentifierSet0x791f, max-number-freeze-frame-records=6, priority=4  # priority: 4 / aging: /ZeC/DTC/DefaultAging / extended data records: /ZeC/DTC/ExtendedDataRecords/StandardDTCInformation /ZeC/DTC/ExtendedDataRecords/StandFreezeFrame / freeze frame content: /ZeC/DTC/FreezeFrames/DataIdentifierSet0x791f / no value for freeze frame identifier / number of freeze frames: 6 / memory selections: /ZeC/DTC/Primary
    Dtc_Props_c1017e51: extended-data-records=[StandardDTCInformation, StandFreezeFrame], freeze-frame-content=DataIdentifierSet0x7946, max-number-freeze-frame-records=6, priority=4  # priority: 4 / aging: /ZeC/DTC/DefaultAging / extended data records: /ZeC/DTC/ExtendedDataRecords/StandardDTCInformation /ZeC/DTC/ExtendedDataRecords/StandFreezeFrame / freeze frame content: /ZeC/DTC/FreezeFrames/DataIdentifierSet0x7946 / no value for freeze frame identifier / number of freeze frames: 6 / memory selections: /ZeC/DTC/Primary
    Dtc_Props_b2a601f: extended-data-records=[StandardDTCInformation, StandFreezeFrame], freeze-frame-content=DataIdentifierSet0x7945, max-number-freeze-frame-records=6, priority=4  # priority: 4 / aging: /ZeC/DTC/DefaultAging / extended data records: /ZeC/DTC/ExtendedDataRecords/StandardDTCInformation /ZeC/DTC/ExtendedDataRecords/StandFreezeFrame / freeze frame content: /ZeC/DTC/FreezeFrames/DataIdentifierSet0x7945 / no value for freeze frame identifier / number of freeze frames: 6 / memory selections: /ZeC/DTC/Primary
    Dtc_Props_d37d1f9f: extended-data-records=[StandardDTCInformation, StandFreezeFrame], freeze-frame-content=DataIdentifierSet0x7948, max-number-freeze-frame-records=6, priority=4  # priority: 4 / aging: /ZeC/DTC/DefaultAging / extended data records: /ZeC/DTC/ExtendedDataRecords/StandardDTCInformation /ZeC/DTC/ExtendedDataRecords/StandFreezeFrame / freeze frame content: /ZeC/DTC/FreezeFrames/DataIdentifierSet0x7948 / no value for freeze frame identifier / number of freeze frames: 6 / memory selections: /ZeC/DTC/Primary
    Dtc_Props_8718746b: extended-data-records=[StandardDTCInformation, StandFreezeFrame], freeze-frame-content=DataIdentifierSet0x7947, max-number-freeze-frame-records=6, priority=4  # priority: 4 / aging: /ZeC/DTC/DefaultAging / extended data records: /ZeC/DTC/ExtendedDataRecords/StandardDTCInformation /ZeC/DTC/ExtendedDataRecords/StandFreezeFrame / freeze frame content: /ZeC/DTC/FreezeFrames/DataIdentifierSet0x7947 / no value for freeze frame identifier / number of freeze frames: 6 / memory selections: /ZeC/DTC/Primary
    Dtc_Props_21450f8: extended-data-records=[StandardDTCInformation, StandFreezeFrame], freeze-frame-content=DataIdentifierSet0x7942, max-number-freeze-frame-records=6, priority=4  # priority: 4 / aging: /ZeC/DTC/DefaultAging / extended data records: /ZeC/DTC/ExtendedDataRecords/StandardDTCInformation /ZeC/DTC/ExtendedDataRecords/StandFreezeFrame / freeze frame content: /ZeC/DTC/FreezeFrames/DataIdentifierSet0x7942 / no value for freeze frame identifier / number of freeze frames: 6 / memory selections: /ZeC/DTC/Primary
    Dtc_Props_c83f4eb6: extended-data-records=[StandardDTCInformation, StandFreezeFrame], freeze-frame-content=DataIdentifierSet0x7941, max-number-freeze-frame-records=6, priority=4  # priority: 4 / aging: /ZeC/DTC/DefaultAging / extended data records: /ZeC/DTC/ExtendedDataRecords/StandardDTCInformation /ZeC/DTC/ExtendedDataRecords/StandFreezeFrame / freeze frame content: /ZeC/DTC/FreezeFrames/DataIdentifierSet0x7941 / no value for freeze frame identifier / number of freeze frames: 6 / memory selections: /ZeC/DTC/Primary
    Dtc_Props_4d336a25: extended-data-records=[StandardDTCInformation, StandFreezeFrame], freeze-frame-content=DataIdentifierSet0x7944, max-number-freeze-frame-records=6, priority=4  # priority: 4 / aging: /ZeC/DTC/DefaultAging / extended data records: /ZeC/DTC/ExtendedDataRecords/StandardDTCInformation /ZeC/DTC/ExtendedDataRecords/StandFreezeFrame / freeze frame content: /ZeC/DTC/FreezeFrames/DataIdentifierSet0x7944 / no value for freeze frame identifier / number of freeze frames: 6 / memory selections: /ZeC/DTC/Primary
    Dtc_Props_440d5ac2: extended-data-records=[StandardDTCInformation, StandFreezeFrame], freeze-frame-content=DataIdentifierSet0x7943, max-number-freeze-frame-records=6, priority=4  # priority: 4 / aging: /ZeC/DTC/DefaultAging / extended data records: /ZeC/DTC/ExtendedDataRecords/StandardDTCInformation /ZeC/DTC/ExtendedDataRecords/StandFreezeFrame / freeze frame content: /ZeC/DTC/FreezeFrames/DataIdentifierSet0x7943 / no value for freeze frame identifier / number of freeze frames: 6 / memory selections: /ZeC/DTC/Primary
    Dtc_Props_956415a5: extended-data-records=[StandardDTCInformation, StandFreezeFrame], freeze-frame-content=DataIdentifierSet0x7949, max-number-freeze-frame-records=6, priority=4  # priority: 4 / aging: /ZeC/DTC/DefaultAging / extended data records: /ZeC/DTC/ExtendedDataRecords/StandardDTCInformation /ZeC/DTC/ExtendedDataRecords/StandFreezeFrame / freeze frame content: /ZeC/DTC/FreezeFrames/DataIdentifierSet0x7949 / no value for freeze frame identifier / number of freeze frames: 6 / memory selections: /ZeC/DTC/Primary
    Dtc_Props_fcfe1a2c: extended-data-records=[StandardDTCInformation, StandFreezeFrame], freeze-frame-content=DataIdentifierSet0x794f, max-number-freeze-frame-records=6, priority=4  # priority: 4 / aging: /ZeC/DTC/DefaultAging / extended data records: /ZeC/DTC/ExtendedDataRecords/StandardDTCInformation /ZeC/DTC/ExtendedDataRecords/StandFreezeFrame / freeze frame content: /ZeC/DTC/FreezeFrames/DataIdentifierSet0x794f / no value for freeze frame identifier / number of freeze frames: 6 / memory selections: /ZeC/DTC/Primary
    Dtc_Props_36d50462: extended-data-records=[StandardDTCInformation, StandFreezeFrame], freeze-frame-content=DataIdentifierSet0x794e, max-number-freeze-frame-records=6, priority=4  # priority: 4 / aging: /ZeC/DTC/DefaultAging / extended data records: /ZeC/DTC/ExtendedDataRecords/StandardDTCInformation /ZeC/DTC/ExtendedDataRecords/StandFreezeFrame / freeze frame content: /ZeC/DTC/FreezeFrames/DataIdentifierSet0x794e / no value for freeze frame identifier / number of freeze frames: 6 / memory selections: /ZeC/DTC/Primary
    Dtc_Props_3feb3485: extended-data-records=[StandardDTCInformation, StandFreezeFrame], freeze-frame-content=DataIdentifierSet0x794b, max-number-freeze-frame-records=6, priority=4  # priority: 4 / aging: /ZeC/DTC/DefaultAging / extended data records: /ZeC/DTC/ExtendedDataRecords/StandardDTCInformation /ZeC/DTC/ExtendedDataRecords/StandFreezeFrame / freeze frame content: /ZeC/DTC/FreezeFrames/DataIdentifierSet0x794b / no value for freeze frame identifier / number of freeze frames: 6 / memory selections: /ZeC/DTC/Primary
    Dtc_Props_f5c02acb: extended-data-records=[StandardDTCInformation, StandFreezeFrame], freeze-frame-content=DataIdentifierSet0x794a, max-number-freeze-frame-records=6, priority=4  # priority: 4 / aging: /ZeC/DTC/DefaultAging / extended data records: /ZeC/DTC/ExtendedDataRecords/StandardDTCInformation /ZeC/DTC/ExtendedDataRecords/StandFreezeFrame / freeze frame content: /ZeC/DTC/FreezeFrames/DataIdentifierSet0x794a / no value for freeze frame identifier / number of freeze frames: 6 / memory selections: /ZeC/DTC/Primary
    Dtc_Props_70cc0e58: extended-data-records=[StandardDTCInformation, StandFreezeFrame], freeze-frame-content=DataIdentifierSet0x794d, max-number-freeze-frame-records=6, priority=4  # priority: 4 / aging: /ZeC/DTC/DefaultAging / extended data records: /ZeC/DTC/ExtendedDataRecords/StandardDTCInformation /ZeC/DTC/ExtendedDataRecords/StandFreezeFrame / freeze frame content: /ZeC/DTC/FreezeFrames/DataIdentifierSet0x794d / no value for freeze frame identifier / number of freeze frames: 6 / memory selections: /ZeC/DTC/Primary
    Dtc_Props_79f23ebf: extended-data-records=[StandardDTCInformation, StandFreezeFrame], freeze-frame-content=DataIdentifierSet0x794c, max-number-freeze-frame-records=6, priority=4  # priority: 4 / aging: /ZeC/DTC/DefaultAging / extended data records: /ZeC/DTC/ExtendedDataRecords/StandardDTCInformation /ZeC/DTC/ExtendedDataRecords/StandFreezeFrame / freeze frame content: /ZeC/DTC/FreezeFrames/DataIdentifierSet0x794c / no value for freeze frame identifier / number of freeze frames: 6 / memory selections: /ZeC/DTC/Primary
    Dtc_Props_e758e0e: extended-data-records=[StandardDTCInformation, StandFreezeFrame], freeze-frame-content=DataIdentifierSet0x7951, max-number-freeze-frame-records=6, priority=4  # priority: 4 / aging: /ZeC/DTC/DefaultAging / extended data records: /ZeC/DTC/ExtendedDataRecords/StandardDTCInformation /ZeC/DTC/ExtendedDataRecords/StandFreezeFrame / freeze frame content: /ZeC/DTC/FreezeFrames/DataIdentifierSet0x7951 / no value for freeze frame identifier / number of freeze frames: 6 / memory selections: /ZeC/DTC/Primary
    Dtc_Props_486c8434: extended-data-records=[StandardDTCInformation, StandFreezeFrame], freeze-frame-content=DataIdentifierSet0x7950, max-number-freeze-frame-records=6, priority=4  # priority: 4 / aging: /ZeC/DTC/DefaultAging / extended data records: /ZeC/DTC/ExtendedDataRecords/StandardDTCInformation /ZeC/DTC/ExtendedDataRecords/StandFreezeFrame / freeze frame content: /ZeC/DTC/FreezeFrames/DataIdentifierSet0x7950 / no value for freeze frame identifier / number of freeze frames: 6 / memory selections: /ZeC/DTC/Primary
    Dtc_Props_354d29f4: extended-data-records=[StandardDTCInformation, StandFreezeFrame], freeze-frame-content=DataIdentifierSet0x7935, max-number-freeze-frame-records=6, priority=4  # priority: 4 / aging: /ZeC/DTC/DefaultAging / extended data records: /ZeC/DTC/ExtendedDataRecords/StandardDTCInformation /ZeC/DTC/ExtendedDataRecords/StandFreezeFrame / freeze frame content: /ZeC/DTC/FreezeFrames/DataIdentifierSet0x7935 / no value for freeze frame identifier / number of freeze frames: 6 / memory selections: /ZeC/DTC/Primary
    Dtc_Props_735423ce: extended-data-records=[StandardDTCInformation, StandFreezeFrame], freeze-frame-content=DataIdentifierSet0x7934, max-number-freeze-frame-records=6, priority=4  # priority: 4 / aging: /ZeC/DTC/DefaultAging / extended data records: /ZeC/DTC/ExtendedDataRecords/StandardDTCInformation /ZeC/DTC/ExtendedDataRecords/StandFreezeFrame / freeze frame content: /ZeC/DTC/FreezeFrames/DataIdentifierSet0x7934 / no value for freeze frame identifier / number of freeze frames: 6 / memory selections: /ZeC/DTC/Primary
    Dtc_Props_b97f3d80: extended-data-records=[StandardDTCInformation, StandFreezeFrame], freeze-frame-content=DataIdentifierSet0x7937, max-number-freeze-frame-records=6, priority=4  # priority: 4 / aging: /ZeC/DTC/DefaultAging / extended data records: /ZeC/DTC/ExtendedDataRecords/StandardDTCInformation /ZeC/DTC/ExtendedDataRecords/StandFreezeFrame / freeze frame content: /ZeC/DTC/FreezeFrames/DataIdentifierSet0x7937 / no value for freeze frame identifier / number of freeze frames: 6 / memory selections: /ZeC/DTC/Primary
    Dtc_Props_ff6637ba: extended-data-records=[StandardDTCInformation, StandFreezeFrame], freeze-frame-content=DataIdentifierSet0x7936, max-number-freeze-frame-records=6, priority=4  # priority: 4 / aging: /ZeC/DTC/DefaultAging / extended data records: /ZeC/DTC/ExtendedDataRecords/StandardDTCInformation /ZeC/DTC/ExtendedDataRecords/StandFreezeFrame / freeze frame content: /ZeC/DTC/FreezeFrames/DataIdentifierSet0x7936 / no value for freeze frame identifier / number of freeze frames: 6 / memory selections: /ZeC/DTC/Primary
    Dtc_Props_f658075d: extended-data-records=[StandardDTCInformation, StandFreezeFrame], freeze-frame-content=DataIdentifierSet0x7931, max-number-freeze-frame-records=6, priority=4  # priority: 4 / aging: /ZeC/DTC/DefaultAging / extended data records: /ZeC/DTC/ExtendedDataRecords/StandardDTCInformation /ZeC/DTC/ExtendedDataRecords/StandFreezeFrame / freeze frame content: /ZeC/DTC/FreezeFrames/DataIdentifierSet0x7931 / no value for freeze frame identifier / number of freeze frames: 6 / memory selections: /ZeC/DTC/Primary
    Dtc_Props_b0410d67: extended-data-records=[StandardDTCInformation, StandFreezeFrame], freeze-frame-content=DataIdentifierSet0x7930, max-number-freeze-frame-records=6, priority=4  # priority: 4 / aging: /ZeC/DTC/DefaultAging / extended data records: /ZeC/DTC/ExtendedDataRecords/StandardDTCInformation /ZeC/DTC/ExtendedDataRecords/StandFreezeFrame / freeze frame content: /ZeC/DTC/FreezeFrames/DataIdentifierSet0x7930 / no value for freeze frame identifier / number of freeze frames: 6 / memory selections: /ZeC/DTC/Primary
    Dtc_Props_7a6a1329: extended-data-records=[StandardDTCInformation, StandFreezeFrame], freeze-frame-content=DataIdentifierSet0x7933, max-number-freeze-frame-records=6, priority=4  # priority: 4 / aging: /ZeC/DTC/DefaultAging / extended data records: /ZeC/DTC/ExtendedDataRecords/StandardDTCInformation /ZeC/DTC/ExtendedDataRecords/StandFreezeFrame / freeze frame content: /ZeC/DTC/FreezeFrames/DataIdentifierSet0x7933 / no value for freeze frame identifier / number of freeze frames: 6 / memory selections: /ZeC/DTC/Primary
    Dtc_Props_3c731913: extended-data-records=[StandardDTCInformation, StandFreezeFrame], freeze-frame-content=DataIdentifierSet0x7932, max-number-freeze-frame-records=6, priority=4  # priority: 4 / aging: /ZeC/DTC/DefaultAging / extended data records: /ZeC/DTC/ExtendedDataRecords/StandardDTCInformation /ZeC/DTC/ExtendedDataRecords/StandFreezeFrame / freeze frame content: /ZeC/DTC/FreezeFrames/DataIdentifierSet0x7932 / no value for freeze frame identifier / number of freeze frames: 6 / memory selections: /ZeC/DTC/Primary
    Dtc_Props_ab035c4e: extended-data-records=[StandardDTCInformation, StandFreezeFrame], freeze-frame-content=DataIdentifierSet0x7939, max-number-freeze-frame-records=6, priority=4  # priority: 4 / aging: /ZeC/DTC/DefaultAging / extended data records: /ZeC/DTC/ExtendedDataRecords/StandardDTCInformation /ZeC/DTC/ExtendedDataRecords/StandFreezeFrame / freeze frame content: /ZeC/DTC/FreezeFrames/DataIdentifierSet0x7939 / no value for freeze frame identifier / number of freeze frames: 6 / memory selections: /ZeC/DTC/Primary
    Dtc_Props_ed1a5674: extended-data-records=[StandardDTCInformation, StandFreezeFrame], freeze-frame-content=DataIdentifierSet0x7938, max-number-freeze-frame-records=6, priority=4  # priority: 4 / aging: /ZeC/DTC/DefaultAging / extended data records: /ZeC/DTC/ExtendedDataRecords/StandardDTCInformation /ZeC/DTC/ExtendedDataRecords/StandFreezeFrame / freeze frame content: /ZeC/DTC/FreezeFrames/DataIdentifierSet0x7938 / no value for freeze frame identifier / number of freeze frames: 6 / memory selections: /ZeC/DTC/Primary
    Dtc_Props_8b24d89: extended-data-records=[StandardDTCInformation, StandFreezeFrame], freeze-frame-content=DataIdentifierSet0x793e, max-number-freeze-frame-records=6, priority=4  # priority: 4 / aging: /ZeC/DTC/DefaultAging / extended data records: /ZeC/DTC/ExtendedDataRecords/StandardDTCInformation /ZeC/DTC/ExtendedDataRecords/StandFreezeFrame / freeze frame content: /ZeC/DTC/FreezeFrames/DataIdentifierSet0x793e / no value for freeze frame identifier / number of freeze frames: 6 / memory selections: /ZeC/DTC/Primary
    Dtc_Props_4eab47b3: extended-data-records=[StandardDTCInformation, StandFreezeFrame], freeze-frame-content=DataIdentifierSet0x793d, max-number-freeze-frame-records=6, priority=4  # priority: 4 / aging: /ZeC/DTC/DefaultAging / extended data records: /ZeC/DTC/ExtendedDataRecords/StandardDTCInformation /ZeC/DTC/ExtendedDataRecords/StandFreezeFrame / freeze frame content: /ZeC/DTC/FreezeFrames/DataIdentifierSet0x793d / no value for freeze frame identifier / number of freeze frames: 6 / memory selections: /ZeC/DTC/Primary
    Dtc_Props_c29953c7: extended-data-records=[StandardDTCInformation, StandFreezeFrame], freeze-frame-content=DataIdentifierSet0x793f, max-number-freeze-frame-records=6, priority=4  # priority: 4 / aging: /ZeC/DTC/DefaultAging / extended data records: /ZeC/DTC/ExtendedDataRecords/StandardDTCInformation /ZeC/DTC/ExtendedDataRecords/StandFreezeFrame / freeze frame content: /ZeC/DTC/FreezeFrames/DataIdentifierSet0x793f / no value for freeze frame identifier / number of freeze frames: 6 / memory selections: /ZeC/DTC/Primary
    Dtc_Props_cba76320: extended-data-records=[StandardDTCInformation, StandFreezeFrame], freeze-frame-content=DataIdentifierSet0x793a, max-number-freeze-frame-records=6, priority=4  # priority: 4 / aging: /ZeC/DTC/DefaultAging / extended data records: /ZeC/DTC/ExtendedDataRecords/StandardDTCInformation /ZeC/DTC/ExtendedDataRecords/StandFreezeFrame / freeze frame content: /ZeC/DTC/FreezeFrames/DataIdentifierSet0x793a / no value for freeze frame identifier / number of freeze frames: 6 / memory selections: /ZeC/DTC/Primary
    Dtc_Props_47957754: extended-data-records=[StandardDTCInformation, StandFreezeFrame], freeze-frame-content=DataIdentifierSet0x793c, max-number-freeze-frame-records=6, priority=4  # priority: 4 / aging: /ZeC/DTC/DefaultAging / extended data records: /ZeC/DTC/ExtendedDataRecords/StandardDTCInformation /ZeC/DTC/ExtendedDataRecords/StandFreezeFrame / freeze frame content: /ZeC/DTC/FreezeFrames/DataIdentifierSet0x793c / no value for freeze frame identifier / number of freeze frames: 6 / memory selections: /ZeC/DTC/Primary
    Dtc_Props_18c7d6e: extended-data-records=[StandardDTCInformation, StandFreezeFrame], freeze-frame-content=DataIdentifierSet0x793b, max-number-freeze-frame-records=6, priority=4  # priority: 4 / aging: /ZeC/DTC/DefaultAging / extended data records: /ZeC/DTC/ExtendedDataRecords/StandardDTCInformation /ZeC/DTC/ExtendedDataRecords/StandFreezeFrame / freeze frame content: /ZeC/DTC/FreezeFrames/DataIdentifierSet0x793b / no value for freeze frame identifier / number of freeze frames: 6 / memory selections: /ZeC/DTC/Primary
    Dtc_Props_8e26448c: extended-data-records=[StandardDTCInformation, StandFreezeFrame], freeze-frame-content=DataIdentifierSet0x7940, max-number-freeze-frame-records=6, priority=4  # priority: 4 / aging: /ZeC/DTC/DefaultAging / extended data records: /ZeC/DTC/ExtendedDataRecords/StandardDTCInformation /ZeC/DTC/ExtendedDataRecords/StandFreezeFrame / freeze frame content: /ZeC/DTC/FreezeFrames/DataIdentifierSet0x7940 / no value for freeze frame identifier / number of freeze frames: 6 / memory selections: /ZeC/DTC/Primary
    Dtc_Props_906b1391: extended-data-records=[StandardDTCInformation, StandFreezeFrame, Record7], priority=3  # priority: 3 / aging: /ZeC/DTC/DefaultAging / extended data records: /ZeC/DTC/ExtendedDataRecords/StandardDTCInformation /ZeC/DTC/ExtendedDataRecords/StandFreezeFrame /ZeC/DTC/ExtendedDataRecords/Record7 / no value for freeze frame content / no value for freeze frame identifier / no value for number of freeze frames / memory selections: /ZeC/DTC/Primary
    Dtc_Props_9585e9dc: extended-data-records=[StandardDTCInformation, StandFreezeFrame, Record6], priority=4  # priority: 4 / aging: /ZeC/DTC/DefaultAging / extended data records: /ZeC/DTC/ExtendedDataRecords/StandardDTCInformation /ZeC/DTC/ExtendedDataRecords/StandFreezeFrame /ZeC/DTC/ExtendedDataRecords/Record6 / no value for freeze frame content / no value for freeze frame identifier / no value for number of freeze frames / memory selections: /ZeC/DTC/Primary
package /ZeC/Routine
  diagnostic routine control class Diagnostic_Routine_Control_Class: access-permission-validity=ACCESS-PERMISSION-SERVICE-INSTANCE  # Diagnostic Routine Control Class
package /ZeC/Routine/Vkms_check_verification_hash
  diagnostic routine VkmsCheckVerificationHash: id=0xc00b  # Vkms_check_verification_hash
    request result Result_Subfunction  # Result Subfunction
      diagnostic-parameter bit-offset=0:
        diagnostic data element Routine_Request_Routine_Results_Response_Vkms_check_verification_hash_Routine_Status_Routine_Result: base-type=uint8, compu {2=Routine Status: Routine Aborted (TTR615), 4=Routine Status: Routine Finished Correctly (TTR815), 3=Routine Status: Routine Execution Stuck (TTR715), 1=Routine Status: Routine Active (TTR515), 0=Routine Status: Routine Inactive; Routine Result: No Results Available (TTR415TTR117), 16=Routine Result: Incorrect Results (TTR216), 32=Routine Result: Correct Results (TTR316)}  # Parameters: Routine Status / Routine Result
      diagnostic-parameter bit-offset=8:
        diagnostic data element Routine_Request_Routine_Results_Response_Vkms_check_verification_hash_ErrorCode: base-type=uint8  # Parameters: ErrorCode
    start Start_Subfunction  # Start Subfunction
      diagnostic-parameter bit-offset=0:
        diagnostic data element Routine_Start_Routine_Request_Vkms_check_verification_hash_Reserved: base-type=uint8  # Parameters: Reserved
      diagnostic-parameter bit-offset=8:
        diagnostic data element Routine_Start_Routine_Request_Vkms_check_verification_hash_VHASH_data: array-size-semantics=FIXED-SIZE, max-number-of-elements=16, base-type=uint8  # Parameters: VHASH_data
  diagnostic routine control RoutineControlVkmsCheckVerificationHash: access-permission=READWRITE0x03ExtendedSession, routine-control-class=Diagnostic_Routine_Control_Class, routine=VkmsCheckVerificationHash  # RoutineControl_Vkms_check_verification_hash
package /ZeC/Routine/Reset_counter_invalid_someip_messages
  diagnostic routine ResetCounterInvalidSomeipMessages: id=0xb11a  # Reset_counter_invalid_someip_messages
    request result Result_Subfunction  # Result Subfunction
      diagnostic-parameter bit-offset=0:
        diagnostic data element Routine_Request_Routine_Results_Response_Reset_counter_invalid_someip_messages_Routine_Status_Routine_Result: base-type=uint8, compu-method=Reset_counter_invalid_someip_messages/TEXTTABLE_RoutineStatusRoutineResult  # Parameters: Routine Status / Routine Result
    start Start_Subfunction  # Start Subfunction
      diagnostic-parameter bit-offset=0:
        diagnostic data element Routine_Start_Routine_Response_Reset_counter_invalid_someip_messages_Routine_Status_Routine_Result: base-type=uint8, compu-method=Reset_counter_invalid_someip_messages/TEXTTABLE_RoutineStatusRoutineResult  # Parameters: Routine Status / Routine Result
    stop Stop_Subfunction  # Stop Subfunction
      diagnostic-parameter bit-offset=0:
        diagnostic data element Routine_Stop_Routine_Response_Reset_counter_invalid_someip_messages_Routine_Status_Routine_Result: base-type=uint8, compu-method=Reset_counter_invalid_someip_messages/TEXTTABLE_RoutineStatusRoutineResult  # Parameters: Routine Status / Routine Result
  compu method TEXTTABLE_RoutineStatusRoutineResult: 2=Routine Status: Routine Aborted (TTR615), 4=Routine Status: Routine Finished Correctly (TTR815), 3=Routine Status: Routine Execution Stuck (TTR715), 1=Routine Status: Routine Active (TTR515), 0=Routine Status: Routine Inactive; Routine Result: No Results Available (TTR415TTR117), 16=Routine Result: Incorrect Results (TTR216), 32=Routine Result: Correct Results (TTR316)
  diagnostic routine control RoutineControlResetCounterInvalidSomeipMessages: access-permission=READWRITEBasicSFDRole0x01DefaultSession0x03ExtendedSession, routine-control-class=Diagnostic_Routine_Control_Class, routine=ResetCounterInvalidSomeipMessages  # RoutineControl_Reset_counter_invalid_someip_messages
package /ZeC/Routine/Vkms_handle_downloadcontainer
  diagnostic routine VkmsHandleDownloadcontainer: id=0xc00a  # Vkms_handle_downloadcontainer
    request result Result_Subfunction  # Result Subfunction
      diagnostic-parameter bit-offset=0:
        diagnostic data element Routine_Request_Routine_Results_Response_Vkms_handle_downloadcontainer_Routine_Status_Routine_Result: base-type=uint8, compu {2=Routine Status: Routine Aborted (TTR615), 4=Routine Status: Routine Finished Correctly (TTR815), 3=Routine Status: Routine Execution Stuck (TTR715), 1=Routine Status: Routine Active (TTR515), 0=Routine Status: Routine Inactive; Routine Result: No Results Available (TTR415TTR117), 16=Routine Result: Incorrect Results (TTR216), 32=Routine Result: Correct Results (TTR316)}  # Parameters: Routine Status / Routine Result
      diagnostic-parameter bit-offset=8:
        diagnostic data element Routine_Request_Routine_Results_Response_Vkms_handle_downloadcontainer_ErrorCode: base-type=uint8  # Parameters: ErrorCode
    start Start_Subfunction  # Start Subfunction
      diagnostic-parameter bit-offset=0:
        diagnostic data element Routine_Start_Routine_Request_Vkms_handle_downloadcontainer_Reserved: base-type=uint8  # Parameters: Reserved
      diagnostic-parameter bit-offset=8:
        diagnostic data element Routine_Start_Routine_Request_Vkms_handle_downloadcontainer_DLC_data: array-size-semantics=VARIABLE-SIZE, max-number-of-elements=1, base-type=uint8  # Parameters: DLC_data
  diagnostic routine control RoutineControlVkmsHandleDownloadcontainer: access-permission=READWRITE0x03ExtendedSession, routine-control-class=Diagnostic_Routine_Control_Class, routine=VkmsHandleDownloadcontainer  # RoutineControl_Vkms_handle_downloadcontainer
package /ZeC/Routine/Request_systems_involved_in_function
  diagnostic routine RequestSystemsInvolvedInFunction: id=0x0f01  # Request_systems_involved_in_function
    start Start_Subfunction  # Start Subfunction
      diagnostic-parameter bit-offset=0:
        diagnostic data element Routine_Start_Routine_Request_Request_systems_involved_in_function_Parameter_type: base-type=uint8, compu {1=Parameter_type: SWCO-IDs (Software Composition Identifiers) (TTR745912)}  # Parameters: Parameter_type
      diagnostic-parameter bit-offset=8:
        diagnostic data element Routine_Start_Routine_Request_Request_systems_involved_in_function_Function_number: array-size-semantics=FIXED-SIZE, max-number-of-elements=8, base-type=uint8  # Parameters: Function_number
      diagnostic-parameter bit-offset=8:
        diagnostic data element Routine_Start_Routine_Response_Request_systems_involved_in_function_Function_number: array-size-semantics=FIXED-SIZE, max-number-of-elements=8, base-type=uint8  # Parameters: Function_number
      diagnostic-parameter bit-offset=72:
        diagnostic data element Routine_Start_Routine_Response_Request_systems_involved_in_function_Number_of_SWCOs: base-type=uint8  # Parameters: Number_of_SWCOs
      diagnostic-parameter bit-offset=80:
        diagnostic data element Routine_Start_Routine_Response_Request_systems_involved_in_function_SWCO_ID: array-size-semantics=VARIABLE-SIZE, max-number-of-elements=64, base-type=uint8  # Parameters: SWCO-ID
  diagnostic routine control RoutineControlRequestSystemsInvolvedInFunction: access-permission=READWRITE0x01DefaultSession0x03ExtendedSession, routine-control-class=Diagnostic_Routine_Control_Class, routine=RequestSystemsInvolvedInFunction  # RoutineControl_Request_systems_involved_in_function
package /ZeC/Routine/Reset_ethernet_link_lost_counter
  diagnostic routine ResetEthernetLinkLostCounter: id=0x068f  # Reset_ethernet_link_lost_counter
    request result Result_Subfunction  # Result Subfunction
      diagnostic-parameter bit-offset=0:
        diagnostic data element Routine_Request_Routine_Results_Response_Reset_ethernet_link_lost_counter_Routine_Status: base-type=uint8, compu {1=Routine Status: Routine Active (TTR298712), 3=Routine Status: Routine Aborted (TTR298912), 2=Routine Status: Routine not active or finished correctly (TTR298812)}  # Parameters: Routine Status
      diagnostic-parameter bit-offset=8:
        diagnostic data element Routine_Request_Routine_Results_Response_Reset_ethernet_link_lost_counter_Routine_Results: base-type=uint16, compu {65535=Routine Results: Correct Results (TTR342912), 1=Routine Results: No Results Available (TTR299112), 0=Routine Results: Incorrect Results (TTR343012)}  # Parameters: Routine Results
    start Start_Subfunction  # Start Subfunction
      diagnostic-parameter bit-offset=0:
        diagnostic data element Routine_Start_Routine_Request_Reset_ethernet_link_lost_counter_Basic_setting: array-size-semantics=FIXED-SIZE, max-number-of-elements=3, base-type=uint8, compu {262144=Basic setting: Basic setting (TTR746712)}  # Parameters: Basic setting
      diagnostic-parameter bit-offset=0:
        diagnostic data element Routine_Start_Routine_Response_Reset_ethernet_link_lost_counter_Routine_Status_Routine_Result: base-type=uint8, compu-method=Reset_ethernet_link_lost_counter/TEXTTABLE_RoutineStatusRoutineResult  # Parameters: Routine Status / Routine Result
    stop Stop_Subfunction  # Stop Subfunction
      diagnostic-parameter bit-offset=0:
        diagnostic data element Routine_Stop_Routine_Response_Reset_ethernet_link_lost_counter_Routine_Status_Routine_Result: base-type=uint8, compu-method=Reset_ethernet_link_lost_counter/TEXTTABLE_RoutineStatusRoutineResult  # Parameters: Routine Status / Routine Result
  compu method TEXTTABLE_RoutineStatusRoutineResult: 2=Routine Status: Routine Aborted (TTR615), 4=Routine Status: Routine Finished Correctly (TTR815), 3=Routine Status: Routine Execution Stuck (TTR715), 1=Routine Status: Routine Active (TTR515), 0=Routine Status: Routine Inactive; Routine Result: No Results Available (TTR415TTR117), 16=Routine Result: Incorrect Results (TTR216), 32=Routine Result: Correct Results (TTR316)
  diagnostic routine control RoutineControlResetEthernetLinkLostCounter: access-permission=READWRITE0x03ExtendedSession0x40EOLSession0x4FDevelopmentSession, routine-control-class=Diagnostic_Routine_Control_Class, routine=ResetEthernetLinkLostCounter  # RoutineControl_Reset_ethernet_link_lost_counter
package /ZeC/Routine/Reset_ip_counter_dropped_udp_tcp_packets_layer_4
  diagnostic routine ResetIpCounterDroppedUdpTcpPacketsLayer4: id=0x068d  # Reset_ip_counter_dropped_udp_tcp_packets_layer_4
    request result Result_Subfunction  # Result Subfunction
      diagnostic-parameter bit-offset=0:
        diagnostic data element Routine_Request_Routine_Results_Response_Reset_ip_counter_dropped_udp_tcp_packets_layer_4_Routine_Status: base-type=uint8, compu {1=Routine Status: Routine Active (TTR298712), 3=Routine Status: Routine Aborted (TTR298912), 2=Routine Status: Routine not active or finished correctly (TTR298812)}  # Parameters: Routine Status
      diagnostic-parameter bit-offset=8:
        diagnostic data element Routine_Request_Routine_Results_Response_Reset_ip_counter_dropped_udp_tcp_packets_layer_4_Routine_Results: base-type=uint16, compu {1=Routine Results: No Results Available (TTR299112), 65535=Routine Results: Correct Results (TTR342912), 0=Routine Results: Incorrect Results (TTR343012)}  # Parameters: Routine Results
    start Start_Subfunction  # Start Subfunction
      diagnostic-parameter bit-offset=0:
        diagnostic data element Routine_Start_Routine_Request_Reset_ip_counter_dropped_udp_tcp_packets_layer_4_Routine_Control_Option: array-size-semantics=FIXED-SIZE, max-number-of-elements=3, base-type=uint8, compu {262144=Routine Control Option: Grundeinstellung (TTR284312)}  # Parameters: Routine Control Option
      diagnostic-parameter bit-offset=0:
        diagnostic data element Routine_Start_Routine_Response_Reset_ip_counter_dropped_udp_tcp_packets_layer_4_Routine_Status_Routine_Result: base-type=uint8, compu-method=Reset_ip_counter_dropped_udp_tcp_packets_layer_4/TEXTTABLE_RoutineStatusRoutineResult  # Parameters: Routine Status / Routine Result
    stop Stop_Subfunction  # Stop Subfunction
      diagnostic-parameter bit-offset=0:
        diagnostic data element Routine_Stop_Routine_Response_Reset_ip_counter_dropped_udp_tcp_packets_layer_4_Routine_Status_Routine_Result: base-type=uint8, compu-method=Reset_ip_counter_dropped_udp_tcp_packets_layer_4/TEXTTABLE_RoutineStatusRoutineResult  # Parameters: Routine Status / Routine Result
  compu method TEXTTABLE_RoutineStatusRoutineResult: 2=Routine Status: Routine Aborted (TTR615), 4=Routine Status: Routine Finished Correctly (TTR815), 3=Routine Status: Routine Execution Stuck (TTR715), 1=Routine Status: Routine Active (TTR515), 0=Routine Status: Routine Inactive; Routine Result: No Results Available (TTR415TTR117), 16=Routine Result: Incorrect Results (TTR216), 32=Routine Result: Correct Results (TTR316)
  diagnostic routine control RoutineControlResetIpCounterDroppedUdpTcpPacketsLayer4: access-permission=READWRITE0x01DefaultSession0x03ExtendedSession, routine-control-class=Diagnostic_Routine_Control_Class, routine=ResetIpCounterDroppedUdpTcpPacketsLayer4  # RoutineControl_Reset_ip_counter_dropped_udp_tcp_packets_layer_4
package /ZeC/Routine/Reset_ip_counter_dropped_ipv6_packets_layer_3
  diagnostic routine ResetIpCounterDroppedIpv6PacketsLayer3: id=0x068c  # Reset_ip_counter_dropped_ipv6_packets_layer_3
    request result Result_Subfunction  # Result Subfunction
      diagnostic-parameter bit-offset=0:
        diagnostic data element Routine_Request_Routine_Results_Response_Reset_ip_counter_dropped_ipv6_packets_layer_3_Routine_Status: base-type=uint8, compu {1=Routine Status: Routine Active (TTR298712), 3=Routine Status: Routine Aborted (TTR298912), 2=Routine Status: Routine not active or finished correctly (TTR298812)}  # Parameters: Routine Status
      diagnostic-parameter bit-offset=8:
        diagnostic data element Routine_Request_Routine_Results_Response_Reset_ip_counter_dropped_ipv6_packets_layer_3_Routine_Results: base-type=uint16, compu {65535=Routine Results: Correct Results (TTR342912), 1=Routine Results: No Results Available (TTR299112), 0=Routine Results: Incorrect Results (TTR343012)}  # Parameters: Routine Results
    start Start_Subfunction  # Start Subfunction
      diagnostic-parameter bit-offset=0:
        diagnostic data element Routine_Start_Routine_Request_Reset_ip_counter_dropped_ipv6_packets_layer_3_Routine_Control_Option: array-size-semantics=FIXED-SIZE, max-number-of-elements=3, base-type=uint8, compu {262144=Routine Control Option: Grundeinstellung (TTR284312)}  # Parameters: Routine Control Option
      diagnostic-parameter bit-offset=0:
        diagnostic data element Routine_Start_Routine_Response_Reset_ip_counter_dropped_ipv6_packets_layer_3_Routine_Status_Routine_Result: base-type=uint8, compu-method=Reset_ip_counter_dropped_ipv6_packets_layer_3/TEXTTABLE_RoutineStatusRoutineResult  # Parameters: Routine Status / Routine Result
    stop Stop_Subfunction  # Stop Subfunction
      diagnostic-parameter bit-offset=0:
        diagnostic data element Routine_Stop_Routine_Response_Reset_ip_counter_dropped_ipv6_packets_layer_3_Routine_Status_Routine_Result: base-type=uint8, compu-method=Reset_ip_counter_dropped_ipv6_packets_layer_3/TEXTTABLE_RoutineStatusRoutineResult  # Parameters: Routine Status / Routine Result
  compu method TEXTTABLE_RoutineStatusRoutineResult: 2=Routine Status: Routine Aborted (TTR615), 4=Routine Status: Routine Finished Correctly (TTR815), 3=Routine Status: Routine Execution Stuck (TTR715), 1=Routine Status: Routine Active (TTR515), 0=Routine Status: Routine Inactive; Routine Result: No Results Available (TTR415TTR117), 16=Routine Result: Incorrect Results (TTR216), 32=Routine Result: Correct Results (TTR316)
  diagnostic routine control RoutineControlResetIpCounterDroppedIpv6PacketsLayer3: access-permission=READWRITE0x01DefaultSession0x03ExtendedSession, routine-control-class=Diagnostic_Routine_Control_Class, routine=ResetIpCounterDroppedIpv6PacketsLayer3  # RoutineControl_Reset_ip_counter_dropped_ipv6_packets_layer_3
package /ZeC/Routine/Reset_counter_invalid_someip_sd_subscriptions
  diagnostic routine ResetCounterInvalidSomeipSdSubscriptions: id=0xb118  # Reset_counter_invalid_someip_sd_subscriptions
    request result Result_Subfunction  # Result Subfunction
      diagnostic-parameter bit-offset=0:
        diagnostic data element Routine_Request_Routine_Results_Response_Reset_counter_invalid_someip_sd_subscriptions_Routine_Status_Routine_Result: base-type=uint8, compu-method=Reset_counter_invalid_someip_sd_subscriptions/TEXTTABLE_RoutineStatusRoutineResult  # Parameters: Routine Status / Routine Result
    start Start_Subfunction  # Start Subfunction
      diagnostic-parameter bit-offset=0:
        diagnostic data element Routine_Start_Routine_Response_Reset_counter_invalid_someip_sd_subscriptions_Routine_Status_Routine_Result: base-type=uint8, compu-method=Reset_counter_invalid_someip_sd_subscriptions/TEXTTABLE_RoutineStatusRoutineResult  # Parameters: Routine Status / Routine Result
    stop Stop_Subfunction  # Stop Subfunction
      diagnostic-parameter bit-offset=0:
        diagnostic data element Routine_Stop_Routine_Response_Reset_counter_invalid_someip_sd_subscriptions_Routine_Status_Routine_Result: base-type=uint8, compu-method=Reset_counter_invalid_someip_sd_subscriptions/TEXTTABLE_RoutineStatusRoutineResult  # Parameters: Routine Status / Routine Result
  compu method TEXTTABLE_RoutineStatusRoutineResult: 2=Routine Status: Routine Aborted (TTR615), 4=Routine Status: Routine Finished Correctly (TTR815), 3=Routine Status: Routine Execution Stuck (TTR715), 1=Routine Status: Routine Active (TTR515), 0=Routine Status: Routine Inactive; Routine Result: No Results Available (TTR415TTR117), 16=Routine Result: Incorrect Results (TTR216), 32=Routine Result: Correct Results (TTR316)
  diagnostic routine control RoutineControlResetCounterInvalidSomeipSdSubscriptions: access-permission=READWRITEBasicSFDRole0x01DefaultSession0x03ExtendedSession, routine-control-class=Diagnostic_Routine_Control_Class, routine=ResetCounterInvalidSomeipSdSubscriptions  # RoutineControl_Reset_counter_invalid_someip_sd_subscriptions
package /ZeC/Routine/Request_configuration_of_protection_of_vehicle_diagnosis
  diagnostic routine RequestConfigurationOfProtectionOfVehicleDiagnosis: id=0x06a9  # Request_configuration_of_protection_of_vehicle_diagnosis
    start Start_Subfunction  # Start Subfunction
      diagnostic-parameter bit-offset=0:
        diagnostic data element Routine_Start_Routine_Request_Request_configuration_of_protection_of_vehicle_diagnosis_PVD_configuration: base-type=uint8, compu-method=TEXTTABLE_PVDConfiguration  # Parameters: PVD_configuration
      diagnostic-parameter bit-offset=0:
        diagnostic data element Routine_Start_Routine_Response_Request_configuration_of_protection_of_vehicle_diagnosis_Routine_Status_Routine_Result: base-type=uint8, compu {2=Routine Status: Routine Aborted (TTR615), 4=Routine Status: Routine Finished Correctly (TTR815), 3=Routine Status: Routine Execution Stuck (TTR715), 1=Routine Status: Routine Active (TTR515), 0=Routine Status: Routine Inactive; Routine Result: No Results Available (TTR415TTR117), 16=Routine Result: Incorrect Results (TTR216), 32=Routine Result: Correct Results (TTR316)}  # Parameters: Routine Status / Routine Result
      diagnostic-parameter bit-offset=8:
        diagnostic data element Routine_Start_Routine_Response_Request_configuration_of_protection_of_vehicle_diagnosis_PVD_configuration: base-type=uint8, compu-method=TEXTTABLE_PVDConfiguration  # Parameters: PVD_configuration
      diagnostic-parameter bit-offset=16:
        diagnostic data element Routine_Start_Routine_Response_Request_configuration_of_protection_of_vehicle_diagnosis_Number_of_PVD_objects: base-type=uint16  # Parameters: Number_of_PVD_objects
      diagnostic-parameter bit-offset=32:
        diagnostic data element Routine_Start_Routine_Response_Request_configuration_of_protection_of_vehicle_diagnosis_ServiceID: base-type=uint8  # Parameters: ServiceID
      diagnostic-parameter bit-offset=40:
        diagnostic data element Routine_Start_Routine_Response_Request_configuration_of_protection_of_vehicle_diagnosis_Parameter: base-type=uint16  # Parameters: Parameter
  compu method TEXTTABLE_PVDConfiguration: 1=PVD_configuration: PVD_access_protected_services_role_EPTI (TTR219912), 3=PVD_configuration: PVD_access_protected_services_role_EXTENDED (TTR220112), 0=PVD_configuration: PVD_end_to_end_secured_data (TTR219812), 5=PVD_configuration: PVD_access_protected_services_role_PRODUCTION (TTR220312), 6=PVD_configuration: PVD_access_protected_services_role_OTA (TTR300612), 4=PVD_configuration: PVD_access_protected_services_role_SUPERUSER (TTR220212), 2=PVD_configuration: PVD_access_protected_services_role_BASIC (TTR220012)
  diagnostic routine control RoutineControlRequestConfigurationOfProtectionOfVehicleDiagnosis: access-permission=READWRITE0x03ExtendedSession, routine-control-class=Diagnostic_Routine_Control_Class, routine=RequestConfigurationOfProtectionOfVehicleDiagnosis  # RoutineControl_Request_configuration_of_protection_of_vehicle_diagnosis
package /ZeC/Routine/Request_logging_data_of_protection_of_vehicle_diagnosis
  diagnostic routine RequestLoggingDataOfProtectionOfVehicleDiagnosis: id=0xc009  # Request_logging_data_of_protection_of_vehicle_diagnosis
    start Start_Subfunction  # Start Subfunction
      diagnostic-parameter bit-offset=0:
        diagnostic data element Routine_Start_Routine_Request_Request_logging_data_of_protection_of_vehicle_diagnosis_Log_Entry_Offset: base-type=uint8, compu {8=Log_Entry_Offset: Log_entries_41_to_45 (TTR225212), 2=Log_Entry_Offset: Log_entries_11_to_15 (TTR224612), 7=Log_Entry_Offset: Log_entries_36_to_40 (TTR225112), 10=Log_Entry_Offset: Log_entries_51_to_53 (TTR225412), 5=Log_Entry_Offset: Log_entries_26_to_30 (TTR224912), 0=Log_Entry_Offset: Log_entries_1_to_5 (TTR224412), 3=Log_Entry_Offset: Log_entries_16_to_20 (TTR224712), 1=Log_Entry_Offset: Log_entries_6_to_10 (TTR224512), 9=Log_Entry_Offset: Log_entries_46_to_50 (TTR225312), 4=Log_Entry_Offset: Log_entries_21_to_25 (TTR224812), 6=Log_Entry_Offset: Log_entries_31_to_35 (TTR225012)}  # Parameters: Log_Entry_Offset
      diagnostic-parameter bit-offset=0:
        diagnostic data element Routine_Start_Routine_Response_Request_logging_data_of_protection_of_vehicle_diagnosis_Routine_Status_Routine_Result: base-type=uint8, compu {2=Routine Status: Routine Aborted (TTR615), 4=Routine Status: Routine Finished Correctly (TTR815), 3=Routine Status: Routine Execution Stuck (TTR715), 1=Routine Status: Routine Active (TTR515), 0=Routine Status: Routine Inactive; Routine Result: No Results Available (TTR415TTR117), 16=Routine Result: Incorrect Results (TTR216), 32=Routine Result: Correct Results (TTR316)}  # Parameters: Routine Status / Routine Result
      diagnostic-parameter bit-offset=8:
        diagnostic data element Routine_Start_Routine_Response_Request_logging_data_of_protection_of_vehicle_diagnosis_Number_of_returned_log_entries: base-type=uint16  # Parameters: Number_of_returned_log_entries
      diagnostic-parameter bit-offset=24:
        diagnostic data element Routine_Start_Routine_Response_Request_logging_data_of_protection_of_vehicle_diagnosis_Log_Entry: array-size-semantics=VARIABLE-SIZE, max-number-of-elements=95, base-type=uint8  # Parameters: Log_Entry
  diagnostic routine control RoutineControlRequestLoggingDataOfProtectionOfVehicleDiagnosis: access-permission=READWRITESuperUserSFDRole0x03ExtendedSession, routine-control-class=Diagnostic_Routine_Control_Class, routine=RequestLoggingDataOfProtectionOfVehicleDiagnosis  # RoutineControl_Request_logging_data_of_protection_of_vehicle_diagnosis
package /ZeC/Routine/Reset_counter_invalid_someip_sd_messages
  diagnostic routine ResetCounterInvalidSomeipSdMessages: id=0xb119  # Reset_counter_invalid_someip_sd_messages
    request result Result_Subfunction  # Result Subfunction
      diagnostic-parameter bit-offset=0:
        diagnostic data element Routine_Request_Routine_Results_Response_Reset_counter_invalid_someip_sd_messages_Routine_Status_Routine_Result: base-type=uint8, compu-method=Reset_counter_invalid_someip_sd_messages/TEXTTABLE_RoutineStatusRoutineResult  # Parameters: Routine Status / Routine Result
    start Start_Subfunction  # Start Subfunction
      diagnostic-parameter bit-offset=0:
        diagnostic data element Routine_Start_Routine_Response_Reset_counter_invalid_someip_sd_messages_Routine_Status_Routine_Result: base-type=uint8, compu-method=Reset_counter_invalid_someip_sd_messages/TEXTTABLE_RoutineStatusRoutineResult  # Parameters: Routine Status / Routine Result
    stop Stop_Subfunction  # Stop Subfunction
      diagnostic-parameter bit-offset=0:
        diagnostic data element Routine_Stop_Routine_Response_Reset_counter_invalid_someip_sd_messages_Routine_Status_Routine_Result: base-type=uint8, compu-method=Reset_counter_invalid_someip_sd_messages/TEXTTABLE_RoutineStatusRoutineResult  # Parameters: Routine Status / Routine Result
  compu method TEXTTABLE_RoutineStatusRoutineResult: 2=Routine Status: Routine Aborted (TTR615), 4=Routine Status: Routine Finished Correctly (TTR815), 3=Routine Status: Routine Execution Stuck (TTR715), 1=Routine Status: Routine Active (TTR515), 0=Routine Status: Routine Inactive; Routine Result: No Results Available (TTR415TTR117), 16=Routine Result: Incorrect Results (TTR216), 32=Routine Result: Correct Results (TTR316)
  diagnostic routine control RoutineControlResetCounterInvalidSomeipSdMessages: access-permission=READWRITEBasicSFDRole0x01DefaultSession0x03ExtendedSession, routine-control-class=Diagnostic_Routine_Control_Class, routine=ResetCounterInvalidSomeipSdMessages  # RoutineControl_Reset_counter_invalid_someip_sd_messages
package /ZeC/Routine/Request_data_of_protection_of_vehicle_diagnosis
  diagnostic routine RequestDataOfProtectionOfVehicleDiagnosis: id=0xc008  # Request_data_of_protection_of_vehicle_diagnosis
    start Start_Subfunction  # Start Subfunction
      diagnostic-parameter bit-offset=0:
        diagnostic data element Routine_Start_Routine_Request_Request_data_of_protection_of_vehicle_diagnosis_request_data: base-type=uint8, compu {7=request data: Safeguard_request (TTR224312), 5=request data: startup request (TTR224112), 1=request data: unlock request without replay protection (TTR223712), 2=request data: unlock request (TTR223812), 4=request data: synchronize (TTR224012), 3=request data: reset request (TTR223912), 6=request data: unlock request with replay protection (TTR224212)}  # Parameters: request data
      diagnostic-parameter bit-offset=0:
        diagnostic data element Routine_Start_Routine_Response_Request_data_of_protection_of_vehicle_diagnosis_Routine_Status_Routine_Result: base-type=uint8, compu {2=Routine Status: Routine Aborted (TTR615), 4=Routine Status: Routine Finished Correctly (TTR815), 3=Routine Status: Routine Execution Stuck (TTR715), 1=Routine Status: Routine Active (TTR515), 0=Routine Status: Routine Inactive; Routine Result: No Results Available (TTR415TTR117), 16=Routine Result: Incorrect Results (TTR216), 32=Routine Result: Correct Results (TTR316)}  # Parameters: Routine Status / Routine Result
      diagnostic-parameter bit-offset=8:
        diagnostic data element Routine_Start_Routine_Response_Request_data_of_protection_of_vehicle_diagnosis_RoutineStatusRecord: base-type=uint8  # Parameters: RoutineStatusRecord
  diagnostic routine control RoutineControlRequestDataOfProtectionOfVehicleDiagnosis: access-permission=READWRITE0x01DefaultSession0x03ExtendedSession, routine-control-class=Diagnostic_Routine_Control_Class, routine=RequestDataOfProtectionOfVehicleDiagnosis  # RoutineControl_Request_data_of_protection_of_vehicle_diagnosis
package /ZeC/Routine/Reset_healing_inhibition
  diagnostic routine ResetHealingInhibition: id=0x06a8  # Reset_healing_inhibition
    start Start_Subfunction  # Start Subfunction
      diagnostic-parameter bit-offset=0:
        diagnostic data element Routine_Start_Routine_Request_Reset_healing_inhibition_Reset_healing_inhibition: base-type=uint8, compu {0=Reset_healing_inhibition: yes (TTR228413)}  # Parameters: Reset_healing_inhibition
      diagnostic-parameter bit-offset=0:
        diagnostic data element Routine_Start_Routine_Response_Reset_healing_inhibition_Reset_healing_inhibition: base-type=uint8, compu {0=Reset_healing_inhibition: yes (TTR228413)}  # Parameters: Reset_healing_inhibition
  diagnostic routine control RoutineControlResetHealingInhibition: access-permission=READWRITEBasicSFDRole0x03ExtendedSession, routine-control-class=Diagnostic_Routine_Control_Class, routine=ResetHealingInhibition  # RoutineControl_Reset_healing_inhibition
package /ZeC/Routine/Reset_ethernet_CRC_error_counter
  diagnostic routine ResetEthernetCRCErrorCounter: id=0x0690  # Reset_ethernet_CRC_error_counter
    request result Result_Subfunction  # Result Subfunction
      diagnostic-parameter bit-offset=0:
        diagnostic data element Routine_Request_Routine_Results_Response_Reset_ethernet_CRC_error_counter_Routine_Status: base-type=uint8, compu {1=Routine Status: Routine Active (TTR298712), 3=Routine Status: Routine Aborted (TTR298912), 2=Routine Status: Routine not active or finished correctly (TTR298812)}  # Parameters: Routine Status
      diagnostic-parameter bit-offset=8:
        diagnostic data element Routine_Request_Routine_Results_Response_Reset_ethernet_CRC_error_counter_Routine_Results: base-type=uint16, compu {1=Routine Results: No Results Available (TTR299112), 65535=Routine Results: Correct Results (TTR342912), 0=Routine Results: Incorrect Results (TTR343012)}  # Parameters: Routine Results
    start Start_Subfunction  # Start Subfunction
      diagnostic-parameter bit-offset=0:
        diagnostic data element Routine_Start_Routine_Request_Reset_ethernet_CRC_error_counter_Basic_setting: array-size-semantics=FIXED-SIZE, max-number-of-elements=3, base-type=uint8, compu {262144=Basic setting: Basic setting (TTR746712)}  # Parameters: Basic setting
      diagnostic-parameter bit-offset=0:
        diagnostic data element Routine_Start_Routine_Response_Reset_ethernet_CRC_error_counter_Routine_Status_Routine_Result: base-type=uint8, compu-method=Reset_ethernet_CRC_error_counter/TEXTTABLE_RoutineStatusRoutineResult  # Parameters: Routine Status / Routine Result
    stop Stop_Subfunction  # Stop Subfunction
      diagnostic-parameter bit-offset=0:
        diagnostic data element Routine_Stop_Routine_Response_Reset_ethernet_CRC_error_counter_Routine_Status_Routine_Result: base-type=uint8, compu-method=Reset_ethernet_CRC_error_counter/TEXTTABLE_RoutineStatusRoutineResult  # Parameters: Routine Status / Routine Result
  compu method TEXTTABLE_RoutineStatusRoutineResult: 2=Routine Status: Routine Aborted (TTR615), 4=Routine Status: Routine Finished Correctly (TTR815), 3=Routine Status: Routine Execution Stuck (TTR715), 1=Routine Status: Routine Active (TTR515), 0=Routine Status: Routine Inactive; Routine Result: No Results Available (TTR415TTR117), 16=Routine Result: Incorrect Results (TTR216), 32=Routine Result: Correct Results (TTR316)
  diagnostic routine control RoutineControlResetEthernetCRCErrorCounter: access-permission=READWRITE0x03ExtendedSession0x40EOLSession0x4FDevelopmentSession, routine-control-class=Diagnostic_Routine_Control_Class, routine=ResetEthernetCRCErrorCounter  # RoutineControl_Reset_ethernet_CRC_error_counter
package /ZeC/Routine/Reset_protection_of_vehicle_diagnosis
  diagnostic routine ResetProtectionOfVehicleDiagnosis: id=0xc007  # Reset_protection_of_vehicle_diagnosis
    start Start_Subfunction  # Start Subfunction
      diagnostic-parameter bit-offset=0:
        diagnostic data element Routine_Start_Routine_Request_Reset_protection_of_vehicle_diagnosis_Reset_Token: base-type=uint8  # Parameters: Reset Token
      diagnostic-parameter bit-offset=0:
        diagnostic data element Routine_Start_Routine_Response_Reset_protection_of_vehicle_diagnosis_Routine_Status_Routine_Result: base-type=uint8, compu {2=Routine Status: Routine Aborted (TTR615), 4=Routine Status: Routine Finished Correctly (TTR815), 3=Routine Status: Routine Execution Stuck (TTR715), 1=Routine Status: Routine Active (TTR515), 0=Routine Status: Routine Inactive; Routine Result: No Results Available (TTR415TTR117), 16=Routine Result: Incorrect Results (TTR216), 32=Routine Result: Correct Results (TTR316)}  # Parameters: Routine Status / Routine Result
      diagnostic-parameter bit-offset=8:
        diagnostic data element Routine_Start_Routine_Response_Reset_protection_of_vehicle_diagnosis_RoutineStatusRecord: base-type=uint8, compu {6=RoutineStatusRecord: Token_Type_not_supported (TTR222213), 5=RoutineStatusRecord: Token_Version_not_supported (TTR222113), 7=RoutineStatusRecord: Replay_protection_invalid (TTR222313), 2=RoutineStatusRecord: Token_is_not_for_this_ecu (TTR221813), 8=RoutineStatusRecord: Token_is_corrupt (TTR222413), 4=RoutineStatusRecord: SFD_OID_not_supported (TTR222013), 3=RoutineStatusRecord: Projekt_ID_is_wrong (TTR221913), 1=RoutineStatusRecord: Signature_validation_error (TTR221713), 0=RoutineStatusRecord: Reset_successful (TTR223612)}  # Parameters: RoutineStatusRecord
  diagnostic routine control RoutineControlResetProtectionOfVehicleDiagnosis: access-permission=READWRITE0x03ExtendedSession, routine-control-class=Diagnostic_Routine_Control_Class, routine=ResetProtectionOfVehicleDiagnosis  # RoutineControl_Reset_protection_of_vehicle_diagnosis
