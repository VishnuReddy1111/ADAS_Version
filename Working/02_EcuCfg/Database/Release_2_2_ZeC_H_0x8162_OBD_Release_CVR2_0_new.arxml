[part 9 of 19: packages /ZeC/DTC/DTC/LIN_22_Slave_12_Defect to /ZeC/DTC/DTC/DB_CANFD_10_Single_Wire_Mode]
AUTOSAR XML (schema 00047)
package /ZeC/DTC/DTC/LIN_22_Slave_12_Defect
  diagnostic trouble code uds LIN_22_Slave_12_Defect: dtc-props=Dtc_Props_358996c7, uds-dtc-value=0x031703  # LIN 22 Slave 12_Defect
  diagnostic event EventLIN22Slave12Defect: aging-allowed=true, event-kind=SWC, prestorage-freeze-frame=false  # Event_LIN 22 Slave 12_Defect
  diagnostic event to trouble code uds mapping EventDtcMapLIN22Slave12Defect: diagnostic-event=EventLIN22Slave12Defect, trouble-code-uds=LIN_22_Slave_12_Defect  # Event_Dtc_Map_LIN 22 Slave 12_Defect
  diagnostic event to operation cycle mapping EventOperCycleMapLIN22Slave12Defect: diagnostic-event=EventLIN22Slave12Defect, operation-cycle=DefaultOperationCycle  # Event_Oper_Cycle_Map_LIN 22 Slave 12_Defect
  diagnostic event to debounce algorithm mapping EventDebounceMapLIN22Slave12Defect: debounce-algorithm=counter_based, diagnostic-event=EventLIN22Slave12Defect  # EventDebounceMap_LIN 22 Slave 12_Defect
package /ZeC/DTC/DTC/LIN_22_Slave_12_NoCommunication
  diagnostic trouble code uds LIN_22_Slave_12_NoCommunication: dtc-props=Dtc_Props_358996c7, uds-dtc-value=0x031704  # LIN 22 Slave 12_NoCommunication
  diagnostic event EventLIN22Slave12NoCommunication: aging-allowed=true, event-kind=SWC, prestorage-freeze-frame=false  # Event_LIN 22 Slave 12_NoCommunication
  diagnostic event to trouble code uds mapping EventDtcMapLIN22Slave12NoCommunication: diagnostic-event=EventLIN22Slave12NoCommunication, trouble-code-uds=LIN_22_Slave_12_NoCommunication  # Event_Dtc_Map_LIN 22 Slave 12_NoCommunication
  diagnostic event to operation cycle mapping EventOperCycleMapLIN22Slave12NoCommunication: diagnostic-event=EventLIN22Slave12NoCommunication, operation-cycle=DefaultOperationCycle  # Event_Oper_Cycle_Map_LIN 22 Slave 12_NoCommunication
  diagnostic event to debounce algorithm mapping EventDebounceMapLIN22Slave12NoCommunication: debounce-algorithm=counter_based, diagnostic-event=EventLIN22Slave12NoCommunication  # EventDebounceMap_LIN 22 Slave 12_NoCommunication
package /ZeC/DTC/DTC/LIN_22_Slave_11_Defect
  diagnostic trouble code uds LIN_22_Slave_11_Defect: dtc-props=Dtc_Props_358996c7, uds-dtc-value=0x031701  # LIN 22 Slave 11_Defect
  diagnostic event EventLIN22Slave11Defect: aging-allowed=true, event-kind=SWC, prestorage-freeze-frame=false  # Event_LIN 22 Slave 11_Defect
  diagnostic event to trouble code uds mapping EventDtcMapLIN22Slave11Defect: diagnostic-event=EventLIN22Slave11Defect, trouble-code-uds=LIN_22_Slave_11_Defect  # Event_Dtc_Map_LIN 22 Slave 11_Defect
  diagnostic event to operation cycle mapping EventOperCycleMapLIN22Slave11Defect: diagnostic-event=EventLIN22Slave11Defect, operation-cycle=DefaultOperationCycle  # Event_Oper_Cycle_Map_LIN 22 Slave 11_Defect
  diagnostic event to debounce algorithm mapping EventDebounceMapLIN22Slave11Defect: debounce-algorithm=counter_based, diagnostic-event=EventLIN22Slave11Defect  # EventDebounceMap_LIN 22 Slave 11_Defect
package /ZeC/DTC/DTC/Power_Path_053_Load_Failure
  diagnostic trouble code uds Power_Path_053_Load_Failure: dtc-props=Dtc_Props_354d29f4, uds-dtc-value=0x005435
  diagnostic event EventPowerPath053LoadFailure: aging-allowed=true, event-kind=SWC, prestorage-freeze-frame=false  # Event_Power_Path_053_Load_Failure
  diagnostic event to trouble code uds mapping EventDtcMapPowerPath053LoadFailure: diagnostic-event=EventPowerPath053LoadFailure, trouble-code-uds=Power_Path_053_Load_Failure  # Event_Dtc_Map_Power_Path_053_Load_Failure
  diagnostic event to operation cycle mapping EventOperCycleMapPowerPath053LoadFailure: diagnostic-event=EventPowerPath053LoadFailure, operation-cycle=DefaultOperationCycle  # Event_Oper_Cycle_Map_Power_Path_053_Load_Failure
  diagnostic event to debounce algorithm mapping EventDebounceMapPowerPath053LoadFailure: debounce-algorithm=time_based, diagnostic-event=EventPowerPath053LoadFailure  # EventDebounceMap_Power_Path_053_Load_Failure
package /ZeC/DTC/DTC/LIN_22_Slave_11_NoCommunication
  diagnostic trouble code uds LIN_22_Slave_11_NoCommunication: dtc-props=Dtc_Props_358996c7, uds-dtc-value=0x031702  # LIN 22 Slave 11_NoCommunication
  diagnostic event EventLIN22Slave11NoCommunication: aging-allowed=true, event-kind=SWC, prestorage-freeze-frame=false  # Event_LIN 22 Slave 11_NoCommunication
  diagnostic event to trouble code uds mapping EventDtcMapLIN22Slave11NoCommunication: diagnostic-event=EventLIN22Slave11NoCommunication, trouble-code-uds=LIN_22_Slave_11_NoCommunication  # Event_Dtc_Map_LIN 22 Slave 11_NoCommunication
  diagnostic event to operation cycle mapping EventOperCycleMapLIN22Slave11NoCommunication: diagnostic-event=EventLIN22Slave11NoCommunication, operation-cycle=DefaultOperationCycle  # Event_Oper_Cycle_Map_LIN 22 Slave 11_NoCommunication
  diagnostic event to debounce algorithm mapping EventDebounceMapLIN22Slave11NoCommunication: debounce-algorithm=counter_based, diagnostic-event=EventLIN22Slave11NoCommunication  # EventDebounceMap_LIN 22 Slave 11_NoCommunication
package /ZeC/DTC/DTC/Power_Path_052_Load_Failure
  diagnostic trouble code uds Power_Path_052_Load_Failure: dtc-props=Dtc_Props_735423ce, uds-dtc-value=0x005434
  diagnostic event EventPowerPath052LoadFailure: aging-allowed=true, event-kind=SWC, prestorage-freeze-frame=false  # Event_Power_Path_052_Load_Failure
  diagnostic event to trouble code uds mapping EventDtcMapPowerPath052LoadFailure: diagnostic-event=EventPowerPath052LoadFailure, trouble-code-uds=Power_Path_052_Load_Failure  # Event_Dtc_Map_Power_Path_052_Load_Failure
  diagnostic event to operation cycle mapping EventOperCycleMapPowerPath052LoadFailure: diagnostic-event=EventPowerPath052LoadFailure, operation-cycle=DefaultOperationCycle  # Event_Oper_Cycle_Map_Power_Path_052_Load_Failure
  diagnostic event to debounce algorithm mapping EventDebounceMapPowerPath052LoadFailure: debounce-algorithm=time_based, diagnostic-event=EventPowerPath052LoadFailure  # EventDebounceMap_Power_Path_052_Load_Failure
package /ZeC/DTC/DTC/Power_Path_055_Load_Failure
  diagnostic trouble code uds Power_Path_055_Load_Failure: dtc-props=Dtc_Props_b97f3d80, uds-dtc-value=0x005437
  diagnostic event EventPowerPath055LoadFailure: aging-allowed=true, event-kind=SWC, prestorage-freeze-frame=false  # Event_Power_Path_055_Load_Failure
  diagnostic event to trouble code uds mapping EventDtcMapPowerPath055LoadFailure: diagnostic-event=EventPowerPath055LoadFailure, trouble-code-uds=Power_Path_055_Load_Failure  # Event_Dtc_Map_Power_Path_055_Load_Failure
  diagnostic event to operation cycle mapping EventOperCycleMapPowerPath055LoadFailure: diagnostic-event=EventPowerPath055LoadFailure, operation-cycle=DefaultOperationCycle  # Event_Oper_Cycle_Map_Power_Path_055_Load_Failure
  diagnostic event to debounce algorithm mapping EventDebounceMapPowerPath055LoadFailure: debounce-algorithm=time_based, diagnostic-event=EventPowerPath055LoadFailure  # EventDebounceMap_Power_Path_055_Load_Failure
package /ZeC/DTC/DTC/Power_Path_054_Load_Failure
  diagnostic trouble code uds Power_Path_054_Load_Failure: dtc-props=Dtc_Props_ff6637ba, uds-dtc-value=0x005436
  diagnostic event EventPowerPath054LoadFailure: aging-allowed=true, event-kind=SWC, prestorage-freeze-frame=false  # Event_Power_Path_054_Load_Failure
  diagnostic event to trouble code uds mapping EventDtcMapPowerPath054LoadFailure: diagnostic-event=EventPowerPath054LoadFailure, trouble-code-uds=Power_Path_054_Load_Failure  # Event_Dtc_Map_Power_Path_054_Load_Failure
  diagnostic event to operation cycle mapping EventOperCycleMapPowerPath054LoadFailure: diagnostic-event=EventPowerPath054LoadFailure, operation-cycle=DefaultOperationCycle  # Event_Oper_Cycle_Map_Power_Path_054_Load_Failure
  diagnostic event to debounce algorithm mapping EventDebounceMapPowerPath054LoadFailure: debounce-algorithm=time_based, diagnostic-event=EventPowerPath054LoadFailure  # EventDebounceMap_Power_Path_054_Load_Failure
package /ZeC/DTC/DTC/Power_Path_058_Load_Failure
  diagnostic trouble code uds Power_Path_058_Load_Failure: dtc-props=Dtc_Props_cba76320, uds-dtc-value=0x00543a
  diagnostic event EventPowerPath058LoadFailure: aging-allowed=true, event-kind=SWC, prestorage-freeze-frame=false  # Event_Power_Path_058_Load_Failure
  diagnostic event to trouble code uds mapping EventDtcMapPowerPath058LoadFailure: diagnostic-event=EventPowerPath058LoadFailure, trouble-code-uds=Power_Path_058_Load_Failure  # Event_Dtc_Map_Power_Path_058_Load_Failure
  diagnostic event to operation cycle mapping EventOperCycleMapPowerPath058LoadFailure: diagnostic-event=EventPowerPath058LoadFailure, operation-cycle=DefaultOperationCycle  # Event_Oper_Cycle_Map_Power_Path_058_Load_Failure
  diagnostic event to debounce algorithm mapping EventDebounceMapPowerPath058LoadFailure: debounce-algorithm=time_based, diagnostic-event=EventPowerPath058LoadFailure  # EventDebounceMap_Power_Path_058_Load_Failure
package /ZeC/DTC/DTC/Power_Path_060_Load_Failure
  diagnostic trouble code uds Power_Path_060_Load_Failure: dtc-props=Dtc_Props_47957754, uds-dtc-value=0x00543c
  diagnostic event EventPowerPath060LoadFailure: aging-allowed=true, event-kind=SWC, prestorage-freeze-frame=false  # Event_Power_Path_060_Load_Failure
  diagnostic event to trouble code uds mapping EventDtcMapPowerPath060LoadFailure: diagnostic-event=EventPowerPath060LoadFailure, trouble-code-uds=Power_Path_060_Load_Failure  # Event_Dtc_Map_Power_Path_060_Load_Failure
  diagnostic event to operation cycle mapping EventOperCycleMapPowerPath060LoadFailure: diagnostic-event=EventPowerPath060LoadFailure, operation-cycle=DefaultOperationCycle  # Event_Oper_Cycle_Map_Power_Path_060_Load_Failure
  diagnostic event to debounce algorithm mapping EventDebounceMapPowerPath060LoadFailure: debounce-algorithm=time_based, diagnostic-event=EventPowerPath060LoadFailure  # EventDebounceMap_Power_Path_060_Load_Failure
package /ZeC/DTC/DTC/Power_Path_059_Load_Failure
  diagnostic trouble code uds Power_Path_059_Load_Failure: dtc-props=Dtc_Props_18c7d6e, uds-dtc-value=0x00543b
  diagnostic event EventPowerPath059LoadFailure: aging-allowed=true, event-kind=SWC, prestorage-freeze-frame=false  # Event_Power_Path_059_Load_Failure
  diagnostic event to trouble code uds mapping EventDtcMapPowerPath059LoadFailure: diagnostic-event=EventPowerPath059LoadFailure, trouble-code-uds=Power_Path_059_Load_Failure  # Event_Dtc_Map_Power_Path_059_Load_Failure
  diagnostic event to operation cycle mapping EventOperCycleMapPowerPath059LoadFailure: diagnostic-event=EventPowerPath059LoadFailure, operation-cycle=DefaultOperationCycle  # Event_Oper_Cycle_Map_Power_Path_059_Load_Failure
  diagnostic event to debounce algorithm mapping EventDebounceMapPowerPath059LoadFailure: debounce-algorithm=time_based, diagnostic-event=EventPowerPath059LoadFailure  # EventDebounceMap_Power_Path_059_Load_Failure
package /ZeC/DTC/DTC/LIN_22_Slave_3_NoCommunication
  diagnostic trouble code uds LIN_22_Slave_3_NoCommunication: dtc-props=Dtc_Props_358996c7, uds-dtc-value=0x03170e  # LIN 22 Slave 3_NoCommunication
  diagnostic event EventLIN22Slave3NoCommunication: aging-allowed=true, event-kind=SWC, prestorage-freeze-frame=false  # Event_LIN 22 Slave 3_NoCommunication
  diagnostic event to trouble code uds mapping EventDtcMapLIN22Slave3NoCommunication: diagnostic-event=EventLIN22Slave3NoCommunication, trouble-code-uds=LIN_22_Slave_3_NoCommunication  # Event_Dtc_Map_LIN 22 Slave 3_NoCommunication
  diagnostic event to operation cycle mapping EventOperCycleMapLIN22Slave3NoCommunication: diagnostic-event=EventLIN22Slave3NoCommunication, operation-cycle=DefaultOperationCycle  # Event_Oper_Cycle_Map_LIN 22 Slave 3_NoCommunication
  diagnostic event to debounce algorithm mapping EventDebounceMapLIN22Slave3NoCommunication: debounce-algorithm=counter_based, diagnostic-event=EventLIN22Slave3NoCommunication  # EventDebounceMap_LIN 22 Slave 3_NoCommunication
package /ZeC/DTC/DTC/LIN_22_Slave_4_Defect
  diagnostic trouble code uds LIN_22_Slave_4_Defect: dtc-props=Dtc_Props_358996c7, uds-dtc-value=0x03170f  # LIN 22 Slave 4_Defect
  diagnostic event EventLIN22Slave4Defect: aging-allowed=true, event-kind=SWC, prestorage-freeze-frame=false  # Event_LIN 22 Slave 4_Defect
  diagnostic event to trouble code uds mapping EventDtcMapLIN22Slave4Defect: diagnostic-event=EventLIN22Slave4Defect, trouble-code-uds=LIN_22_Slave_4_Defect  # Event_Dtc_Map_LIN 22 Slave 4_Defect
  diagnostic event to operation cycle mapping EventOperCycleMapLIN22Slave4Defect: diagnostic-event=EventLIN22Slave4Defect, operation-cycle=DefaultOperationCycle  # Event_Oper_Cycle_Map_LIN 22 Slave 4_Defect
  diagnostic event to debounce algorithm mapping EventDebounceMapLIN22Slave4Defect: debounce-algorithm=counter_based, diagnostic-event=EventLIN22Slave4Defect  # EventDebounceMap_LIN 22 Slave 4_Defect
package /ZeC/DTC/DTC/LIN_22_Slave_2_NoCommunication
  diagnostic trouble code uds LIN_22_Slave_2_NoCommunication: dtc-props=Dtc_Props_358996c7, uds-dtc-value=0x03170c  # LIN 22 Slave 2_NoCommunication
  diagnostic event EventLIN22Slave2NoCommunication: aging-allowed=true, event-kind=SWC, prestorage-freeze-frame=false  # Event_LIN 22 Slave 2_NoCommunication
  diagnostic event to trouble code uds mapping EventDtcMapLIN22Slave2NoCommunication: diagnostic-event=EventLIN22Slave2NoCommunication, trouble-code-uds=LIN_22_Slave_2_NoCommunication  # Event_Dtc_Map_LIN 22 Slave 2_NoCommunication
  diagnostic event to operation cycle mapping EventOperCycleMapLIN22Slave2NoCommunication: diagnostic-event=EventLIN22Slave2NoCommunication, operation-cycle=DefaultOperationCycle  # Event_Oper_Cycle_Map_LIN 22 Slave 2_NoCommunication
  diagnostic event to debounce algorithm mapping EventDebounceMapLIN22Slave2NoCommunication: debounce-algorithm=counter_based, diagnostic-event=EventLIN22Slave2NoCommunication  # EventDebounceMap_LIN 22 Slave 2_NoCommunication
package /ZeC/DTC/DTC/LIN_22_Slave_3_Defect
  diagnostic trouble code uds LIN_22_Slave_3_Defect: dtc-props=Dtc_Props_358996c7, uds-dtc-value=0x03170d  # LIN 22 Slave 3_Defect
  diagnostic event EventLIN22Slave3Defect: aging-allowed=true, event-kind=SWC, prestorage-freeze-frame=false  # Event_LIN 22 Slave 3_Defect
  diagnostic event to trouble code uds mapping EventDtcMapLIN22Slave3Defect: diagnostic-event=EventLIN22Slave3Defect, trouble-code-uds=LIN_22_Slave_3_Defect  # Event_Dtc_Map_LIN 22 Slave 3_Defect
  diagnostic event to operation cycle mapping EventOperCycleMapLIN22Slave3Defect: diagnostic-event=EventLIN22Slave3Defect, operation-cycle=DefaultOperationCycle  # Event_Oper_Cycle_Map_LIN 22 Slave 3_Defect
  diagnostic event to debounce algorithm mapping EventDebounceMapLIN22Slave3Defect: debounce-algorithm=counter_based, diagnostic-event=EventLIN22Slave3Defect  # EventDebounceMap_LIN 22 Slave 3_Defect
package /ZeC/DTC/DTC/LIN_22_Slave_15_NoCommunication
  diagnostic trouble code uds LIN_22_Slave_15_NoCommunication: dtc-props=Dtc_Props_358996c7, uds-dtc-value=0x03170a  # LIN 22 Slave 15_NoCommunication
  diagnostic event EventLIN22Slave15NoCommunication: aging-allowed=true, event-kind=SWC, prestorage-freeze-frame=false  # Event_LIN 22 Slave 15_NoCommunication
  diagnostic event to trouble code uds mapping EventDtcMapLIN22Slave15NoCommunication: diagnostic-event=EventLIN22Slave15NoCommunication, trouble-code-uds=LIN_22_Slave_15_NoCommunication  # Event_Dtc_Map_LIN 22 Slave 15_NoCommunication
  diagnostic event to operation cycle mapping EventOperCycleMapLIN22Slave15NoCommunication: diagnostic-event=EventLIN22Slave15NoCommunication, operation-cycle=DefaultOperationCycle  # Event_Oper_Cycle_Map_LIN 22 Slave 15_NoCommunication
  diagnostic event to debounce algorithm mapping EventDebounceMapLIN22Slave15NoCommunication: debounce-algorithm=counter_based, diagnostic-event=EventLIN22Slave15NoCommunication  # EventDebounceMap_LIN 22 Slave 15_NoCommunication
package /ZeC/DTC/DTC/Power_Path_062_Load_Failure
  diagnostic trouble code uds Power_Path_062_Load_Failure: dtc-props=Dtc_Props_8b24d89, uds-dtc-value=0x00543e
  diagnostic event EventPowerPath062LoadFailure: aging-allowed=true, event-kind=SWC, prestorage-freeze-frame=false  # Event_Power_Path_062_Load_Failure
  diagnostic event to trouble code uds mapping EventDtcMapPowerPath062LoadFailure: diagnostic-event=EventPowerPath062LoadFailure, trouble-code-uds=Power_Path_062_Load_Failure  # Event_Dtc_Map_Power_Path_062_Load_Failure
  diagnostic event to operation cycle mapping EventOperCycleMapPowerPath062LoadFailure: diagnostic-event=EventPowerPath062LoadFailure, operation-cycle=DefaultOperationCycle  # Event_Oper_Cycle_Map_Power_Path_062_Load_Failure
  diagnostic event to debounce algorithm mapping EventDebounceMapPowerPath062LoadFailure: debounce-algorithm=time_based, diagnostic-event=EventPowerPath062LoadFailure  # EventDebounceMap_Power_Path_062_Load_Failure
package /ZeC/DTC/DTC/LIN_22_Slave_2_Defect
  diagnostic trouble code uds LIN_22_Slave_2_Defect: dtc-props=Dtc_Props_358996c7, uds-dtc-value=0x03170b  # LIN 22 Slave 2_Defect
  diagnostic event EventLIN22Slave2Defect: aging-allowed=true, event-kind=SWC, prestorage-freeze-frame=false  # Event_LIN 22 Slave 2_Defect
  diagnostic event to trouble code uds mapping EventDtcMapLIN22Slave2Defect: diagnostic-event=EventLIN22Slave2Defect, trouble-code-uds=LIN_22_Slave_2_Defect  # Event_Dtc_Map_LIN 22 Slave 2_Defect
  diagnostic event to operation cycle mapping EventOperCycleMapLIN22Slave2Defect: diagnostic-event=EventLIN22Slave2Defect, operation-cycle=DefaultOperationCycle  # Event_Oper_Cycle_Map_LIN 22 Slave 2_Defect
  diagnostic event to debounce algorithm mapping EventDebounceMapLIN22Slave2Defect: debounce-algorithm=counter_based, diagnostic-event=EventLIN22Slave2Defect  # EventDebounceMap_LIN 22 Slave 2_Defect
package /ZeC/DTC/DTC/Power_Path_061_Load_Failure
  diagnostic trouble code uds Power_Path_061_Load_Failure: dtc-props=Dtc_Props_4eab47b3, uds-dtc-value=0x00543d
  diagnostic event EventPowerPath061LoadFailure: aging-allowed=true, event-kind=SWC, prestorage-freeze-frame=false  # Event_Power_Path_061_Load_Failure
  diagnostic event to trouble code uds mapping EventDtcMapPowerPath061LoadFailure: diagnostic-event=EventPowerPath061LoadFailure, trouble-code-uds=Power_Path_061_Load_Failure  # Event_Dtc_Map_Power_Path_061_Load_Failure
  diagnostic event to operation cycle mapping EventOperCycleMapPowerPath061LoadFailure: diagnostic-event=EventPowerPath061LoadFailure, operation-cycle=DefaultOperationCycle  # Event_Oper_Cycle_Map_Power_Path_061_Load_Failure
  diagnostic event to debounce algorithm mapping EventDebounceMapPowerPath061LoadFailure: debounce-algorithm=time_based, diagnostic-event=EventPowerPath061LoadFailure  # EventDebounceMap_Power_Path_061_Load_Failure
package /ZeC/DTC/DTC/Power_Path_063_Load_Failure
  diagnostic trouble code uds Power_Path_063_Load_Failure: dtc-props=Dtc_Props_c29953c7, uds-dtc-value=0x00543f
  diagnostic event EventPowerPath063LoadFailure: aging-allowed=true, event-kind=SWC, prestorage-freeze-frame=false  # Event_Power_Path_063_Load_Failure
  diagnostic event to trouble code uds mapping EventDtcMapPowerPath063LoadFailure: diagnostic-event=EventPowerPath063LoadFailure, trouble-code-uds=Power_Path_063_Load_Failure  # Event_Dtc_Map_Power_Path_063_Load_Failure
  diagnostic event to operation cycle mapping EventOperCycleMapPowerPath063LoadFailure: diagnostic-event=EventPowerPath063LoadFailure, operation-cycle=DefaultOperationCycle  # Event_Oper_Cycle_Map_Power_Path_063_Load_Failure
  diagnostic event to debounce algorithm mapping EventDebounceMapPowerPath063LoadFailure: debounce-algorithm=time_based, diagnostic-event=EventPowerPath063LoadFailure  # EventDebounceMap_Power_Path_063_Load_Failure
package /ZeC/DTC/DTC/Power_Path_066_Load_Failure
  diagnostic trouble code uds Power_Path_066_Load_Failure: dtc-props=Dtc_Props_21450f8, uds-dtc-value=0x005442
  diagnostic event EventPowerPath066LoadFailure: aging-allowed=true, event-kind=SWC, prestorage-freeze-frame=false  # Event_Power_Path_066_Load_Failure
  diagnostic event to trouble code uds mapping EventDtcMapPowerPath066LoadFailure: diagnostic-event=EventPowerPath066LoadFailure, trouble-code-uds=Power_Path_066_Load_Failure  # Event_Dtc_Map_Power_Path_066_Load_Failure
  diagnostic event to operation cycle mapping EventOperCycleMapPowerPath066LoadFailure: diagnostic-event=EventPowerPath066LoadFailure, operation-cycle=DefaultOperationCycle  # Event_Oper_Cycle_Map_Power_Path_066_Load_Failure
  diagnostic event to debounce algorithm mapping EventDebounceMapPowerPath066LoadFailure: debounce-algorithm=time_based, diagnostic-event=EventPowerPath066LoadFailure  # EventDebounceMap_Power_Path_066_Load_Failure
package /ZeC/DTC/DTC/Power_Path_065_Load_Failure
  diagnostic trouble code uds Power_Path_065_Load_Failure: dtc-props=Dtc_Props_c83f4eb6, uds-dtc-value=0x005441
  diagnostic event EventPowerPath065LoadFailure: aging-allowed=true, event-kind=SWC, prestorage-freeze-frame=false  # Event_Power_Path_065_Load_Failure
  diagnostic event to trouble code uds mapping EventDtcMapPowerPath065LoadFailure: diagnostic-event=EventPowerPath065LoadFailure, trouble-code-uds=Power_Path_065_Load_Failure  # Event_Dtc_Map_Power_Path_065_Load_Failure
  diagnostic event to operation cycle mapping EventOperCycleMapPowerPath065LoadFailure: diagnostic-event=EventPowerPath065LoadFailure, operation-cycle=DefaultOperationCycle  # Event_Oper_Cycle_Map_Power_Path_065_Load_Failure
  diagnostic event to debounce algorithm mapping EventDebounceMapPowerPath065LoadFailure: debounce-algorithm=time_based, diagnostic-event=EventPowerPath065LoadFailure  # EventDebounceMap_Power_Path_065_Load_Failure
package /ZeC/DTC/DTC/Power_Path_068_Load_Failure
  diagnostic trouble code uds Power_Path_068_Load_Failure: dtc-props=Dtc_Props_4d336a25, uds-dtc-value=0x005444
  diagnostic event EventPowerPath068LoadFailure: aging-allowed=true, event-kind=SWC, prestorage-freeze-frame=false  # Event_Power_Path_068_Load_Failure
  diagnostic event to trouble code uds mapping EventDtcMapPowerPath068LoadFailure: diagnostic-event=EventPowerPath068LoadFailure, trouble-code-uds=Power_Path_068_Load_Failure  # Event_Dtc_Map_Power_Path_068_Load_Failure
  diagnostic event to operation cycle mapping EventOperCycleMapPowerPath068LoadFailure: diagnostic-event=EventPowerPath068LoadFailure, operation-cycle=DefaultOperationCycle  # Event_Oper_Cycle_Map_Power_Path_068_Load_Failure
  diagnostic event to debounce algorithm mapping EventDebounceMapPowerPath068LoadFailure: debounce-algorithm=time_based, diagnostic-event=EventPowerPath068LoadFailure  # EventDebounceMap_Power_Path_068_Load_Failure
package /ZeC/DTC/DTC/Power_Path_067_Load_Failure
  diagnostic trouble code uds Power_Path_067_Load_Failure: dtc-props=Dtc_Props_440d5ac2, uds-dtc-value=0x005443
  diagnostic event EventPowerPath067LoadFailure: aging-allowed=true, event-kind=SWC, prestorage-freeze-frame=false  # Event_Power_Path_067_Load_Failure
  diagnostic event to trouble code uds mapping EventDtcMapPowerPath067LoadFailure: diagnostic-event=EventPowerPath067LoadFailure, trouble-code-uds=Power_Path_067_Load_Failure  # Event_Dtc_Map_Power_Path_067_Load_Failure
  diagnostic event to operation cycle mapping EventOperCycleMapPowerPath067LoadFailure: diagnostic-event=EventPowerPath067LoadFailure, operation-cycle=DefaultOperationCycle  # Event_Oper_Cycle_Map_Power_Path_067_Load_Failure
  diagnostic event to debounce algorithm mapping EventDebounceMapPowerPath067LoadFailure: debounce-algorithm=time_based, diagnostic-event=EventPowerPath067LoadFailure  # EventDebounceMap_Power_Path_067_Load_Failure
package /ZeC/DTC/DTC/LIN_22_Slave_15_Defect
  diagnostic trouble code uds LIN_22_Slave_15_Defect: dtc-props=Dtc_Props_358996c7, uds-dtc-value=0x031709  # LIN 22 Slave 15_Defect
  diagnostic event EventLIN22Slave15Defect: aging-allowed=true, event-kind=SWC, prestorage-freeze-frame=false  # Event_LIN 22 Slave 15_Defect
  diagnostic event to trouble code uds mapping EventDtcMapLIN22Slave15Defect: diagnostic-event=EventLIN22Slave15Defect, trouble-code-uds=LIN_22_Slave_15_Defect  # Event_Dtc_Map_LIN 22 Slave 15_Defect
  diagnostic event to operation cycle mapping EventOperCycleMapLIN22Slave15Defect: diagnostic-event=EventLIN22Slave15Defect, operation-cycle=DefaultOperationCycle  # Event_Oper_Cycle_Map_LIN 22 Slave 15_Defect
  diagnostic event to debounce algorithm mapping EventDebounceMapLIN22Slave15Defect: debounce-algorithm=counter_based, diagnostic-event=EventLIN22Slave15Defect  # EventDebounceMap_LIN 22 Slave 15_Defect
package /ZeC/DTC/DTC/LIN_22_Slave_14_Defect
  diagnostic trouble code uds LIN_22_Slave_14_Defect: dtc-props=Dtc_Props_358996c7, uds-dtc-value=0x031707  # LIN 22 Slave 14_Defect
  diagnostic event EventLIN22Slave14Defect: aging-allowed=true, event-kind=SWC, prestorage-freeze-frame=false  # Event_LIN 22 Slave 14_Defect
  diagnostic event to trouble code uds mapping EventDtcMapLIN22Slave14Defect: diagnostic-event=EventLIN22Slave14Defect, trouble-code-uds=LIN_22_Slave_14_Defect  # Event_Dtc_Map_LIN 22 Slave 14_Defect
  diagnostic event to operation cycle mapping EventOperCycleMapLIN22Slave14Defect: diagnostic-event=EventLIN22Slave14Defect, operation-cycle=DefaultOperationCycle  # Event_Oper_Cycle_Map_LIN 22 Slave 14_Defect
  diagnostic event to debounce algorithm mapping EventDebounceMapLIN22Slave14Defect: debounce-algorithm=counter_based, diagnostic-event=EventLIN22Slave14Defect  # EventDebounceMap_LIN 22 Slave 14_Defect
package /ZeC/DTC/DTC/Power_Path_064_Load_Failure
  diagnostic trouble code uds Power_Path_064_Load_Failure: dtc-props=Dtc_Props_8e26448c, uds-dtc-value=0x005440
  diagnostic event EventPowerPath064LoadFailure: aging-allowed=true, event-kind=SWC, prestorage-freeze-frame=false  # Event_Power_Path_064_Load_Failure
  diagnostic event to trouble code uds mapping EventDtcMapPowerPath064LoadFailure: diagnostic-event=EventPowerPath064LoadFailure, trouble-code-uds=Power_Path_064_Load_Failure  # Event_Dtc_Map_Power_Path_064_Load_Failure
  diagnostic event to operation cycle mapping EventOperCycleMapPowerPath064LoadFailure: diagnostic-event=EventPowerPath064LoadFailure, operation-cycle=DefaultOperationCycle  # Event_Oper_Cycle_Map_Power_Path_064_Load_Failure
  diagnostic event to debounce algorithm mapping EventDebounceMapPowerPath064LoadFailure: debounce-algorithm=time_based, diagnostic-event=EventPowerPath064LoadFailure  # EventDebounceMap_Power_Path_064_Load_Failure
package /ZeC/DTC/DTC/LIN_22_Slave_14_NoCommunication
  diagnostic trouble code uds LIN_22_Slave_14_NoCommunication: dtc-props=Dtc_Props_358996c7, uds-dtc-value=0x031708  # LIN 22 Slave 14_NoCommunication
  diagnostic event EventLIN22Slave14NoCommunication: aging-allowed=true, event-kind=SWC, prestorage-freeze-frame=false  # Event_LIN 22 Slave 14_NoCommunication
  diagnostic event to trouble code uds mapping EventDtcMapLIN22Slave14NoCommunication: diagnostic-event=EventLIN22Slave14NoCommunication, trouble-code-uds=LIN_22_Slave_14_NoCommunication  # Event_Dtc_Map_LIN 22 Slave 14_NoCommunication
  diagnostic event to operation cycle mapping EventOperCycleMapLIN22Slave14NoCommunication: diagnostic-event=EventLIN22Slave14NoCommunication, operation-cycle=DefaultOperationCycle  # Event_Oper_Cycle_Map_LIN 22 Slave 14_NoCommunication
  diagnostic event to debounce algorithm mapping EventDebounceMapLIN22Slave14NoCommunication: debounce-algorithm=counter_based, diagnostic-event=EventLIN22Slave14NoCommunication  # EventDebounceMap_LIN 22 Slave 14_NoCommunication
package /ZeC/DTC/DTC/LIN_17_Slave_13_Defect
  diagnostic trouble code uds LIN_17_Slave_13_Defect: dtc-props=Dtc_Props_358996c7, uds-dtc-value=0x031118  # LIN 17 Slave 13_Defect
  diagnostic event EventLIN17Slave13Defect: aging-allowed=true, event-kind=SWC, prestorage-freeze-frame=false  # Event_LIN 17 Slave 13_Defect
  diagnostic event to trouble code uds mapping EventDtcMapLIN17Slave13Defect: diagnostic-event=EventLIN17Slave13Defect, trouble-code-uds=LIN_17_Slave_13_Defect  # Event_Dtc_Map_LIN 17 Slave 13_Defect
  diagnostic event to operation cycle mapping EventOperCycleMapLIN17Slave13Defect: diagnostic-event=EventLIN17Slave13Defect, operation-cycle=DefaultOperationCycle  # Event_Oper_Cycle_Map_LIN 17 Slave 13_Defect
  diagnostic event to debounce algorithm mapping EventDebounceMapLIN17Slave13Defect: debounce-algorithm=counter_based, diagnostic-event=EventLIN17Slave13Defect  # EventDebounceMap_LIN 17 Slave 13_Defect
package /ZeC/DTC/DTC/LIN_17_Slave_13_NoCommunication
  diagnostic trouble code uds LIN_17_Slave_13_NoCommunication: dtc-props=Dtc_Props_358996c7, uds-dtc-value=0x031119  # LIN 17 Slave 13_NoCommunication
  diagnostic event EventLIN17Slave13NoCommunication: aging-allowed=true, event-kind=SWC, prestorage-freeze-frame=false  # Event_LIN 17 Slave 13_NoCommunication
  diagnostic event to trouble code uds mapping EventDtcMapLIN17Slave13NoCommunication: diagnostic-event=EventLIN17Slave13NoCommunication, trouble-code-uds=LIN_17_Slave_13_NoCommunication  # Event_Dtc_Map_LIN 17 Slave 13_NoCommunication
  diagnostic event to operation cycle mapping EventOperCycleMapLIN17Slave13NoCommunication: diagnostic-event=EventLIN17Slave13NoCommunication, operation-cycle=DefaultOperationCycle  # Event_Oper_Cycle_Map_LIN 17 Slave 13_NoCommunication
  diagnostic event to debounce algorithm mapping EventDebounceMapLIN17Slave13NoCommunication: debounce-algorithm=counter_based, diagnostic-event=EventLIN17Slave13NoCommunication  # EventDebounceMap_LIN 17 Slave 13_NoCommunication
package /ZeC/DTC/DTC/LIN_17_Slave_12_Defect
  diagnostic trouble code uds LIN_17_Slave_12_Defect: dtc-props=Dtc_Props_358996c7, uds-dtc-value=0x031116  # LIN 17 Slave 12_Defect
  diagnostic event EventLIN17Slave12Defect: aging-allowed=true, event-kind=SWC, prestorage-freeze-frame=false  # Event_LIN 17 Slave 12_Defect
  diagnostic event to trouble code uds mapping EventDtcMapLIN17Slave12Defect: diagnostic-event=EventLIN17Slave12Defect, trouble-code-uds=LIN_17_Slave_12_Defect  # Event_Dtc_Map_LIN 17 Slave 12_Defect
  diagnostic event to operation cycle mapping EventOperCycleMapLIN17Slave12Defect: diagnostic-event=EventLIN17Slave12Defect, operation-cycle=DefaultOperationCycle  # Event_Oper_Cycle_Map_LIN 17 Slave 12_Defect
  diagnostic event to debounce algorithm mapping EventDebounceMapLIN17Slave12Defect: debounce-algorithm=counter_based, diagnostic-event=EventLIN17Slave12Defect  # EventDebounceMap_LIN 17 Slave 12_Defect
package /ZeC/DTC/DTC/LIN_17_Slave_12_NoCommunication
  diagnostic trouble code uds LIN_17_Slave_12_NoCommunication: dtc-props=Dtc_Props_358996c7, uds-dtc-value=0x031117  # LIN 17 Slave 12_NoCommunication
  diagnostic event EventLIN17Slave12NoCommunication: aging-allowed=true, event-kind=SWC, prestorage-freeze-frame=false  # Event_LIN 17 Slave 12_NoCommunication
  diagnostic event to trouble code uds mapping EventDtcMapLIN17Slave12NoCommunication: diagnostic-event=EventLIN17Slave12NoCommunication, trouble-code-uds=LIN_17_Slave_12_NoCommunication  # Event_Dtc_Map_LIN 17 Slave 12_NoCommunication
  diagnostic event to operation cycle mapping EventOperCycleMapLIN17Slave12NoCommunication: diagnostic-event=EventLIN17Slave12NoCommunication, operation-cycle=DefaultOperationCycle  # Event_Oper_Cycle_Map_LIN 17 Slave 12_NoCommunication
  diagnostic event to debounce algorithm mapping EventDebounceMapLIN17Slave12NoCommunication: debounce-algorithm=counter_based, diagnostic-event=EventLIN17Slave12NoCommunication  # EventDebounceMap_LIN 17 Slave 12_NoCommunication
package /ZeC/DTC/DTC/LIN_17_Slave_11_Defect
  diagnostic trouble code uds LIN_17_Slave_11_Defect: dtc-props=Dtc_Props_358996c7, uds-dtc-value=0x031114  # LIN 17 Slave 11_Defect
  diagnostic event EventLIN17Slave11Defect: aging-allowed=true, event-kind=SWC, prestorage-freeze-frame=false  # Event_LIN 17 Slave 11_Defect
  diagnostic event to trouble code uds mapping EventDtcMapLIN17Slave11Defect: diagnostic-event=EventLIN17Slave11Defect, trouble-code-uds=LIN_17_Slave_11_Defect  # Event_Dtc_Map_LIN 17 Slave 11_Defect
  diagnostic event to operation cycle mapping EventOperCycleMapLIN17Slave11Defect: diagnostic-event=EventLIN17Slave11Defect, operation-cycle=DefaultOperationCycle  # Event_Oper_Cycle_Map_LIN 17 Slave 11_Defect
  diagnostic event to debounce algorithm mapping EventDebounceMapLIN17Slave11Defect: debounce-algorithm=counter_based, diagnostic-event=EventLIN17Slave11Defect  # EventDebounceMap_LIN 17 Slave 11_Defect
package /ZeC/DTC/DTC/LIN_17_Slave_11_NoCommunication
  diagnostic trouble code uds LIN_17_Slave_11_NoCommunication: dtc-props=Dtc_Props_358996c7, uds-dtc-value=0x031115  # LIN 17 Slave 11_NoCommunication
  diagnostic event EventLIN17Slave11NoCommunication: aging-allowed=true, event-kind=SWC, prestorage-freeze-frame=false  # Event_LIN 17 Slave 11_NoCommunication
  diagnostic event to trouble code uds mapping EventDtcMapLIN17Slave11NoCommunication: diagnostic-event=EventLIN17Slave11NoCommunication, trouble-code-uds=LIN_17_Slave_11_NoCommunication  # Event_Dtc_Map_LIN 17 Slave 11_NoCommunication
  diagnostic event to operation cycle mapping EventOperCycleMapLIN17Slave11NoCommunication: diagnostic-event=EventLIN17Slave11NoCommunication, operation-cycle=DefaultOperationCycle  # Event_Oper_Cycle_Map_LIN 17 Slave 11_NoCommunication
  diagnostic event to debounce algorithm mapping EventDebounceMapLIN17Slave11NoCommunication: debounce-algorithm=counter_based, diagnostic-event=EventLIN17Slave11NoCommunication  # EventDebounceMap_LIN 17 Slave 11_NoCommunication
package /ZeC/DTC/DTC/LIN_17_Slave_10_Defect
  diagnostic trouble code uds LIN_17_Slave_10_Defect: dtc-props=Dtc_Props_358996c7, uds-dtc-value=0x031112  # LIN 17 Slave 10_Defect
  diagnostic event EventLIN17Slave10Defect: aging-allowed=true, event-kind=SWC, prestorage-freeze-frame=false  # Event_LIN 17 Slave 10_Defect
  diagnostic event to trouble code uds mapping EventDtcMapLIN17Slave10Defect: diagnostic-event=EventLIN17Slave10Defect, trouble-code-uds=LIN_17_Slave_10_Defect  # Event_Dtc_Map_LIN 17 Slave 10_Defect
  diagnostic event to operation cycle mapping EventOperCycleMapLIN17Slave10Defect: diagnostic-event=EventLIN17Slave10Defect, operation-cycle=DefaultOperationCycle  # Event_Oper_Cycle_Map_LIN 17 Slave 10_Defect
  diagnostic event to debounce algorithm mapping EventDebounceMapLIN17Slave10Defect: debounce-algorithm=counter_based, diagnostic-event=EventLIN17Slave10Defect  # EventDebounceMap_LIN 17 Slave 10_Defect
package /ZeC/DTC/DTC/LIN_17_Slave_10_NoCommunication
  diagnostic trouble code uds LIN_17_Slave_10_NoCommunication: dtc-props=Dtc_Props_358996c7, uds-dtc-value=0x031113  # LIN 17 Slave 10_NoCommunication
  diagnostic event EventLIN17Slave10NoCommunication: aging-allowed=true, event-kind=SWC, prestorage-freeze-frame=false  # Event_LIN 17 Slave 10_NoCommunication
  diagnostic event to trouble code uds mapping EventDtcMapLIN17Slave10NoCommunication: diagnostic-event=EventLIN17Slave10NoCommunication, trouble-code-uds=LIN_17_Slave_10_NoCommunication  # Event_Dtc_Map_LIN 17 Slave 10_NoCommunication
  diagnostic event to operation cycle mapping EventOperCycleMapLIN17Slave10NoCommunication: diagnostic-event=EventLIN17Slave10NoCommunication, operation-cycle=DefaultOperationCycle  # Event_Oper_Cycle_Map_LIN 17 Slave 10_NoCommunication
  diagnostic event to debounce algorithm mapping EventDebounceMapLIN17Slave10NoCommunication: debounce-algorithm=counter_based, diagnostic-event=EventLIN17Slave10NoCommunication  # EventDebounceMap_LIN 17 Slave 10_NoCommunication
package /ZeC/DTC/DTC/LIN_17_Slave_1_Defect
  diagnostic trouble code uds LIN_17_Slave_1_Defect: dtc-props=Dtc_Props_358996c7, uds-dtc-value=0x031110  # LIN 17 Slave 1_Defect
  diagnostic event EventLIN17Slave1Defect: aging-allowed=true, event-kind=SWC, prestorage-freeze-frame=false  # Event_LIN 17 Slave 1_Defect
  diagnostic event to trouble code uds mapping EventDtcMapLIN17Slave1Defect: diagnostic-event=EventLIN17Slave1Defect, trouble-code-uds=LIN_17_Slave_1_Defect  # Event_Dtc_Map_LIN 17 Slave 1_Defect
  diagnostic event to operation cycle mapping EventOperCycleMapLIN17Slave1Defect: diagnostic-event=EventLIN17Slave1Defect, operation-cycle=DefaultOperationCycle  # Event_Oper_Cycle_Map_LIN 17 Slave 1_Defect
  diagnostic event to debounce algorithm mapping EventDebounceMapLIN17Slave1Defect: debounce-algorithm=counter_based, diagnostic-event=EventLIN17Slave1Defect  # EventDebounceMap_LIN 17 Slave 1_Defect
package /ZeC/DTC/DTC/LIN_17_Slave_1_NoCommunication
  diagnostic trouble code uds LIN_17_Slave_1_NoCommunication: dtc-props=Dtc_Props_358996c7, uds-dtc-value=0x031111  # LIN 17 Slave 1_NoCommunication
  diagnostic event EventLIN17Slave1NoCommunication: aging-allowed=true, event-kind=SWC, prestorage-freeze-frame=false  # Event_LIN 17 Slave 1_NoCommunication
  diagnostic event to trouble code uds mapping EventDtcMapLIN17Slave1NoCommunication: diagnostic-event=EventLIN17Slave1NoCommunication, trouble-code-uds=LIN_17_Slave_1_NoCommunication  # Event_Dtc_Map_LIN 17 Slave 1_NoCommunication
  diagnostic event to operation cycle mapping EventOperCycleMapLIN17Slave1NoCommunication: diagnostic-event=EventLIN17Slave1NoCommunication, operation-cycle=DefaultOperationCycle  # Event_Oper_Cycle_Map_LIN 17 Slave 1_NoCommunication
  diagnostic event to debounce algorithm mapping EventDebounceMapLIN17Slave1NoCommunication: debounce-algorithm=counter_based, diagnostic-event=EventLIN17Slave1NoCommunication  # EventDebounceMap_LIN 17 Slave 1_NoCommunication
package /ZeC/DTC/DTC/LIN_17_Slave_15_NoCommunication
  diagnostic trouble code uds LIN_17_Slave_15_NoCommunication: dtc-props=Dtc_Props_358996c7, uds-dtc-value=0x03111d  # LIN 17 Slave 15_NoCommunication
  diagnostic event EventLIN17Slave15NoCommunication: aging-allowed=true, event-kind=SWC, prestorage-freeze-frame=false  # Event_LIN 17 Slave 15_NoCommunication
  diagnostic event to trouble code uds mapping EventDtcMapLIN17Slave15NoCommunication: diagnostic-event=EventLIN17Slave15NoCommunication, trouble-code-uds=LIN_17_Slave_15_NoCommunication  # Event_Dtc_Map_LIN 17 Slave 15_NoCommunication
  diagnostic event to operation cycle mapping EventOperCycleMapLIN17Slave15NoCommunication: diagnostic-event=EventLIN17Slave15NoCommunication, operation-cycle=DefaultOperationCycle  # Event_Oper_Cycle_Map_LIN 17 Slave 15_NoCommunication
  diagnostic event to debounce algorithm mapping EventDebounceMapLIN17Slave15NoCommunication: debounce-algorithm=counter_based, diagnostic-event=EventLIN17Slave15NoCommunication  # EventDebounceMap_LIN 17 Slave 15_NoCommunication
package /ZeC/DTC/DTC/LIN_17_Slave_2_Defect
  diagnostic trouble code uds LIN_17_Slave_2_Defect: dtc-props=Dtc_Props_358996c7, uds-dtc-value=0x03111e  # LIN 17 Slave 2_Defect
  diagnostic event EventLIN17Slave2Defect: aging-allowed=true, event-kind=SWC, prestorage-freeze-frame=false  # Event_LIN 17 Slave 2_Defect
  diagnostic event to trouble code uds mapping EventDtcMapLIN17Slave2Defect: diagnostic-event=EventLIN17Slave2Defect, trouble-code-uds=LIN_17_Slave_2_Defect  # Event_Dtc_Map_LIN 17 Slave 2_Defect
  diagnostic event to operation cycle mapping EventOperCycleMapLIN17Slave2Defect: diagnostic-event=EventLIN17Slave2Defect, operation-cycle=DefaultOperationCycle  # Event_Oper_Cycle_Map_LIN 17 Slave 2_Defect
  diagnostic event to debounce algorithm mapping EventDebounceMapLIN17Slave2Defect: debounce-algorithm=counter_based, diagnostic-event=EventLIN17Slave2Defect  # EventDebounceMap_LIN 17 Slave 2_Defect
package /ZeC/DTC/DTC/LIN_17_Slave_14_NoCommunication
  diagnostic trouble code uds LIN_17_Slave_14_NoCommunication: dtc-props=Dtc_Props_358996c7, uds-dtc-value=0x03111b  # LIN 17 Slave 14_NoCommunication
  diagnostic event EventLIN17Slave14NoCommunication: aging-allowed=true, event-kind=SWC, prestorage-freeze-frame=false  # Event_LIN 17 Slave 14_NoCommunication
  diagnostic event to trouble code uds mapping EventDtcMapLIN17Slave14NoCommunication: diagnostic-event=EventLIN17Slave14NoCommunication, trouble-code-uds=LIN_17_Slave_14_NoCommunication  # Event_Dtc_Map_LIN 17 Slave 14_NoCommunication
  diagnostic event to operation cycle mapping EventOperCycleMapLIN17Slave14NoCommunication: diagnostic-event=EventLIN17Slave14NoCommunication, operation-cycle=DefaultOperationCycle  # Event_Oper_Cycle_Map_LIN 17 Slave 14_NoCommunication
  diagnostic event to debounce algorithm mapping EventDebounceMapLIN17Slave14NoCommunication: debounce-algorithm=counter_based, diagnostic-event=EventLIN17Slave14NoCommunication  # EventDebounceMap_LIN 17 Slave 14_NoCommunication
package /ZeC/DTC/DTC/LIN_17_Slave_15_Defect
  diagnostic trouble code uds LIN_17_Slave_15_Defect: dtc-props=Dtc_Props_358996c7, uds-dtc-value=0x03111c  # LIN 17 Slave 15_Defect
  diagnostic event EventLIN17Slave15Defect: aging-allowed=true, event-kind=SWC, prestorage-freeze-frame=false  # Event_LIN 17 Slave 15_Defect
  diagnostic event to trouble code uds mapping EventDtcMapLIN17Slave15Defect: diagnostic-event=EventLIN17Slave15Defect, trouble-code-uds=LIN_17_Slave_15_Defect  # Event_Dtc_Map_LIN 17 Slave 15_Defect
  diagnostic event to operation cycle mapping EventOperCycleMapLIN17Slave15Defect: diagnostic-event=EventLIN17Slave15Defect, operation-cycle=DefaultOperationCycle  # Event_Oper_Cycle_Map_LIN 17 Slave 15_Defect
  diagnostic event to debounce algorithm mapping EventDebounceMapLIN17Slave15Defect: debounce-algorithm=counter_based, diagnostic-event=EventLIN17Slave15Defect  # EventDebounceMap_LIN 17 Slave 15_Defect
package /ZeC/DTC/DTC/LIN_17_Slave_14_Defect
  diagnostic trouble code uds LIN_17_Slave_14_Defect: dtc-props=Dtc_Props_358996c7, uds-dtc-value=0x03111a  # LIN 17 Slave 14_Defect
  diagnostic event EventLIN17Slave14Defect: aging-allowed=true, event-kind=SWC, prestorage-freeze-frame=false  # Event_LIN 17 Slave 14_Defect
  diagnostic event to trouble code uds mapping EventDtcMapLIN17Slave14Defect: diagnostic-event=EventLIN17Slave14Defect, trouble-code-uds=LIN_17_Slave_14_Defect  # Event_Dtc_Map_LIN 17 Slave 14_Defect
  diagnostic event to operation cycle mapping EventOperCycleMapLIN17Slave14Defect: diagnostic-event=EventLIN17Slave14Defect, operation-cycle=DefaultOperationCycle  # Event_Oper_Cycle_Map_LIN 17 Slave 14_Defect
  diagnostic event to debounce algorithm mapping EventDebounceMapLIN17Slave14Defect: debounce-algorithm=counter_based, diagnostic-event=EventLIN17Slave14Defect  # EventDebounceMap_LIN 17 Slave 14_Defect
package /ZeC/DTC/DTC/Power_Path_154_Short_to_GND_Failure
  diagnostic trouble code uds Power_Path_154_Short_to_GND_Failure: dtc-props=Dtc_Props_18a0fe94, uds-dtc-value=0x00529a
  diagnostic event EventPowerPath154ShortToGNDFailure: aging-allowed=true, event-kind=SWC, prestorage-freeze-frame=false  # Event_Power_Path_154_Short_to_GND_Failure
  diagnostic event to trouble code uds mapping EventDtcMapPowerPath154ShortToGNDFailure: diagnostic-event=EventPowerPath154ShortToGNDFailure, trouble-code-uds=Power_Path_154_Short_to_GND_Failure  # Event_Dtc_Map_Power_Path_154_Short_to_GND_Failure
  diagnostic event to operation cycle mapping EventOperCycleMapPowerPath154ShortToGNDFailure: diagnostic-event=EventPowerPath154ShortToGNDFailure, operation-cycle=DefaultOperationCycle  # Event_Oper_Cycle_Map_Power_Path_154_Short_to_GND_Failure
  diagnostic event to debounce algorithm mapping EventDebounceMapPowerPath154ShortToGNDFailure: debounce-algorithm=time_based, diagnostic-event=EventPowerPath154ShortToGNDFailure  # EventDebounceMap_Power_Path_154_Short_to_GND_Failure
package /ZeC/DTC/DTC/Power_Path_156_Short_to_GND_Failure
  diagnostic trouble code uds Power_Path_156_Short_to_GND_Failure: dtc-props=Dtc_Props_9492eae0, uds-dtc-value=0x00529c
  diagnostic event EventPowerPath156ShortToGNDFailure: aging-allowed=true, event-kind=SWC, prestorage-freeze-frame=false  # Event_Power_Path_156_Short_to_GND_Failure
  diagnostic event to trouble code uds mapping EventDtcMapPowerPath156ShortToGNDFailure: diagnostic-event=EventPowerPath156ShortToGNDFailure, trouble-code-uds=Power_Path_156_Short_to_GND_Failure  # Event_Dtc_Map_Power_Path_156_Short_to_GND_Failure
  diagnostic event to operation cycle mapping EventOperCycleMapPowerPath156ShortToGNDFailure: diagnostic-event=EventPowerPath156ShortToGNDFailure, operation-cycle=DefaultOperationCycle  # Event_Oper_Cycle_Map_Power_Path_156_Short_to_GND_Failure
  diagnostic event to debounce algorithm mapping EventDebounceMapPowerPath156ShortToGNDFailure: debounce-algorithm=time_based, diagnostic-event=EventPowerPath156ShortToGNDFailure  # EventDebounceMap_Power_Path_156_Short_to_GND_Failure
package /ZeC/DTC/DTC/Power_Path_155_Short_to_GND_Failure
  diagnostic trouble code uds Power_Path_155_Short_to_GND_Failure: dtc-props=Dtc_Props_d28be0da, uds-dtc-value=0x00529b
  diagnostic event EventPowerPath155ShortToGNDFailure: aging-allowed=true, event-kind=SWC, prestorage-freeze-frame=false  # Event_Power_Path_155_Short_to_GND_Failure
  diagnostic event to trouble code uds mapping EventDtcMapPowerPath155ShortToGNDFailure: diagnostic-event=EventPowerPath155ShortToGNDFailure, trouble-code-uds=Power_Path_155_Short_to_GND_Failure  # Event_Dtc_Map_Power_Path_155_Short_to_GND_Failure
  diagnostic event to operation cycle mapping EventOperCycleMapPowerPath155ShortToGNDFailure: diagnostic-event=EventPowerPath155ShortToGNDFailure, operation-cycle=DefaultOperationCycle  # Event_Oper_Cycle_Map_Power_Path_155_Short_to_GND_Failure
  diagnostic event to debounce algorithm mapping EventDebounceMapPowerPath155ShortToGNDFailure: debounce-algorithm=time_based, diagnostic-event=EventPowerPath155ShortToGNDFailure  # EventDebounceMap_Power_Path_155_Short_to_GND_Failure
package /ZeC/DTC/DTC/sec_firewall_configuration_signature_verification_failed
  diagnostic trouble code uds sec_firewall_configuration_signature_verification_failed: dtc-props=Dtc_Props_14158306, uds-dtc-value=0x033302
  diagnostic event EventSecFirewallConfigurationSignatureVerificationFailed: aging-allowed=true, event-kind=SWC, prestorage-freeze-frame=false  # Event_sec_firewall_configuration_signature_verification_failed
  diagnostic event to trouble code uds mapping EventDtcMapSecFirewallConfigurationSignatureVerificationFailed: diagnostic-event=EventSecFirewallConfigurationSignatureVerificationFailed, trouble-code-uds=sec_firewall_configuration_signature_verification_failed  # Event_Dtc_Map_sec_firewall_configuration_signature_verification_failed
  diagnostic event to operation cycle mapping EventOperCycleMapSecFirewallConfigurationSignatureVerificationFailed: diagnostic-event=EventSecFirewallConfigurationSignatureVerificationFailed, operation-cycle=DefaultOperationCycle  # Event_Oper_Cycle_Map_sec_firewall_configuration_signature_verification_failed
  diagnostic event to debounce algorithm mapping EventDebounceMapSecFirewallConfigurationSignatureVerificationFailed: debounce-algorithm=counter_based, diagnostic-event=EventSecFirewallConfigurationSignatureVerificationFailed  # EventDebounceMap_sec_firewall_configuration_signature_verification_failed
package /ZeC/DTC/DTC/sec_switch_configuration_signature_verification_failed
  diagnostic trouble code uds sec_switch_configuration_signature_verification_failed: dtc-props=Dtc_Props_14158306, uds-dtc-value=0x033301
  diagnostic event EventSecSwitchConfigurationSignatureVerificationFailed: aging-allowed=true, event-kind=SWC, prestorage-freeze-frame=false  # Event_sec_switch_configuration_signature_verification_failed
  diagnostic event to trouble code uds mapping EventDtcMapSecSwitchConfigurationSignatureVerificationFailed: diagnostic-event=EventSecSwitchConfigurationSignatureVerificationFailed, trouble-code-uds=sec_switch_configuration_signature_verification_failed  # Event_Dtc_Map_sec_switch_configuration_signature_verification_failed
  diagnostic event to operation cycle mapping EventOperCycleMapSecSwitchConfigurationSignatureVerificationFailed: diagnostic-event=EventSecSwitchConfigurationSignatureVerificationFailed, operation-cycle=DefaultOperationCycle  # Event_Oper_Cycle_Map_sec_switch_configuration_signature_verification_failed
  diagnostic event to debounce algorithm mapping EventDebounceMapSecSwitchConfigurationSignatureVerificationFailed: debounce-algorithm=counter_based, diagnostic-event=EventSecSwitchConfigurationSignatureVerificationFailed  # EventDebounceMap_sec_switch_configuration_signature_verification_failed
package /ZeC/DTC/DTC/LIN_17_Local_Databus_Electrical_Failure
  diagnostic trouble code uds LIN_17_Local_Databus_Electrical_Failure: dtc-props=Dtc_Props_358996c7, uds-dtc-value=0x031121  # LIN 17 Local_Databus_Electrical_Failure
  diagnostic event EventLIN17LocalDatabusElectricalFailure: aging-allowed=true, event-kind=SWC, prestorage-freeze-frame=false  # Event_LIN 17 Local_Databus_Electrical_Failure
  diagnostic event to trouble code uds mapping EventDtcMapLIN17LocalDatabusElectricalFailure: diagnostic-event=EventLIN17LocalDatabusElectricalFailure, trouble-code-uds=LIN_17_Local_Databus_Electrical_Failure  # Event_Dtc_Map_LIN 17 Local_Databus_Electrical_Failure
  diagnostic event to operation cycle mapping EventOperCycleMapLIN17LocalDatabusElectricalFailure: diagnostic-event=EventLIN17LocalDatabusElectricalFailure, operation-cycle=DefaultOperationCycle  # Event_Oper_Cycle_Map_LIN 17 Local_Databus_Electrical_Failure
  diagnostic event to debounce algorithm mapping EventDebounceMapLIN17LocalDatabusElectricalFailure: debounce-algorithm=counter_based, diagnostic-event=EventLIN17LocalDatabusElectricalFailure  # EventDebounceMap_LIN 17 Local_Databus_Electrical_Failure
package /ZeC/DTC/DTC/Power_Path_158_Short_to_GND_Failure
  diagnostic trouble code uds Power_Path_158_Short_to_GND_Failure: dtc-props=Dtc_Props_dbb5d03d, uds-dtc-value=0x00529e
  diagnostic event EventPowerPath158ShortToGNDFailure: aging-allowed=true, event-kind=SWC, prestorage-freeze-frame=false  # Event_Power_Path_158_Short_to_GND_Failure
  diagnostic event to trouble code uds mapping EventDtcMapPowerPath158ShortToGNDFailure: diagnostic-event=EventPowerPath158ShortToGNDFailure, trouble-code-uds=Power_Path_158_Short_to_GND_Failure  # Event_Dtc_Map_Power_Path_158_Short_to_GND_Failure
  diagnostic event to operation cycle mapping EventOperCycleMapPowerPath158ShortToGNDFailure: diagnostic-event=EventPowerPath158ShortToGNDFailure, operation-cycle=DefaultOperationCycle  # Event_Oper_Cycle_Map_Power_Path_158_Short_to_GND_Failure
  diagnostic event to debounce algorithm mapping EventDebounceMapPowerPath158ShortToGNDFailure: debounce-algorithm=time_based, diagnostic-event=EventPowerPath158ShortToGNDFailure  # EventDebounceMap_Power_Path_158_Short_to_GND_Failure
package /ZeC/DTC/DTC/Power_Path_157_Short_to_GND_Failure
  diagnostic trouble code uds Power_Path_157_Short_to_GND_Failure: dtc-props=Dtc_Props_9dacda07, uds-dtc-value=0x00529d
  diagnostic event EventPowerPath157ShortToGNDFailure: aging-allowed=true, event-kind=SWC, prestorage-freeze-frame=false  # Event_Power_Path_157_Short_to_GND_Failure
  diagnostic event to trouble code uds mapping EventDtcMapPowerPath157ShortToGNDFailure: diagnostic-event=EventPowerPath157ShortToGNDFailure, trouble-code-uds=Power_Path_157_Short_to_GND_Failure  # Event_Dtc_Map_Power_Path_157_Short_to_GND_Failure
  diagnostic event to operation cycle mapping EventOperCycleMapPowerPath157ShortToGNDFailure: diagnostic-event=EventPowerPath157ShortToGNDFailure, operation-cycle=DefaultOperationCycle  # Event_Oper_Cycle_Map_Power_Path_157_Short_to_GND_Failure
  diagnostic event to debounce algorithm mapping EventDebounceMapPowerPath157ShortToGNDFailure: debounce-algorithm=time_based, diagnostic-event=EventPowerPath157ShortToGNDFailure  # EventDebounceMap_Power_Path_157_Short_to_GND_Failure
package /ZeC/DTC/DTC/LIN_17_Databus_No_Comm
  diagnostic trouble code uds LIN_17_Databus_No_Comm: dtc-props=Dtc_Props_358996c7, uds-dtc-value=0x031120  # LIN 17 Databus_No_Comm
  diagnostic event EventLIN17DatabusNoComm: aging-allowed=true, event-kind=SWC, prestorage-freeze-frame=false  # Event_LIN 17 Databus_No_Comm
  diagnostic event to trouble code uds mapping EventDtcMapLIN17DatabusNoComm: diagnostic-event=EventLIN17DatabusNoComm, trouble-code-uds=LIN_17_Databus_No_Comm  # Event_Dtc_Map_LIN 17 Databus_No_Comm
  diagnostic event to operation cycle mapping EventOperCycleMapLIN17DatabusNoComm: diagnostic-event=EventLIN17DatabusNoComm, operation-cycle=DefaultOperationCycle  # Event_Oper_Cycle_Map_LIN 17 Databus_No_Comm
  diagnostic event to debounce algorithm mapping EventDebounceMapLIN17DatabusNoComm: debounce-algorithm=counter_based, diagnostic-event=EventLIN17DatabusNoComm  # EventDebounceMap_LIN 17 Databus_No_Comm
package /ZeC/DTC/DTC/Power_Path_159_Short_to_GND_Failure
  diagnostic trouble code uds Power_Path_159_Short_to_GND_Failure: dtc-props=Dtc_Props_119ece73, uds-dtc-value=0x00529f
  diagnostic event EventPowerPath159ShortToGNDFailure: aging-allowed=true, event-kind=SWC, prestorage-freeze-frame=false  # Event_Power_Path_159_Short_to_GND_Failure
  diagnostic event to trouble code uds mapping EventDtcMapPowerPath159ShortToGNDFailure: diagnostic-event=EventPowerPath159ShortToGNDFailure, trouble-code-uds=Power_Path_159_Short_to_GND_Failure  # Event_Dtc_Map_Power_Path_159_Short_to_GND_Failure
  diagnostic event to operation cycle mapping EventOperCycleMapPowerPath159ShortToGNDFailure: diagnostic-event=EventPowerPath159ShortToGNDFailure, operation-cycle=DefaultOperationCycle  # Event_Oper_Cycle_Map_Power_Path_159_Short_to_GND_Failure
  diagnostic event to debounce algorithm mapping EventDebounceMapPowerPath159ShortToGNDFailure: debounce-algorithm=time_based, diagnostic-event=EventPowerPath159ShortToGNDFailure  # EventDebounceMap_Power_Path_159_Short_to_GND_Failure
package /ZeC/DTC/DTC/LIN_17_Slave_6_NoCommunication
  diagnostic trouble code uds LIN_17_Slave_6_NoCommunication: dtc-props=Dtc_Props_358996c7, uds-dtc-value=0x031109  # LIN 17 Slave 6_NoCommunication
  diagnostic event EventLIN17Slave6NoCommunication: aging-allowed=true, event-kind=SWC, prestorage-freeze-frame=false  # Event_LIN 17 Slave 6_NoCommunication
  diagnostic event to trouble code uds mapping EventDtcMapLIN17Slave6NoCommunication: diagnostic-event=EventLIN17Slave6NoCommunication, trouble-code-uds=LIN_17_Slave_6_NoCommunication  # Event_Dtc_Map_LIN 17 Slave 6_NoCommunication
  diagnostic event to operation cycle mapping EventOperCycleMapLIN17Slave6NoCommunication: diagnostic-event=EventLIN17Slave6NoCommunication, operation-cycle=DefaultOperationCycle  # Event_Oper_Cycle_Map_LIN 17 Slave 6_NoCommunication
  diagnostic event to debounce algorithm mapping EventDebounceMapLIN17Slave6NoCommunication: debounce-algorithm=counter_based, diagnostic-event=EventLIN17Slave6NoCommunication  # EventDebounceMap_LIN 17 Slave 6_NoCommunication
package /ZeC/DTC/DTC/LIN_17_Slave_5_NoCommunication
  diagnostic trouble code uds LIN_17_Slave_5_NoCommunication: dtc-props=Dtc_Props_358996c7, uds-dtc-value=0x031107  # LIN 17 Slave 5_NoCommunication
  diagnostic event EventLIN17Slave5NoCommunication: aging-allowed=true, event-kind=SWC, prestorage-freeze-frame=false  # Event_LIN 17 Slave 5_NoCommunication
  diagnostic event to trouble code uds mapping EventDtcMapLIN17Slave5NoCommunication: diagnostic-event=EventLIN17Slave5NoCommunication, trouble-code-uds=LIN_17_Slave_5_NoCommunication  # Event_Dtc_Map_LIN 17 Slave 5_NoCommunication
  diagnostic event to operation cycle mapping EventOperCycleMapLIN17Slave5NoCommunication: diagnostic-event=EventLIN17Slave5NoCommunication, operation-cycle=DefaultOperationCycle  # Event_Oper_Cycle_Map_LIN 17 Slave 5_NoCommunication
  diagnostic event to debounce algorithm mapping EventDebounceMapLIN17Slave5NoCommunication: debounce-algorithm=counter_based, diagnostic-event=EventLIN17Slave5NoCommunication  # EventDebounceMap_LIN 17 Slave 5_NoCommunication
package /ZeC/DTC/DTC/LIN_17_Slave_6_Defect
  diagnostic trouble code uds LIN_17_Slave_6_Defect: dtc-props=Dtc_Props_358996c7, uds-dtc-value=0x031108  # LIN 17 Slave 6_Defect
  diagnostic event EventLIN17Slave6Defect: aging-allowed=true, event-kind=SWC, prestorage-freeze-frame=false  # Event_LIN 17 Slave 6_Defect
  diagnostic event to trouble code uds mapping EventDtcMapLIN17Slave6Defect: diagnostic-event=EventLIN17Slave6Defect, trouble-code-uds=LIN_17_Slave_6_Defect  # Event_Dtc_Map_LIN 17 Slave 6_Defect
  diagnostic event to operation cycle mapping EventOperCycleMapLIN17Slave6Defect: diagnostic-event=EventLIN17Slave6Defect, operation-cycle=DefaultOperationCycle  # Event_Oper_Cycle_Map_LIN 17 Slave 6_Defect
  diagnostic event to debounce algorithm mapping EventDebounceMapLIN17Slave6Defect: debounce-algorithm=counter_based, diagnostic-event=EventLIN17Slave6Defect  # EventDebounceMap_LIN 17 Slave 6_Defect
package /ZeC/DTC/DTC/LIN_17_Slave_4_NoCommunication
  diagnostic trouble code uds LIN_17_Slave_4_NoCommunication: dtc-props=Dtc_Props_358996c7, uds-dtc-value=0x031105  # LIN 17 Slave 4_NoCommunication
  diagnostic event EventLIN17Slave4NoCommunication: aging-allowed=true, event-kind=SWC, prestorage-freeze-frame=false  # Event_LIN 17 Slave 4_NoCommunication
  diagnostic event to trouble code uds mapping EventDtcMapLIN17Slave4NoCommunication: diagnostic-event=EventLIN17Slave4NoCommunication, trouble-code-uds=LIN_17_Slave_4_NoCommunication  # Event_Dtc_Map_LIN 17 Slave 4_NoCommunication
  diagnostic event to operation cycle mapping EventOperCycleMapLIN17Slave4NoCommunication: diagnostic-event=EventLIN17Slave4NoCommunication, operation-cycle=DefaultOperationCycle  # Event_Oper_Cycle_Map_LIN 17 Slave 4_NoCommunication
  diagnostic event to debounce algorithm mapping EventDebounceMapLIN17Slave4NoCommunication: debounce-algorithm=counter_based, diagnostic-event=EventLIN17Slave4NoCommunication  # EventDebounceMap_LIN 17 Slave 4_NoCommunication
package /ZeC/DTC/DTC/LIN_17_Slave_5_Defect
  diagnostic trouble code uds LIN_17_Slave_5_Defect: dtc-props=Dtc_Props_358996c7, uds-dtc-value=0x031106  # LIN 17 Slave 5_Defect
  diagnostic event EventLIN17Slave5Defect: aging-allowed=true, event-kind=SWC, prestorage-freeze-frame=false  # Event_LIN 17 Slave 5_Defect
  diagnostic event to trouble code uds mapping EventDtcMapLIN17Slave5Defect: diagnostic-event=EventLIN17Slave5Defect, trouble-code-uds=LIN_17_Slave_5_Defect  # Event_Dtc_Map_LIN 17 Slave 5_Defect
  diagnostic event to operation cycle mapping EventOperCycleMapLIN17Slave5Defect: diagnostic-event=EventLIN17Slave5Defect, operation-cycle=DefaultOperationCycle  # Event_Oper_Cycle_Map_LIN 17 Slave 5_Defect
  diagnostic event to debounce algorithm mapping EventDebounceMapLIN17Slave5Defect: debounce-algorithm=counter_based, diagnostic-event=EventLIN17Slave5Defect  # EventDebounceMap_LIN 17 Slave 5_Defect
package /ZeC/DTC/DTC/LIN_17_Slave_3_NoCommunication
  diagnostic trouble code uds LIN_17_Slave_3_NoCommunication: dtc-props=Dtc_Props_358996c7, uds-dtc-value=0x031103  # LIN 17 Slave 3_NoCommunication
  diagnostic event EventLIN17Slave3NoCommunication: aging-allowed=true, event-kind=SWC, prestorage-freeze-frame=false  # Event_LIN 17 Slave 3_NoCommunication
  diagnostic event to trouble code uds mapping EventDtcMapLIN17Slave3NoCommunication: diagnostic-event=EventLIN17Slave3NoCommunication, trouble-code-uds=LIN_17_Slave_3_NoCommunication  # Event_Dtc_Map_LIN 17 Slave 3_NoCommunication
  diagnostic event to operation cycle mapping EventOperCycleMapLIN17Slave3NoCommunication: diagnostic-event=EventLIN17Slave3NoCommunication, operation-cycle=DefaultOperationCycle  # Event_Oper_Cycle_Map_LIN 17 Slave 3_NoCommunication
  diagnostic event to debounce algorithm mapping EventDebounceMapLIN17Slave3NoCommunication: debounce-algorithm=counter_based, diagnostic-event=EventLIN17Slave3NoCommunication  # EventDebounceMap_LIN 17 Slave 3_NoCommunication
package /ZeC/DTC/DTC/LIN_17_Slave_4_Defect
  diagnostic trouble code uds LIN_17_Slave_4_Defect: dtc-props=Dtc_Props_358996c7, uds-dtc-value=0x031104  # LIN 17 Slave 4_Defect
  diagnostic event EventLIN17Slave4Defect: aging-allowed=true, event-kind=SWC, prestorage-freeze-frame=false  # Event_LIN 17 Slave 4_Defect
  diagnostic event to trouble code uds mapping EventDtcMapLIN17Slave4Defect: diagnostic-event=EventLIN17Slave4Defect, trouble-code-uds=LIN_17_Slave_4_Defect  # Event_Dtc_Map_LIN 17 Slave 4_Defect
  diagnostic event to operation cycle mapping EventOperCycleMapLIN17Slave4Defect: diagnostic-event=EventLIN17Slave4Defect, operation-cycle=DefaultOperationCycle  # Event_Oper_Cycle_Map_LIN 17 Slave 4_Defect
  diagnostic event to debounce algorithm mapping EventDebounceMapLIN17Slave4Defect: debounce-algorithm=counter_based, diagnostic-event=EventLIN17Slave4Defect  # EventDebounceMap_LIN 17 Slave 4_Defect
package /ZeC/DTC/DTC/LIN_17_Slave_2_NoCommunication
  diagnostic trouble code uds LIN_17_Slave_2_NoCommunication: dtc-props=Dtc_Props_358996c7, uds-dtc-value=0x031101  # LIN 17 Slave 2_NoCommunication
  diagnostic event EventLIN17Slave2NoCommunication: aging-allowed=true, event-kind=SWC, prestorage-freeze-frame=false  # Event_LIN 17 Slave 2_NoCommunication
  diagnostic event to trouble code uds mapping EventDtcMapLIN17Slave2NoCommunication: diagnostic-event=EventLIN17Slave2NoCommunication, trouble-code-uds=LIN_17_Slave_2_NoCommunication  # Event_Dtc_Map_LIN 17 Slave 2_NoCommunication
  diagnostic event to operation cycle mapping EventOperCycleMapLIN17Slave2NoCommunication: diagnostic-event=EventLIN17Slave2NoCommunication, operation-cycle=DefaultOperationCycle  # Event_Oper_Cycle_Map_LIN 17 Slave 2_NoCommunication
  diagnostic event to debounce algorithm mapping EventDebounceMapLIN17Slave2NoCommunication: debounce-algorithm=counter_based, diagnostic-event=EventLIN17Slave2NoCommunication  # EventDebounceMap_LIN 17 Slave 2_NoCommunication
package /ZeC/DTC/DTC/LIN_17_Slave_3_Defect
  diagnostic trouble code uds LIN_17_Slave_3_Defect: dtc-props=Dtc_Props_358996c7, uds-dtc-value=0x031102  # LIN 17 Slave 3_Defect
  diagnostic event EventLIN17Slave3Defect: aging-allowed=true, event-kind=SWC, prestorage-freeze-frame=false  # Event_LIN 17 Slave 3_Defect
  diagnostic event to trouble code uds mapping EventDtcMapLIN17Slave3Defect: diagnostic-event=EventLIN17Slave3Defect, trouble-code-uds=LIN_17_Slave_3_Defect  # Event_Dtc_Map_LIN 17 Slave 3_Defect
  diagnostic event to operation cycle mapping EventOperCycleMapLIN17Slave3Defect: diagnostic-event=EventLIN17Slave3Defect, operation-cycle=DefaultOperationCycle  # Event_Oper_Cycle_Map_LIN 17 Slave 3_Defect
  diagnostic event to debounce algorithm mapping EventDebounceMapLIN17Slave3Defect: debounce-algorithm=counter_based, diagnostic-event=EventLIN17Slave3Defect  # EventDebounceMap_LIN 17 Slave 3_Defect
package /ZeC/DTC/DTC/LIN_17_Slave_9_Defect
  diagnostic trouble code uds LIN_17_Slave_9_Defect: dtc-props=Dtc_Props_358996c7, uds-dtc-value=0x03110e  # LIN 17 Slave 9_Defect
  diagnostic event EventLIN17Slave9Defect: aging-allowed=true, event-kind=SWC, prestorage-freeze-frame=false  # Event_LIN 17 Slave 9_Defect
  diagnostic event to trouble code uds mapping EventDtcMapLIN17Slave9Defect: diagnostic-event=EventLIN17Slave9Defect, trouble-code-uds=LIN_17_Slave_9_Defect  # Event_Dtc_Map_LIN 17 Slave 9_Defect
  diagnostic event to operation cycle mapping EventOperCycleMapLIN17Slave9Defect: diagnostic-event=EventLIN17Slave9Defect, operation-cycle=DefaultOperationCycle  # Event_Oper_Cycle_Map_LIN 17 Slave 9_Defect
  diagnostic event to debounce algorithm mapping EventDebounceMapLIN17Slave9Defect: debounce-algorithm=counter_based, diagnostic-event=EventLIN17Slave9Defect  # EventDebounceMap_LIN 17 Slave 9_Defect
package /ZeC/DTC/DTC/LIN_17_Slave_9_NoCommunication
  diagnostic trouble code uds LIN_17_Slave_9_NoCommunication: dtc-props=Dtc_Props_358996c7, uds-dtc-value=0x03110f  # LIN 17 Slave 9_NoCommunication
  diagnostic event EventLIN17Slave9NoCommunication: aging-allowed=true, event-kind=SWC, prestorage-freeze-frame=false  # Event_LIN 17 Slave 9_NoCommunication
  diagnostic event to trouble code uds mapping EventDtcMapLIN17Slave9NoCommunication: diagnostic-event=EventLIN17Slave9NoCommunication, trouble-code-uds=LIN_17_Slave_9_NoCommunication  # Event_Dtc_Map_LIN 17 Slave 9_NoCommunication
  diagnostic event to operation cycle mapping EventOperCycleMapLIN17Slave9NoCommunication: diagnostic-event=EventLIN17Slave9NoCommunication, operation-cycle=DefaultOperationCycle  # Event_Oper_Cycle_Map_LIN 17 Slave 9_NoCommunication
  diagnostic event to debounce algorithm mapping EventDebounceMapLIN17Slave9NoCommunication: debounce-algorithm=counter_based, diagnostic-event=EventLIN17Slave9NoCommunication  # EventDebounceMap_LIN 17 Slave 9_NoCommunication
package /ZeC/DTC/DTC/LIN_17_Slave_8_Defect
  diagnostic trouble code uds LIN_17_Slave_8_Defect: dtc-props=Dtc_Props_358996c7, uds-dtc-value=0x03110c  # LIN 17 Slave 8_Defect
  diagnostic event EventLIN17Slave8Defect: aging-allowed=true, event-kind=SWC, prestorage-freeze-frame=false  # Event_LIN 17 Slave 8_Defect
  diagnostic event to trouble code uds mapping EventDtcMapLIN17Slave8Defect: diagnostic-event=EventLIN17Slave8Defect, trouble-code-uds=LIN_17_Slave_8_Defect  # Event_Dtc_Map_LIN 17 Slave 8_Defect
  diagnostic event to operation cycle mapping EventOperCycleMapLIN17Slave8Defect: diagnostic-event=EventLIN17Slave8Defect, operation-cycle=DefaultOperationCycle  # Event_Oper_Cycle_Map_LIN 17 Slave 8_Defect
  diagnostic event to debounce algorithm mapping EventDebounceMapLIN17Slave8Defect: debounce-algorithm=counter_based, diagnostic-event=EventLIN17Slave8Defect  # EventDebounceMap_LIN 17 Slave 8_Defect
package /ZeC/DTC/DTC/LIN_17_Slave_8_NoCommunication
  diagnostic trouble code uds LIN_17_Slave_8_NoCommunication: dtc-props=Dtc_Props_358996c7, uds-dtc-value=0x03110d  # LIN 17 Slave 8_NoCommunication
  diagnostic event EventLIN17Slave8NoCommunication: aging-allowed=true, event-kind=SWC, prestorage-freeze-frame=false  # Event_LIN 17 Slave 8_NoCommunication
  diagnostic event to trouble code uds mapping EventDtcMapLIN17Slave8NoCommunication: diagnostic-event=EventLIN17Slave8NoCommunication, trouble-code-uds=LIN_17_Slave_8_NoCommunication  # Event_Dtc_Map_LIN 17 Slave 8_NoCommunication
  diagnostic event to operation cycle mapping EventOperCycleMapLIN17Slave8NoCommunication: diagnostic-event=EventLIN17Slave8NoCommunication, operation-cycle=DefaultOperationCycle  # Event_Oper_Cycle_Map_LIN 17 Slave 8_NoCommunication
  diagnostic event to debounce algorithm mapping EventDebounceMapLIN17Slave8NoCommunication: debounce-algorithm=counter_based, diagnostic-event=EventLIN17Slave8NoCommunication  # EventDebounceMap_LIN 17 Slave 8_NoCommunication
package /ZeC/DTC/DTC/LIN_17_Slave_7_Defect
  diagnostic trouble code uds LIN_17_Slave_7_Defect: dtc-props=Dtc_Props_358996c7, uds-dtc-value=0x03110a  # LIN 17 Slave 7_Defect
  diagnostic event EventLIN17Slave7Defect: aging-allowed=true, event-kind=SWC, prestorage-freeze-frame=false  # Event_LIN 17 Slave 7_Defect
  diagnostic event to trouble code uds mapping EventDtcMapLIN17Slave7Defect: diagnostic-event=EventLIN17Slave7Defect, trouble-code-uds=LIN_17_Slave_7_Defect  # Event_Dtc_Map_LIN 17 Slave 7_Defect
  diagnostic event to operation cycle mapping EventOperCycleMapLIN17Slave7Defect: diagnostic-event=EventLIN17Slave7Defect, operation-cycle=DefaultOperationCycle  # Event_Oper_Cycle_Map_LIN 17 Slave 7_Defect
  diagnostic event to debounce algorithm mapping EventDebounceMapLIN17Slave7Defect: debounce-algorithm=counter_based, diagnostic-event=EventLIN17Slave7Defect  # EventDebounceMap_LIN 17 Slave 7_Defect
package /ZeC/DTC/DTC/LIN_17_Slave_7_NoCommunication
  diagnostic trouble code uds LIN_17_Slave_7_NoCommunication: dtc-props=Dtc_Props_358996c7, uds-dtc-value=0x03110b  # LIN 17 Slave 7_NoCommunication
  diagnostic event EventLIN17Slave7NoCommunication: aging-allowed=true, event-kind=SWC, prestorage-freeze-frame=false  # Event_LIN 17 Slave 7_NoCommunication
  diagnostic event to trouble code uds mapping EventDtcMapLIN17Slave7NoCommunication: diagnostic-event=EventLIN17Slave7NoCommunication, trouble-code-uds=LIN_17_Slave_7_NoCommunication  # Event_Dtc_Map_LIN 17 Slave 7_NoCommunication
  diagnostic event to operation cycle mapping EventOperCycleMapLIN17Slave7NoCommunication: diagnostic-event=EventLIN17Slave7NoCommunication, operation-cycle=DefaultOperationCycle  # Event_Oper_Cycle_Map_LIN 17 Slave 7_NoCommunication
  diagnostic event to debounce algorithm mapping EventDebounceMapLIN17Slave7NoCommunication: debounce-algorithm=counter_based, diagnostic-event=EventLIN17Slave7NoCommunication  # EventDebounceMap_LIN 17 Slave 7_NoCommunication
package /ZeC/DTC/DTC/CAN_04_ECU_5_No_Communication
  diagnostic trouble code uds CAN_04_ECU_5_No_Communication: dtc-props=Dtc_Props_14158306, uds-dtc-value=0x032409
  diagnostic event EventCAN04ECU5NoCommunication: aging-allowed=true, event-kind=SWC, prestorage-freeze-frame=false  # Event_CAN_04_ECU_5_No_Communication
  diagnostic event to trouble code uds mapping EventDtcMapCAN04ECU5NoCommunication: diagnostic-event=EventCAN04ECU5NoCommunication, trouble-code-uds=CAN_04_ECU_5_No_Communication  # Event_Dtc_Map_CAN_04_ECU_5_No_Communication
  diagnostic event to operation cycle mapping EventOperCycleMapCAN04ECU5NoCommunication: diagnostic-event=EventCAN04ECU5NoCommunication, operation-cycle=DefaultOperationCycle  # Event_Oper_Cycle_Map_CAN_04_ECU_5_No_Communication
  diagnostic event to debounce algorithm mapping EventDebounceMapCAN04ECU5NoCommunication: debounce-algorithm=counter_based, diagnostic-event=EventCAN04ECU5NoCommunication  # EventDebounceMap_CAN_04_ECU_5_No_Communication
package /ZeC/DTC/DTC/CAN_04_ECU_3_No_Communication
  diagnostic trouble code uds CAN_04_ECU_3_No_Communication: dtc-props=Dtc_Props_14158306, uds-dtc-value=0x032407
  diagnostic event EventCAN04ECU3NoCommunication: aging-allowed=true, event-kind=SWC, prestorage-freeze-frame=false  # Event_CAN_04_ECU_3_No_Communication
  diagnostic event to trouble code uds mapping EventDtcMapCAN04ECU3NoCommunication: diagnostic-event=EventCAN04ECU3NoCommunication, trouble-code-uds=CAN_04_ECU_3_No_Communication  # Event_Dtc_Map_CAN_04_ECU_3_No_Communication
  diagnostic event to operation cycle mapping EventOperCycleMapCAN04ECU3NoCommunication: diagnostic-event=EventCAN04ECU3NoCommunication, operation-cycle=DefaultOperationCycle  # Event_Oper_Cycle_Map_CAN_04_ECU_3_No_Communication
  diagnostic event to debounce algorithm mapping EventDebounceMapCAN04ECU3NoCommunication: debounce-algorithm=counter_based, diagnostic-event=EventCAN04ECU3NoCommunication  # EventDebounceMap_CAN_04_ECU_3_No_Communication
package /ZeC/DTC/DTC/CAN_04_ECU_4_No_Communication
  diagnostic trouble code uds CAN_04_ECU_4_No_Communication: dtc-props=Dtc_Props_14158306, uds-dtc-value=0x032408
  diagnostic event EventCAN04ECU4NoCommunication: aging-allowed=true, event-kind=SWC, prestorage-freeze-frame=false  # Event_CAN_04_ECU_4_No_Communication
  diagnostic event to trouble code uds mapping EventDtcMapCAN04ECU4NoCommunication: diagnostic-event=EventCAN04ECU4NoCommunication, trouble-code-uds=CAN_04_ECU_4_No_Communication  # Event_Dtc_Map_CAN_04_ECU_4_No_Communication
  diagnostic event to operation cycle mapping EventOperCycleMapCAN04ECU4NoCommunication: diagnostic-event=EventCAN04ECU4NoCommunication, operation-cycle=DefaultOperationCycle  # Event_Oper_Cycle_Map_CAN_04_ECU_4_No_Communication
  diagnostic event to debounce algorithm mapping EventDebounceMapCAN04ECU4NoCommunication: debounce-algorithm=counter_based, diagnostic-event=EventCAN04ECU4NoCommunication  # EventDebounceMap_CAN_04_ECU_4_No_Communication
package /ZeC/DTC/DTC/CAN_04_ECU_1_No_Communication
  diagnostic trouble code uds CAN_04_ECU_1_No_Communication: dtc-props=Dtc_Props_14158306, uds-dtc-value=0x032405
  diagnostic event EventCAN04ECU1NoCommunication: aging-allowed=true, event-kind=SWC, prestorage-freeze-frame=false  # Event_CAN_04_ECU_1_No_Communication
  diagnostic event to trouble code uds mapping EventDtcMapCAN04ECU1NoCommunication: diagnostic-event=EventCAN04ECU1NoCommunication, trouble-code-uds=CAN_04_ECU_1_No_Communication  # Event_Dtc_Map_CAN_04_ECU_1_No_Communication
  diagnostic event to operation cycle mapping EventOperCycleMapCAN04ECU1NoCommunication: diagnostic-event=EventCAN04ECU1NoCommunication, operation-cycle=DefaultOperationCycle  # Event_Oper_Cycle_Map_CAN_04_ECU_1_No_Communication
  diagnostic event to debounce algorithm mapping EventDebounceMapCAN04ECU1NoCommunication: debounce-algorithm=counter_based, diagnostic-event=EventCAN04ECU1NoCommunication  # EventDebounceMap_CAN_04_ECU_1_No_Communication
package /ZeC/DTC/DTC/Power_Path_105_Short_to_GND_Failure
  diagnostic trouble code uds Power_Path_105_Short_to_GND_Failure: dtc-props=Dtc_Props_c2809294, uds-dtc-value=0x005269
  diagnostic event EventPowerPath105ShortToGNDFailure: aging-allowed=true, event-kind=SWC, prestorage-freeze-frame=false  # Event_Power_Path_105_Short_to_GND_Failure
  diagnostic event to trouble code uds mapping EventDtcMapPowerPath105ShortToGNDFailure: diagnostic-event=EventPowerPath105ShortToGNDFailure, trouble-code-uds=Power_Path_105_Short_to_GND_Failure  # Event_Dtc_Map_Power_Path_105_Short_to_GND_Failure
  diagnostic event to operation cycle mapping EventOperCycleMapPowerPath105ShortToGNDFailure: diagnostic-event=EventPowerPath105ShortToGNDFailure, operation-cycle=DefaultOperationCycle  # Event_Oper_Cycle_Map_Power_Path_105_Short_to_GND_Failure
  diagnostic event to debounce algorithm mapping EventDebounceMapPowerPath105ShortToGNDFailure: debounce-algorithm=time_based, diagnostic-event=EventPowerPath105ShortToGNDFailure  # EventDebounceMap_Power_Path_105_Short_to_GND_Failure
package /ZeC/DTC/DTC/CAN_04_ECU_2_No_Communication
  diagnostic trouble code uds CAN_04_ECU_2_No_Communication: dtc-props=Dtc_Props_14158306, uds-dtc-value=0x032406
  diagnostic event EventCAN04ECU2NoCommunication: aging-allowed=true, event-kind=SWC, prestorage-freeze-frame=false  # Event_CAN_04_ECU_2_No_Communication
  diagnostic event to trouble code uds mapping EventDtcMapCAN04ECU2NoCommunication: diagnostic-event=EventCAN04ECU2NoCommunication, trouble-code-uds=CAN_04_ECU_2_No_Communication  # Event_Dtc_Map_CAN_04_ECU_2_No_Communication
  diagnostic event to operation cycle mapping EventOperCycleMapCAN04ECU2NoCommunication: diagnostic-event=EventCAN04ECU2NoCommunication, operation-cycle=DefaultOperationCycle  # Event_Oper_Cycle_Map_CAN_04_ECU_2_No_Communication
  diagnostic event to debounce algorithm mapping EventDebounceMapCAN04ECU2NoCommunication: debounce-algorithm=counter_based, diagnostic-event=EventCAN04ECU2NoCommunication  # EventDebounceMap_CAN_04_ECU_2_No_Communication
package /ZeC/DTC/DTC/DB_CANFD_04_Single_Wire_Mode
  diagnostic trouble code uds DB_CANFD_04_Single_Wire_Mode: dtc-props=Dtc_Props_14158306, uds-dtc-value=0x032403
  diagnostic event EventDBCANFD04SingleWireMode: aging-allowed=true, event-kind=SWC, prestorage-freeze-frame=false  # Event_DB_CANFD_04_Single_Wire_Mode
  diagnostic event to trouble code uds mapping EventDtcMapDBCANFD04SingleWireMode: diagnostic-event=EventDBCANFD04SingleWireMode, trouble-code-uds=DB_CANFD_04_Single_Wire_Mode  # Event_Dtc_Map_DB_CANFD_04_Single_Wire_Mode
  diagnostic event to operation cycle mapping EventOperCycleMapDBCANFD04SingleWireMode: diagnostic-event=EventDBCANFD04SingleWireMode, operation-cycle=DefaultOperationCycle  # Event_Oper_Cycle_Map_DB_CANFD_04_Single_Wire_Mode
  diagnostic event to debounce algorithm mapping EventDebounceMapDBCANFD04SingleWireMode: debounce-algorithm=counter_based, diagnostic-event=EventDBCANFD04SingleWireMode  # EventDebounceMap_DB_CANFD_04_Single_Wire_Mode
package /ZeC/DTC/DTC/DB_CANFD_04_Error_Received_Value
  diagnostic trouble code uds DB_CANFD_04_Error_Received_Value: dtc-props=Dtc_Props_b618fb9, uds-dtc-value=0x032404
  diagnostic event EventDBCANFD04ErrorReceivedValue: aging-allowed=true, event-kind=SWC, prestorage-freeze-frame=false  # Event_DB_CANFD_04_Error_Received_Value
  diagnostic event to trouble code uds mapping EventDtcMapDBCANFD04ErrorReceivedValue: diagnostic-event=EventDBCANFD04ErrorReceivedValue, trouble-code-uds=DB_CANFD_04_Error_Received_Value  # Event_Dtc_Map_DB_CANFD_04_Error_Received_Value
  diagnostic event to operation cycle mapping EventOperCycleMapDBCANFD04ErrorReceivedValue: diagnostic-event=EventDBCANFD04ErrorReceivedValue, operation-cycle=DefaultOperationCycle  # Event_Oper_Cycle_Map_DB_CANFD_04_Error_Received_Value
  diagnostic event to debounce algorithm mapping EventDebounceMapDBCANFD04ErrorReceivedValue: debounce-algorithm=counter_based, diagnostic-event=EventDBCANFD04ErrorReceivedValue  # EventDebounceMap_DB_CANFD_04_Error_Received_Value
package /ZeC/DTC/DTC/Power_Path_111_Short_to_GND_Failure
  diagnostic trouble code uds Power_Path_111_Short_to_GND_Failure: dtc-props=Dtc_Props_ab1a9d1d, uds-dtc-value=0x00526f
  diagnostic event EventPowerPath111ShortToGNDFailure: aging-allowed=true, event-kind=SWC, prestorage-freeze-frame=false  # Event_Power_Path_111_Short_to_GND_Failure
  diagnostic event to trouble code uds mapping EventDtcMapPowerPath111ShortToGNDFailure: diagnostic-event=EventPowerPath111ShortToGNDFailure, trouble-code-uds=Power_Path_111_Short_to_GND_Failure  # Event_Dtc_Map_Power_Path_111_Short_to_GND_Failure
  diagnostic event to operation cycle mapping EventOperCycleMapPowerPath111ShortToGNDFailure: diagnostic-event=EventPowerPath111ShortToGNDFailure, operation-cycle=DefaultOperationCycle  # Event_Oper_Cycle_Map_Power_Path_111_Short_to_GND_Failure
  diagnostic event to debounce algorithm mapping EventDebounceMapPowerPath111ShortToGNDFailure: debounce-algorithm=time_based, diagnostic-event=EventPowerPath111ShortToGNDFailure  # EventDebounceMap_Power_Path_111_Short_to_GND_Failure
package /ZeC/DTC/DTC/DB_CANFD_04_Defect
  diagnostic trouble code uds DB_CANFD_04_Defect: dtc-props=Dtc_Props_14158306, uds-dtc-value=0x032401
  diagnostic event EventDBCANFD04Defect: aging-allowed=true, event-kind=SWC, prestorage-freeze-frame=false  # Event_DB_CANFD_04_Defect
  diagnostic event to trouble code uds mapping EventDtcMapDBCANFD04Defect: diagnostic-event=EventDBCANFD04Defect, trouble-code-uds=DB_CANFD_04_Defect  # Event_Dtc_Map_DB_CANFD_04_Defect
  diagnostic event to operation cycle mapping EventOperCycleMapDBCANFD04Defect: diagnostic-event=EventDBCANFD04Defect, operation-cycle=DefaultOperationCycle  # Event_Oper_Cycle_Map_DB_CANFD_04_Defect
  diagnostic event to debounce algorithm mapping EventDebounceMapDBCANFD04Defect: debounce-algorithm=counter_based, diagnostic-event=EventDBCANFD04Defect  # EventDebounceMap_DB_CANFD_04_Defect
package /ZeC/DTC/DTC/LIN_2_Local_Databus_Electrical_Failure
  diagnostic trouble code uds LIN_2_Local_Databus_Electrical_Failure: dtc-props=Dtc_Props_358996c7, uds-dtc-value=0x030221  # LIN 2 Local_Databus_Electrical_Failure
  diagnostic event EventLIN2LocalDatabusElectricalFailure: aging-allowed=true, event-kind=SWC, prestorage-freeze-frame=false  # Event_LIN 2 Local_Databus_Electrical_Failure
  diagnostic event to trouble code uds mapping EventDtcMapLIN2LocalDatabusElectricalFailure: diagnostic-event=EventLIN2LocalDatabusElectricalFailure, trouble-code-uds=LIN_2_Local_Databus_Electrical_Failure  # Event_Dtc_Map_LIN 2 Local_Databus_Electrical_Failure
  diagnostic event to operation cycle mapping EventOperCycleMapLIN2LocalDatabusElectricalFailure: diagnostic-event=EventLIN2LocalDatabusElectricalFailure, operation-cycle=DefaultOperationCycle  # Event_Oper_Cycle_Map_LIN 2 Local_Databus_Electrical_Failure
  diagnostic event to debounce algorithm mapping EventDebounceMapLIN2LocalDatabusElectricalFailure: debounce-algorithm=counter_based, diagnostic-event=EventLIN2LocalDatabusElectricalFailure  # EventDebounceMap_LIN 2 Local_Databus_Electrical_Failure
package /ZeC/DTC/DTC/Power_Path_110_Short_to_GND_Failure
  diagnostic trouble code uds Power_Path_110_Short_to_GND_Failure: dtc-props=Dtc_Props_61318353, uds-dtc-value=0x00526e
  diagnostic event EventPowerPath110ShortToGNDFailure: aging-allowed=true, event-kind=SWC, prestorage-freeze-frame=false  # Event_Power_Path_110_Short_to_GND_Failure
  diagnostic event to trouble code uds mapping EventDtcMapPowerPath110ShortToGNDFailure: diagnostic-event=EventPowerPath110ShortToGNDFailure, trouble-code-uds=Power_Path_110_Short_to_GND_Failure  # Event_Dtc_Map_Power_Path_110_Short_to_GND_Failure
  diagnostic event to operation cycle mapping EventOperCycleMapPowerPath110ShortToGNDFailure: diagnostic-event=EventPowerPath110ShortToGNDFailure, operation-cycle=DefaultOperationCycle  # Event_Oper_Cycle_Map_Power_Path_110_Short_to_GND_Failure
  diagnostic event to debounce algorithm mapping EventDebounceMapPowerPath110ShortToGNDFailure: debounce-algorithm=time_based, diagnostic-event=EventPowerPath110ShortToGNDFailure  # EventDebounceMap_Power_Path_110_Short_to_GND_Failure
package /ZeC/DTC/DTC/DB_CANFD_04_No_Communication
  diagnostic trouble code uds DB_CANFD_04_No_Communication: dtc-props=Dtc_Props_14158306, uds-dtc-value=0x032402
  diagnostic event EventDBCANFD04NoCommunication: aging-allowed=true, event-kind=SWC, prestorage-freeze-frame=false  # Event_DB_CANFD_04_No_Communication
  diagnostic event to trouble code uds mapping EventDtcMapDBCANFD04NoCommunication: diagnostic-event=EventDBCANFD04NoCommunication, trouble-code-uds=DB_CANFD_04_No_Communication  # Event_Dtc_Map_DB_CANFD_04_No_Communication
  diagnostic event to operation cycle mapping EventOperCycleMapDBCANFD04NoCommunication: diagnostic-event=EventDBCANFD04NoCommunication, operation-cycle=DefaultOperationCycle  # Event_Oper_Cycle_Map_DB_CANFD_04_No_Communication
  diagnostic event to debounce algorithm mapping EventDebounceMapDBCANFD04NoCommunication: debounce-algorithm=counter_based, diagnostic-event=EventDBCANFD04NoCommunication  # EventDebounceMap_DB_CANFD_04_No_Communication
package /ZeC/DTC/DTC/Power_Path_107_Short_to_GND_Failure
  diagnostic trouble code uds Power_Path_107_Short_to_GND_Failure: dtc-props=Dtc_Props_680fb3b4, uds-dtc-value=0x00526b
  diagnostic event EventPowerPath107ShortToGNDFailure: aging-allowed=true, event-kind=SWC, prestorage-freeze-frame=false  # Event_Power_Path_107_Short_to_GND_Failure
  diagnostic event to trouble code uds mapping EventDtcMapPowerPath107ShortToGNDFailure: diagnostic-event=EventPowerPath107ShortToGNDFailure, trouble-code-uds=Power_Path_107_Short_to_GND_Failure  # Event_Dtc_Map_Power_Path_107_Short_to_GND_Failure
  diagnostic event to operation cycle mapping EventOperCycleMapPowerPath107ShortToGNDFailure: diagnostic-event=EventPowerPath107ShortToGNDFailure, operation-cycle=DefaultOperationCycle  # Event_Oper_Cycle_Map_Power_Path_107_Short_to_GND_Failure
  diagnostic event to debounce algorithm mapping EventDebounceMapPowerPath107ShortToGNDFailure: debounce-algorithm=time_based, diagnostic-event=EventPowerPath107ShortToGNDFailure  # EventDebounceMap_Power_Path_107_Short_to_GND_Failure
package /ZeC/DTC/DTC/Power_Path_106_Short_to_GND_Failure
  diagnostic trouble code uds Power_Path_106_Short_to_GND_Failure: dtc-props=Dtc_Props_a224adfa, uds-dtc-value=0x00526a
  diagnostic event EventPowerPath106ShortToGNDFailure: aging-allowed=true, event-kind=SWC, prestorage-freeze-frame=false  # Event_Power_Path_106_Short_to_GND_Failure
  diagnostic event to trouble code uds mapping EventDtcMapPowerPath106ShortToGNDFailure: diagnostic-event=EventPowerPath106ShortToGNDFailure, trouble-code-uds=Power_Path_106_Short_to_GND_Failure  # Event_Dtc_Map_Power_Path_106_Short_to_GND_Failure
  diagnostic event to operation cycle mapping EventOperCycleMapPowerPath106ShortToGNDFailure: diagnostic-event=EventPowerPath106ShortToGNDFailure, operation-cycle=DefaultOperationCycle  # Event_Oper_Cycle_Map_Power_Path_106_Short_to_GND_Failure
  diagnostic event to debounce algorithm mapping EventDebounceMapPowerPath106ShortToGNDFailure: debounce-algorithm=time_based, diagnostic-event=EventPowerPath106ShortToGNDFailure  # EventDebounceMap_Power_Path_106_Short_to_GND_Failure
package /ZeC/DTC/DTC/LIN_2_Databus_No_Comm
  diagnostic trouble code uds LIN_2_Databus_No_Comm: dtc-props=Dtc_Props_358996c7, uds-dtc-value=0x030220  # LIN 2 Databus_No_Comm
  diagnostic event EventLIN2DatabusNoComm: aging-allowed=true, event-kind=SWC, prestorage-freeze-frame=false  # Event_LIN 2 Databus_No_Comm
  diagnostic event to trouble code uds mapping EventDtcMapLIN2DatabusNoComm: diagnostic-event=EventLIN2DatabusNoComm, trouble-code-uds=LIN_2_Databus_No_Comm  # Event_Dtc_Map_LIN 2 Databus_No_Comm
  diagnostic event to operation cycle mapping EventOperCycleMapLIN2DatabusNoComm: diagnostic-event=EventLIN2DatabusNoComm, operation-cycle=DefaultOperationCycle  # Event_Oper_Cycle_Map_LIN 2 Databus_No_Comm
  diagnostic event to debounce algorithm mapping EventDebounceMapLIN2DatabusNoComm: debounce-algorithm=counter_based, diagnostic-event=EventLIN2DatabusNoComm  # EventDebounceMap_LIN 2 Databus_No_Comm
package /ZeC/DTC/DTC/Power_Path_109_Short_to_GND_Failure
  diagnostic trouble code uds Power_Path_109_Short_to_GND_Failure: dtc-props=Dtc_Props_27288969, uds-dtc-value=0x00526d
  diagnostic event EventPowerPath109ShortToGNDFailure: aging-allowed=true, event-kind=SWC, prestorage-freeze-frame=false  # Event_Power_Path_109_Short_to_GND_Failure
  diagnostic event to trouble code uds mapping EventDtcMapPowerPath109ShortToGNDFailure: diagnostic-event=EventPowerPath109ShortToGNDFailure, trouble-code-uds=Power_Path_109_Short_to_GND_Failure  # Event_Dtc_Map_Power_Path_109_Short_to_GND_Failure
  diagnostic event to operation cycle mapping EventOperCycleMapPowerPath109ShortToGNDFailure: diagnostic-event=EventPowerPath109ShortToGNDFailure, operation-cycle=DefaultOperationCycle  # Event_Oper_Cycle_Map_Power_Path_109_Short_to_GND_Failure
  diagnostic event to debounce algorithm mapping EventDebounceMapPowerPath109ShortToGNDFailure: debounce-algorithm=time_based, diagnostic-event=EventPowerPath109ShortToGNDFailure  # EventDebounceMap_Power_Path_109_Short_to_GND_Failure
package /ZeC/DTC/DTC/Power_Path_108_Short_to_GND_Failure
  diagnostic trouble code uds Power_Path_108_Short_to_GND_Failure: dtc-props=Dtc_Props_2e16b98e, uds-dtc-value=0x00526c
  diagnostic event EventPowerPath108ShortToGNDFailure: aging-allowed=true, event-kind=SWC, prestorage-freeze-frame=false  # Event_Power_Path_108_Short_to_GND_Failure
  diagnostic event to trouble code uds mapping EventDtcMapPowerPath108ShortToGNDFailure: diagnostic-event=EventPowerPath108ShortToGNDFailure, trouble-code-uds=Power_Path_108_Short_to_GND_Failure  # Event_Dtc_Map_Power_Path_108_Short_to_GND_Failure
  diagnostic event to operation cycle mapping EventOperCycleMapPowerPath108ShortToGNDFailure: diagnostic-event=EventPowerPath108ShortToGNDFailure, operation-cycle=DefaultOperationCycle  # Event_Oper_Cycle_Map_Power_Path_108_Short_to_GND_Failure
  diagnostic event to debounce algorithm mapping EventDebounceMapPowerPath108ShortToGNDFailure: debounce-algorithm=time_based, diagnostic-event=EventPowerPath108ShortToGNDFailure  # EventDebounceMap_Power_Path_108_Short_to_GND_Failure
package /ZeC/DTC/DTC/Power_Path_113_Short_to_GND_Failure
  diagnostic trouble code uds Power_Path_113_Short_to_GND_Failure: dtc-props=Dtc_Props_5991093f, uds-dtc-value=0x005271
  diagnostic event EventPowerPath113ShortToGNDFailure: aging-allowed=true, event-kind=SWC, prestorage-freeze-frame=false  # Event_Power_Path_113_Short_to_GND_Failure
  diagnostic event to trouble code uds mapping EventDtcMapPowerPath113ShortToGNDFailure: diagnostic-event=EventPowerPath113ShortToGNDFailure, trouble-code-uds=Power_Path_113_Short_to_GND_Failure  # Event_Dtc_Map_Power_Path_113_Short_to_GND_Failure
  diagnostic event to operation cycle mapping EventOperCycleMapPowerPath113ShortToGNDFailure: diagnostic-event=EventPowerPath113ShortToGNDFailure, operation-cycle=DefaultOperationCycle  # Event_Oper_Cycle_Map_Power_Path_113_Short_to_GND_Failure
  diagnostic event to debounce algorithm mapping EventDebounceMapPowerPath113ShortToGNDFailure: debounce-algorithm=time_based, diagnostic-event=EventPowerPath113ShortToGNDFailure  # EventDebounceMap_Power_Path_113_Short_to_GND_Failure
package /ZeC/DTC/DTC/Power_Path_112_Short_to_GND_Failure
  diagnostic trouble code uds Power_Path_112_Short_to_GND_Failure: dtc-props=Dtc_Props_1f880305, uds-dtc-value=0x005270
  diagnostic event EventPowerPath112ShortToGNDFailure: aging-allowed=true, event-kind=SWC, prestorage-freeze-frame=false  # Event_Power_Path_112_Short_to_GND_Failure
  diagnostic event to trouble code uds mapping EventDtcMapPowerPath112ShortToGNDFailure: diagnostic-event=EventPowerPath112ShortToGNDFailure, trouble-code-uds=Power_Path_112_Short_to_GND_Failure  # Event_Dtc_Map_Power_Path_112_Short_to_GND_Failure
  diagnostic event to operation cycle mapping EventOperCycleMapPowerPath112ShortToGNDFailure: diagnostic-event=EventPowerPath112ShortToGNDFailure, operation-cycle=DefaultOperationCycle  # Event_Oper_Cycle_Map_Power_Path_112_Short_to_GND_Failure
  diagnostic event to debounce algorithm mapping EventDebounceMapPowerPath112ShortToGNDFailure: debounce-algorithm=time_based, diagnostic-event=EventPowerPath112ShortToGNDFailure  # EventDebounceMap_Power_Path_112_Short_to_GND_Failure
package /ZeC/DTC/DTC/Power_Path_119_Short_to_GND_Failure
  diagnostic trouble code uds Power_Path_119_Short_to_GND_Failure: dtc-props=Dtc_Props_16b633e2, uds-dtc-value=0x005277
  diagnostic event EventPowerPath119ShortToGNDFailure: aging-allowed=true, event-kind=SWC, prestorage-freeze-frame=false  # Event_Power_Path_119_Short_to_GND_Failure
  diagnostic event to trouble code uds mapping EventDtcMapPowerPath119ShortToGNDFailure: diagnostic-event=EventPowerPath119ShortToGNDFailure, trouble-code-uds=Power_Path_119_Short_to_GND_Failure  # Event_Dtc_Map_Power_Path_119_Short_to_GND_Failure
  diagnostic event to operation cycle mapping EventOperCycleMapPowerPath119ShortToGNDFailure: diagnostic-event=EventPowerPath119ShortToGNDFailure, operation-cycle=DefaultOperationCycle  # Event_Oper_Cycle_Map_Power_Path_119_Short_to_GND_Failure
  diagnostic event to debounce algorithm mapping EventDebounceMapPowerPath119ShortToGNDFailure: debounce-algorithm=time_based, diagnostic-event=EventPowerPath119ShortToGNDFailure  # EventDebounceMap_Power_Path_119_Short_to_GND_Failure
package /ZeC/DTC/DTC/Power_Path_118_Short_to_GND_Failure
  diagnostic trouble code uds Power_Path_118_Short_to_GND_Failure: dtc-props=Dtc_Props_50af39d8, uds-dtc-value=0x005276
  diagnostic event EventPowerPath118ShortToGNDFailure: aging-allowed=true, event-kind=SWC, prestorage-freeze-frame=false  # Event_Power_Path_118_Short_to_GND_Failure
  diagnostic event to trouble code uds mapping EventDtcMapPowerPath118ShortToGNDFailure: diagnostic-event=EventPowerPath118ShortToGNDFailure, trouble-code-uds=Power_Path_118_Short_to_GND_Failure  # Event_Dtc_Map_Power_Path_118_Short_to_GND_Failure
  diagnostic event to operation cycle mapping EventOperCycleMapPowerPath118ShortToGNDFailure: diagnostic-event=EventPowerPath118ShortToGNDFailure, operation-cycle=DefaultOperationCycle  # Event_Oper_Cycle_Map_Power_Path_118_Short_to_GND_Failure
  diagnostic event to debounce algorithm mapping EventDebounceMapPowerPath118ShortToGNDFailure: debounce-algorithm=time_based, diagnostic-event=EventPowerPath118ShortToGNDFailure  # EventDebounceMap_Power_Path_118_Short_to_GND_Failure
package /ZeC/DTC/DTC/Power_Path_121_Short_to_GND_Failure
  diagnostic trouble code uds Power_Path_121_Short_to_GND_Failure: dtc-props=Dtc_Props_4ca522c, uds-dtc-value=0x005279
  diagnostic event EventPowerPath121ShortToGNDFailure: aging-allowed=true, event-kind=SWC, prestorage-freeze-frame=false  # Event_Power_Path_121_Short_to_GND_Failure
  diagnostic event to trouble code uds mapping EventDtcMapPowerPath121ShortToGNDFailure: diagnostic-event=EventPowerPath121ShortToGNDFailure, trouble-code-uds=Power_Path_121_Short_to_GND_Failure  # Event_Dtc_Map_Power_Path_121_Short_to_GND_Failure
  diagnostic event to operation cycle mapping EventOperCycleMapPowerPath121ShortToGNDFailure: diagnostic-event=EventPowerPath121ShortToGNDFailure, operation-cycle=DefaultOperationCycle  # Event_Oper_Cycle_Map_Power_Path_121_Short_to_GND_Failure
  diagnostic event to debounce algorithm mapping EventDebounceMapPowerPath121ShortToGNDFailure: debounce-algorithm=time_based, diagnostic-event=EventPowerPath121ShortToGNDFailure  # EventDebounceMap_Power_Path_121_Short_to_GND_Failure
package /ZeC/DTC/DTC/Power_Path_120_Short_to_GND_Failure
  diagnostic trouble code uds Power_Path_120_Short_to_GND_Failure: dtc-props=Dtc_Props_42d35816, uds-dtc-value=0x005278
  diagnostic event EventPowerPath120ShortToGNDFailure: aging-allowed=true, event-kind=SWC, prestorage-freeze-frame=false  # Event_Power_Path_120_Short_to_GND_Failure
  diagnostic event to trouble code uds mapping EventDtcMapPowerPath120ShortToGNDFailure: diagnostic-event=EventPowerPath120ShortToGNDFailure, trouble-code-uds=Power_Path_120_Short_to_GND_Failure  # Event_Dtc_Map_Power_Path_120_Short_to_GND_Failure
  diagnostic event to operation cycle mapping EventOperCycleMapPowerPath120ShortToGNDFailure: diagnostic-event=EventPowerPath120ShortToGNDFailure, operation-cycle=DefaultOperationCycle  # Event_Oper_Cycle_Map_Power_Path_120_Short_to_GND_Failure
  diagnostic event to debounce algorithm mapping EventDebounceMapPowerPath120ShortToGNDFailure: debounce-algorithm=time_based, diagnostic-event=EventPowerPath120ShortToGNDFailure  # EventDebounceMap_Power_Path_120_Short_to_GND_Failure
package /ZeC/DTC/DTC/Power_Path_115_Short_to_GND_Failure
  diagnostic trouble code uds Power_Path_115_Short_to_GND_Failure: dtc-props=Dtc_Props_d5a31d4b, uds-dtc-value=0x005273
  diagnostic event EventPowerPath115ShortToGNDFailure: aging-allowed=true, event-kind=SWC, prestorage-freeze-frame=false  # Event_Power_Path_115_Short_to_GND_Failure
  diagnostic event to trouble code uds mapping EventDtcMapPowerPath115ShortToGNDFailure: diagnostic-event=EventPowerPath115ShortToGNDFailure, trouble-code-uds=Power_Path_115_Short_to_GND_Failure  # Event_Dtc_Map_Power_Path_115_Short_to_GND_Failure
  diagnostic event to operation cycle mapping EventOperCycleMapPowerPath115ShortToGNDFailure: diagnostic-event=EventPowerPath115ShortToGNDFailure, operation-cycle=DefaultOperationCycle  # Event_Oper_Cycle_Map_Power_Path_115_Short_to_GND_Failure
  diagnostic event to debounce algorithm mapping EventDebounceMapPowerPath115ShortToGNDFailure: debounce-algorithm=time_based, diagnostic-event=EventPowerPath115ShortToGNDFailure  # EventDebounceMap_Power_Path_115_Short_to_GND_Failure
package /ZeC/DTC/DTC/Power_Path_114_Short_to_GND_Failure
  diagnostic trouble code uds Power_Path_114_Short_to_GND_Failure: dtc-props=Dtc_Props_93ba1771, uds-dtc-value=0x005272
  diagnostic event EventPowerPath114ShortToGNDFailure: aging-allowed=true, event-kind=SWC, prestorage-freeze-frame=false  # Event_Power_Path_114_Short_to_GND_Failure
  diagnostic event to trouble code uds mapping EventDtcMapPowerPath114ShortToGNDFailure: diagnostic-event=EventPowerPath114ShortToGNDFailure, trouble-code-uds=Power_Path_114_Short_to_GND_Failure  # Event_Dtc_Map_Power_Path_114_Short_to_GND_Failure
  diagnostic event to operation cycle mapping EventOperCycleMapPowerPath114ShortToGNDFailure: diagnostic-event=EventPowerPath114ShortToGNDFailure, operation-cycle=DefaultOperationCycle  # Event_Oper_Cycle_Map_Power_Path_114_Short_to_GND_Failure
  diagnostic event to debounce algorithm mapping EventDebounceMapPowerPath114ShortToGNDFailure: debounce-algorithm=time_based, diagnostic-event=EventPowerPath114ShortToGNDFailure  # EventDebounceMap_Power_Path_114_Short_to_GND_Failure
package /ZeC/DTC/DTC/Power_Path_117_Short_to_GND_Failure
  diagnostic trouble code uds Power_Path_117_Short_to_GND_Failure: dtc-props=Dtc_Props_9a842796, uds-dtc-value=0x005275
  diagnostic event EventPowerPath117ShortToGNDFailure: aging-allowed=true, event-kind=SWC, prestorage-freeze-frame=false  # Event_Power_Path_117_Short_to_GND_Failure
  diagnostic event to trouble code uds mapping EventDtcMapPowerPath117ShortToGNDFailure: diagnostic-event=EventPowerPath117ShortToGNDFailure, trouble-code-uds=Power_Path_117_Short_to_GND_Failure  # Event_Dtc_Map_Power_Path_117_Short_to_GND_Failure
  diagnostic event to operation cycle mapping EventOperCycleMapPowerPath117ShortToGNDFailure: diagnostic-event=EventPowerPath117ShortToGNDFailure, operation-cycle=DefaultOperationCycle  # Event_Oper_Cycle_Map_Power_Path_117_Short_to_GND_Failure
  diagnostic event to debounce algorithm mapping EventDebounceMapPowerPath117ShortToGNDFailure: debounce-algorithm=time_based, diagnostic-event=EventPowerPath117ShortToGNDFailure  # EventDebounceMap_Power_Path_117_Short_to_GND_Failure
package /ZeC/DTC/DTC/Power_Path_116_Short_to_GND_Failure
  diagnostic trouble code uds Power_Path_116_Short_to_GND_Failure: dtc-props=Dtc_Props_dc9d2dac, uds-dtc-value=0x005274
  diagnostic event EventPowerPath116ShortToGNDFailure: aging-allowed=true, event-kind=SWC, prestorage-freeze-frame=false  # Event_Power_Path_116_Short_to_GND_Failure
  diagnostic event to trouble code uds mapping EventDtcMapPowerPath116ShortToGNDFailure: diagnostic-event=EventPowerPath116ShortToGNDFailure, trouble-code-uds=Power_Path_116_Short_to_GND_Failure  # Event_Dtc_Map_Power_Path_116_Short_to_GND_Failure
  diagnostic event to operation cycle mapping EventOperCycleMapPowerPath116ShortToGNDFailure: diagnostic-event=EventPowerPath116ShortToGNDFailure, operation-cycle=DefaultOperationCycle  # Event_Oper_Cycle_Map_Power_Path_116_Short_to_GND_Failure
  diagnostic event to debounce algorithm mapping EventDebounceMapPowerPath116ShortToGNDFailure: debounce-algorithm=time_based, diagnostic-event=EventPowerPath116ShortToGNDFailure  # EventDebounceMap_Power_Path_116_Short_to_GND_Failure
package /ZeC/DTC/DTC/Power_Path_089_Short_to_GND_Failure
  diagnostic trouble code uds Power_Path_089_Short_to_GND_Failure: dtc-props=Dtc_Props_532ed51d, uds-dtc-value=0x005259
  diagnostic event EventPowerPath089ShortToGNDFailure: aging-allowed=true, event-kind=SWC, prestorage-freeze-frame=false  # Event_Power_Path_089_Short_to_GND_Failure
  diagnostic event to trouble code uds mapping EventDtcMapPowerPath089ShortToGNDFailure: diagnostic-event=EventPowerPath089ShortToGNDFailure, trouble-code-uds=Power_Path_089_Short_to_GND_Failure  # Event_Dtc_Map_Power_Path_089_Short_to_GND_Failure
  diagnostic event to operation cycle mapping EventOperCycleMapPowerPath089ShortToGNDFailure: diagnostic-event=EventPowerPath089ShortToGNDFailure, operation-cycle=DefaultOperationCycle  # Event_Oper_Cycle_Map_Power_Path_089_Short_to_GND_Failure
  diagnostic event to debounce algorithm mapping EventDebounceMapPowerPath089ShortToGNDFailure: debounce-algorithm=time_based, diagnostic-event=EventPowerPath089ShortToGNDFailure  # EventDebounceMap_Power_Path_089_Short_to_GND_Failure
package /ZeC/DTC/DTC/Power_Path_088_Short_to_GND_Failure
  diagnostic trouble code uds Power_Path_088_Short_to_GND_Failure: dtc-props=Dtc_Props_1537df27, uds-dtc-value=0x005258
  diagnostic event EventPowerPath088ShortToGNDFailure: aging-allowed=true, event-kind=SWC, prestorage-freeze-frame=false  # Event_Power_Path_088_Short_to_GND_Failure
  diagnostic event to trouble code uds mapping EventDtcMapPowerPath088ShortToGNDFailure: diagnostic-event=EventPowerPath088ShortToGNDFailure, trouble-code-uds=Power_Path_088_Short_to_GND_Failure  # Event_Dtc_Map_Power_Path_088_Short_to_GND_Failure
  diagnostic event to operation cycle mapping EventOperCycleMapPowerPath088ShortToGNDFailure: diagnostic-event=EventPowerPath088ShortToGNDFailure, operation-cycle=DefaultOperationCycle  # Event_Oper_Cycle_Map_Power_Path_088_Short_to_GND_Failure
  diagnostic event to debounce algorithm mapping EventDebounceMapPowerPath088ShortToGNDFailure: debounce-algorithm=time_based, diagnostic-event=EventPowerPath088ShortToGNDFailure  # EventDebounceMap_Power_Path_088_Short_to_GND_Failure
package /ZeC/DTC/DTC/Power_Path_094_Short_to_GND_Failure
  diagnostic trouble code uds Power_Path_094_Short_to_GND_Failure: dtc-props=Dtc_Props_f09fc4da, uds-dtc-value=0x00525e
  diagnostic event EventPowerPath094ShortToGNDFailure: aging-allowed=true, event-kind=SWC, prestorage-freeze-frame=false  # Event_Power_Path_094_Short_to_GND_Failure
  diagnostic event to trouble code uds mapping EventDtcMapPowerPath094ShortToGNDFailure: diagnostic-event=EventPowerPath094ShortToGNDFailure, trouble-code-uds=Power_Path_094_Short_to_GND_Failure  # Event_Dtc_Map_Power_Path_094_Short_to_GND_Failure
  diagnostic event to operation cycle mapping EventOperCycleMapPowerPath094ShortToGNDFailure: diagnostic-event=EventPowerPath094ShortToGNDFailure, operation-cycle=DefaultOperationCycle  # Event_Oper_Cycle_Map_Power_Path_094_Short_to_GND_Failure
  diagnostic event to debounce algorithm mapping EventDebounceMapPowerPath094ShortToGNDFailure: debounce-algorithm=time_based, diagnostic-event=EventPowerPath094ShortToGNDFailure  # EventDebounceMap_Power_Path_094_Short_to_GND_Failure
package /ZeC/DTC/DTC/Power_Path_093_Short_to_GND_Failure
  diagnostic trouble code uds Power_Path_093_Short_to_GND_Failure: dtc-props=Dtc_Props_b686cee0, uds-dtc-value=0x00525d
  diagnostic event EventPowerPath093ShortToGNDFailure: aging-allowed=true, event-kind=SWC, prestorage-freeze-frame=false  # Event_Power_Path_093_Short_to_GND_Failure
  diagnostic event to trouble code uds mapping EventDtcMapPowerPath093ShortToGNDFailure: diagnostic-event=EventPowerPath093ShortToGNDFailure, trouble-code-uds=Power_Path_093_Short_to_GND_Failure  # Event_Dtc_Map_Power_Path_093_Short_to_GND_Failure
  diagnostic event to operation cycle mapping EventOperCycleMapPowerPath093ShortToGNDFailure: diagnostic-event=EventPowerPath093ShortToGNDFailure, operation-cycle=DefaultOperationCycle  # Event_Oper_Cycle_Map_Power_Path_093_Short_to_GND_Failure
  diagnostic event to debounce algorithm mapping EventDebounceMapPowerPath093ShortToGNDFailure: debounce-algorithm=time_based, diagnostic-event=EventPowerPath093ShortToGNDFailure  # EventDebounceMap_Power_Path_093_Short_to_GND_Failure
package /ZeC/DTC/DTC/CAN_04_ECU_6_No_Communication
  diagnostic trouble code uds CAN_04_ECU_6_No_Communication: dtc-props=Dtc_Props_14158306, uds-dtc-value=0x032410
  diagnostic event EventCAN04ECU6NoCommunication: aging-allowed=true, event-kind=SWC, prestorage-freeze-frame=false  # Event_CAN_04_ECU_6_No_Communication
  diagnostic event to trouble code uds mapping EventDtcMapCAN04ECU6NoCommunication: diagnostic-event=EventCAN04ECU6NoCommunication, trouble-code-uds=CAN_04_ECU_6_No_Communication  # Event_Dtc_Map_CAN_04_ECU_6_No_Communication
  diagnostic event to operation cycle mapping EventOperCycleMapCAN04ECU6NoCommunication: diagnostic-event=EventCAN04ECU6NoCommunication, operation-cycle=DefaultOperationCycle  # Event_Oper_Cycle_Map_CAN_04_ECU_6_No_Communication
  diagnostic event to debounce algorithm mapping EventDebounceMapCAN04ECU6NoCommunication: debounce-algorithm=counter_based, diagnostic-event=EventCAN04ECU6NoCommunication  # EventDebounceMap_CAN_04_ECU_6_No_Communication
package /ZeC/DTC/DTC/Power_Path_095_Short_to_GND_Failure
  diagnostic trouble code uds Power_Path_095_Short_to_GND_Failure: dtc-props=Dtc_Props_3ab4da94, uds-dtc-value=0x00525f
  diagnostic event EventPowerPath095ShortToGNDFailure: aging-allowed=true, event-kind=SWC, prestorage-freeze-frame=false  # Event_Power_Path_095_Short_to_GND_Failure
  diagnostic event to trouble code uds mapping EventDtcMapPowerPath095ShortToGNDFailure: diagnostic-event=EventPowerPath095ShortToGNDFailure, trouble-code-uds=Power_Path_095_Short_to_GND_Failure  # Event_Dtc_Map_Power_Path_095_Short_to_GND_Failure
  diagnostic event to operation cycle mapping EventOperCycleMapPowerPath095ShortToGNDFailure: diagnostic-event=EventPowerPath095ShortToGNDFailure, operation-cycle=DefaultOperationCycle  # Event_Oper_Cycle_Map_Power_Path_095_Short_to_GND_Failure
  diagnostic event to debounce algorithm mapping EventDebounceMapPowerPath095ShortToGNDFailure: debounce-algorithm=time_based, diagnostic-event=EventPowerPath095ShortToGNDFailure  # EventDebounceMap_Power_Path_095_Short_to_GND_Failure
package /ZeC/DTC/DTC/Power_Path_090_Short_to_GND_Failure
  diagnostic trouble code uds Power_Path_090_Short_to_GND_Failure: dtc-props=Dtc_Props_338aea73, uds-dtc-value=0x00525a
  diagnostic event EventPowerPath090ShortToGNDFailure: aging-allowed=true, event-kind=SWC, prestorage-freeze-frame=false  # Event_Power_Path_090_Short_to_GND_Failure
  diagnostic event to trouble code uds mapping EventDtcMapPowerPath090ShortToGNDFailure: diagnostic-event=EventPowerPath090ShortToGNDFailure, trouble-code-uds=Power_Path_090_Short_to_GND_Failure  # Event_Dtc_Map_Power_Path_090_Short_to_GND_Failure
  diagnostic event to operation cycle mapping EventOperCycleMapPowerPath090ShortToGNDFailure: diagnostic-event=EventPowerPath090ShortToGNDFailure, operation-cycle=DefaultOperationCycle  # Event_Oper_Cycle_Map_Power_Path_090_Short_to_GND_Failure
  diagnostic event to debounce algorithm mapping EventDebounceMapPowerPath090ShortToGNDFailure: debounce-algorithm=time_based, diagnostic-event=EventPowerPath090ShortToGNDFailure  # EventDebounceMap_Power_Path_090_Short_to_GND_Failure
package /ZeC/DTC/DTC/Power_Path_092_Short_to_GND_Failure
  diagnostic trouble code uds Power_Path_092_Short_to_GND_Failure: dtc-props=Dtc_Props_bfb8fe07, uds-dtc-value=0x00525c
  diagnostic event EventPowerPath092ShortToGNDFailure: aging-allowed=true, event-kind=SWC, prestorage-freeze-frame=false  # Event_Power_Path_092_Short_to_GND_Failure
  diagnostic event to trouble code uds mapping EventDtcMapPowerPath092ShortToGNDFailure: diagnostic-event=EventPowerPath092ShortToGNDFailure, trouble-code-uds=Power_Path_092_Short_to_GND_Failure  # Event_Dtc_Map_Power_Path_092_Short_to_GND_Failure
  diagnostic event to operation cycle mapping EventOperCycleMapPowerPath092ShortToGNDFailure: diagnostic-event=EventPowerPath092ShortToGNDFailure, operation-cycle=DefaultOperationCycle  # Event_Oper_Cycle_Map_Power_Path_092_Short_to_GND_Failure
  diagnostic event to debounce algorithm mapping EventDebounceMapPowerPath092ShortToGNDFailure: debounce-algorithm=time_based, diagnostic-event=EventPowerPath092ShortToGNDFailure  # EventDebounceMap_Power_Path_092_Short_to_GND_Failure
package /ZeC/DTC/DTC/Power_Path_091_Short_to_GND_Failure
  diagnostic trouble code uds Power_Path_091_Short_to_GND_Failure: dtc-props=Dtc_Props_f9a1f43d, uds-dtc-value=0x00525b
  diagnostic event EventPowerPath091ShortToGNDFailure: aging-allowed=true, event-kind=SWC, prestorage-freeze-frame=false  # Event_Power_Path_091_Short_to_GND_Failure
  diagnostic event to trouble code uds mapping EventDtcMapPowerPath091ShortToGNDFailure: diagnostic-event=EventPowerPath091ShortToGNDFailure, trouble-code-uds=Power_Path_091_Short_to_GND_Failure  # Event_Dtc_Map_Power_Path_091_Short_to_GND_Failure
  diagnostic event to operation cycle mapping EventOperCycleMapPowerPath091ShortToGNDFailure: diagnostic-event=EventPowerPath091ShortToGNDFailure, operation-cycle=DefaultOperationCycle  # Event_Oper_Cycle_Map_Power_Path_091_Short_to_GND_Failure
  diagnostic event to debounce algorithm mapping EventDebounceMapPowerPath091ShortToGNDFailure: debounce-algorithm=time_based, diagnostic-event=EventPowerPath091ShortToGNDFailure  # EventDebounceMap_Power_Path_091_Short_to_GND_Failure
package /ZeC/DTC/DTC/Power_Path_096_Short_to_GND_Failure
  diagnostic trouble code uds Power_Path_096_Short_to_GND_Failure: dtc-props=Dtc_Props_d9c2c3bd, uds-dtc-value=0x005260
  diagnostic event EventPowerPath096ShortToGNDFailure: aging-allowed=true, event-kind=SWC, prestorage-freeze-frame=false  # Event_Power_Path_096_Short_to_GND_Failure
  diagnostic event to trouble code uds mapping EventDtcMapPowerPath096ShortToGNDFailure: diagnostic-event=EventPowerPath096ShortToGNDFailure, trouble-code-uds=Power_Path_096_Short_to_GND_Failure  # Event_Dtc_Map_Power_Path_096_Short_to_GND_Failure
  diagnostic event to operation cycle mapping EventOperCycleMapPowerPath096ShortToGNDFailure: diagnostic-event=EventPowerPath096ShortToGNDFailure, operation-cycle=DefaultOperationCycle  # Event_Oper_Cycle_Map_Power_Path_096_Short_to_GND_Failure
  diagnostic event to debounce algorithm mapping EventDebounceMapPowerPath096ShortToGNDFailure: debounce-algorithm=time_based, diagnostic-event=EventPowerPath096ShortToGNDFailure  # EventDebounceMap_Power_Path_096_Short_to_GND_Failure
package /ZeC/DTC/DTC/Power_Path_102_Short_to_GND_Failure
  diagnostic trouble code uds Power_Path_102_Short_to_GND_Failure: dtc-props=Dtc_Props_96e5f960, uds-dtc-value=0x005266
  diagnostic event EventPowerPath102ShortToGNDFailure: aging-allowed=true, event-kind=SWC, prestorage-freeze-frame=false  # Event_Power_Path_102_Short_to_GND_Failure
  diagnostic event to trouble code uds mapping EventDtcMapPowerPath102ShortToGNDFailure: diagnostic-event=EventPowerPath102ShortToGNDFailure, trouble-code-uds=Power_Path_102_Short_to_GND_Failure  # Event_Dtc_Map_Power_Path_102_Short_to_GND_Failure
  diagnostic event to operation cycle mapping EventOperCycleMapPowerPath102ShortToGNDFailure: diagnostic-event=EventPowerPath102ShortToGNDFailure, operation-cycle=DefaultOperationCycle  # Event_Oper_Cycle_Map_Power_Path_102_Short_to_GND_Failure
  diagnostic event to debounce algorithm mapping EventDebounceMapPowerPath102ShortToGNDFailure: debounce-algorithm=time_based, diagnostic-event=EventPowerPath102ShortToGNDFailure  # EventDebounceMap_Power_Path_102_Short_to_GND_Failure
package /ZeC/DTC/DTC/Power_Path_101_Short_to_GND_Failure
  diagnostic trouble code uds Power_Path_101_Short_to_GND_Failure: dtc-props=Dtc_Props_5ccee72e, uds-dtc-value=0x005265
  diagnostic event EventPowerPath101ShortToGNDFailure: aging-allowed=true, event-kind=SWC, prestorage-freeze-frame=false  # Event_Power_Path_101_Short_to_GND_Failure
  diagnostic event to trouble code uds mapping EventDtcMapPowerPath101ShortToGNDFailure: diagnostic-event=EventPowerPath101ShortToGNDFailure, trouble-code-uds=Power_Path_101_Short_to_GND_Failure  # Event_Dtc_Map_Power_Path_101_Short_to_GND_Failure
  diagnostic event to operation cycle mapping EventOperCycleMapPowerPath101ShortToGNDFailure: diagnostic-event=EventPowerPath101ShortToGNDFailure, operation-cycle=DefaultOperationCycle  # Event_Oper_Cycle_Map_Power_Path_101_Short_to_GND_Failure
  diagnostic event to debounce algorithm mapping EventDebounceMapPowerPath101ShortToGNDFailure: debounce-algorithm=time_based, diagnostic-event=EventPowerPath101ShortToGNDFailure  # EventDebounceMap_Power_Path_101_Short_to_GND_Failure
package /ZeC/DTC/DTC/Power_Path_104_Short_to_GND_Failure
  diagnostic trouble code uds Power_Path_104_Short_to_GND_Failure: dtc-props=Dtc_Props_849998ae, uds-dtc-value=0x005268
  diagnostic event EventPowerPath104ShortToGNDFailure: aging-allowed=true, event-kind=SWC, prestorage-freeze-frame=false  # Event_Power_Path_104_Short_to_GND_Failure
  diagnostic event to trouble code uds mapping EventDtcMapPowerPath104ShortToGNDFailure: diagnostic-event=EventPowerPath104ShortToGNDFailure, trouble-code-uds=Power_Path_104_Short_to_GND_Failure  # Event_Dtc_Map_Power_Path_104_Short_to_GND_Failure
  diagnostic event to operation cycle mapping EventOperCycleMapPowerPath104ShortToGNDFailure: diagnostic-event=EventPowerPath104ShortToGNDFailure, operation-cycle=DefaultOperationCycle  # Event_Oper_Cycle_Map_Power_Path_104_Short_to_GND_Failure
  diagnostic event to debounce algorithm mapping EventDebounceMapPowerPath104ShortToGNDFailure: debounce-algorithm=time_based, diagnostic-event=EventPowerPath104ShortToGNDFailure  # EventDebounceMap_Power_Path_104_Short_to_GND_Failure
package /ZeC/DTC/DTC/Power_Path_103_Short_to_GND_Failure
  diagnostic trouble code uds Power_Path_103_Short_to_GND_Failure: dtc-props=Dtc_Props_d0fcf35a, uds-dtc-value=0x005267
  diagnostic event EventPowerPath103ShortToGNDFailure: aging-allowed=true, event-kind=SWC, prestorage-freeze-frame=false  # Event_Power_Path_103_Short_to_GND_Failure
  diagnostic event to trouble code uds mapping EventDtcMapPowerPath103ShortToGNDFailure: diagnostic-event=EventPowerPath103ShortToGNDFailure, trouble-code-uds=Power_Path_103_Short_to_GND_Failure  # Event_Dtc_Map_Power_Path_103_Short_to_GND_Failure
  diagnostic event to operation cycle mapping EventOperCycleMapPowerPath103ShortToGNDFailure: diagnostic-event=EventPowerPath103ShortToGNDFailure, operation-cycle=DefaultOperationCycle  # Event_Oper_Cycle_Map_Power_Path_103_Short_to_GND_Failure
  diagnostic event to debounce algorithm mapping EventDebounceMapPowerPath103ShortToGNDFailure: debounce-algorithm=time_based, diagnostic-event=EventPowerPath103ShortToGNDFailure  # EventDebounceMap_Power_Path_103_Short_to_GND_Failure
package /ZeC/DTC/DTC/Power_Path_098_Short_to_GND_Failure
  diagnostic trouble code uds Power_Path_098_Short_to_GND_Failure: dtc-props=Dtc_Props_55f0d7c9, uds-dtc-value=0x005262
  diagnostic event EventPowerPath098ShortToGNDFailure: aging-allowed=true, event-kind=SWC, prestorage-freeze-frame=false  # Event_Power_Path_098_Short_to_GND_Failure
  diagnostic event to trouble code uds mapping EventDtcMapPowerPath098ShortToGNDFailure: diagnostic-event=EventPowerPath098ShortToGNDFailure, trouble-code-uds=Power_Path_098_Short_to_GND_Failure  # Event_Dtc_Map_Power_Path_098_Short_to_GND_Failure
  diagnostic event to operation cycle mapping EventOperCycleMapPowerPath098ShortToGNDFailure: diagnostic-event=EventPowerPath098ShortToGNDFailure, operation-cycle=DefaultOperationCycle  # Event_Oper_Cycle_Map_Power_Path_098_Short_to_GND_Failure
  diagnostic event to debounce algorithm mapping EventDebounceMapPowerPath098ShortToGNDFailure: debounce-algorithm=time_based, diagnostic-event=EventPowerPath098ShortToGNDFailure  # EventDebounceMap_Power_Path_098_Short_to_GND_Failure
package /ZeC/DTC/DTC/Power_Path_097_Short_to_GND_Failure
  diagnostic trouble code uds Power_Path_097_Short_to_GND_Failure: dtc-props=Dtc_Props_9fdbc987, uds-dtc-value=0x005261
  diagnostic event EventPowerPath097ShortToGNDFailure: aging-allowed=true, event-kind=SWC, prestorage-freeze-frame=false  # Event_Power_Path_097_Short_to_GND_Failure
  diagnostic event to trouble code uds mapping EventDtcMapPowerPath097ShortToGNDFailure: diagnostic-event=EventPowerPath097ShortToGNDFailure, trouble-code-uds=Power_Path_097_Short_to_GND_Failure  # Event_Dtc_Map_Power_Path_097_Short_to_GND_Failure
  diagnostic event to operation cycle mapping EventOperCycleMapPowerPath097ShortToGNDFailure: diagnostic-event=EventPowerPath097ShortToGNDFailure, operation-cycle=DefaultOperationCycle  # Event_Oper_Cycle_Map_Power_Path_097_Short_to_GND_Failure
  diagnostic event to debounce algorithm mapping EventDebounceMapPowerPath097ShortToGNDFailure: debounce-algorithm=time_based, diagnostic-event=EventPowerPath097ShortToGNDFailure  # EventDebounceMap_Power_Path_097_Short_to_GND_Failure
package /ZeC/DTC/DTC/Power_Path_100_Short_to_GND_Failure
  diagnostic trouble code uds Power_Path_100_Short_to_GND_Failure: dtc-props=Dtc_Props_1ad7ed14, uds-dtc-value=0x005264
  diagnostic event EventPowerPath100ShortToGNDFailure: aging-allowed=true, event-kind=SWC, prestorage-freeze-frame=false  # Event_Power_Path_100_Short_to_GND_Failure
  diagnostic event to trouble code uds mapping EventDtcMapPowerPath100ShortToGNDFailure: diagnostic-event=EventPowerPath100ShortToGNDFailure, trouble-code-uds=Power_Path_100_Short_to_GND_Failure  # Event_Dtc_Map_Power_Path_100_Short_to_GND_Failure
  diagnostic event to operation cycle mapping EventOperCycleMapPowerPath100ShortToGNDFailure: diagnostic-event=EventPowerPath100ShortToGNDFailure, operation-cycle=DefaultOperationCycle  # Event_Oper_Cycle_Map_Power_Path_100_Short_to_GND_Failure
  diagnostic event to debounce algorithm mapping EventDebounceMapPowerPath100ShortToGNDFailure: debounce-algorithm=time_based, diagnostic-event=EventPowerPath100ShortToGNDFailure  # EventDebounceMap_Power_Path_100_Short_to_GND_Failure
package /ZeC/DTC/DTC/Power_Path_099_Short_to_GND_Failure
  diagnostic trouble code uds Power_Path_099_Short_to_GND_Failure: dtc-props=Dtc_Props_13e9ddf3, uds-dtc-value=0x005263
  diagnostic event EventPowerPath099ShortToGNDFailure: aging-allowed=true, event-kind=SWC, prestorage-freeze-frame=false  # Event_Power_Path_099_Short_to_GND_Failure
  diagnostic event to trouble code uds mapping EventDtcMapPowerPath099ShortToGNDFailure: diagnostic-event=EventPowerPath099ShortToGNDFailure, trouble-code-uds=Power_Path_099_Short_to_GND_Failure  # Event_Dtc_Map_Power_Path_099_Short_to_GND_Failure
  diagnostic event to operation cycle mapping EventOperCycleMapPowerPath099ShortToGNDFailure: diagnostic-event=EventPowerPath099ShortToGNDFailure, operation-cycle=DefaultOperationCycle  # Event_Oper_Cycle_Map_Power_Path_099_Short_to_GND_Failure
  diagnostic event to debounce algorithm mapping EventDebounceMapPowerPath099ShortToGNDFailure: debounce-algorithm=time_based, diagnostic-event=EventPowerPath099ShortToGNDFailure  # EventDebounceMap_Power_Path_099_Short_to_GND_Failure
package /ZeC/DTC/DTC/LIN_2_Slave_3_Defect
  diagnostic trouble code uds LIN_2_Slave_3_Defect: dtc-props=Dtc_Props_358996c7, uds-dtc-value=0x030208  # LIN 2 Slave 3_Defect
  diagnostic event EventLIN2Slave3Defect: aging-allowed=true, event-kind=SWC, prestorage-freeze-frame=false  # Event_LIN 2 Slave 3_Defect
  diagnostic event to trouble code uds mapping EventDtcMapLIN2Slave3Defect: diagnostic-event=EventLIN2Slave3Defect, trouble-code-uds=LIN_2_Slave_3_Defect  # Event_Dtc_Map_LIN 2 Slave 3_Defect
  diagnostic event to operation cycle mapping EventOperCycleMapLIN2Slave3Defect: diagnostic-event=EventLIN2Slave3Defect, operation-cycle=DefaultOperationCycle  # Event_Oper_Cycle_Map_LIN 2 Slave 3_Defect
  diagnostic event to debounce algorithm mapping EventDebounceMapLIN2Slave3Defect: debounce-algorithm=counter_based, diagnostic-event=EventLIN2Slave3Defect  # EventDebounceMap_LIN 2 Slave 3_Defect
package /ZeC/DTC/DTC/LIN_2_Slave_2_NoCommunication
  diagnostic trouble code uds LIN_2_Slave_2_NoCommunication: dtc-props=Dtc_Props_358996c7, uds-dtc-value=0x030207  # LIN 2 Slave 2_NoCommunication
  diagnostic event EventLIN2Slave2NoCommunication: aging-allowed=true, event-kind=SWC, prestorage-freeze-frame=false  # Event_LIN 2 Slave 2_NoCommunication
  diagnostic event to trouble code uds mapping EventDtcMapLIN2Slave2NoCommunication: diagnostic-event=EventLIN2Slave2NoCommunication, trouble-code-uds=LIN_2_Slave_2_NoCommunication  # Event_Dtc_Map_LIN 2 Slave 2_NoCommunication
  diagnostic event to operation cycle mapping EventOperCycleMapLIN2Slave2NoCommunication: diagnostic-event=EventLIN2Slave2NoCommunication, operation-cycle=DefaultOperationCycle  # Event_Oper_Cycle_Map_LIN 2 Slave 2_NoCommunication
  diagnostic event to debounce algorithm mapping EventDebounceMapLIN2Slave2NoCommunication: debounce-algorithm=counter_based, diagnostic-event=EventLIN2Slave2NoCommunication  # EventDebounceMap_LIN 2 Slave 2_NoCommunication
package /ZeC/DTC/DTC/Power_Path_139_Short_to_GND_Failure
  diagnostic trouble code uds Power_Path_139_Short_to_GND_Failure: dtc-props=Dtc_Props_14c12062, uds-dtc-value=0x00528b
  diagnostic event EventPowerPath139ShortToGNDFailure: aging-allowed=true, event-kind=SWC, prestorage-freeze-frame=false  # Event_Power_Path_139_Short_to_GND_Failure
  diagnostic event to trouble code uds mapping EventDtcMapPowerPath139ShortToGNDFailure: diagnostic-event=EventPowerPath139ShortToGNDFailure, trouble-code-uds=Power_Path_139_Short_to_GND_Failure  # Event_Dtc_Map_Power_Path_139_Short_to_GND_Failure
  diagnostic event to operation cycle mapping EventOperCycleMapPowerPath139ShortToGNDFailure: diagnostic-event=EventPowerPath139ShortToGNDFailure, operation-cycle=DefaultOperationCycle  # Event_Oper_Cycle_Map_Power_Path_139_Short_to_GND_Failure
  diagnostic event to debounce algorithm mapping EventDebounceMapPowerPath139ShortToGNDFailure: debounce-algorithm=time_based, diagnostic-event=EventPowerPath139ShortToGNDFailure  # EventDebounceMap_Power_Path_139_Short_to_GND_Failure
package /ZeC/DTC/DTC/LIN_2_Slave_3_NoCommunication
  diagnostic trouble code uds LIN_2_Slave_3_NoCommunication: dtc-props=Dtc_Props_358996c7, uds-dtc-value=0x030209  # LIN 2 Slave 3_NoCommunication
  diagnostic event EventLIN2Slave3NoCommunication: aging-allowed=true, event-kind=SWC, prestorage-freeze-frame=false  # Event_LIN 2 Slave 3_NoCommunication
  diagnostic event to trouble code uds mapping EventDtcMapLIN2Slave3NoCommunication: diagnostic-event=EventLIN2Slave3NoCommunication, trouble-code-uds=LIN_2_Slave_3_NoCommunication  # Event_Dtc_Map_LIN 2 Slave 3_NoCommunication
  diagnostic event to operation cycle mapping EventOperCycleMapLIN2Slave3NoCommunication: diagnostic-event=EventLIN2Slave3NoCommunication, operation-cycle=DefaultOperationCycle  # Event_Oper_Cycle_Map_LIN 2 Slave 3_NoCommunication
  diagnostic event to debounce algorithm mapping EventDebounceMapLIN2Slave3NoCommunication: debounce-algorithm=counter_based, diagnostic-event=EventLIN2Slave3NoCommunication  # EventDebounceMap_LIN 2 Slave 3_NoCommunication
package /ZeC/DTC/DTC/Power_Path_138_Short_to_GND_Failure
  diagnostic trouble code uds Power_Path_138_Short_to_GND_Failure: dtc-props=Dtc_Props_deea3e2c, uds-dtc-value=0x00528a
  diagnostic event EventPowerPath138ShortToGNDFailure: aging-allowed=true, event-kind=SWC, prestorage-freeze-frame=false  # Event_Power_Path_138_Short_to_GND_Failure
  diagnostic event to trouble code uds mapping EventDtcMapPowerPath138ShortToGNDFailure: diagnostic-event=EventPowerPath138ShortToGNDFailure, trouble-code-uds=Power_Path_138_Short_to_GND_Failure  # Event_Dtc_Map_Power_Path_138_Short_to_GND_Failure
  diagnostic event to operation cycle mapping EventOperCycleMapPowerPath138ShortToGNDFailure: diagnostic-event=EventPowerPath138ShortToGNDFailure, operation-cycle=DefaultOperationCycle  # Event_Oper_Cycle_Map_Power_Path_138_Short_to_GND_Failure
  diagnostic event to debounce algorithm mapping EventDebounceMapPowerPath138ShortToGNDFailure: debounce-algorithm=time_based, diagnostic-event=EventPowerPath138ShortToGNDFailure  # EventDebounceMap_Power_Path_138_Short_to_GND_Failure
package /ZeC/DTC/DTC/LIN_12_Slave_6_NoCommunication
  diagnostic trouble code uds LIN_12_Slave_6_NoCommunication: dtc-props=Dtc_Props_358996c7, uds-dtc-value=0x030c1e  # LIN 12 Slave 6_NoCommunication
  diagnostic event EventLIN12Slave6NoCommunication: aging-allowed=true, event-kind=SWC, prestorage-freeze-frame=false  # Event_LIN 12 Slave 6_NoCommunication
  diagnostic event to trouble code uds mapping EventDtcMapLIN12Slave6NoCommunication: diagnostic-event=EventLIN12Slave6NoCommunication, trouble-code-uds=LIN_12_Slave_6_NoCommunication  # Event_Dtc_Map_LIN 12 Slave 6_NoCommunication
  diagnostic event to operation cycle mapping EventOperCycleMapLIN12Slave6NoCommunication: diagnostic-event=EventLIN12Slave6NoCommunication, operation-cycle=DefaultOperationCycle  # Event_Oper_Cycle_Map_LIN 12 Slave 6_NoCommunication
  diagnostic event to debounce algorithm mapping EventDebounceMapLIN12Slave6NoCommunication: debounce-algorithm=counter_based, diagnostic-event=EventLIN12Slave6NoCommunication  # EventDebounceMap_LIN 12 Slave 6_NoCommunication
package /ZeC/DTC/DTC/LIN_2_Slave_15_Defect
  diagnostic trouble code uds LIN_2_Slave_15_Defect: dtc-props=Dtc_Props_358996c7, uds-dtc-value=0x030204  # LIN 2 Slave 15_Defect
  diagnostic event EventLIN2Slave15Defect: aging-allowed=true, event-kind=SWC, prestorage-freeze-frame=false  # Event_LIN 2 Slave 15_Defect
  diagnostic event to trouble code uds mapping EventDtcMapLIN2Slave15Defect: diagnostic-event=EventLIN2Slave15Defect, trouble-code-uds=LIN_2_Slave_15_Defect  # Event_Dtc_Map_LIN 2 Slave 15_Defect
  diagnostic event to operation cycle mapping EventOperCycleMapLIN2Slave15Defect: diagnostic-event=EventLIN2Slave15Defect, operation-cycle=DefaultOperationCycle  # Event_Oper_Cycle_Map_LIN 2 Slave 15_Defect
  diagnostic event to debounce algorithm mapping EventDebounceMapLIN2Slave15Defect: debounce-algorithm=counter_based, diagnostic-event=EventLIN2Slave15Defect  # EventDebounceMap_LIN 2 Slave 15_Defect
package /ZeC/DTC/DTC/LIN_2_Slave_14_NoCommunication
  diagnostic trouble code uds LIN_2_Slave_14_NoCommunication: dtc-props=Dtc_Props_358996c7, uds-dtc-value=0x030203  # LIN 2 Slave 14_NoCommunication
  diagnostic event EventLIN2Slave14NoCommunication: aging-allowed=true, event-kind=SWC, prestorage-freeze-frame=false  # Event_LIN 2 Slave 14_NoCommunication
  diagnostic event to trouble code uds mapping EventDtcMapLIN2Slave14NoCommunication: diagnostic-event=EventLIN2Slave14NoCommunication, trouble-code-uds=LIN_2_Slave_14_NoCommunication  # Event_Dtc_Map_LIN 2 Slave 14_NoCommunication
  diagnostic event to operation cycle mapping EventOperCycleMapLIN2Slave14NoCommunication: diagnostic-event=EventLIN2Slave14NoCommunication, operation-cycle=DefaultOperationCycle  # Event_Oper_Cycle_Map_LIN 2 Slave 14_NoCommunication
  diagnostic event to debounce algorithm mapping EventDebounceMapLIN2Slave14NoCommunication: debounce-algorithm=counter_based, diagnostic-event=EventLIN2Slave14NoCommunication  # EventDebounceMap_LIN 2 Slave 14_NoCommunication
package /ZeC/DTC/DTC/LIN_12_Slave_5_NoCommunication
  diagnostic trouble code uds LIN_12_Slave_5_NoCommunication: dtc-props=Dtc_Props_358996c7, uds-dtc-value=0x030c1c  # LIN 12 Slave 5_NoCommunication
  diagnostic event EventLIN12Slave5NoCommunication: aging-allowed=true, event-kind=SWC, prestorage-freeze-frame=false  # Event_LIN 12 Slave 5_NoCommunication
  diagnostic event to trouble code uds mapping EventDtcMapLIN12Slave5NoCommunication: diagnostic-event=EventLIN12Slave5NoCommunication, trouble-code-uds=LIN_12_Slave_5_NoCommunication  # Event_Dtc_Map_LIN 12 Slave 5_NoCommunication
  diagnostic event to operation cycle mapping EventOperCycleMapLIN12Slave5NoCommunication: diagnostic-event=EventLIN12Slave5NoCommunication, operation-cycle=DefaultOperationCycle  # Event_Oper_Cycle_Map_LIN 12 Slave 5_NoCommunication
  diagnostic event to debounce algorithm mapping EventDebounceMapLIN12Slave5NoCommunication: debounce-algorithm=counter_based, diagnostic-event=EventLIN12Slave5NoCommunication  # EventDebounceMap_LIN 12 Slave 5_NoCommunication
package /ZeC/DTC/DTC/LIN_2_Slave_2_Defect
  diagnostic trouble code uds LIN_2_Slave_2_Defect: dtc-props=Dtc_Props_358996c7, uds-dtc-value=0x030206  # LIN 2 Slave 2_Defect
  diagnostic event EventLIN2Slave2Defect: aging-allowed=true, event-kind=SWC, prestorage-freeze-frame=false  # Event_LIN 2 Slave 2_Defect
  diagnostic event to trouble code uds mapping EventDtcMapLIN2Slave2Defect: diagnostic-event=EventLIN2Slave2Defect, trouble-code-uds=LIN_2_Slave_2_Defect  # Event_Dtc_Map_LIN 2 Slave 2_Defect
  diagnostic event to operation cycle mapping EventOperCycleMapLIN2Slave2Defect: diagnostic-event=EventLIN2Slave2Defect, operation-cycle=DefaultOperationCycle  # Event_Oper_Cycle_Map_LIN 2 Slave 2_Defect
  diagnostic event to debounce algorithm mapping EventDebounceMapLIN2Slave2Defect: debounce-algorithm=counter_based, diagnostic-event=EventLIN2Slave2Defect  # EventDebounceMap_LIN 2 Slave 2_Defect
package /ZeC/DTC/DTC/LIN_12_Slave_6_Defect
  diagnostic trouble code uds LIN_12_Slave_6_Defect: dtc-props=Dtc_Props_358996c7, uds-dtc-value=0x030c1d  # LIN 12 Slave 6_Defect
  diagnostic event EventLIN12Slave6Defect: aging-allowed=true, event-kind=SWC, prestorage-freeze-frame=false  # Event_LIN 12 Slave 6_Defect
  diagnostic event to trouble code uds mapping EventDtcMapLIN12Slave6Defect: diagnostic-event=EventLIN12Slave6Defect, trouble-code-uds=LIN_12_Slave_6_Defect  # Event_Dtc_Map_LIN 12 Slave 6_Defect
  diagnostic event to operation cycle mapping EventOperCycleMapLIN12Slave6Defect: diagnostic-event=EventLIN12Slave6Defect, operation-cycle=DefaultOperationCycle  # Event_Oper_Cycle_Map_LIN 12 Slave 6_Defect
  diagnostic event to debounce algorithm mapping EventDebounceMapLIN12Slave6Defect: debounce-algorithm=counter_based, diagnostic-event=EventLIN12Slave6Defect  # EventDebounceMap_LIN 12 Slave 6_Defect
package /ZeC/DTC/DTC/LIN_2_Slave_15_NoCommunication
  diagnostic trouble code uds LIN_2_Slave_15_NoCommunication: dtc-props=Dtc_Props_358996c7, uds-dtc-value=0x030205  # LIN 2 Slave 15_NoCommunication
  diagnostic event EventLIN2Slave15NoCommunication: aging-allowed=true, event-kind=SWC, prestorage-freeze-frame=false  # Event_LIN 2 Slave 15_NoCommunication
  diagnostic event to trouble code uds mapping EventDtcMapLIN2Slave15NoCommunication: diagnostic-event=EventLIN2Slave15NoCommunication, trouble-code-uds=LIN_2_Slave_15_NoCommunication  # Event_Dtc_Map_LIN 2 Slave 15_NoCommunication
  diagnostic event to operation cycle mapping EventOperCycleMapLIN2Slave15NoCommunication: diagnostic-event=EventLIN2Slave15NoCommunication, operation-cycle=DefaultOperationCycle  # Event_Oper_Cycle_Map_LIN 2 Slave 15_NoCommunication
  diagnostic event to debounce algorithm mapping EventDebounceMapLIN2Slave15NoCommunication: debounce-algorithm=counter_based, diagnostic-event=EventLIN2Slave15NoCommunication  # EventDebounceMap_LIN 2 Slave 15_NoCommunication
package /ZeC/DTC/DTC/LIN_12_Slave_4_NoCommunication
  diagnostic trouble code uds LIN_12_Slave_4_NoCommunication: dtc-props=Dtc_Props_358996c7, uds-dtc-value=0x030c1a  # LIN 12 Slave 4_NoCommunication
  diagnostic event EventLIN12Slave4NoCommunication: aging-allowed=true, event-kind=SWC, prestorage-freeze-frame=false  # Event_LIN 12 Slave 4_NoCommunication
  diagnostic event to trouble code uds mapping EventDtcMapLIN12Slave4NoCommunication: diagnostic-event=EventLIN12Slave4NoCommunication, trouble-code-uds=LIN_12_Slave_4_NoCommunication  # Event_Dtc_Map_LIN 12 Slave 4_NoCommunication
  diagnostic event to operation cycle mapping EventOperCycleMapLIN12Slave4NoCommunication: diagnostic-event=EventLIN12Slave4NoCommunication, operation-cycle=DefaultOperationCycle  # Event_Oper_Cycle_Map_LIN 12 Slave 4_NoCommunication
  diagnostic event to debounce algorithm mapping EventDebounceMapLIN12Slave4NoCommunication: debounce-algorithm=counter_based, diagnostic-event=EventLIN12Slave4NoCommunication  # EventDebounceMap_LIN 12 Slave 4_NoCommunication
package /ZeC/DTC/DTC/LIN_12_Slave_5_Defect
  diagnostic trouble code uds LIN_12_Slave_5_Defect: dtc-props=Dtc_Props_358996c7, uds-dtc-value=0x030c1b  # LIN 12 Slave 5_Defect
  diagnostic event EventLIN12Slave5Defect: aging-allowed=true, event-kind=SWC, prestorage-freeze-frame=false  # Event_LIN 12 Slave 5_Defect
  diagnostic event to trouble code uds mapping EventDtcMapLIN12Slave5Defect: diagnostic-event=EventLIN12Slave5Defect, trouble-code-uds=LIN_12_Slave_5_Defect  # Event_Dtc_Map_LIN 12 Slave 5_Defect
  diagnostic event to operation cycle mapping EventOperCycleMapLIN12Slave5Defect: diagnostic-event=EventLIN12Slave5Defect, operation-cycle=DefaultOperationCycle  # Event_Oper_Cycle_Map_LIN 12 Slave 5_Defect
  diagnostic event to debounce algorithm mapping EventDebounceMapLIN12Slave5Defect: debounce-algorithm=counter_based, diagnostic-event=EventLIN12Slave5Defect  # EventDebounceMap_LIN 12 Slave 5_Defect
package /ZeC/DTC/DTC/LIN_2_Slave_14_Defect
  diagnostic trouble code uds LIN_2_Slave_14_Defect: dtc-props=Dtc_Props_358996c7, uds-dtc-value=0x030202  # LIN 2 Slave 14_Defect
  diagnostic event EventLIN2Slave14Defect: aging-allowed=true, event-kind=SWC, prestorage-freeze-frame=false  # Event_LIN 2 Slave 14_Defect
  diagnostic event to trouble code uds mapping EventDtcMapLIN2Slave14Defect: diagnostic-event=EventLIN2Slave14Defect, trouble-code-uds=LIN_2_Slave_14_Defect  # Event_Dtc_Map_LIN 2 Slave 14_Defect
  diagnostic event to operation cycle mapping EventOperCycleMapLIN2Slave14Defect: diagnostic-event=EventLIN2Slave14Defect, operation-cycle=DefaultOperationCycle  # Event_Oper_Cycle_Map_LIN 2 Slave 14_Defect
  diagnostic event to debounce algorithm mapping EventDebounceMapLIN2Slave14Defect: debounce-algorithm=counter_based, diagnostic-event=EventLIN2Slave14Defect  # EventDebounceMap_LIN 2 Slave 14_Defect
package /ZeC/DTC/DTC/LIN_2_Slave_13_NoCommunication
  diagnostic trouble code uds LIN_2_Slave_13_NoCommunication: dtc-props=Dtc_Props_358996c7, uds-dtc-value=0x030201  # LIN 2 Slave 13_NoCommunication
  diagnostic event EventLIN2Slave13NoCommunication: aging-allowed=true, event-kind=SWC, prestorage-freeze-frame=false  # Event_LIN 2 Slave 13_NoCommunication
  diagnostic event to trouble code uds mapping EventDtcMapLIN2Slave13NoCommunication: diagnostic-event=EventLIN2Slave13NoCommunication, trouble-code-uds=LIN_2_Slave_13_NoCommunication  # Event_Dtc_Map_LIN 2 Slave 13_NoCommunication
  diagnostic event to operation cycle mapping EventOperCycleMapLIN2Slave13NoCommunication: diagnostic-event=EventLIN2Slave13NoCommunication, operation-cycle=DefaultOperationCycle  # Event_Oper_Cycle_Map_LIN 2 Slave 13_NoCommunication
  diagnostic event to debounce algorithm mapping EventDebounceMapLIN2Slave13NoCommunication: debounce-algorithm=counter_based, diagnostic-event=EventLIN2Slave13NoCommunication  # EventDebounceMap_LIN 2 Slave 13_NoCommunication
package /ZeC/DTC/DTC/Power_Path_141_Short_to_GND_Failure
  diagnostic trouble code uds Power_Path_141_Short_to_GND_Failure: dtc-props=Dtc_Props_5be61abf, uds-dtc-value=0x00528d
  diagnostic event EventPowerPath141ShortToGNDFailure: aging-allowed=true, event-kind=SWC, prestorage-freeze-frame=false  # Event_Power_Path_141_Short_to_GND_Failure
  diagnostic event to trouble code uds mapping EventDtcMapPowerPath141ShortToGNDFailure: diagnostic-event=EventPowerPath141ShortToGNDFailure, trouble-code-uds=Power_Path_141_Short_to_GND_Failure  # Event_Dtc_Map_Power_Path_141_Short_to_GND_Failure
  diagnostic event to operation cycle mapping EventOperCycleMapPowerPath141ShortToGNDFailure: diagnostic-event=EventPowerPath141ShortToGNDFailure, operation-cycle=DefaultOperationCycle  # Event_Oper_Cycle_Map_Power_Path_141_Short_to_GND_Failure
  diagnostic event to debounce algorithm mapping EventDebounceMapPowerPath141ShortToGNDFailure: debounce-algorithm=time_based, diagnostic-event=EventPowerPath141ShortToGNDFailure  # EventDebounceMap_Power_Path_141_Short_to_GND_Failure
package /ZeC/DTC/DTC/Power_Path_140_Short_to_GND_Failure
  diagnostic trouble code uds Power_Path_140_Short_to_GND_Failure: dtc-props=Dtc_Props_52d82a58, uds-dtc-value=0x00528c
  diagnostic event EventPowerPath140ShortToGNDFailure: aging-allowed=true, event-kind=SWC, prestorage-freeze-frame=false  # Event_Power_Path_140_Short_to_GND_Failure
  diagnostic event to trouble code uds mapping EventDtcMapPowerPath140ShortToGNDFailure: diagnostic-event=EventPowerPath140ShortToGNDFailure, trouble-code-uds=Power_Path_140_Short_to_GND_Failure  # Event_Dtc_Map_Power_Path_140_Short_to_GND_Failure
  diagnostic event to operation cycle mapping EventOperCycleMapPowerPath140ShortToGNDFailure: diagnostic-event=EventPowerPath140ShortToGNDFailure, operation-cycle=DefaultOperationCycle  # Event_Oper_Cycle_Map_Power_Path_140_Short_to_GND_Failure
  diagnostic event to debounce algorithm mapping EventDebounceMapPowerPath140ShortToGNDFailure: debounce-algorithm=time_based, diagnostic-event=EventPowerPath140ShortToGNDFailure  # EventDebounceMap_Power_Path_140_Short_to_GND_Failure
package /ZeC/DTC/DTC/Power_Path_143_Short_to_GND_Failure
  diagnostic trouble code uds Power_Path_143_Short_to_GND_Failure: dtc-props=Dtc_Props_d7d40ecb, uds-dtc-value=0x00528f
  diagnostic event EventPowerPath143ShortToGNDFailure: aging-allowed=true, event-kind=SWC, prestorage-freeze-frame=false  # Event_Power_Path_143_Short_to_GND_Failure
  diagnostic event to trouble code uds mapping EventDtcMapPowerPath143ShortToGNDFailure: diagnostic-event=EventPowerPath143ShortToGNDFailure, trouble-code-uds=Power_Path_143_Short_to_GND_Failure  # Event_Dtc_Map_Power_Path_143_Short_to_GND_Failure
  diagnostic event to operation cycle mapping EventOperCycleMapPowerPath143ShortToGNDFailure: diagnostic-event=EventPowerPath143ShortToGNDFailure, operation-cycle=DefaultOperationCycle  # Event_Oper_Cycle_Map_Power_Path_143_Short_to_GND_Failure
  diagnostic event to debounce algorithm mapping EventDebounceMapPowerPath143ShortToGNDFailure: debounce-algorithm=time_based, diagnostic-event=EventPowerPath143ShortToGNDFailure  # EventDebounceMap_Power_Path_143_Short_to_GND_Failure
package /ZeC/DTC/DTC/Power_Path_142_Short_to_GND_Failure
  diagnostic trouble code uds Power_Path_142_Short_to_GND_Failure: dtc-props=Dtc_Props_1dff1085, uds-dtc-value=0x00528e
  diagnostic event EventPowerPath142ShortToGNDFailure: aging-allowed=true, event-kind=SWC, prestorage-freeze-frame=false  # Event_Power_Path_142_Short_to_GND_Failure
  diagnostic event to trouble code uds mapping EventDtcMapPowerPath142ShortToGNDFailure: diagnostic-event=EventPowerPath142ShortToGNDFailure, trouble-code-uds=Power_Path_142_Short_to_GND_Failure  # Event_Dtc_Map_Power_Path_142_Short_to_GND_Failure
  diagnostic event to operation cycle mapping EventOperCycleMapPowerPath142ShortToGNDFailure: diagnostic-event=EventPowerPath142ShortToGNDFailure, operation-cycle=DefaultOperationCycle  # Event_Oper_Cycle_Map_Power_Path_142_Short_to_GND_Failure
  diagnostic event to debounce algorithm mapping EventDebounceMapPowerPath142ShortToGNDFailure: debounce-algorithm=time_based, diagnostic-event=EventPowerPath142ShortToGNDFailure  # EventDebounceMap_Power_Path_142_Short_to_GND_Failure
package /ZeC/DTC/DTC/Power_Path_145_Short_to_GND_Failure
  diagnostic trouble code uds Power_Path_145_Short_to_GND_Failure: dtc-props=Dtc_Props_255f9ae9, uds-dtc-value=0x005291
  diagnostic event EventPowerPath145ShortToGNDFailure: aging-allowed=true, event-kind=SWC, prestorage-freeze-frame=false  # Event_Power_Path_145_Short_to_GND_Failure
  diagnostic event to trouble code uds mapping EventDtcMapPowerPath145ShortToGNDFailure: diagnostic-event=EventPowerPath145ShortToGNDFailure, trouble-code-uds=Power_Path_145_Short_to_GND_Failure  # Event_Dtc_Map_Power_Path_145_Short_to_GND_Failure
  diagnostic event to operation cycle mapping EventOperCycleMapPowerPath145ShortToGNDFailure: diagnostic-event=EventPowerPath145ShortToGNDFailure, operation-cycle=DefaultOperationCycle  # Event_Oper_Cycle_Map_Power_Path_145_Short_to_GND_Failure
  diagnostic event to debounce algorithm mapping EventDebounceMapPowerPath145ShortToGNDFailure: debounce-algorithm=time_based, diagnostic-event=EventPowerPath145ShortToGNDFailure  # EventDebounceMap_Power_Path_145_Short_to_GND_Failure
package /ZeC/DTC/DTC/Power_Path_144_Short_to_GND_Failure
  diagnostic trouble code uds Power_Path_144_Short_to_GND_Failure: dtc-props=Dtc_Props_634690d3, uds-dtc-value=0x005290
  diagnostic event EventPowerPath144ShortToGNDFailure: aging-allowed=true, event-kind=SWC, prestorage-freeze-frame=false  # Event_Power_Path_144_Short_to_GND_Failure
  diagnostic event to trouble code uds mapping EventDtcMapPowerPath144ShortToGNDFailure: diagnostic-event=EventPowerPath144ShortToGNDFailure, trouble-code-uds=Power_Path_144_Short_to_GND_Failure  # Event_Dtc_Map_Power_Path_144_Short_to_GND_Failure
  diagnostic event to operation cycle mapping EventOperCycleMapPowerPath144ShortToGNDFailure: diagnostic-event=EventPowerPath144ShortToGNDFailure, operation-cycle=DefaultOperationCycle  # Event_Oper_Cycle_Map_Power_Path_144_Short_to_GND_Failure
  diagnostic event to debounce algorithm mapping EventDebounceMapPowerPath144ShortToGNDFailure: debounce-algorithm=time_based, diagnostic-event=EventPowerPath144ShortToGNDFailure  # EventDebounceMap_Power_Path_144_Short_to_GND_Failure
package /ZeC/DTC/DTC/Power_Path_147_Short_to_GND_Failure
  diagnostic trouble code uds Power_Path_147_Short_to_GND_Failure: dtc-props=Dtc_Props_a96d8e9d, uds-dtc-value=0x005293
  diagnostic event EventPowerPath147ShortToGNDFailure: aging-allowed=true, event-kind=SWC, prestorage-freeze-frame=false  # Event_Power_Path_147_Short_to_GND_Failure
  diagnostic event to trouble code uds mapping EventDtcMapPowerPath147ShortToGNDFailure: diagnostic-event=EventPowerPath147ShortToGNDFailure, trouble-code-uds=Power_Path_147_Short_to_GND_Failure  # Event_Dtc_Map_Power_Path_147_Short_to_GND_Failure
  diagnostic event to operation cycle mapping EventOperCycleMapPowerPath147ShortToGNDFailure: diagnostic-event=EventPowerPath147ShortToGNDFailure, operation-cycle=DefaultOperationCycle  # Event_Oper_Cycle_Map_Power_Path_147_Short_to_GND_Failure
  diagnostic event to debounce algorithm mapping EventDebounceMapPowerPath147ShortToGNDFailure: debounce-algorithm=time_based, diagnostic-event=EventPowerPath147ShortToGNDFailure  # EventDebounceMap_Power_Path_147_Short_to_GND_Failure
package /ZeC/DTC/DTC/Power_Path_146_Short_to_GND_Failure
  diagnostic trouble code uds Power_Path_146_Short_to_GND_Failure: dtc-props=Dtc_Props_ef7484a7, uds-dtc-value=0x005292
  diagnostic event EventPowerPath146ShortToGNDFailure: aging-allowed=true, event-kind=SWC, prestorage-freeze-frame=false  # Event_Power_Path_146_Short_to_GND_Failure
  diagnostic event to trouble code uds mapping EventDtcMapPowerPath146ShortToGNDFailure: diagnostic-event=EventPowerPath146ShortToGNDFailure, trouble-code-uds=Power_Path_146_Short_to_GND_Failure  # Event_Dtc_Map_Power_Path_146_Short_to_GND_Failure
  diagnostic event to operation cycle mapping EventOperCycleMapPowerPath146ShortToGNDFailure: diagnostic-event=EventPowerPath146ShortToGNDFailure, operation-cycle=DefaultOperationCycle  # Event_Oper_Cycle_Map_Power_Path_146_Short_to_GND_Failure
  diagnostic event to debounce algorithm mapping EventDebounceMapPowerPath146ShortToGNDFailure: debounce-algorithm=time_based, diagnostic-event=EventPowerPath146ShortToGNDFailure  # EventDebounceMap_Power_Path_146_Short_to_GND_Failure
package /ZeC/DTC/DTC/LIN_2_Slave_5_NoCommunication
  diagnostic trouble code uds LIN_2_Slave_5_NoCommunication: dtc-props=Dtc_Props_358996c7, uds-dtc-value=0x03020d  # LIN 2 Slave 5_NoCommunication
  diagnostic event EventLIN2Slave5NoCommunication: aging-allowed=true, event-kind=SWC, prestorage-freeze-frame=false  # Event_LIN 2 Slave 5_NoCommunication
  diagnostic event to trouble code uds mapping EventDtcMapLIN2Slave5NoCommunication: diagnostic-event=EventLIN2Slave5NoCommunication, trouble-code-uds=LIN_2_Slave_5_NoCommunication  # Event_Dtc_Map_LIN 2 Slave 5_NoCommunication
  diagnostic event to operation cycle mapping EventOperCycleMapLIN2Slave5NoCommunication: diagnostic-event=EventLIN2Slave5NoCommunication, operation-cycle=DefaultOperationCycle  # Event_Oper_Cycle_Map_LIN 2 Slave 5_NoCommunication
  diagnostic event to debounce algorithm mapping EventDebounceMapLIN2Slave5NoCommunication: debounce-algorithm=counter_based, diagnostic-event=EventLIN2Slave5NoCommunication  # EventDebounceMap_LIN 2 Slave 5_NoCommunication
package /ZeC/DTC/DTC/LIN_2_Slave_5_Defect
  diagnostic trouble code uds LIN_2_Slave_5_Defect: dtc-props=Dtc_Props_358996c7, uds-dtc-value=0x03020c  # LIN 2 Slave 5_Defect
  diagnostic event EventLIN2Slave5Defect: aging-allowed=true, event-kind=SWC, prestorage-freeze-frame=false  # Event_LIN 2 Slave 5_Defect
  diagnostic event to trouble code uds mapping EventDtcMapLIN2Slave5Defect: diagnostic-event=EventLIN2Slave5Defect, trouble-code-uds=LIN_2_Slave_5_Defect  # Event_Dtc_Map_LIN 2 Slave 5_Defect
  diagnostic event to operation cycle mapping EventOperCycleMapLIN2Slave5Defect: diagnostic-event=EventLIN2Slave5Defect, operation-cycle=DefaultOperationCycle  # Event_Oper_Cycle_Map_LIN 2 Slave 5_Defect
  diagnostic event to debounce algorithm mapping EventDebounceMapLIN2Slave5Defect: debounce-algorithm=counter_based, diagnostic-event=EventLIN2Slave5Defect  # EventDebounceMap_LIN 2 Slave 5_Defect
package /ZeC/DTC/DTC/Power_Path_160_Not_Found_Failure
  diagnostic trouble code uds Power_Path_160_Not_Found_Failure: dtc-props=Dtc_Props_c92c78b3, uds-dtc-value=0x0056a0
  diagnostic event EventPowerPath160NotFoundFailure: aging-allowed=true, event-kind=SWC, prestorage-freeze-frame=false  # Event_Power_Path_160_Not_Found_Failure
  diagnostic event to trouble code uds mapping EventDtcMapPowerPath160NotFoundFailure: diagnostic-event=EventPowerPath160NotFoundFailure, trouble-code-uds=Power_Path_160_Not_Found_Failure  # Event_Dtc_Map_Power_Path_160_Not_Found_Failure
  diagnostic event to operation cycle mapping EventOperCycleMapPowerPath160NotFoundFailure: diagnostic-event=EventPowerPath160NotFoundFailure, operation-cycle=DefaultOperationCycle  # Event_Oper_Cycle_Map_Power_Path_160_Not_Found_Failure
  diagnostic event to debounce algorithm mapping EventDebounceMapPowerPath160NotFoundFailure: debounce-algorithm=time_based, diagnostic-event=EventPowerPath160NotFoundFailure  # EventDebounceMap_Power_Path_160_Not_Found_Failure
package /ZeC/DTC/DTC/LIN_2_Slave_6_NoCommunication
  diagnostic trouble code uds LIN_2_Slave_6_NoCommunication: dtc-props=Dtc_Props_358996c7, uds-dtc-value=0x03020f  # LIN 2 Slave 6_NoCommunication
  diagnostic event EventLIN2Slave6NoCommunication: aging-allowed=true, event-kind=SWC, prestorage-freeze-frame=false  # Event_LIN 2 Slave 6_NoCommunication
  diagnostic event to trouble code uds mapping EventDtcMapLIN2Slave6NoCommunication: diagnostic-event=EventLIN2Slave6NoCommunication, trouble-code-uds=LIN_2_Slave_6_NoCommunication  # Event_Dtc_Map_LIN 2 Slave 6_NoCommunication
  diagnostic event to operation cycle mapping EventOperCycleMapLIN2Slave6NoCommunication: diagnostic-event=EventLIN2Slave6NoCommunication, operation-cycle=DefaultOperationCycle  # Event_Oper_Cycle_Map_LIN 2 Slave 6_NoCommunication
  diagnostic event to debounce algorithm mapping EventDebounceMapLIN2Slave6NoCommunication: debounce-algorithm=counter_based, diagnostic-event=EventLIN2Slave6NoCommunication  # EventDebounceMap_LIN 2 Slave 6_NoCommunication
package /ZeC/DTC/DTC/LIN_2_Slave_6_Defect
  diagnostic trouble code uds LIN_2_Slave_6_Defect: dtc-props=Dtc_Props_358996c7, uds-dtc-value=0x03020e  # LIN 2 Slave 6_Defect
  diagnostic event EventLIN2Slave6Defect: aging-allowed=true, event-kind=SWC, prestorage-freeze-frame=false  # Event_LIN 2 Slave 6_Defect
  diagnostic event to trouble code uds mapping EventDtcMapLIN2Slave6Defect: diagnostic-event=EventLIN2Slave6Defect, trouble-code-uds=LIN_2_Slave_6_Defect  # Event_Dtc_Map_LIN 2 Slave 6_Defect
  diagnostic event to operation cycle mapping EventOperCycleMapLIN2Slave6Defect: diagnostic-event=EventLIN2Slave6Defect, operation-cycle=DefaultOperationCycle  # Event_Oper_Cycle_Map_LIN 2 Slave 6_Defect
  diagnostic event to debounce algorithm mapping EventDebounceMapLIN2Slave6Defect: debounce-algorithm=counter_based, diagnostic-event=EventLIN2Slave6Defect  # EventDebounceMap_LIN 2 Slave 6_Defect
package /ZeC/DTC/DTC/Power_Path_153_Short_to_GND_Failure
  diagnostic trouble code uds Power_Path_153_Short_to_GND_Failure: dtc-props=Dtc_Props_7804c1fa, uds-dtc-value=0x005299
  diagnostic event EventPowerPath153ShortToGNDFailure: aging-allowed=true, event-kind=SWC, prestorage-freeze-frame=false  # Event_Power_Path_153_Short_to_GND_Failure
  diagnostic event to trouble code uds mapping EventDtcMapPowerPath153ShortToGNDFailure: diagnostic-event=EventPowerPath153ShortToGNDFailure, trouble-code-uds=Power_Path_153_Short_to_GND_Failure  # Event_Dtc_Map_Power_Path_153_Short_to_GND_Failure
  diagnostic event to operation cycle mapping EventOperCycleMapPowerPath153ShortToGNDFailure: diagnostic-event=EventPowerPath153ShortToGNDFailure, operation-cycle=DefaultOperationCycle  # Event_Oper_Cycle_Map_Power_Path_153_Short_to_GND_Failure
  diagnostic event to debounce algorithm mapping EventDebounceMapPowerPath153ShortToGNDFailure: debounce-algorithm=time_based, diagnostic-event=EventPowerPath153ShortToGNDFailure  # EventDebounceMap_Power_Path_153_Short_to_GND_Failure
package /ZeC/DTC/DTC/Power_Path_152_Short_to_GND_Failure
  diagnostic trouble code uds Power_Path_152_Short_to_GND_Failure: dtc-props=Dtc_Props_3e1dcbc0, uds-dtc-value=0x005298
  diagnostic event EventPowerPath152ShortToGNDFailure: aging-allowed=true, event-kind=SWC, prestorage-freeze-frame=false  # Event_Power_Path_152_Short_to_GND_Failure
  diagnostic event to trouble code uds mapping EventDtcMapPowerPath152ShortToGNDFailure: diagnostic-event=EventPowerPath152ShortToGNDFailure, trouble-code-uds=Power_Path_152_Short_to_GND_Failure  # Event_Dtc_Map_Power_Path_152_Short_to_GND_Failure
  diagnostic event to operation cycle mapping EventOperCycleMapPowerPath152ShortToGNDFailure: diagnostic-event=EventPowerPath152ShortToGNDFailure, operation-cycle=DefaultOperationCycle  # Event_Oper_Cycle_Map_Power_Path_152_Short_to_GND_Failure
  diagnostic event to debounce algorithm mapping EventDebounceMapPowerPath152ShortToGNDFailure: debounce-algorithm=time_based, diagnostic-event=EventPowerPath152ShortToGNDFailure  # EventDebounceMap_Power_Path_152_Short_to_GND_Failure
package /ZeC/DTC/DTC/LIN_12_Databus_No_Comm
  diagnostic trouble code uds LIN_12_Databus_No_Comm: dtc-props=Dtc_Props_358996c7, uds-dtc-value=0x030c20  # LIN 12 Databus_No_Comm
  diagnostic event EventLIN12DatabusNoComm: aging-allowed=true, event-kind=SWC, prestorage-freeze-frame=false  # Event_LIN 12 Databus_No_Comm
  diagnostic event to trouble code uds mapping EventDtcMapLIN12DatabusNoComm: diagnostic-event=EventLIN12DatabusNoComm, trouble-code-uds=LIN_12_Databus_No_Comm  # Event_Dtc_Map_LIN 12 Databus_No_Comm
  diagnostic event to operation cycle mapping EventOperCycleMapLIN12DatabusNoComm: diagnostic-event=EventLIN12DatabusNoComm, operation-cycle=DefaultOperationCycle  # Event_Oper_Cycle_Map_LIN 12 Databus_No_Comm
  diagnostic event to debounce algorithm mapping EventDebounceMapLIN12DatabusNoComm: debounce-algorithm=counter_based, diagnostic-event=EventLIN12DatabusNoComm  # EventDebounceMap_LIN 12 Databus_No_Comm
package /ZeC/DTC/DTC/LIN_2_Slave_4_NoCommunication
  diagnostic trouble code uds LIN_2_Slave_4_NoCommunication: dtc-props=Dtc_Props_358996c7, uds-dtc-value=0x03020b  # LIN 2 Slave 4_NoCommunication
  diagnostic event EventLIN2Slave4NoCommunication: aging-allowed=true, event-kind=SWC, prestorage-freeze-frame=false  # Event_LIN 2 Slave 4_NoCommunication
  diagnostic event to trouble code uds mapping EventDtcMapLIN2Slave4NoCommunication: diagnostic-event=EventLIN2Slave4NoCommunication, trouble-code-uds=LIN_2_Slave_4_NoCommunication  # Event_Dtc_Map_LIN 2 Slave 4_NoCommunication
  diagnostic event to operation cycle mapping EventOperCycleMapLIN2Slave4NoCommunication: diagnostic-event=EventLIN2Slave4NoCommunication, operation-cycle=DefaultOperationCycle  # Event_Oper_Cycle_Map_LIN 2 Slave 4_NoCommunication
  diagnostic event to debounce algorithm mapping EventDebounceMapLIN2Slave4NoCommunication: debounce-algorithm=counter_based, diagnostic-event=EventLIN2Slave4NoCommunication  # EventDebounceMap_LIN 2 Slave 4_NoCommunication
package /ZeC/DTC/DTC/LIN_12_Local_Databus_Electrical_Failure
  diagnostic trouble code uds LIN_12_Local_Databus_Electrical_Failure: dtc-props=Dtc_Props_358996c7, uds-dtc-value=0x030c21  # LIN 12 Local_Databus_Electrical_Failure
  diagnostic event EventLIN12LocalDatabusElectricalFailure: aging-allowed=true, event-kind=SWC, prestorage-freeze-frame=false  # Event_LIN 12 Local_Databus_Electrical_Failure
  diagnostic event to trouble code uds mapping EventDtcMapLIN12LocalDatabusElectricalFailure: diagnostic-event=EventLIN12LocalDatabusElectricalFailure, trouble-code-uds=LIN_12_Local_Databus_Electrical_Failure  # Event_Dtc_Map_LIN 12 Local_Databus_Electrical_Failure
  diagnostic event to operation cycle mapping EventOperCycleMapLIN12LocalDatabusElectricalFailure: diagnostic-event=EventLIN12LocalDatabusElectricalFailure, operation-cycle=DefaultOperationCycle  # Event_Oper_Cycle_Map_LIN 12 Local_Databus_Electrical_Failure
  diagnostic event to debounce algorithm mapping EventDebounceMapLIN12LocalDatabusElectricalFailure: debounce-algorithm=counter_based, diagnostic-event=EventLIN12LocalDatabusElectricalFailure  # EventDebounceMap_LIN 12 Local_Databus_Electrical_Failure
package /ZeC/DTC/DTC/LIN_2_Slave_4_Defect
  diagnostic trouble code uds LIN_2_Slave_4_Defect: dtc-props=Dtc_Props_358996c7, uds-dtc-value=0x03020a  # LIN 2 Slave 4_Defect
  diagnostic event EventLIN2Slave4Defect: aging-allowed=true, event-kind=SWC, prestorage-freeze-frame=false  # Event_LIN 2 Slave 4_Defect
  diagnostic event to trouble code uds mapping EventDtcMapLIN2Slave4Defect: diagnostic-event=EventLIN2Slave4Defect, trouble-code-uds=LIN_2_Slave_4_Defect  # Event_Dtc_Map_LIN 2 Slave 4_Defect
  diagnostic event to operation cycle mapping EventOperCycleMapLIN2Slave4Defect: diagnostic-event=EventLIN2Slave4Defect, operation-cycle=DefaultOperationCycle  # Event_Oper_Cycle_Map_LIN 2 Slave 4_Defect
  diagnostic event to debounce algorithm mapping EventDebounceMapLIN2Slave4Defect: debounce-algorithm=counter_based, diagnostic-event=EventLIN2Slave4Defect  # EventDebounceMap_LIN 2 Slave 4_Defect
package /ZeC/DTC/DTC/Power_Path_149_Short_to_GND_Failure
  diagnostic trouble code uds Power_Path_149_Short_to_GND_Failure: dtc-props=Dtc_Props_e64ab440, uds-dtc-value=0x005295
  diagnostic event EventPowerPath149ShortToGNDFailure: aging-allowed=true, event-kind=SWC, prestorage-freeze-frame=false  # Event_Power_Path_149_Short_to_GND_Failure
  diagnostic event to trouble code uds mapping EventDtcMapPowerPath149ShortToGNDFailure: diagnostic-event=EventPowerPath149ShortToGNDFailure, trouble-code-uds=Power_Path_149_Short_to_GND_Failure  # Event_Dtc_Map_Power_Path_149_Short_to_GND_Failure
  diagnostic event to operation cycle mapping EventOperCycleMapPowerPath149ShortToGNDFailure: diagnostic-event=EventPowerPath149ShortToGNDFailure, operation-cycle=DefaultOperationCycle  # Event_Oper_Cycle_Map_Power_Path_149_Short_to_GND_Failure
  diagnostic event to debounce algorithm mapping EventDebounceMapPowerPath149ShortToGNDFailure: debounce-algorithm=time_based, diagnostic-event=EventPowerPath149ShortToGNDFailure  # EventDebounceMap_Power_Path_149_Short_to_GND_Failure
package /ZeC/DTC/DTC/Power_Path_148_Short_to_GND_Failure
  diagnostic trouble code uds Power_Path_148_Short_to_GND_Failure: dtc-props=Dtc_Props_a053be7a, uds-dtc-value=0x005294
  diagnostic event EventPowerPath148ShortToGNDFailure: aging-allowed=true, event-kind=SWC, prestorage-freeze-frame=false  # Event_Power_Path_148_Short_to_GND_Failure
  diagnostic event to trouble code uds mapping EventDtcMapPowerPath148ShortToGNDFailure: diagnostic-event=EventPowerPath148ShortToGNDFailure, trouble-code-uds=Power_Path_148_Short_to_GND_Failure  # Event_Dtc_Map_Power_Path_148_Short_to_GND_Failure
  diagnostic event to operation cycle mapping EventOperCycleMapPowerPath148ShortToGNDFailure: diagnostic-event=EventPowerPath148ShortToGNDFailure, operation-cycle=DefaultOperationCycle  # Event_Oper_Cycle_Map_Power_Path_148_Short_to_GND_Failure
  diagnostic event to debounce algorithm mapping EventDebounceMapPowerPath148ShortToGNDFailure: debounce-algorithm=time_based, diagnostic-event=EventPowerPath148ShortToGNDFailure  # EventDebounceMap_Power_Path_148_Short_to_GND_Failure
package /ZeC/DTC/DTC/Power_Path_151_Short_to_GND_Failure
  diagnostic trouble code uds Power_Path_151_Short_to_GND_Failure: dtc-props=Dtc_Props_6a78a034, uds-dtc-value=0x005297
  diagnostic event EventPowerPath151ShortToGNDFailure: aging-allowed=true, event-kind=SWC, prestorage-freeze-frame=false  # Event_Power_Path_151_Short_to_GND_Failure
  diagnostic event to trouble code uds mapping EventDtcMapPowerPath151ShortToGNDFailure: diagnostic-event=EventPowerPath151ShortToGNDFailure, trouble-code-uds=Power_Path_151_Short_to_GND_Failure  # Event_Dtc_Map_Power_Path_151_Short_to_GND_Failure
  diagnostic event to operation cycle mapping EventOperCycleMapPowerPath151ShortToGNDFailure: diagnostic-event=EventPowerPath151ShortToGNDFailure, operation-cycle=DefaultOperationCycle  # Event_Oper_Cycle_Map_Power_Path_151_Short_to_GND_Failure
  diagnostic event to debounce algorithm mapping EventDebounceMapPowerPath151ShortToGNDFailure: debounce-algorithm=time_based, diagnostic-event=EventPowerPath151ShortToGNDFailure  # EventDebounceMap_Power_Path_151_Short_to_GND_Failure
package /ZeC/DTC/DTC/Power_Path_150_Short_to_GND_Failure
  diagnostic trouble code uds Power_Path_150_Short_to_GND_Failure: dtc-props=Dtc_Props_2c61aa0e, uds-dtc-value=0x005296
  diagnostic event EventPowerPath150ShortToGNDFailure: aging-allowed=true, event-kind=SWC, prestorage-freeze-frame=false  # Event_Power_Path_150_Short_to_GND_Failure
  diagnostic event to trouble code uds mapping EventDtcMapPowerPath150ShortToGNDFailure: diagnostic-event=EventPowerPath150ShortToGNDFailure, trouble-code-uds=Power_Path_150_Short_to_GND_Failure  # Event_Dtc_Map_Power_Path_150_Short_to_GND_Failure
  diagnostic event to operation cycle mapping EventOperCycleMapPowerPath150ShortToGNDFailure: diagnostic-event=EventPowerPath150ShortToGNDFailure, operation-cycle=DefaultOperationCycle  # Event_Oper_Cycle_Map_Power_Path_150_Short_to_GND_Failure
  diagnostic event to debounce algorithm mapping EventDebounceMapPowerPath150ShortToGNDFailure: debounce-algorithm=time_based, diagnostic-event=EventPowerPath150ShortToGNDFailure  # EventDebounceMap_Power_Path_150_Short_to_GND_Failure
package /ZeC/DTC/DTC/LIN_2_Slave_10_NoCommunication
  diagnostic trouble code uds LIN_2_Slave_10_NoCommunication: dtc-props=Dtc_Props_358996c7, uds-dtc-value=0x030219  # LIN 2 Slave 10_NoCommunication
  diagnostic event EventLIN2Slave10NoCommunication: aging-allowed=true, event-kind=SWC, prestorage-freeze-frame=false  # Event_LIN 2 Slave 10_NoCommunication
  diagnostic event to trouble code uds mapping EventDtcMapLIN2Slave10NoCommunication: diagnostic-event=EventLIN2Slave10NoCommunication, trouble-code-uds=LIN_2_Slave_10_NoCommunication  # Event_Dtc_Map_LIN 2 Slave 10_NoCommunication
  diagnostic event to operation cycle mapping EventOperCycleMapLIN2Slave10NoCommunication: diagnostic-event=EventLIN2Slave10NoCommunication, operation-cycle=DefaultOperationCycle  # Event_Oper_Cycle_Map_LIN 2 Slave 10_NoCommunication
  diagnostic event to debounce algorithm mapping EventDebounceMapLIN2Slave10NoCommunication: debounce-algorithm=counter_based, diagnostic-event=EventLIN2Slave10NoCommunication  # EventDebounceMap_LIN 2 Slave 10_NoCommunication
package /ZeC/DTC/DTC/LIN_2_Slave_10_Defect
  diagnostic trouble code uds LIN_2_Slave_10_Defect: dtc-props=Dtc_Props_358996c7, uds-dtc-value=0x030218  # LIN 2 Slave 10_Defect
  diagnostic event EventLIN2Slave10Defect: aging-allowed=true, event-kind=SWC, prestorage-freeze-frame=false  # Event_LIN 2 Slave 10_Defect
  diagnostic event to trouble code uds mapping EventDtcMapLIN2Slave10Defect: diagnostic-event=EventLIN2Slave10Defect, trouble-code-uds=LIN_2_Slave_10_Defect  # Event_Dtc_Map_LIN 2 Slave 10_Defect
  diagnostic event to operation cycle mapping EventOperCycleMapLIN2Slave10Defect: diagnostic-event=EventLIN2Slave10Defect, operation-cycle=DefaultOperationCycle  # Event_Oper_Cycle_Map_LIN 2 Slave 10_Defect
  diagnostic event to debounce algorithm mapping EventDebounceMapLIN2Slave10Defect: debounce-algorithm=counter_based, diagnostic-event=EventLIN2Slave10Defect  # EventDebounceMap_LIN 2 Slave 10_Defect
package /ZeC/DTC/DTC/Power_Path_122_Short_to_GND_Failure
  diagnostic trouble code uds Power_Path_122_Short_to_GND_Failure: dtc-props=Dtc_Props_646e6d42, uds-dtc-value=0x00527a
  diagnostic event EventPowerPath122ShortToGNDFailure: aging-allowed=true, event-kind=SWC, prestorage-freeze-frame=false  # Event_Power_Path_122_Short_to_GND_Failure
  diagnostic event to trouble code uds mapping EventDtcMapPowerPath122ShortToGNDFailure: diagnostic-event=EventPowerPath122ShortToGNDFailure, trouble-code-uds=Power_Path_122_Short_to_GND_Failure  # Event_Dtc_Map_Power_Path_122_Short_to_GND_Failure
  diagnostic event to operation cycle mapping EventOperCycleMapPowerPath122ShortToGNDFailure: diagnostic-event=EventPowerPath122ShortToGNDFailure, operation-cycle=DefaultOperationCycle  # Event_Oper_Cycle_Map_Power_Path_122_Short_to_GND_Failure
  diagnostic event to debounce algorithm mapping EventDebounceMapPowerPath122ShortToGNDFailure: debounce-algorithm=time_based, diagnostic-event=EventPowerPath122ShortToGNDFailure  # EventDebounceMap_Power_Path_122_Short_to_GND_Failure
package /ZeC/DTC/DTC/LIN_2_Slave_9_NoCommunication
  diagnostic trouble code uds LIN_2_Slave_9_NoCommunication: dtc-props=Dtc_Props_358996c7, uds-dtc-value=0x030215  # LIN 2 Slave 9_NoCommunication
  diagnostic event EventLIN2Slave9NoCommunication: aging-allowed=true, event-kind=SWC, prestorage-freeze-frame=false  # Event_LIN 2 Slave 9_NoCommunication
  diagnostic event to trouble code uds mapping EventDtcMapLIN2Slave9NoCommunication: diagnostic-event=EventLIN2Slave9NoCommunication, trouble-code-uds=LIN_2_Slave_9_NoCommunication  # Event_Dtc_Map_LIN 2 Slave 9_NoCommunication
  diagnostic event to operation cycle mapping EventOperCycleMapLIN2Slave9NoCommunication: diagnostic-event=EventLIN2Slave9NoCommunication, operation-cycle=DefaultOperationCycle  # Event_Oper_Cycle_Map_LIN 2 Slave 9_NoCommunication
  diagnostic event to debounce algorithm mapping EventDebounceMapLIN2Slave9NoCommunication: debounce-algorithm=counter_based, diagnostic-event=EventLIN2Slave9NoCommunication  # EventDebounceMap_LIN 2 Slave 9_NoCommunication
package /ZeC/DTC/DTC/LIN_2_Slave_9_Defect
  diagnostic trouble code uds LIN_2_Slave_9_Defect: dtc-props=Dtc_Props_358996c7, uds-dtc-value=0x030214  # LIN 2 Slave 9_Defect
  diagnostic event EventLIN2Slave9Defect: aging-allowed=true, event-kind=SWC, prestorage-freeze-frame=false  # Event_LIN 2 Slave 9_Defect
  diagnostic event to trouble code uds mapping EventDtcMapLIN2Slave9Defect: diagnostic-event=EventLIN2Slave9Defect, trouble-code-uds=LIN_2_Slave_9_Defect  # Event_Dtc_Map_LIN 2 Slave 9_Defect
  diagnostic event to operation cycle mapping EventOperCycleMapLIN2Slave9Defect: diagnostic-event=EventLIN2Slave9Defect, operation-cycle=DefaultOperationCycle  # Event_Oper_Cycle_Map_LIN 2 Slave 9_Defect
  diagnostic event to debounce algorithm mapping EventDebounceMapLIN2Slave9Defect: debounce-algorithm=counter_based, diagnostic-event=EventLIN2Slave9Defect  # EventDebounceMap_LIN 2 Slave 9_Defect
package /ZeC/DTC/DTC/LIN_2_Slave_1_NoCommunication
  diagnostic trouble code uds LIN_2_Slave_1_NoCommunication: dtc-props=Dtc_Props_358996c7, uds-dtc-value=0x030217  # LIN 2 Slave 1_NoCommunication
  diagnostic event EventLIN2Slave1NoCommunication: aging-allowed=true, event-kind=SWC, prestorage-freeze-frame=false  # Event_LIN 2 Slave 1_NoCommunication
  diagnostic event to trouble code uds mapping EventDtcMapLIN2Slave1NoCommunication: diagnostic-event=EventLIN2Slave1NoCommunication, trouble-code-uds=LIN_2_Slave_1_NoCommunication  # Event_Dtc_Map_LIN 2 Slave 1_NoCommunication
  diagnostic event to operation cycle mapping EventOperCycleMapLIN2Slave1NoCommunication: diagnostic-event=EventLIN2Slave1NoCommunication, operation-cycle=DefaultOperationCycle  # Event_Oper_Cycle_Map_LIN 2 Slave 1_NoCommunication
  diagnostic event to debounce algorithm mapping EventDebounceMapLIN2Slave1NoCommunication: debounce-algorithm=counter_based, diagnostic-event=EventLIN2Slave1NoCommunication  # EventDebounceMap_LIN 2 Slave 1_NoCommunication
package /ZeC/DTC/DTC/LIN_2_Slave_1_Defect
  diagnostic trouble code uds LIN_2_Slave_1_Defect: dtc-props=Dtc_Props_358996c7, uds-dtc-value=0x030216  # LIN 2 Slave 1_Defect
  diagnostic event EventLIN2Slave1Defect: aging-allowed=true, event-kind=SWC, prestorage-freeze-frame=false  # Event_LIN 2 Slave 1_Defect
  diagnostic event to trouble code uds mapping EventDtcMapLIN2Slave1Defect: diagnostic-event=EventLIN2Slave1Defect, trouble-code-uds=LIN_2_Slave_1_Defect  # Event_Dtc_Map_LIN 2 Slave 1_Defect
  diagnostic event to operation cycle mapping EventOperCycleMapLIN2Slave1Defect: diagnostic-event=EventLIN2Slave1Defect, operation-cycle=DefaultOperationCycle  # Event_Oper_Cycle_Map_LIN 2 Slave 1_Defect
  diagnostic event to debounce algorithm mapping EventDebounceMapLIN2Slave1Defect: debounce-algorithm=counter_based, diagnostic-event=EventLIN2Slave1Defect  # EventDebounceMap_LIN 2 Slave 1_Defect
package /ZeC/DTC/DTC/LIN_2_Slave_7_NoCommunication
  diagnostic trouble code uds LIN_2_Slave_7_NoCommunication: dtc-props=Dtc_Props_358996c7, uds-dtc-value=0x030211  # LIN 2 Slave 7_NoCommunication
  diagnostic event EventLIN2Slave7NoCommunication: aging-allowed=true, event-kind=SWC, prestorage-freeze-frame=false  # Event_LIN 2 Slave 7_NoCommunication
  diagnostic event to trouble code uds mapping EventDtcMapLIN2Slave7NoCommunication: diagnostic-event=EventLIN2Slave7NoCommunication, trouble-code-uds=LIN_2_Slave_7_NoCommunication  # Event_Dtc_Map_LIN 2 Slave 7_NoCommunication
  diagnostic event to operation cycle mapping EventOperCycleMapLIN2Slave7NoCommunication: diagnostic-event=EventLIN2Slave7NoCommunication, operation-cycle=DefaultOperationCycle  # Event_Oper_Cycle_Map_LIN 2 Slave 7_NoCommunication
  diagnostic event to debounce algorithm mapping EventDebounceMapLIN2Slave7NoCommunication: debounce-algorithm=counter_based, diagnostic-event=EventLIN2Slave7NoCommunication  # EventDebounceMap_LIN 2 Slave 7_NoCommunication
package /ZeC/DTC/DTC/LIN_2_Slave_7_Defect
  diagnostic trouble code uds LIN_2_Slave_7_Defect: dtc-props=Dtc_Props_358996c7, uds-dtc-value=0x030210  # LIN 2 Slave 7_Defect
  diagnostic event EventLIN2Slave7Defect: aging-allowed=true, event-kind=SWC, prestorage-freeze-frame=false  # Event_LIN 2 Slave 7_Defect
  diagnostic event to trouble code uds mapping EventDtcMapLIN2Slave7Defect: diagnostic-event=EventLIN2Slave7Defect, trouble-code-uds=LIN_2_Slave_7_Defect  # Event_Dtc_Map_LIN 2 Slave 7_Defect
  diagnostic event to operation cycle mapping EventOperCycleMapLIN2Slave7Defect: diagnostic-event=EventLIN2Slave7Defect, operation-cycle=DefaultOperationCycle  # Event_Oper_Cycle_Map_LIN 2 Slave 7_Defect
  diagnostic event to debounce algorithm mapping EventDebounceMapLIN2Slave7Defect: debounce-algorithm=counter_based, diagnostic-event=EventLIN2Slave7Defect  # EventDebounceMap_LIN 2 Slave 7_Defect
package /ZeC/DTC/DTC/Power_Path_127_Short_to_GND_Failure
  diagnostic trouble code uds Power_Path_127_Short_to_GND_Failure: dtc-props=Dtc_Props_6d505da5, uds-dtc-value=0x00527f
  diagnostic event EventPowerPath127ShortToGNDFailure: aging-allowed=true, event-kind=SWC, prestorage-freeze-frame=false  # Event_Power_Path_127_Short_to_GND_Failure
  diagnostic event to trouble code uds mapping EventDtcMapPowerPath127ShortToGNDFailure: diagnostic-event=EventPowerPath127ShortToGNDFailure, trouble-code-uds=Power_Path_127_Short_to_GND_Failure  # Event_Dtc_Map_Power_Path_127_Short_to_GND_Failure
  diagnostic event to operation cycle mapping EventOperCycleMapPowerPath127ShortToGNDFailure: diagnostic-event=EventPowerPath127ShortToGNDFailure, operation-cycle=DefaultOperationCycle  # Event_Oper_Cycle_Map_Power_Path_127_Short_to_GND_Failure
  diagnostic event to debounce algorithm mapping EventDebounceMapPowerPath127ShortToGNDFailure: debounce-algorithm=time_based, diagnostic-event=EventPowerPath127ShortToGNDFailure  # EventDebounceMap_Power_Path_127_Short_to_GND_Failure
package /ZeC/DTC/DTC/LIN_2_Slave_8_NoCommunication
  diagnostic trouble code uds LIN_2_Slave_8_NoCommunication: dtc-props=Dtc_Props_358996c7, uds-dtc-value=0x030213  # LIN 2 Slave 8_NoCommunication
  diagnostic event EventLIN2Slave8NoCommunication: aging-allowed=true, event-kind=SWC, prestorage-freeze-frame=false  # Event_LIN 2 Slave 8_NoCommunication
  diagnostic event to trouble code uds mapping EventDtcMapLIN2Slave8NoCommunication: diagnostic-event=EventLIN2Slave8NoCommunication, trouble-code-uds=LIN_2_Slave_8_NoCommunication  # Event_Dtc_Map_LIN 2 Slave 8_NoCommunication
  diagnostic event to operation cycle mapping EventOperCycleMapLIN2Slave8NoCommunication: diagnostic-event=EventLIN2Slave8NoCommunication, operation-cycle=DefaultOperationCycle  # Event_Oper_Cycle_Map_LIN 2 Slave 8_NoCommunication
  diagnostic event to debounce algorithm mapping EventDebounceMapLIN2Slave8NoCommunication: debounce-algorithm=counter_based, diagnostic-event=EventLIN2Slave8NoCommunication  # EventDebounceMap_LIN 2 Slave 8_NoCommunication
package /ZeC/DTC/DTC/LIN_2_Slave_8_Defect
  diagnostic trouble code uds LIN_2_Slave_8_Defect: dtc-props=Dtc_Props_358996c7, uds-dtc-value=0x030212  # LIN 2 Slave 8_Defect
  diagnostic event EventLIN2Slave8Defect: aging-allowed=true, event-kind=SWC, prestorage-freeze-frame=false  # Event_LIN 2 Slave 8_Defect
  diagnostic event to trouble code uds mapping EventDtcMapLIN2Slave8Defect: diagnostic-event=EventLIN2Slave8Defect, trouble-code-uds=LIN_2_Slave_8_Defect  # Event_Dtc_Map_LIN 2 Slave 8_Defect
  diagnostic event to operation cycle mapping EventOperCycleMapLIN2Slave8Defect: diagnostic-event=EventLIN2Slave8Defect, operation-cycle=DefaultOperationCycle  # Event_Oper_Cycle_Map_LIN 2 Slave 8_Defect
  diagnostic event to debounce algorithm mapping EventDebounceMapLIN2Slave8Defect: debounce-algorithm=counter_based, diagnostic-event=EventLIN2Slave8Defect  # EventDebounceMap_LIN 2 Slave 8_Defect
package /ZeC/DTC/DTC/Power_Path_124_Short_to_GND_Failure
  diagnostic trouble code uds Power_Path_124_Short_to_GND_Failure: dtc-props=Dtc_Props_e85c7936, uds-dtc-value=0x00527c
  diagnostic event EventPowerPath124ShortToGNDFailure: aging-allowed=true, event-kind=SWC, prestorage-freeze-frame=false  # Event_Power_Path_124_Short_to_GND_Failure
  diagnostic event to trouble code uds mapping EventDtcMapPowerPath124ShortToGNDFailure: diagnostic-event=EventPowerPath124ShortToGNDFailure, trouble-code-uds=Power_Path_124_Short_to_GND_Failure  # Event_Dtc_Map_Power_Path_124_Short_to_GND_Failure
  diagnostic event to operation cycle mapping EventOperCycleMapPowerPath124ShortToGNDFailure: diagnostic-event=EventPowerPath124ShortToGNDFailure, operation-cycle=DefaultOperationCycle  # Event_Oper_Cycle_Map_Power_Path_124_Short_to_GND_Failure
  diagnostic event to debounce algorithm mapping EventDebounceMapPowerPath124ShortToGNDFailure: debounce-algorithm=time_based, diagnostic-event=EventPowerPath124ShortToGNDFailure  # EventDebounceMap_Power_Path_124_Short_to_GND_Failure
package /ZeC/DTC/DTC/Power_Path_123_Short_to_GND_Failure
  diagnostic trouble code uds Power_Path_123_Short_to_GND_Failure: dtc-props=Dtc_Props_ae45730c, uds-dtc-value=0x00527b
  diagnostic event EventPowerPath123ShortToGNDFailure: aging-allowed=true, event-kind=SWC, prestorage-freeze-frame=false  # Event_Power_Path_123_Short_to_GND_Failure
  diagnostic event to trouble code uds mapping EventDtcMapPowerPath123ShortToGNDFailure: diagnostic-event=EventPowerPath123ShortToGNDFailure, trouble-code-uds=Power_Path_123_Short_to_GND_Failure  # Event_Dtc_Map_Power_Path_123_Short_to_GND_Failure
  diagnostic event to operation cycle mapping EventOperCycleMapPowerPath123ShortToGNDFailure: diagnostic-event=EventPowerPath123ShortToGNDFailure, operation-cycle=DefaultOperationCycle  # Event_Oper_Cycle_Map_Power_Path_123_Short_to_GND_Failure
  diagnostic event to debounce algorithm mapping EventDebounceMapPowerPath123ShortToGNDFailure: debounce-algorithm=time_based, diagnostic-event=EventPowerPath123ShortToGNDFailure  # EventDebounceMap_Power_Path_123_Short_to_GND_Failure
package /ZeC/DTC/DTC/Power_Path_126_Short_to_GND_Failure
  diagnostic trouble code uds Power_Path_126_Short_to_GND_Failure: dtc-props=Dtc_Props_a77b43eb, uds-dtc-value=0x00527e
  diagnostic event EventPowerPath126ShortToGNDFailure: aging-allowed=true, event-kind=SWC, prestorage-freeze-frame=false  # Event_Power_Path_126_Short_to_GND_Failure
  diagnostic event to trouble code uds mapping EventDtcMapPowerPath126ShortToGNDFailure: diagnostic-event=EventPowerPath126ShortToGNDFailure, trouble-code-uds=Power_Path_126_Short_to_GND_Failure  # Event_Dtc_Map_Power_Path_126_Short_to_GND_Failure
  diagnostic event to operation cycle mapping EventOperCycleMapPowerPath126ShortToGNDFailure: diagnostic-event=EventPowerPath126ShortToGNDFailure, operation-cycle=DefaultOperationCycle  # Event_Oper_Cycle_Map_Power_Path_126_Short_to_GND_Failure
  diagnostic event to debounce algorithm mapping EventDebounceMapPowerPath126ShortToGNDFailure: debounce-algorithm=time_based, diagnostic-event=EventPowerPath126ShortToGNDFailure  # EventDebounceMap_Power_Path_126_Short_to_GND_Failure
package /ZeC/DTC/DTC/Power_Path_125_Short_to_GND_Failure
  diagnostic trouble code uds Power_Path_125_Short_to_GND_Failure: dtc-props=Dtc_Props_e16249d1, uds-dtc-value=0x00527d
  diagnostic event EventPowerPath125ShortToGNDFailure: aging-allowed=true, event-kind=SWC, prestorage-freeze-frame=false  # Event_Power_Path_125_Short_to_GND_Failure
  diagnostic event to trouble code uds mapping EventDtcMapPowerPath125ShortToGNDFailure: diagnostic-event=EventPowerPath125ShortToGNDFailure, trouble-code-uds=Power_Path_125_Short_to_GND_Failure  # Event_Dtc_Map_Power_Path_125_Short_to_GND_Failure
  diagnostic event to operation cycle mapping EventOperCycleMapPowerPath125ShortToGNDFailure: diagnostic-event=EventPowerPath125ShortToGNDFailure, operation-cycle=DefaultOperationCycle  # Event_Oper_Cycle_Map_Power_Path_125_Short_to_GND_Failure
  diagnostic event to debounce algorithm mapping EventDebounceMapPowerPath125ShortToGNDFailure: debounce-algorithm=time_based, diagnostic-event=EventPowerPath125ShortToGNDFailure  # EventDebounceMap_Power_Path_125_Short_to_GND_Failure
package /ZeC/DTC/DTC/Power_Path_128_Short_to_GND_Failure
  diagnostic trouble code uds Power_Path_128_Short_to_GND_Failure: dtc-props=Dtc_Props_a50c506b, uds-dtc-value=0x005280
  diagnostic event EventPowerPath128ShortToGNDFailure: aging-allowed=true, event-kind=SWC, prestorage-freeze-frame=false  # Event_Power_Path_128_Short_to_GND_Failure
  diagnostic event to trouble code uds mapping EventDtcMapPowerPath128ShortToGNDFailure: diagnostic-event=EventPowerPath128ShortToGNDFailure, trouble-code-uds=Power_Path_128_Short_to_GND_Failure  # Event_Dtc_Map_Power_Path_128_Short_to_GND_Failure
  diagnostic event to operation cycle mapping EventOperCycleMapPowerPath128ShortToGNDFailure: diagnostic-event=EventPowerPath128ShortToGNDFailure, operation-cycle=DefaultOperationCycle  # Event_Oper_Cycle_Map_Power_Path_128_Short_to_GND_Failure
  diagnostic event to debounce algorithm mapping EventDebounceMapPowerPath128ShortToGNDFailure: debounce-algorithm=time_based, diagnostic-event=EventPowerPath128ShortToGNDFailure  # EventDebounceMap_Power_Path_128_Short_to_GND_Failure
package /ZeC/DTC/DTC/Power_Path_130_Short_to_GND_Failure
  diagnostic trouble code uds Power_Path_130_Short_to_GND_Failure: dtc-props=Dtc_Props_293e441f, uds-dtc-value=0x005282
  diagnostic event EventPowerPath130ShortToGNDFailure: aging-allowed=true, event-kind=SWC, prestorage-freeze-frame=false  # Event_Power_Path_130_Short_to_GND_Failure
  diagnostic event to trouble code uds mapping EventDtcMapPowerPath130ShortToGNDFailure: diagnostic-event=EventPowerPath130ShortToGNDFailure, trouble-code-uds=Power_Path_130_Short_to_GND_Failure  # Event_Dtc_Map_Power_Path_130_Short_to_GND_Failure
  diagnostic event to operation cycle mapping EventOperCycleMapPowerPath130ShortToGNDFailure: diagnostic-event=EventPowerPath130ShortToGNDFailure, operation-cycle=DefaultOperationCycle  # Event_Oper_Cycle_Map_Power_Path_130_Short_to_GND_Failure
  diagnostic event to debounce algorithm mapping EventDebounceMapPowerPath130ShortToGNDFailure: debounce-algorithm=time_based, diagnostic-event=EventPowerPath130ShortToGNDFailure  # EventDebounceMap_Power_Path_130_Short_to_GND_Failure
package /ZeC/DTC/DTC/Power_Path_129_Short_to_GND_Failure
  diagnostic trouble code uds Power_Path_129_Short_to_GND_Failure: dtc-props=Dtc_Props_e3155a51, uds-dtc-value=0x005281
  diagnostic event EventPowerPath129ShortToGNDFailure: aging-allowed=true, event-kind=SWC, prestorage-freeze-frame=false  # Event_Power_Path_129_Short_to_GND_Failure
  diagnostic event to trouble code uds mapping EventDtcMapPowerPath129ShortToGNDFailure: diagnostic-event=EventPowerPath129ShortToGNDFailure, trouble-code-uds=Power_Path_129_Short_to_GND_Failure  # Event_Dtc_Map_Power_Path_129_Short_to_GND_Failure
  diagnostic event to operation cycle mapping EventOperCycleMapPowerPath129ShortToGNDFailure: diagnostic-event=EventPowerPath129ShortToGNDFailure, operation-cycle=DefaultOperationCycle  # Event_Oper_Cycle_Map_Power_Path_129_Short_to_GND_Failure
  diagnostic event to debounce algorithm mapping EventDebounceMapPowerPath129ShortToGNDFailure: debounce-algorithm=time_based, diagnostic-event=EventPowerPath129ShortToGNDFailure  # EventDebounceMap_Power_Path_129_Short_to_GND_Failure
package /ZeC/DTC/DTC/LIN_2_Slave_13_Defect
  diagnostic trouble code uds LIN_2_Slave_13_Defect: dtc-props=Dtc_Props_358996c7, uds-dtc-value=0x03021e  # LIN 2 Slave 13_Defect
  diagnostic event EventLIN2Slave13Defect: aging-allowed=true, event-kind=SWC, prestorage-freeze-frame=false  # Event_LIN 2 Slave 13_Defect
  diagnostic event to trouble code uds mapping EventDtcMapLIN2Slave13Defect: diagnostic-event=EventLIN2Slave13Defect, trouble-code-uds=LIN_2_Slave_13_Defect  # Event_Dtc_Map_LIN 2 Slave 13_Defect
  diagnostic event to operation cycle mapping EventOperCycleMapLIN2Slave13Defect: diagnostic-event=EventLIN2Slave13Defect, operation-cycle=DefaultOperationCycle  # Event_Oper_Cycle_Map_LIN 2 Slave 13_Defect
  diagnostic event to debounce algorithm mapping EventDebounceMapLIN2Slave13Defect: debounce-algorithm=counter_based, diagnostic-event=EventLIN2Slave13Defect  # EventDebounceMap_LIN 2 Slave 13_Defect
package /ZeC/DTC/DTC/LIN_2_Slave_12_NoCommunication
  diagnostic trouble code uds LIN_2_Slave_12_NoCommunication: dtc-props=Dtc_Props_358996c7, uds-dtc-value=0x03021d  # LIN 2 Slave 12_NoCommunication
  diagnostic event EventLIN2Slave12NoCommunication: aging-allowed=true, event-kind=SWC, prestorage-freeze-frame=false  # Event_LIN 2 Slave 12_NoCommunication
  diagnostic event to trouble code uds mapping EventDtcMapLIN2Slave12NoCommunication: diagnostic-event=EventLIN2Slave12NoCommunication, trouble-code-uds=LIN_2_Slave_12_NoCommunication  # Event_Dtc_Map_LIN 2 Slave 12_NoCommunication
  diagnostic event to operation cycle mapping EventOperCycleMapLIN2Slave12NoCommunication: diagnostic-event=EventLIN2Slave12NoCommunication, operation-cycle=DefaultOperationCycle  # Event_Oper_Cycle_Map_LIN 2 Slave 12_NoCommunication
  diagnostic event to debounce algorithm mapping EventDebounceMapLIN2Slave12NoCommunication: debounce-algorithm=counter_based, diagnostic-event=EventLIN2Slave12NoCommunication  # EventDebounceMap_LIN 2 Slave 12_NoCommunication
package /ZeC/DTC/DTC/LIN_2_Slave_11_Defect
  diagnostic trouble code uds LIN_2_Slave_11_Defect: dtc-props=Dtc_Props_358996c7, uds-dtc-value=0x03021a  # LIN 2 Slave 11_Defect
  diagnostic event EventLIN2Slave11Defect: aging-allowed=true, event-kind=SWC, prestorage-freeze-frame=false  # Event_LIN 2 Slave 11_Defect
  diagnostic event to trouble code uds mapping EventDtcMapLIN2Slave11Defect: diagnostic-event=EventLIN2Slave11Defect, trouble-code-uds=LIN_2_Slave_11_Defect  # Event_Dtc_Map_LIN 2 Slave 11_Defect
  diagnostic event to operation cycle mapping EventOperCycleMapLIN2Slave11Defect: diagnostic-event=EventLIN2Slave11Defect, operation-cycle=DefaultOperationCycle  # Event_Oper_Cycle_Map_LIN 2 Slave 11_Defect
  diagnostic event to debounce algorithm mapping EventDebounceMapLIN2Slave11Defect: debounce-algorithm=counter_based, diagnostic-event=EventLIN2Slave11Defect  # EventDebounceMap_LIN 2 Slave 11_Defect
package /ZeC/DTC/DTC/Power_Path_136_Short_to_GND_Failure
  diagnostic trouble code uds Power_Path_136_Short_to_GND_Failure: dtc-props=Dtc_Props_f8570b78, uds-dtc-value=0x005288
  diagnostic event EventPowerPath136ShortToGNDFailure: aging-allowed=true, event-kind=SWC, prestorage-freeze-frame=false  # Event_Power_Path_136_Short_to_GND_Failure
  diagnostic event to trouble code uds mapping EventDtcMapPowerPath136ShortToGNDFailure: diagnostic-event=EventPowerPath136ShortToGNDFailure, trouble-code-uds=Power_Path_136_Short_to_GND_Failure  # Event_Dtc_Map_Power_Path_136_Short_to_GND_Failure
  diagnostic event to operation cycle mapping EventOperCycleMapPowerPath136ShortToGNDFailure: diagnostic-event=EventPowerPath136ShortToGNDFailure, operation-cycle=DefaultOperationCycle  # Event_Oper_Cycle_Map_Power_Path_136_Short_to_GND_Failure
  diagnostic event to debounce algorithm mapping EventDebounceMapPowerPath136ShortToGNDFailure: debounce-algorithm=time_based, diagnostic-event=EventPowerPath136ShortToGNDFailure  # EventDebounceMap_Power_Path_136_Short_to_GND_Failure
package /ZeC/DTC/DTC/Power_Path_135_Short_to_GND_Failure
  diagnostic trouble code uds Power_Path_135_Short_to_GND_Failure: dtc-props=Dtc_Props_ac32608c, uds-dtc-value=0x005287
  diagnostic event EventPowerPath135ShortToGNDFailure: aging-allowed=true, event-kind=SWC, prestorage-freeze-frame=false  # Event_Power_Path_135_Short_to_GND_Failure
  diagnostic event to trouble code uds mapping EventDtcMapPowerPath135ShortToGNDFailure: diagnostic-event=EventPowerPath135ShortToGNDFailure, trouble-code-uds=Power_Path_135_Short_to_GND_Failure  # Event_Dtc_Map_Power_Path_135_Short_to_GND_Failure
  diagnostic event to operation cycle mapping EventOperCycleMapPowerPath135ShortToGNDFailure: diagnostic-event=EventPowerPath135ShortToGNDFailure, operation-cycle=DefaultOperationCycle  # Event_Oper_Cycle_Map_Power_Path_135_Short_to_GND_Failure
  diagnostic event to debounce algorithm mapping EventDebounceMapPowerPath135ShortToGNDFailure: debounce-algorithm=time_based, diagnostic-event=EventPowerPath135ShortToGNDFailure  # EventDebounceMap_Power_Path_135_Short_to_GND_Failure
package /ZeC/DTC/DTC/LIN_2_Slave_12_Defect
  diagnostic trouble code uds LIN_2_Slave_12_Defect: dtc-props=Dtc_Props_358996c7, uds-dtc-value=0x03021c  # LIN 2 Slave 12_Defect
  diagnostic event EventLIN2Slave12Defect: aging-allowed=true, event-kind=SWC, prestorage-freeze-frame=false  # Event_LIN 2 Slave 12_Defect
  diagnostic event to trouble code uds mapping EventDtcMapLIN2Slave12Defect: diagnostic-event=EventLIN2Slave12Defect, trouble-code-uds=LIN_2_Slave_12_Defect  # Event_Dtc_Map_LIN 2 Slave 12_Defect
  diagnostic event to operation cycle mapping EventOperCycleMapLIN2Slave12Defect: diagnostic-event=EventLIN2Slave12Defect, operation-cycle=DefaultOperationCycle  # Event_Oper_Cycle_Map_LIN 2 Slave 12_Defect
  diagnostic event to debounce algorithm mapping EventDebounceMapLIN2Slave12Defect: debounce-algorithm=counter_based, diagnostic-event=EventLIN2Slave12Defect  # EventDebounceMap_LIN 2 Slave 12_Defect
package /ZeC/DTC/DTC/LIN_2_Slave_11_NoCommunication
  diagnostic trouble code uds LIN_2_Slave_11_NoCommunication: dtc-props=Dtc_Props_358996c7, uds-dtc-value=0x03021b  # LIN 2 Slave 11_NoCommunication
  diagnostic event EventLIN2Slave11NoCommunication: aging-allowed=true, event-kind=SWC, prestorage-freeze-frame=false  # Event_LIN 2 Slave 11_NoCommunication
  diagnostic event to trouble code uds mapping EventDtcMapLIN2Slave11NoCommunication: diagnostic-event=EventLIN2Slave11NoCommunication, trouble-code-uds=LIN_2_Slave_11_NoCommunication  # Event_Dtc_Map_LIN 2 Slave 11_NoCommunication
  diagnostic event to operation cycle mapping EventOperCycleMapLIN2Slave11NoCommunication: diagnostic-event=EventLIN2Slave11NoCommunication, operation-cycle=DefaultOperationCycle  # Event_Oper_Cycle_Map_LIN 2 Slave 11_NoCommunication
  diagnostic event to debounce algorithm mapping EventDebounceMapLIN2Slave11NoCommunication: debounce-algorithm=counter_based, diagnostic-event=EventLIN2Slave11NoCommunication  # EventDebounceMap_LIN 2 Slave 11_NoCommunication
package /ZeC/DTC/DTC/Power_Path_137_Short_to_GND_Failure
  diagnostic trouble code uds Power_Path_137_Short_to_GND_Failure: dtc-props=Dtc_Props_be4e0142, uds-dtc-value=0x005289
  diagnostic event EventPowerPath137ShortToGNDFailure: aging-allowed=true, event-kind=SWC, prestorage-freeze-frame=false  # Event_Power_Path_137_Short_to_GND_Failure
  diagnostic event to trouble code uds mapping EventDtcMapPowerPath137ShortToGNDFailure: diagnostic-event=EventPowerPath137ShortToGNDFailure, trouble-code-uds=Power_Path_137_Short_to_GND_Failure  # Event_Dtc_Map_Power_Path_137_Short_to_GND_Failure
  diagnostic event to operation cycle mapping EventOperCycleMapPowerPath137ShortToGNDFailure: diagnostic-event=EventPowerPath137ShortToGNDFailure, operation-cycle=DefaultOperationCycle  # Event_Oper_Cycle_Map_Power_Path_137_Short_to_GND_Failure
  diagnostic event to debounce algorithm mapping EventDebounceMapPowerPath137ShortToGNDFailure: debounce-algorithm=time_based, diagnostic-event=EventPowerPath137ShortToGNDFailure  # EventDebounceMap_Power_Path_137_Short_to_GND_Failure
package /ZeC/DTC/DTC/Power_Path_132_Short_to_GND_Failure
  diagnostic trouble code uds Power_Path_132_Short_to_GND_Failure: dtc-props=Dtc_Props_66197ec2, uds-dtc-value=0x005284
  diagnostic event EventPowerPath132ShortToGNDFailure: aging-allowed=true, event-kind=SWC, prestorage-freeze-frame=false  # Event_Power_Path_132_Short_to_GND_Failure
  diagnostic event to trouble code uds mapping EventDtcMapPowerPath132ShortToGNDFailure: diagnostic-event=EventPowerPath132ShortToGNDFailure, trouble-code-uds=Power_Path_132_Short_to_GND_Failure  # Event_Dtc_Map_Power_Path_132_Short_to_GND_Failure
  diagnostic event to operation cycle mapping EventOperCycleMapPowerPath132ShortToGNDFailure: diagnostic-event=EventPowerPath132ShortToGNDFailure, operation-cycle=DefaultOperationCycle  # Event_Oper_Cycle_Map_Power_Path_132_Short_to_GND_Failure
  diagnostic event to debounce algorithm mapping EventDebounceMapPowerPath132ShortToGNDFailure: debounce-algorithm=time_based, diagnostic-event=EventPowerPath132ShortToGNDFailure  # EventDebounceMap_Power_Path_132_Short_to_GND_Failure
package /ZeC/DTC/DTC/Power_Path_131_Short_to_GND_Failure
  diagnostic trouble code uds Power_Path_131_Short_to_GND_Failure: dtc-props=Dtc_Props_6f274e25, uds-dtc-value=0x005283
  diagnostic event EventPowerPath131ShortToGNDFailure: aging-allowed=true, event-kind=SWC, prestorage-freeze-frame=false  # Event_Power_Path_131_Short_to_GND_Failure
  diagnostic event to trouble code uds mapping EventDtcMapPowerPath131ShortToGNDFailure: diagnostic-event=EventPowerPath131ShortToGNDFailure, trouble-code-uds=Power_Path_131_Short_to_GND_Failure  # Event_Dtc_Map_Power_Path_131_Short_to_GND_Failure
  diagnostic event to operation cycle mapping EventOperCycleMapPowerPath131ShortToGNDFailure: diagnostic-event=EventPowerPath131ShortToGNDFailure, operation-cycle=DefaultOperationCycle  # Event_Oper_Cycle_Map_Power_Path_131_Short_to_GND_Failure
  diagnostic event to debounce algorithm mapping EventDebounceMapPowerPath131ShortToGNDFailure: debounce-algorithm=time_based, diagnostic-event=EventPowerPath131ShortToGNDFailure  # EventDebounceMap_Power_Path_131_Short_to_GND_Failure
package /ZeC/DTC/DTC/Power_Path_134_Short_to_GND_Failure
  diagnostic trouble code uds Power_Path_134_Short_to_GND_Failure: dtc-props=Dtc_Props_ea2b6ab6, uds-dtc-value=0x005286
  diagnostic event EventPowerPath134ShortToGNDFailure: aging-allowed=true, event-kind=SWC, prestorage-freeze-frame=false  # Event_Power_Path_134_Short_to_GND_Failure
  diagnostic event to trouble code uds mapping EventDtcMapPowerPath134ShortToGNDFailure: diagnostic-event=EventPowerPath134ShortToGNDFailure, trouble-code-uds=Power_Path_134_Short_to_GND_Failure  # Event_Dtc_Map_Power_Path_134_Short_to_GND_Failure
  diagnostic event to operation cycle mapping EventOperCycleMapPowerPath134ShortToGNDFailure: diagnostic-event=EventPowerPath134ShortToGNDFailure, operation-cycle=DefaultOperationCycle  # Event_Oper_Cycle_Map_Power_Path_134_Short_to_GND_Failure
  diagnostic event to debounce algorithm mapping EventDebounceMapPowerPath134ShortToGNDFailure: debounce-algorithm=time_based, diagnostic-event=EventPowerPath134ShortToGNDFailure  # EventDebounceMap_Power_Path_134_Short_to_GND_Failure
package /ZeC/DTC/DTC/Power_Path_133_Short_to_GND_Failure
  diagnostic trouble code uds Power_Path_133_Short_to_GND_Failure: dtc-props=Dtc_Props_200074f8, uds-dtc-value=0x005285
  diagnostic event EventPowerPath133ShortToGNDFailure: aging-allowed=true, event-kind=SWC, prestorage-freeze-frame=false  # Event_Power_Path_133_Short_to_GND_Failure
  diagnostic event to trouble code uds mapping EventDtcMapPowerPath133ShortToGNDFailure: diagnostic-event=EventPowerPath133ShortToGNDFailure, trouble-code-uds=Power_Path_133_Short_to_GND_Failure  # Event_Dtc_Map_Power_Path_133_Short_to_GND_Failure
  diagnostic event to operation cycle mapping EventOperCycleMapPowerPath133ShortToGNDFailure: diagnostic-event=EventPowerPath133ShortToGNDFailure, operation-cycle=DefaultOperationCycle  # Event_Oper_Cycle_Map_Power_Path_133_Short_to_GND_Failure
  diagnostic event to debounce algorithm mapping EventDebounceMapPowerPath133ShortToGNDFailure: debounce-algorithm=time_based, diagnostic-event=EventPowerPath133ShortToGNDFailure  # EventDebounceMap_Power_Path_133_Short_to_GND_Failure
package /ZeC/DTC/DTC/Power_Path_160_Short_to_GND_Failure
  diagnostic trouble code uds Power_Path_160_Short_to_GND_Failure: dtc-props=Dtc_Props_c92c78b3, uds-dtc-value=0x0052a0
  diagnostic event EventPowerPath160ShortToGNDFailure: aging-allowed=true, event-kind=SWC, prestorage-freeze-frame=false  # Event_Power_Path_160_Short_to_GND_Failure
  diagnostic event to trouble code uds mapping EventDtcMapPowerPath160ShortToGNDFailure: diagnostic-event=EventPowerPath160ShortToGNDFailure, trouble-code-uds=Power_Path_160_Short_to_GND_Failure  # Event_Dtc_Map_Power_Path_160_Short_to_GND_Failure
  diagnostic event to operation cycle mapping EventOperCycleMapPowerPath160ShortToGNDFailure: diagnostic-event=EventPowerPath160ShortToGNDFailure, operation-cycle=DefaultOperationCycle  # Event_Oper_Cycle_Map_Power_Path_160_Short_to_GND_Failure
  diagnostic event to debounce algorithm mapping EventDebounceMapPowerPath160ShortToGNDFailure: debounce-algorithm=time_based, diagnostic-event=EventPowerPath160ShortToGNDFailure  # EventDebounceMap_Power_Path_160_Short_to_GND_Failure
package /ZeC/DTC/DTC/CAN_10_ECU_5_No_Communication
  diagnostic trouble code uds CAN_10_ECU_5_No_Communication: dtc-props=Dtc_Props_14158306, uds-dtc-value=0x032a09
  diagnostic event EventCAN10ECU5NoCommunication: aging-allowed=true, event-kind=SWC, prestorage-freeze-frame=false  # Event_CAN_10_ECU_5_No_Communication
  diagnostic event to trouble code uds mapping EventDtcMapCAN10ECU5NoCommunication: diagnostic-event=EventCAN10ECU5NoCommunication, trouble-code-uds=CAN_10_ECU_5_No_Communication  # Event_Dtc_Map_CAN_10_ECU_5_No_Communication
  diagnostic event to operation cycle mapping EventOperCycleMapCAN10ECU5NoCommunication: diagnostic-event=EventCAN10ECU5NoCommunication, operation-cycle=DefaultOperationCycle  # Event_Oper_Cycle_Map_CAN_10_ECU_5_No_Communication
  diagnostic event to debounce algorithm mapping EventDebounceMapCAN10ECU5NoCommunication: debounce-algorithm=counter_based, diagnostic-event=EventCAN10ECU5NoCommunication  # EventDebounceMap_CAN_10_ECU_5_No_Communication
package /ZeC/DTC/DTC/CAN_10_ECU_4_No_Communication
  diagnostic trouble code uds CAN_10_ECU_4_No_Communication: dtc-props=Dtc_Props_14158306, uds-dtc-value=0x032a08
  diagnostic event EventCAN10ECU4NoCommunication: aging-allowed=true, event-kind=SWC, prestorage-freeze-frame=false  # Event_CAN_10_ECU_4_No_Communication
  diagnostic event to trouble code uds mapping EventDtcMapCAN10ECU4NoCommunication: diagnostic-event=EventCAN10ECU4NoCommunication, trouble-code-uds=CAN_10_ECU_4_No_Communication  # Event_Dtc_Map_CAN_10_ECU_4_No_Communication
  diagnostic event to operation cycle mapping EventOperCycleMapCAN10ECU4NoCommunication: diagnostic-event=EventCAN10ECU4NoCommunication, operation-cycle=DefaultOperationCycle  # Event_Oper_Cycle_Map_CAN_10_ECU_4_No_Communication
  diagnostic event to debounce algorithm mapping EventDebounceMapCAN10ECU4NoCommunication: debounce-algorithm=counter_based, diagnostic-event=EventCAN10ECU4NoCommunication  # EventDebounceMap_CAN_10_ECU_4_No_Communication
package /ZeC/DTC/DTC/CAN_10_ECU_3_No_Communication
  diagnostic trouble code uds CAN_10_ECU_3_No_Communication: dtc-props=Dtc_Props_14158306, uds-dtc-value=0x032a07
  diagnostic event EventCAN10ECU3NoCommunication: aging-allowed=true, event-kind=SWC, prestorage-freeze-frame=false  # Event_CAN_10_ECU_3_No_Communication
  diagnostic event to trouble code uds mapping EventDtcMapCAN10ECU3NoCommunication: diagnostic-event=EventCAN10ECU3NoCommunication, trouble-code-uds=CAN_10_ECU_3_No_Communication  # Event_Dtc_Map_CAN_10_ECU_3_No_Communication
  diagnostic event to operation cycle mapping EventOperCycleMapCAN10ECU3NoCommunication: diagnostic-event=EventCAN10ECU3NoCommunication, operation-cycle=DefaultOperationCycle  # Event_Oper_Cycle_Map_CAN_10_ECU_3_No_Communication
  diagnostic event to debounce algorithm mapping EventDebounceMapCAN10ECU3NoCommunication: debounce-algorithm=counter_based, diagnostic-event=EventCAN10ECU3NoCommunication  # EventDebounceMap_CAN_10_ECU_3_No_Communication
package /ZeC/DTC/DTC/CAN_10_ECU_2_No_Communication
  diagnostic trouble code uds CAN_10_ECU_2_No_Communication: dtc-props=Dtc_Props_14158306, uds-dtc-value=0x032a06
  diagnostic event EventCAN10ECU2NoCommunication: aging-allowed=true, event-kind=SWC, prestorage-freeze-frame=false  # Event_CAN_10_ECU_2_No_Communication
  diagnostic event to trouble code uds mapping EventDtcMapCAN10ECU2NoCommunication: diagnostic-event=EventCAN10ECU2NoCommunication, trouble-code-uds=CAN_10_ECU_2_No_Communication  # Event_Dtc_Map_CAN_10_ECU_2_No_Communication
  diagnostic event to operation cycle mapping EventOperCycleMapCAN10ECU2NoCommunication: diagnostic-event=EventCAN10ECU2NoCommunication, operation-cycle=DefaultOperationCycle  # Event_Oper_Cycle_Map_CAN_10_ECU_2_No_Communication
  diagnostic event to debounce algorithm mapping EventDebounceMapCAN10ECU2NoCommunication: debounce-algorithm=counter_based, diagnostic-event=EventCAN10ECU2NoCommunication  # EventDebounceMap_CAN_10_ECU_2_No_Communication
package /ZeC/DTC/DTC/CAN_10_ECU_1_No_Communication
  diagnostic trouble code uds CAN_10_ECU_1_No_Communication: dtc-props=Dtc_Props_14158306, uds-dtc-value=0x032a05
  diagnostic event EventCAN10ECU1NoCommunication: aging-allowed=true, event-kind=SWC, prestorage-freeze-frame=false  # Event_CAN_10_ECU_1_No_Communication
  diagnostic event to trouble code uds mapping EventDtcMapCAN10ECU1NoCommunication: diagnostic-event=EventCAN10ECU1NoCommunication, trouble-code-uds=CAN_10_ECU_1_No_Communication  # Event_Dtc_Map_CAN_10_ECU_1_No_Communication
  diagnostic event to operation cycle mapping EventOperCycleMapCAN10ECU1NoCommunication: diagnostic-event=EventCAN10ECU1NoCommunication, operation-cycle=DefaultOperationCycle  # Event_Oper_Cycle_Map_CAN_10_ECU_1_No_Communication
  diagnostic event to debounce algorithm mapping EventDebounceMapCAN10ECU1NoCommunication: debounce-algorithm=counter_based, diagnostic-event=EventCAN10ECU1NoCommunication  # EventDebounceMap_CAN_10_ECU_1_No_Communication
package /ZeC/DTC/DTC/DB_CANFD_10_Error_Received_Value
  diagnostic trouble code uds DB_CANFD_10_Error_Received_Value: dtc-props=Dtc_Props_b618fb9, uds-dtc-value=0x032a04
  diagnostic event EventDBCANFD10ErrorReceivedValue: aging-allowed=true, event-kind=SWC, prestorage-freeze-frame=false  # Event_DB_CANFD_10_Error_Received_Value
  diagnostic event to trouble code uds mapping EventDtcMapDBCANFD10ErrorReceivedValue: diagnostic-event=EventDBCANFD10ErrorReceivedValue, trouble-code-uds=DB_CANFD_10_Error_Received_Value  # Event_Dtc_Map_DB_CANFD_10_Error_Received_Value
  diagnostic event to operation cycle mapping EventOperCycleMapDBCANFD10ErrorReceivedValue: diagnostic-event=EventDBCANFD10ErrorReceivedValue, operation-cycle=DefaultOperationCycle  # Event_Oper_Cycle_Map_DB_CANFD_10_Error_Received_Value
  diagnostic event to debounce algorithm mapping EventDebounceMapDBCANFD10ErrorReceivedValue: debounce-algorithm=counter_based, diagnostic-event=EventDBCANFD10ErrorReceivedValue  # EventDebounceMap_DB_CANFD_10_Error_Received_Value
package /ZeC/DTC/DTC/DB_CANFD_10_Single_Wire_Mode
  diagnostic trouble code uds DB_CANFD_10_Single_Wire_Mode: dtc-props=Dtc_Props_14158306, uds-dtc-value=0x032a03
  diagnostic event EventDBCANFD10SingleWireMode: aging-allowed=true, event-kind=SWC, prestorage-freeze-frame=false  # Event_DB_CANFD_10_Single_Wire_Mode
  diagnostic event to trouble code uds mapping EventDtcMapDBCANFD10SingleWireMode: diagnostic-event=EventDBCANFD10SingleWireMode, trouble-code-uds=DB_CANFD_10_Single_Wire_Mode  # Event_Dtc_Map_DB_CANFD_10_Single_Wire_Mode
  diagnostic event to operation cycle mapping EventOperCycleMapDBCANFD10SingleWireMode: diagnostic-event=EventDBCANFD10SingleWireMode, operation-cycle=DefaultOperationCycle  # Event_Oper_Cycle_Map_DB_CANFD_10_Single_Wire_Mode
  diagnostic event to debounce algorithm mapping EventDebounceMapDBCANFD10SingleWireMode: debounce-algorithm=counter_based, diagnostic-event=EventDBCANFD10SingleWireMode  # EventDebounceMap_DB_CANFD_10_Single_Wire_Mode
