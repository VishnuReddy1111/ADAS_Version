[part 16 of 19: packages /ZeC/DTC/DTC/Power_Path_146_Single_Device_Failure to /ZeC/DTC/DTC/Power_Path_136_Over_Load_Failure]
AUTOSAR XML (schema 00047)
package /ZeC/DTC/DTC/Power_Path_146_Single_Device_Failure
  diagnostic trouble code uds Power_Path_146_Single_Device_Failure: dtc-props=Dtc_Props_ef7484a7, uds-dtc-value=0x005992
  diagnostic event EventPowerPath146SingleDeviceFailure: aging-allowed=true, event-kind=SWC, prestorage-freeze-frame=false  # Event_Power_Path_146_Single_Device_Failure
  diagnostic event to trouble code uds mapping EventDtcMapPowerPath146SingleDeviceFailure: diagnostic-event=EventPowerPath146SingleDeviceFailure, trouble-code-uds=Power_Path_146_Single_Device_Failure  # Event_Dtc_Map_Power_Path_146_Single_Device_Failure
  diagnostic event to operation cycle mapping EventOperCycleMapPowerPath146SingleDeviceFailure: diagnostic-event=EventPowerPath146SingleDeviceFailure, operation-cycle=DefaultOperationCycle  # Event_Oper_Cycle_Map_Power_Path_146_Single_Device_Failure
  diagnostic event to debounce algorithm mapping EventDebounceMapPowerPath146SingleDeviceFailure: debounce-algorithm=time_based, diagnostic-event=EventPowerPath146SingleDeviceFailure  # EventDebounceMap_Power_Path_146_Single_Device_Failure
package /ZeC/DTC/DTC/Power_Path_145_Single_Device_Failure
  diagnostic trouble code uds Power_Path_145_Single_Device_Failure: dtc-props=Dtc_Props_255f9ae9, uds-dtc-value=0x005991
  diagnostic event EventPowerPath145SingleDeviceFailure: aging-allowed=true, event-kind=SWC, prestorage-freeze-frame=false  # Event_Power_Path_145_Single_Device_Failure
  diagnostic event to trouble code uds mapping EventDtcMapPowerPath145SingleDeviceFailure: diagnostic-event=EventPowerPath145SingleDeviceFailure, trouble-code-uds=Power_Path_145_Single_Device_Failure  # Event_Dtc_Map_Power_Path_145_Single_Device_Failure
  diagnostic event to operation cycle mapping EventOperCycleMapPowerPath145SingleDeviceFailure: diagnostic-event=EventPowerPath145SingleDeviceFailure, operation-cycle=DefaultOperationCycle  # Event_Oper_Cycle_Map_Power_Path_145_Single_Device_Failure
  diagnostic event to debounce algorithm mapping EventDebounceMapPowerPath145SingleDeviceFailure: debounce-algorithm=time_based, diagnostic-event=EventPowerPath145SingleDeviceFailure  # EventDebounceMap_Power_Path_145_Single_Device_Failure
package /ZeC/DTC/DTC/Power_Path_148_Single_Device_Failure
  diagnostic trouble code uds Power_Path_148_Single_Device_Failure: dtc-props=Dtc_Props_a053be7a, uds-dtc-value=0x005994
  diagnostic event EventPowerPath148SingleDeviceFailure: aging-allowed=true, event-kind=SWC, prestorage-freeze-frame=false  # Event_Power_Path_148_Single_Device_Failure
  diagnostic event to trouble code uds mapping EventDtcMapPowerPath148SingleDeviceFailure: diagnostic-event=EventPowerPath148SingleDeviceFailure, trouble-code-uds=Power_Path_148_Single_Device_Failure  # Event_Dtc_Map_Power_Path_148_Single_Device_Failure
  diagnostic event to operation cycle mapping EventOperCycleMapPowerPath148SingleDeviceFailure: diagnostic-event=EventPowerPath148SingleDeviceFailure, operation-cycle=DefaultOperationCycle  # Event_Oper_Cycle_Map_Power_Path_148_Single_Device_Failure
  diagnostic event to debounce algorithm mapping EventDebounceMapPowerPath148SingleDeviceFailure: debounce-algorithm=time_based, diagnostic-event=EventPowerPath148SingleDeviceFailure  # EventDebounceMap_Power_Path_148_Single_Device_Failure
package /ZeC/DTC/DTC/Power_Path_016_Over_Load_Failure
  diagnostic trouble code uds Power_Path_016_Over_Load_Failure: dtc-props=Dtc_Props_e7a58a56, uds-dtc-value=0x005510
  diagnostic event EventPowerPath016OverLoadFailure: aging-allowed=true, event-kind=SWC, prestorage-freeze-frame=false  # Event_Power_Path_016_Over_Load_Failure
  diagnostic event to trouble code uds mapping EventDtcMapPowerPath016OverLoadFailure: diagnostic-event=EventPowerPath016OverLoadFailure, trouble-code-uds=Power_Path_016_Over_Load_Failure  # Event_Dtc_Map_Power_Path_016_Over_Load_Failure
  diagnostic event to operation cycle mapping EventOperCycleMapPowerPath016OverLoadFailure: diagnostic-event=EventPowerPath016OverLoadFailure, operation-cycle=DefaultOperationCycle  # Event_Oper_Cycle_Map_Power_Path_016_Over_Load_Failure
  diagnostic event to debounce algorithm mapping EventDebounceMapPowerPath016OverLoadFailure: debounce-algorithm=time_based, diagnostic-event=EventPowerPath016OverLoadFailure  # EventDebounceMap_Power_Path_016_Over_Load_Failure
package /ZeC/DTC/DTC/Power_Path_147_Single_Device_Failure
  diagnostic trouble code uds Power_Path_147_Single_Device_Failure: dtc-props=Dtc_Props_a96d8e9d, uds-dtc-value=0x005993
  diagnostic event EventPowerPath147SingleDeviceFailure: aging-allowed=true, event-kind=SWC, prestorage-freeze-frame=false  # Event_Power_Path_147_Single_Device_Failure
  diagnostic event to trouble code uds mapping EventDtcMapPowerPath147SingleDeviceFailure: diagnostic-event=EventPowerPath147SingleDeviceFailure, trouble-code-uds=Power_Path_147_Single_Device_Failure  # Event_Dtc_Map_Power_Path_147_Single_Device_Failure
  diagnostic event to operation cycle mapping EventOperCycleMapPowerPath147SingleDeviceFailure: diagnostic-event=EventPowerPath147SingleDeviceFailure, operation-cycle=DefaultOperationCycle  # Event_Oper_Cycle_Map_Power_Path_147_Single_Device_Failure
  diagnostic event to debounce algorithm mapping EventDebounceMapPowerPath147SingleDeviceFailure: debounce-algorithm=time_based, diagnostic-event=EventPowerPath147SingleDeviceFailure  # EventDebounceMap_Power_Path_147_Single_Device_Failure
package /ZeC/DTC/DTC/Power_Path_144_Single_Device_Failure
  diagnostic trouble code uds Power_Path_144_Single_Device_Failure: dtc-props=Dtc_Props_634690d3, uds-dtc-value=0x005990
  diagnostic event EventPowerPath144SingleDeviceFailure: aging-allowed=true, event-kind=SWC, prestorage-freeze-frame=false  # Event_Power_Path_144_Single_Device_Failure
  diagnostic event to trouble code uds mapping EventDtcMapPowerPath144SingleDeviceFailure: diagnostic-event=EventPowerPath144SingleDeviceFailure, trouble-code-uds=Power_Path_144_Single_Device_Failure  # Event_Dtc_Map_Power_Path_144_Single_Device_Failure
  diagnostic event to operation cycle mapping EventOperCycleMapPowerPath144SingleDeviceFailure: diagnostic-event=EventPowerPath144SingleDeviceFailure, operation-cycle=DefaultOperationCycle  # Event_Oper_Cycle_Map_Power_Path_144_Single_Device_Failure
  diagnostic event to debounce algorithm mapping EventDebounceMapPowerPath144SingleDeviceFailure: debounce-algorithm=time_based, diagnostic-event=EventPowerPath144SingleDeviceFailure  # EventDebounceMap_Power_Path_144_Single_Device_Failure
package /ZeC/DTC/DTC/LIN_23_Slave_4_Defect
  diagnostic trouble code uds LIN_23_Slave_4_Defect: dtc-props=Dtc_Props_358996c7, uds-dtc-value=0x031804  # LIN 23 Slave 4_Defect
  diagnostic event EventLIN23Slave4Defect: aging-allowed=true, event-kind=SWC, prestorage-freeze-frame=false  # Event_LIN 23 Slave 4_Defect
  diagnostic event to trouble code uds mapping EventDtcMapLIN23Slave4Defect: diagnostic-event=EventLIN23Slave4Defect, trouble-code-uds=LIN_23_Slave_4_Defect  # Event_Dtc_Map_LIN 23 Slave 4_Defect
  diagnostic event to operation cycle mapping EventOperCycleMapLIN23Slave4Defect: diagnostic-event=EventLIN23Slave4Defect, operation-cycle=DefaultOperationCycle  # Event_Oper_Cycle_Map_LIN 23 Slave 4_Defect
  diagnostic event to debounce algorithm mapping EventDebounceMapLIN23Slave4Defect: debounce-algorithm=counter_based, diagnostic-event=EventLIN23Slave4Defect  # EventDebounceMap_LIN 23 Slave 4_Defect
package /ZeC/DTC/DTC/Power_Path_120_Single_Device_Failure
  diagnostic trouble code uds Power_Path_120_Single_Device_Failure: dtc-props=Dtc_Props_42d35816, uds-dtc-value=0x005978
  diagnostic event EventPowerPath120SingleDeviceFailure: aging-allowed=true, event-kind=SWC, prestorage-freeze-frame=false  # Event_Power_Path_120_Single_Device_Failure
  diagnostic event to trouble code uds mapping EventDtcMapPowerPath120SingleDeviceFailure: diagnostic-event=EventPowerPath120SingleDeviceFailure, trouble-code-uds=Power_Path_120_Single_Device_Failure  # Event_Dtc_Map_Power_Path_120_Single_Device_Failure
  diagnostic event to operation cycle mapping EventOperCycleMapPowerPath120SingleDeviceFailure: diagnostic-event=EventPowerPath120SingleDeviceFailure, operation-cycle=DefaultOperationCycle  # Event_Oper_Cycle_Map_Power_Path_120_Single_Device_Failure
  diagnostic event to debounce algorithm mapping EventDebounceMapPowerPath120SingleDeviceFailure: debounce-algorithm=time_based, diagnostic-event=EventPowerPath120SingleDeviceFailure  # EventDebounceMap_Power_Path_120_Single_Device_Failure
package /ZeC/DTC/DTC/LIN_23_Slave_4_NoCommunication
  diagnostic trouble code uds LIN_23_Slave_4_NoCommunication: dtc-props=Dtc_Props_358996c7, uds-dtc-value=0x031805  # LIN 23 Slave 4_NoCommunication
  diagnostic event EventLIN23Slave4NoCommunication: aging-allowed=true, event-kind=SWC, prestorage-freeze-frame=false  # Event_LIN 23 Slave 4_NoCommunication
  diagnostic event to trouble code uds mapping EventDtcMapLIN23Slave4NoCommunication: diagnostic-event=EventLIN23Slave4NoCommunication, trouble-code-uds=LIN_23_Slave_4_NoCommunication  # Event_Dtc_Map_LIN 23 Slave 4_NoCommunication
  diagnostic event to operation cycle mapping EventOperCycleMapLIN23Slave4NoCommunication: diagnostic-event=EventLIN23Slave4NoCommunication, operation-cycle=DefaultOperationCycle  # Event_Oper_Cycle_Map_LIN 23 Slave 4_NoCommunication
  diagnostic event to debounce algorithm mapping EventDebounceMapLIN23Slave4NoCommunication: debounce-algorithm=counter_based, diagnostic-event=EventLIN23Slave4NoCommunication  # EventDebounceMap_LIN 23 Slave 4_NoCommunication
package /ZeC/DTC/DTC/Power_Path_119_Single_Device_Failure
  diagnostic trouble code uds Power_Path_119_Single_Device_Failure: dtc-props=Dtc_Props_16b633e2, uds-dtc-value=0x005977
  diagnostic event EventPowerPath119SingleDeviceFailure: aging-allowed=true, event-kind=SWC, prestorage-freeze-frame=false  # Event_Power_Path_119_Single_Device_Failure
  diagnostic event to trouble code uds mapping EventDtcMapPowerPath119SingleDeviceFailure: diagnostic-event=EventPowerPath119SingleDeviceFailure, trouble-code-uds=Power_Path_119_Single_Device_Failure  # Event_Dtc_Map_Power_Path_119_Single_Device_Failure
  diagnostic event to operation cycle mapping EventOperCycleMapPowerPath119SingleDeviceFailure: diagnostic-event=EventPowerPath119SingleDeviceFailure, operation-cycle=DefaultOperationCycle  # Event_Oper_Cycle_Map_Power_Path_119_Single_Device_Failure
  diagnostic event to debounce algorithm mapping EventDebounceMapPowerPath119SingleDeviceFailure: debounce-algorithm=time_based, diagnostic-event=EventPowerPath119SingleDeviceFailure  # EventDebounceMap_Power_Path_119_Single_Device_Failure
package /ZeC/DTC/DTC/LIN_23_Slave_3_Defect
  diagnostic trouble code uds LIN_23_Slave_3_Defect: dtc-props=Dtc_Props_358996c7, uds-dtc-value=0x031802  # LIN 23 Slave 3_Defect
  diagnostic event EventLIN23Slave3Defect: aging-allowed=true, event-kind=SWC, prestorage-freeze-frame=false  # Event_LIN 23 Slave 3_Defect
  diagnostic event to trouble code uds mapping EventDtcMapLIN23Slave3Defect: diagnostic-event=EventLIN23Slave3Defect, trouble-code-uds=LIN_23_Slave_3_Defect  # Event_Dtc_Map_LIN 23 Slave 3_Defect
  diagnostic event to operation cycle mapping EventOperCycleMapLIN23Slave3Defect: diagnostic-event=EventLIN23Slave3Defect, operation-cycle=DefaultOperationCycle  # Event_Oper_Cycle_Map_LIN 23 Slave 3_Defect
  diagnostic event to debounce algorithm mapping EventDebounceMapLIN23Slave3Defect: debounce-algorithm=counter_based, diagnostic-event=EventLIN23Slave3Defect  # EventDebounceMap_LIN 23 Slave 3_Defect
package /ZeC/DTC/DTC/LIN_23_Slave_3_NoCommunication
  diagnostic trouble code uds LIN_23_Slave_3_NoCommunication: dtc-props=Dtc_Props_358996c7, uds-dtc-value=0x031803  # LIN 23 Slave 3_NoCommunication
  diagnostic event EventLIN23Slave3NoCommunication: aging-allowed=true, event-kind=SWC, prestorage-freeze-frame=false  # Event_LIN 23 Slave 3_NoCommunication
  diagnostic event to trouble code uds mapping EventDtcMapLIN23Slave3NoCommunication: diagnostic-event=EventLIN23Slave3NoCommunication, trouble-code-uds=LIN_23_Slave_3_NoCommunication  # Event_Dtc_Map_LIN 23 Slave 3_NoCommunication
  diagnostic event to operation cycle mapping EventOperCycleMapLIN23Slave3NoCommunication: diagnostic-event=EventLIN23Slave3NoCommunication, operation-cycle=DefaultOperationCycle  # Event_Oper_Cycle_Map_LIN 23 Slave 3_NoCommunication
  diagnostic event to debounce algorithm mapping EventDebounceMapLIN23Slave3NoCommunication: debounce-algorithm=counter_based, diagnostic-event=EventLIN23Slave3NoCommunication  # EventDebounceMap_LIN 23 Slave 3_NoCommunication
package /ZeC/DTC/DTC/Power_Path_121_Single_Device_Failure
  diagnostic trouble code uds Power_Path_121_Single_Device_Failure: dtc-props=Dtc_Props_4ca522c, uds-dtc-value=0x005979
  diagnostic event EventPowerPath121SingleDeviceFailure: aging-allowed=true, event-kind=SWC, prestorage-freeze-frame=false  # Event_Power_Path_121_Single_Device_Failure
  diagnostic event to trouble code uds mapping EventDtcMapPowerPath121SingleDeviceFailure: diagnostic-event=EventPowerPath121SingleDeviceFailure, trouble-code-uds=Power_Path_121_Single_Device_Failure  # Event_Dtc_Map_Power_Path_121_Single_Device_Failure
  diagnostic event to operation cycle mapping EventOperCycleMapPowerPath121SingleDeviceFailure: diagnostic-event=EventPowerPath121SingleDeviceFailure, operation-cycle=DefaultOperationCycle  # Event_Oper_Cycle_Map_Power_Path_121_Single_Device_Failure
  diagnostic event to debounce algorithm mapping EventDebounceMapPowerPath121SingleDeviceFailure: debounce-algorithm=time_based, diagnostic-event=EventPowerPath121SingleDeviceFailure  # EventDebounceMap_Power_Path_121_Single_Device_Failure
package /ZeC/DTC/DTC/Power_Path_116_Single_Device_Failure
  diagnostic trouble code uds Power_Path_116_Single_Device_Failure: dtc-props=Dtc_Props_dc9d2dac, uds-dtc-value=0x005974
  diagnostic event EventPowerPath116SingleDeviceFailure: aging-allowed=true, event-kind=SWC, prestorage-freeze-frame=false  # Event_Power_Path_116_Single_Device_Failure
  diagnostic event to trouble code uds mapping EventDtcMapPowerPath116SingleDeviceFailure: diagnostic-event=EventPowerPath116SingleDeviceFailure, trouble-code-uds=Power_Path_116_Single_Device_Failure  # Event_Dtc_Map_Power_Path_116_Single_Device_Failure
  diagnostic event to operation cycle mapping EventOperCycleMapPowerPath116SingleDeviceFailure: diagnostic-event=EventPowerPath116SingleDeviceFailure, operation-cycle=DefaultOperationCycle  # Event_Oper_Cycle_Map_Power_Path_116_Single_Device_Failure
  diagnostic event to debounce algorithm mapping EventDebounceMapPowerPath116SingleDeviceFailure: debounce-algorithm=time_based, diagnostic-event=EventPowerPath116SingleDeviceFailure  # EventDebounceMap_Power_Path_116_Single_Device_Failure
package /ZeC/DTC/DTC/LIN_23_Slave_2_NoCommunication
  diagnostic trouble code uds LIN_23_Slave_2_NoCommunication: dtc-props=Dtc_Props_358996c7, uds-dtc-value=0x031801  # LIN 23 Slave 2_NoCommunication
  diagnostic event EventLIN23Slave2NoCommunication: aging-allowed=true, event-kind=SWC, prestorage-freeze-frame=false  # Event_LIN 23 Slave 2_NoCommunication
  diagnostic event to trouble code uds mapping EventDtcMapLIN23Slave2NoCommunication: diagnostic-event=EventLIN23Slave2NoCommunication, trouble-code-uds=LIN_23_Slave_2_NoCommunication  # Event_Dtc_Map_LIN 23 Slave 2_NoCommunication
  diagnostic event to operation cycle mapping EventOperCycleMapLIN23Slave2NoCommunication: diagnostic-event=EventLIN23Slave2NoCommunication, operation-cycle=DefaultOperationCycle  # Event_Oper_Cycle_Map_LIN 23 Slave 2_NoCommunication
  diagnostic event to debounce algorithm mapping EventDebounceMapLIN23Slave2NoCommunication: debounce-algorithm=counter_based, diagnostic-event=EventLIN23Slave2NoCommunication  # EventDebounceMap_LIN 23 Slave 2_NoCommunication
package /ZeC/DTC/DTC/Power_Path_115_Single_Device_Failure
  diagnostic trouble code uds Power_Path_115_Single_Device_Failure: dtc-props=Dtc_Props_d5a31d4b, uds-dtc-value=0x005973
  diagnostic event EventPowerPath115SingleDeviceFailure: aging-allowed=true, event-kind=SWC, prestorage-freeze-frame=false  # Event_Power_Path_115_Single_Device_Failure
  diagnostic event to trouble code uds mapping EventDtcMapPowerPath115SingleDeviceFailure: diagnostic-event=EventPowerPath115SingleDeviceFailure, trouble-code-uds=Power_Path_115_Single_Device_Failure  # Event_Dtc_Map_Power_Path_115_Single_Device_Failure
  diagnostic event to operation cycle mapping EventOperCycleMapPowerPath115SingleDeviceFailure: diagnostic-event=EventPowerPath115SingleDeviceFailure, operation-cycle=DefaultOperationCycle  # Event_Oper_Cycle_Map_Power_Path_115_Single_Device_Failure
  diagnostic event to debounce algorithm mapping EventDebounceMapPowerPath115SingleDeviceFailure: debounce-algorithm=time_based, diagnostic-event=EventPowerPath115SingleDeviceFailure  # EventDebounceMap_Power_Path_115_Single_Device_Failure
package /ZeC/DTC/DTC/Power_Path_118_Single_Device_Failure
  diagnostic trouble code uds Power_Path_118_Single_Device_Failure: dtc-props=Dtc_Props_50af39d8, uds-dtc-value=0x005976
  diagnostic event EventPowerPath118SingleDeviceFailure: aging-allowed=true, event-kind=SWC, prestorage-freeze-frame=false  # Event_Power_Path_118_Single_Device_Failure
  diagnostic event to trouble code uds mapping EventDtcMapPowerPath118SingleDeviceFailure: diagnostic-event=EventPowerPath118SingleDeviceFailure, trouble-code-uds=Power_Path_118_Single_Device_Failure  # Event_Dtc_Map_Power_Path_118_Single_Device_Failure
  diagnostic event to operation cycle mapping EventOperCycleMapPowerPath118SingleDeviceFailure: diagnostic-event=EventPowerPath118SingleDeviceFailure, operation-cycle=DefaultOperationCycle  # Event_Oper_Cycle_Map_Power_Path_118_Single_Device_Failure
  diagnostic event to debounce algorithm mapping EventDebounceMapPowerPath118SingleDeviceFailure: debounce-algorithm=time_based, diagnostic-event=EventPowerPath118SingleDeviceFailure  # EventDebounceMap_Power_Path_118_Single_Device_Failure
package /ZeC/DTC/DTC/Power_Path_117_Single_Device_Failure
  diagnostic trouble code uds Power_Path_117_Single_Device_Failure: dtc-props=Dtc_Props_9a842796, uds-dtc-value=0x005975
  diagnostic event EventPowerPath117SingleDeviceFailure: aging-allowed=true, event-kind=SWC, prestorage-freeze-frame=false  # Event_Power_Path_117_Single_Device_Failure
  diagnostic event to trouble code uds mapping EventDtcMapPowerPath117SingleDeviceFailure: diagnostic-event=EventPowerPath117SingleDeviceFailure, trouble-code-uds=Power_Path_117_Single_Device_Failure  # Event_Dtc_Map_Power_Path_117_Single_Device_Failure
  diagnostic event to operation cycle mapping EventOperCycleMapPowerPath117SingleDeviceFailure: diagnostic-event=EventPowerPath117SingleDeviceFailure, operation-cycle=DefaultOperationCycle  # Event_Oper_Cycle_Map_Power_Path_117_Single_Device_Failure
  diagnostic event to debounce algorithm mapping EventDebounceMapPowerPath117SingleDeviceFailure: debounce-algorithm=time_based, diagnostic-event=EventPowerPath117SingleDeviceFailure  # EventDebounceMap_Power_Path_117_Single_Device_Failure
package /ZeC/DTC/DTC/Power_Path_123_Single_Device_Failure
  diagnostic trouble code uds Power_Path_123_Single_Device_Failure: dtc-props=Dtc_Props_ae45730c, uds-dtc-value=0x00597b
  diagnostic event EventPowerPath123SingleDeviceFailure: aging-allowed=true, event-kind=SWC, prestorage-freeze-frame=false  # Event_Power_Path_123_Single_Device_Failure
  diagnostic event to trouble code uds mapping EventDtcMapPowerPath123SingleDeviceFailure: diagnostic-event=EventPowerPath123SingleDeviceFailure, trouble-code-uds=Power_Path_123_Single_Device_Failure  # Event_Dtc_Map_Power_Path_123_Single_Device_Failure
  diagnostic event to operation cycle mapping EventOperCycleMapPowerPath123SingleDeviceFailure: diagnostic-event=EventPowerPath123SingleDeviceFailure, operation-cycle=DefaultOperationCycle  # Event_Oper_Cycle_Map_Power_Path_123_Single_Device_Failure
  diagnostic event to debounce algorithm mapping EventDebounceMapPowerPath123SingleDeviceFailure: debounce-algorithm=time_based, diagnostic-event=EventPowerPath123SingleDeviceFailure  # EventDebounceMap_Power_Path_123_Single_Device_Failure
package /ZeC/DTC/DTC/Power_Path_122_Single_Device_Failure
  diagnostic trouble code uds Power_Path_122_Single_Device_Failure: dtc-props=Dtc_Props_646e6d42, uds-dtc-value=0x00597a
  diagnostic event EventPowerPath122SingleDeviceFailure: aging-allowed=true, event-kind=SWC, prestorage-freeze-frame=false  # Event_Power_Path_122_Single_Device_Failure
  diagnostic event to trouble code uds mapping EventDtcMapPowerPath122SingleDeviceFailure: diagnostic-event=EventPowerPath122SingleDeviceFailure, trouble-code-uds=Power_Path_122_Single_Device_Failure  # Event_Dtc_Map_Power_Path_122_Single_Device_Failure
  diagnostic event to operation cycle mapping EventOperCycleMapPowerPath122SingleDeviceFailure: diagnostic-event=EventPowerPath122SingleDeviceFailure, operation-cycle=DefaultOperationCycle  # Event_Oper_Cycle_Map_Power_Path_122_Single_Device_Failure
  diagnostic event to debounce algorithm mapping EventDebounceMapPowerPath122SingleDeviceFailure: debounce-algorithm=time_based, diagnostic-event=EventPowerPath122SingleDeviceFailure  # EventDebounceMap_Power_Path_122_Single_Device_Failure
package /ZeC/DTC/DTC/LIN_23_Slave_8_NoCommunication
  diagnostic trouble code uds LIN_23_Slave_8_NoCommunication: dtc-props=Dtc_Props_358996c7, uds-dtc-value=0x03180d  # LIN 23 Slave 8_NoCommunication
  diagnostic event EventLIN23Slave8NoCommunication: aging-allowed=true, event-kind=SWC, prestorage-freeze-frame=false  # Event_LIN 23 Slave 8_NoCommunication
  diagnostic event to trouble code uds mapping EventDtcMapLIN23Slave8NoCommunication: diagnostic-event=EventLIN23Slave8NoCommunication, trouble-code-uds=LIN_23_Slave_8_NoCommunication  # Event_Dtc_Map_LIN 23 Slave 8_NoCommunication
  diagnostic event to operation cycle mapping EventOperCycleMapLIN23Slave8NoCommunication: diagnostic-event=EventLIN23Slave8NoCommunication, operation-cycle=DefaultOperationCycle  # Event_Oper_Cycle_Map_LIN 23 Slave 8_NoCommunication
  diagnostic event to debounce algorithm mapping EventDebounceMapLIN23Slave8NoCommunication: debounce-algorithm=counter_based, diagnostic-event=EventLIN23Slave8NoCommunication  # EventDebounceMap_LIN 23 Slave 8_NoCommunication
package /ZeC/DTC/DTC/LIN_23_Slave_9_Defect
  diagnostic trouble code uds LIN_23_Slave_9_Defect: dtc-props=Dtc_Props_358996c7, uds-dtc-value=0x03180e  # LIN 23 Slave 9_Defect
  diagnostic event EventLIN23Slave9Defect: aging-allowed=true, event-kind=SWC, prestorage-freeze-frame=false  # Event_LIN 23 Slave 9_Defect
  diagnostic event to trouble code uds mapping EventDtcMapLIN23Slave9Defect: diagnostic-event=EventLIN23Slave9Defect, trouble-code-uds=LIN_23_Slave_9_Defect  # Event_Dtc_Map_LIN 23 Slave 9_Defect
  diagnostic event to operation cycle mapping EventOperCycleMapLIN23Slave9Defect: diagnostic-event=EventLIN23Slave9Defect, operation-cycle=DefaultOperationCycle  # Event_Oper_Cycle_Map_LIN 23 Slave 9_Defect
  diagnostic event to debounce algorithm mapping EventDebounceMapLIN23Slave9Defect: debounce-algorithm=counter_based, diagnostic-event=EventLIN23Slave9Defect  # EventDebounceMap_LIN 23 Slave 9_Defect
package /ZeC/DTC/DTC/LIN_23_Slave_7_NoCommunication
  diagnostic trouble code uds LIN_23_Slave_7_NoCommunication: dtc-props=Dtc_Props_358996c7, uds-dtc-value=0x03180b  # LIN 23 Slave 7_NoCommunication
  diagnostic event EventLIN23Slave7NoCommunication: aging-allowed=true, event-kind=SWC, prestorage-freeze-frame=false  # Event_LIN 23 Slave 7_NoCommunication
  diagnostic event to trouble code uds mapping EventDtcMapLIN23Slave7NoCommunication: diagnostic-event=EventLIN23Slave7NoCommunication, trouble-code-uds=LIN_23_Slave_7_NoCommunication  # Event_Dtc_Map_LIN 23 Slave 7_NoCommunication
  diagnostic event to operation cycle mapping EventOperCycleMapLIN23Slave7NoCommunication: diagnostic-event=EventLIN23Slave7NoCommunication, operation-cycle=DefaultOperationCycle  # Event_Oper_Cycle_Map_LIN 23 Slave 7_NoCommunication
  diagnostic event to debounce algorithm mapping EventDebounceMapLIN23Slave7NoCommunication: debounce-algorithm=counter_based, diagnostic-event=EventLIN23Slave7NoCommunication  # EventDebounceMap_LIN 23 Slave 7_NoCommunication
package /ZeC/DTC/DTC/LIN_23_Slave_8_Defect
  diagnostic trouble code uds LIN_23_Slave_8_Defect: dtc-props=Dtc_Props_358996c7, uds-dtc-value=0x03180c  # LIN 23 Slave 8_Defect
  diagnostic event EventLIN23Slave8Defect: aging-allowed=true, event-kind=SWC, prestorage-freeze-frame=false  # Event_LIN 23 Slave 8_Defect
  diagnostic event to trouble code uds mapping EventDtcMapLIN23Slave8Defect: diagnostic-event=EventLIN23Slave8Defect, trouble-code-uds=LIN_23_Slave_8_Defect  # Event_Dtc_Map_LIN 23 Slave 8_Defect
  diagnostic event to operation cycle mapping EventOperCycleMapLIN23Slave8Defect: diagnostic-event=EventLIN23Slave8Defect, operation-cycle=DefaultOperationCycle  # Event_Oper_Cycle_Map_LIN 23 Slave 8_Defect
  diagnostic event to debounce algorithm mapping EventDebounceMapLIN23Slave8Defect: debounce-algorithm=counter_based, diagnostic-event=EventLIN23Slave8Defect  # EventDebounceMap_LIN 23 Slave 8_Defect
package /ZeC/DTC/DTC/Power_Path_125_Single_Device_Failure
  diagnostic trouble code uds Power_Path_125_Single_Device_Failure: dtc-props=Dtc_Props_e16249d1, uds-dtc-value=0x00597d
  diagnostic event EventPowerPath125SingleDeviceFailure: aging-allowed=true, event-kind=SWC, prestorage-freeze-frame=false  # Event_Power_Path_125_Single_Device_Failure
  diagnostic event to trouble code uds mapping EventDtcMapPowerPath125SingleDeviceFailure: diagnostic-event=EventPowerPath125SingleDeviceFailure, trouble-code-uds=Power_Path_125_Single_Device_Failure  # Event_Dtc_Map_Power_Path_125_Single_Device_Failure
  diagnostic event to operation cycle mapping EventOperCycleMapPowerPath125SingleDeviceFailure: diagnostic-event=EventPowerPath125SingleDeviceFailure, operation-cycle=DefaultOperationCycle  # Event_Oper_Cycle_Map_Power_Path_125_Single_Device_Failure
  diagnostic event to debounce algorithm mapping EventDebounceMapPowerPath125SingleDeviceFailure: debounce-algorithm=time_based, diagnostic-event=EventPowerPath125SingleDeviceFailure  # EventDebounceMap_Power_Path_125_Single_Device_Failure
package /ZeC/DTC/DTC/LIN_23_Slave_7_Defect
  diagnostic trouble code uds LIN_23_Slave_7_Defect: dtc-props=Dtc_Props_358996c7, uds-dtc-value=0x03180a  # LIN 23 Slave 7_Defect
  diagnostic event EventLIN23Slave7Defect: aging-allowed=true, event-kind=SWC, prestorage-freeze-frame=false  # Event_LIN 23 Slave 7_Defect
  diagnostic event to trouble code uds mapping EventDtcMapLIN23Slave7Defect: diagnostic-event=EventLIN23Slave7Defect, trouble-code-uds=LIN_23_Slave_7_Defect  # Event_Dtc_Map_LIN 23 Slave 7_Defect
  diagnostic event to operation cycle mapping EventOperCycleMapLIN23Slave7Defect: diagnostic-event=EventLIN23Slave7Defect, operation-cycle=DefaultOperationCycle  # Event_Oper_Cycle_Map_LIN 23 Slave 7_Defect
  diagnostic event to debounce algorithm mapping EventDebounceMapLIN23Slave7Defect: debounce-algorithm=counter_based, diagnostic-event=EventLIN23Slave7Defect  # EventDebounceMap_LIN 23 Slave 7_Defect
package /ZeC/DTC/DTC/Power_Path_124_Single_Device_Failure
  diagnostic trouble code uds Power_Path_124_Single_Device_Failure: dtc-props=Dtc_Props_e85c7936, uds-dtc-value=0x00597c
  diagnostic event EventPowerPath124SingleDeviceFailure: aging-allowed=true, event-kind=SWC, prestorage-freeze-frame=false  # Event_Power_Path_124_Single_Device_Failure
  diagnostic event to trouble code uds mapping EventDtcMapPowerPath124SingleDeviceFailure: diagnostic-event=EventPowerPath124SingleDeviceFailure, trouble-code-uds=Power_Path_124_Single_Device_Failure  # Event_Dtc_Map_Power_Path_124_Single_Device_Failure
  diagnostic event to operation cycle mapping EventOperCycleMapPowerPath124SingleDeviceFailure: diagnostic-event=EventPowerPath124SingleDeviceFailure, operation-cycle=DefaultOperationCycle  # Event_Oper_Cycle_Map_Power_Path_124_Single_Device_Failure
  diagnostic event to debounce algorithm mapping EventDebounceMapPowerPath124SingleDeviceFailure: debounce-algorithm=time_based, diagnostic-event=EventPowerPath124SingleDeviceFailure  # EventDebounceMap_Power_Path_124_Single_Device_Failure
package /ZeC/DTC/DTC/Power_Path_127_Single_Device_Failure
  diagnostic trouble code uds Power_Path_127_Single_Device_Failure: dtc-props=Dtc_Props_6d505da5, uds-dtc-value=0x00597f
  diagnostic event EventPowerPath127SingleDeviceFailure: aging-allowed=true, event-kind=SWC, prestorage-freeze-frame=false  # Event_Power_Path_127_Single_Device_Failure
  diagnostic event to trouble code uds mapping EventDtcMapPowerPath127SingleDeviceFailure: diagnostic-event=EventPowerPath127SingleDeviceFailure, trouble-code-uds=Power_Path_127_Single_Device_Failure  # Event_Dtc_Map_Power_Path_127_Single_Device_Failure
  diagnostic event to operation cycle mapping EventOperCycleMapPowerPath127SingleDeviceFailure: diagnostic-event=EventPowerPath127SingleDeviceFailure, operation-cycle=DefaultOperationCycle  # Event_Oper_Cycle_Map_Power_Path_127_Single_Device_Failure
  diagnostic event to debounce algorithm mapping EventDebounceMapPowerPath127SingleDeviceFailure: debounce-algorithm=time_based, diagnostic-event=EventPowerPath127SingleDeviceFailure  # EventDebounceMap_Power_Path_127_Single_Device_Failure
package /ZeC/DTC/DTC/Power_Path_126_Single_Device_Failure
  diagnostic trouble code uds Power_Path_126_Single_Device_Failure: dtc-props=Dtc_Props_a77b43eb, uds-dtc-value=0x00597e
  diagnostic event EventPowerPath126SingleDeviceFailure: aging-allowed=true, event-kind=SWC, prestorage-freeze-frame=false  # Event_Power_Path_126_Single_Device_Failure
  diagnostic event to trouble code uds mapping EventDtcMapPowerPath126SingleDeviceFailure: diagnostic-event=EventPowerPath126SingleDeviceFailure, trouble-code-uds=Power_Path_126_Single_Device_Failure  # Event_Dtc_Map_Power_Path_126_Single_Device_Failure
  diagnostic event to operation cycle mapping EventOperCycleMapPowerPath126SingleDeviceFailure: diagnostic-event=EventPowerPath126SingleDeviceFailure, operation-cycle=DefaultOperationCycle  # Event_Oper_Cycle_Map_Power_Path_126_Single_Device_Failure
  diagnostic event to debounce algorithm mapping EventDebounceMapPowerPath126SingleDeviceFailure: debounce-algorithm=time_based, diagnostic-event=EventPowerPath126SingleDeviceFailure  # EventDebounceMap_Power_Path_126_Single_Device_Failure
package /ZeC/DTC/DTC/Power_Path_129_Single_Device_Failure
  diagnostic trouble code uds Power_Path_129_Single_Device_Failure: dtc-props=Dtc_Props_e3155a51, uds-dtc-value=0x005981
  diagnostic event EventPowerPath129SingleDeviceFailure: aging-allowed=true, event-kind=SWC, prestorage-freeze-frame=false  # Event_Power_Path_129_Single_Device_Failure
  diagnostic event to trouble code uds mapping EventDtcMapPowerPath129SingleDeviceFailure: diagnostic-event=EventPowerPath129SingleDeviceFailure, trouble-code-uds=Power_Path_129_Single_Device_Failure  # Event_Dtc_Map_Power_Path_129_Single_Device_Failure
  diagnostic event to operation cycle mapping EventOperCycleMapPowerPath129SingleDeviceFailure: diagnostic-event=EventPowerPath129SingleDeviceFailure, operation-cycle=DefaultOperationCycle  # Event_Oper_Cycle_Map_Power_Path_129_Single_Device_Failure
  diagnostic event to debounce algorithm mapping EventDebounceMapPowerPath129SingleDeviceFailure: debounce-algorithm=time_based, diagnostic-event=EventPowerPath129SingleDeviceFailure  # EventDebounceMap_Power_Path_129_Single_Device_Failure
package /ZeC/DTC/DTC/Power_Path_128_Single_Device_Failure
  diagnostic trouble code uds Power_Path_128_Single_Device_Failure: dtc-props=Dtc_Props_a50c506b, uds-dtc-value=0x005980
  diagnostic event EventPowerPath128SingleDeviceFailure: aging-allowed=true, event-kind=SWC, prestorage-freeze-frame=false  # Event_Power_Path_128_Single_Device_Failure
  diagnostic event to trouble code uds mapping EventDtcMapPowerPath128SingleDeviceFailure: diagnostic-event=EventPowerPath128SingleDeviceFailure, trouble-code-uds=Power_Path_128_Single_Device_Failure  # Event_Dtc_Map_Power_Path_128_Single_Device_Failure
  diagnostic event to operation cycle mapping EventOperCycleMapPowerPath128SingleDeviceFailure: diagnostic-event=EventPowerPath128SingleDeviceFailure, operation-cycle=DefaultOperationCycle  # Event_Oper_Cycle_Map_Power_Path_128_Single_Device_Failure
  diagnostic event to debounce algorithm mapping EventDebounceMapPowerPath128SingleDeviceFailure: debounce-algorithm=time_based, diagnostic-event=EventPowerPath128SingleDeviceFailure  # EventDebounceMap_Power_Path_128_Single_Device_Failure
package /ZeC/DTC/DTC/Power_Path_131_Single_Device_Failure
  diagnostic trouble code uds Power_Path_131_Single_Device_Failure: dtc-props=Dtc_Props_6f274e25, uds-dtc-value=0x005983
  diagnostic event EventPowerPath131SingleDeviceFailure: aging-allowed=true, event-kind=SWC, prestorage-freeze-frame=false  # Event_Power_Path_131_Single_Device_Failure
  diagnostic event to trouble code uds mapping EventDtcMapPowerPath131SingleDeviceFailure: diagnostic-event=EventPowerPath131SingleDeviceFailure, trouble-code-uds=Power_Path_131_Single_Device_Failure  # Event_Dtc_Map_Power_Path_131_Single_Device_Failure
  diagnostic event to operation cycle mapping EventOperCycleMapPowerPath131SingleDeviceFailure: diagnostic-event=EventPowerPath131SingleDeviceFailure, operation-cycle=DefaultOperationCycle  # Event_Oper_Cycle_Map_Power_Path_131_Single_Device_Failure
  diagnostic event to debounce algorithm mapping EventDebounceMapPowerPath131SingleDeviceFailure: debounce-algorithm=time_based, diagnostic-event=EventPowerPath131SingleDeviceFailure  # EventDebounceMap_Power_Path_131_Single_Device_Failure
package /ZeC/DTC/DTC/Power_Path_130_Single_Device_Failure
  diagnostic trouble code uds Power_Path_130_Single_Device_Failure: dtc-props=Dtc_Props_293e441f, uds-dtc-value=0x005982
  diagnostic event EventPowerPath130SingleDeviceFailure: aging-allowed=true, event-kind=SWC, prestorage-freeze-frame=false  # Event_Power_Path_130_Single_Device_Failure
  diagnostic event to trouble code uds mapping EventDtcMapPowerPath130SingleDeviceFailure: diagnostic-event=EventPowerPath130SingleDeviceFailure, trouble-code-uds=Power_Path_130_Single_Device_Failure  # Event_Dtc_Map_Power_Path_130_Single_Device_Failure
  diagnostic event to operation cycle mapping EventOperCycleMapPowerPath130SingleDeviceFailure: diagnostic-event=EventPowerPath130SingleDeviceFailure, operation-cycle=DefaultOperationCycle  # Event_Oper_Cycle_Map_Power_Path_130_Single_Device_Failure
  diagnostic event to debounce algorithm mapping EventDebounceMapPowerPath130SingleDeviceFailure: debounce-algorithm=time_based, diagnostic-event=EventPowerPath130SingleDeviceFailure  # EventDebounceMap_Power_Path_130_Single_Device_Failure
package /ZeC/DTC/DTC/LIN_23_Slave_6_Defect
  diagnostic trouble code uds LIN_23_Slave_6_Defect: dtc-props=Dtc_Props_358996c7, uds-dtc-value=0x031808  # LIN 23 Slave 6_Defect
  diagnostic event EventLIN23Slave6Defect: aging-allowed=true, event-kind=SWC, prestorage-freeze-frame=false  # Event_LIN 23 Slave 6_Defect
  diagnostic event to trouble code uds mapping EventDtcMapLIN23Slave6Defect: diagnostic-event=EventLIN23Slave6Defect, trouble-code-uds=LIN_23_Slave_6_Defect  # Event_Dtc_Map_LIN 23 Slave 6_Defect
  diagnostic event to operation cycle mapping EventOperCycleMapLIN23Slave6Defect: diagnostic-event=EventLIN23Slave6Defect, operation-cycle=DefaultOperationCycle  # Event_Oper_Cycle_Map_LIN 23 Slave 6_Defect
  diagnostic event to debounce algorithm mapping EventDebounceMapLIN23Slave6Defect: debounce-algorithm=counter_based, diagnostic-event=EventLIN23Slave6Defect  # EventDebounceMap_LIN 23 Slave 6_Defect
package /ZeC/DTC/DTC/LIN_23_Slave_6_NoCommunication
  diagnostic trouble code uds LIN_23_Slave_6_NoCommunication: dtc-props=Dtc_Props_358996c7, uds-dtc-value=0x031809  # LIN 23 Slave 6_NoCommunication
  diagnostic event EventLIN23Slave6NoCommunication: aging-allowed=true, event-kind=SWC, prestorage-freeze-frame=false  # Event_LIN 23 Slave 6_NoCommunication
  diagnostic event to trouble code uds mapping EventDtcMapLIN23Slave6NoCommunication: diagnostic-event=EventLIN23Slave6NoCommunication, trouble-code-uds=LIN_23_Slave_6_NoCommunication  # Event_Dtc_Map_LIN 23 Slave 6_NoCommunication
  diagnostic event to operation cycle mapping EventOperCycleMapLIN23Slave6NoCommunication: diagnostic-event=EventLIN23Slave6NoCommunication, operation-cycle=DefaultOperationCycle  # Event_Oper_Cycle_Map_LIN 23 Slave 6_NoCommunication
  diagnostic event to debounce algorithm mapping EventDebounceMapLIN23Slave6NoCommunication: debounce-algorithm=counter_based, diagnostic-event=EventLIN23Slave6NoCommunication  # EventDebounceMap_LIN 23 Slave 6_NoCommunication
package /ZeC/DTC/DTC/LIN_23_Slave_5_Defect
  diagnostic trouble code uds LIN_23_Slave_5_Defect: dtc-props=Dtc_Props_358996c7, uds-dtc-value=0x031806  # LIN 23 Slave 5_Defect
  diagnostic event EventLIN23Slave5Defect: aging-allowed=true, event-kind=SWC, prestorage-freeze-frame=false  # Event_LIN 23 Slave 5_Defect
  diagnostic event to trouble code uds mapping EventDtcMapLIN23Slave5Defect: diagnostic-event=EventLIN23Slave5Defect, trouble-code-uds=LIN_23_Slave_5_Defect  # Event_Dtc_Map_LIN 23 Slave 5_Defect
  diagnostic event to operation cycle mapping EventOperCycleMapLIN23Slave5Defect: diagnostic-event=EventLIN23Slave5Defect, operation-cycle=DefaultOperationCycle  # Event_Oper_Cycle_Map_LIN 23 Slave 5_Defect
  diagnostic event to debounce algorithm mapping EventDebounceMapLIN23Slave5Defect: debounce-algorithm=counter_based, diagnostic-event=EventLIN23Slave5Defect  # EventDebounceMap_LIN 23 Slave 5_Defect
package /ZeC/DTC/DTC/LIN_23_Slave_5_NoCommunication
  diagnostic trouble code uds LIN_23_Slave_5_NoCommunication: dtc-props=Dtc_Props_358996c7, uds-dtc-value=0x031807  # LIN 23 Slave 5_NoCommunication
  diagnostic event EventLIN23Slave5NoCommunication: aging-allowed=true, event-kind=SWC, prestorage-freeze-frame=false  # Event_LIN 23 Slave 5_NoCommunication
  diagnostic event to trouble code uds mapping EventDtcMapLIN23Slave5NoCommunication: diagnostic-event=EventLIN23Slave5NoCommunication, trouble-code-uds=LIN_23_Slave_5_NoCommunication  # Event_Dtc_Map_LIN 23 Slave 5_NoCommunication
  diagnostic event to operation cycle mapping EventOperCycleMapLIN23Slave5NoCommunication: diagnostic-event=EventLIN23Slave5NoCommunication, operation-cycle=DefaultOperationCycle  # Event_Oper_Cycle_Map_LIN 23 Slave 5_NoCommunication
  diagnostic event to debounce algorithm mapping EventDebounceMapLIN23Slave5NoCommunication: debounce-algorithm=counter_based, diagnostic-event=EventLIN23Slave5NoCommunication  # EventDebounceMap_LIN 23 Slave 5_NoCommunication
package /ZeC/DTC/DTC/Power_Path_039_Over_Load_Failure
  diagnostic trouble code uds Power_Path_039_Over_Load_Failure: dtc-props=Dtc_Props_7f35fd38, uds-dtc-value=0x005527
  diagnostic event EventPowerPath039OverLoadFailure: aging-allowed=true, event-kind=SWC, prestorage-freeze-frame=false  # Event_Power_Path_039_Over_Load_Failure
  diagnostic event to trouble code uds mapping EventDtcMapPowerPath039OverLoadFailure: diagnostic-event=EventPowerPath039OverLoadFailure, trouble-code-uds=Power_Path_039_Over_Load_Failure  # Event_Dtc_Map_Power_Path_039_Over_Load_Failure
  diagnostic event to operation cycle mapping EventOperCycleMapPowerPath039OverLoadFailure: diagnostic-event=EventPowerPath039OverLoadFailure, operation-cycle=DefaultOperationCycle  # Event_Oper_Cycle_Map_Power_Path_039_Over_Load_Failure
  diagnostic event to debounce algorithm mapping EventDebounceMapPowerPath039OverLoadFailure: debounce-algorithm=time_based, diagnostic-event=EventPowerPath039OverLoadFailure  # EventDebounceMap_Power_Path_039_Over_Load_Failure
package /ZeC/DTC/DTC/Power_Path_038_Over_Load_Failure
  diagnostic trouble code uds Power_Path_038_Over_Load_Failure: dtc-props=Dtc_Props_392cf702, uds-dtc-value=0x005526
  diagnostic event EventPowerPath038OverLoadFailure: aging-allowed=true, event-kind=SWC, prestorage-freeze-frame=false  # Event_Power_Path_038_Over_Load_Failure
  diagnostic event to trouble code uds mapping EventDtcMapPowerPath038OverLoadFailure: diagnostic-event=EventPowerPath038OverLoadFailure, trouble-code-uds=Power_Path_038_Over_Load_Failure  # Event_Dtc_Map_Power_Path_038_Over_Load_Failure
  diagnostic event to operation cycle mapping EventOperCycleMapPowerPath038OverLoadFailure: diagnostic-event=EventPowerPath038OverLoadFailure, operation-cycle=DefaultOperationCycle  # Event_Oper_Cycle_Map_Power_Path_038_Over_Load_Failure
  diagnostic event to debounce algorithm mapping EventDebounceMapPowerPath038OverLoadFailure: debounce-algorithm=time_based, diagnostic-event=EventPowerPath038OverLoadFailure  # EventDebounceMap_Power_Path_038_Over_Load_Failure
package /ZeC/DTC/DTC/Power_Path_041_Over_Load_Failure
  diagnostic trouble code uds Power_Path_041_Over_Load_Failure: dtc-props=Dtc_Props_6d499cf6, uds-dtc-value=0x005529
  diagnostic event EventPowerPath041OverLoadFailure: aging-allowed=true, event-kind=SWC, prestorage-freeze-frame=false  # Event_Power_Path_041_Over_Load_Failure
  diagnostic event to trouble code uds mapping EventDtcMapPowerPath041OverLoadFailure: diagnostic-event=EventPowerPath041OverLoadFailure, trouble-code-uds=Power_Path_041_Over_Load_Failure  # Event_Dtc_Map_Power_Path_041_Over_Load_Failure
  diagnostic event to operation cycle mapping EventOperCycleMapPowerPath041OverLoadFailure: diagnostic-event=EventPowerPath041OverLoadFailure, operation-cycle=DefaultOperationCycle  # Event_Oper_Cycle_Map_Power_Path_041_Over_Load_Failure
  diagnostic event to debounce algorithm mapping EventDebounceMapPowerPath041OverLoadFailure: debounce-algorithm=time_based, diagnostic-event=EventPowerPath041OverLoadFailure  # EventDebounceMap_Power_Path_041_Over_Load_Failure
package /ZeC/DTC/DTC/Power_Path_040_Over_Load_Failure
  diagnostic trouble code uds Power_Path_040_Over_Load_Failure: dtc-props=Dtc_Props_2b5096cc, uds-dtc-value=0x005528
  diagnostic event EventPowerPath040OverLoadFailure: aging-allowed=true, event-kind=SWC, prestorage-freeze-frame=false  # Event_Power_Path_040_Over_Load_Failure
  diagnostic event to trouble code uds mapping EventDtcMapPowerPath040OverLoadFailure: diagnostic-event=EventPowerPath040OverLoadFailure, trouble-code-uds=Power_Path_040_Over_Load_Failure  # Event_Dtc_Map_Power_Path_040_Over_Load_Failure
  diagnostic event to operation cycle mapping EventOperCycleMapPowerPath040OverLoadFailure: diagnostic-event=EventPowerPath040OverLoadFailure, operation-cycle=DefaultOperationCycle  # Event_Oper_Cycle_Map_Power_Path_040_Over_Load_Failure
  diagnostic event to debounce algorithm mapping EventDebounceMapPowerPath040OverLoadFailure: debounce-algorithm=time_based, diagnostic-event=EventPowerPath040OverLoadFailure  # EventDebounceMap_Power_Path_040_Over_Load_Failure
package /ZeC/DTC/DTC/Power_Path_035_Over_Load_Failure
  diagnostic trouble code uds Power_Path_035_Over_Load_Failure: dtc-props=Dtc_Props_bc20d391, uds-dtc-value=0x005523
  diagnostic event EventPowerPath035OverLoadFailure: aging-allowed=true, event-kind=SWC, prestorage-freeze-frame=false  # Event_Power_Path_035_Over_Load_Failure
  diagnostic event to trouble code uds mapping EventDtcMapPowerPath035OverLoadFailure: diagnostic-event=EventPowerPath035OverLoadFailure, trouble-code-uds=Power_Path_035_Over_Load_Failure  # Event_Dtc_Map_Power_Path_035_Over_Load_Failure
  diagnostic event to operation cycle mapping EventOperCycleMapPowerPath035OverLoadFailure: diagnostic-event=EventPowerPath035OverLoadFailure, operation-cycle=DefaultOperationCycle  # Event_Oper_Cycle_Map_Power_Path_035_Over_Load_Failure
  diagnostic event to debounce algorithm mapping EventDebounceMapPowerPath035OverLoadFailure: debounce-algorithm=time_based, diagnostic-event=EventPowerPath035OverLoadFailure  # EventDebounceMap_Power_Path_035_Over_Load_Failure
package /ZeC/DTC/DTC/Power_Path_034_Over_Load_Failure
  diagnostic trouble code uds Power_Path_034_Over_Load_Failure: dtc-props=Dtc_Props_fa39d9ab, uds-dtc-value=0x005522
  diagnostic event EventPowerPath034OverLoadFailure: aging-allowed=true, event-kind=SWC, prestorage-freeze-frame=false  # Event_Power_Path_034_Over_Load_Failure
  diagnostic event to trouble code uds mapping EventDtcMapPowerPath034OverLoadFailure: diagnostic-event=EventPowerPath034OverLoadFailure, trouble-code-uds=Power_Path_034_Over_Load_Failure  # Event_Dtc_Map_Power_Path_034_Over_Load_Failure
  diagnostic event to operation cycle mapping EventOperCycleMapPowerPath034OverLoadFailure: diagnostic-event=EventPowerPath034OverLoadFailure, operation-cycle=DefaultOperationCycle  # Event_Oper_Cycle_Map_Power_Path_034_Over_Load_Failure
  diagnostic event to debounce algorithm mapping EventDebounceMapPowerPath034OverLoadFailure: debounce-algorithm=time_based, diagnostic-event=EventPowerPath034OverLoadFailure  # EventDebounceMap_Power_Path_034_Over_Load_Failure
package /ZeC/DTC/DTC/LIN_9_Local_Databus_Electrical_Failure
  diagnostic trouble code uds LIN_9_Local_Databus_Electrical_Failure: dtc-props=Dtc_Props_358996c7, uds-dtc-value=0x030921  # LIN 9 Local_Databus_Electrical_Failure
  diagnostic event EventLIN9LocalDatabusElectricalFailure: aging-allowed=true, event-kind=SWC, prestorage-freeze-frame=false  # Event_LIN 9 Local_Databus_Electrical_Failure
  diagnostic event to trouble code uds mapping EventDtcMapLIN9LocalDatabusElectricalFailure: diagnostic-event=EventLIN9LocalDatabusElectricalFailure, trouble-code-uds=LIN_9_Local_Databus_Electrical_Failure  # Event_Dtc_Map_LIN 9 Local_Databus_Electrical_Failure
  diagnostic event to operation cycle mapping EventOperCycleMapLIN9LocalDatabusElectricalFailure: diagnostic-event=EventLIN9LocalDatabusElectricalFailure, operation-cycle=DefaultOperationCycle  # Event_Oper_Cycle_Map_LIN 9 Local_Databus_Electrical_Failure
  diagnostic event to debounce algorithm mapping EventDebounceMapLIN9LocalDatabusElectricalFailure: debounce-algorithm=counter_based, diagnostic-event=EventLIN9LocalDatabusElectricalFailure  # EventDebounceMap_LIN 9 Local_Databus_Electrical_Failure
package /ZeC/DTC/DTC/Power_Path_037_Over_Load_Failure
  diagnostic trouble code uds Power_Path_037_Over_Load_Failure: dtc-props=Dtc_Props_f307e94c, uds-dtc-value=0x005525
  diagnostic event EventPowerPath037OverLoadFailure: aging-allowed=true, event-kind=SWC, prestorage-freeze-frame=false  # Event_Power_Path_037_Over_Load_Failure
  diagnostic event to trouble code uds mapping EventDtcMapPowerPath037OverLoadFailure: diagnostic-event=EventPowerPath037OverLoadFailure, trouble-code-uds=Power_Path_037_Over_Load_Failure  # Event_Dtc_Map_Power_Path_037_Over_Load_Failure
  diagnostic event to operation cycle mapping EventOperCycleMapPowerPath037OverLoadFailure: diagnostic-event=EventPowerPath037OverLoadFailure, operation-cycle=DefaultOperationCycle  # Event_Oper_Cycle_Map_Power_Path_037_Over_Load_Failure
  diagnostic event to debounce algorithm mapping EventDebounceMapPowerPath037OverLoadFailure: debounce-algorithm=time_based, diagnostic-event=EventPowerPath037OverLoadFailure  # EventDebounceMap_Power_Path_037_Over_Load_Failure
package /ZeC/DTC/DTC/LIN_9_Databus_No_Comm
  diagnostic trouble code uds LIN_9_Databus_No_Comm: dtc-props=Dtc_Props_358996c7, uds-dtc-value=0x030920  # LIN 9 Databus_No_Comm
  diagnostic event EventLIN9DatabusNoComm: aging-allowed=true, event-kind=SWC, prestorage-freeze-frame=false  # Event_LIN 9 Databus_No_Comm
  diagnostic event to trouble code uds mapping EventDtcMapLIN9DatabusNoComm: diagnostic-event=EventLIN9DatabusNoComm, trouble-code-uds=LIN_9_Databus_No_Comm  # Event_Dtc_Map_LIN 9 Databus_No_Comm
  diagnostic event to operation cycle mapping EventOperCycleMapLIN9DatabusNoComm: diagnostic-event=EventLIN9DatabusNoComm, operation-cycle=DefaultOperationCycle  # Event_Oper_Cycle_Map_LIN 9 Databus_No_Comm
  diagnostic event to debounce algorithm mapping EventDebounceMapLIN9DatabusNoComm: debounce-algorithm=counter_based, diagnostic-event=EventLIN9DatabusNoComm  # EventDebounceMap_LIN 9 Databus_No_Comm
package /ZeC/DTC/DTC/Power_Path_036_Over_Load_Failure
  diagnostic trouble code uds Power_Path_036_Over_Load_Failure: dtc-props=Dtc_Props_b51ee376, uds-dtc-value=0x005524
  diagnostic event EventPowerPath036OverLoadFailure: aging-allowed=true, event-kind=SWC, prestorage-freeze-frame=false  # Event_Power_Path_036_Over_Load_Failure
  diagnostic event to trouble code uds mapping EventDtcMapPowerPath036OverLoadFailure: diagnostic-event=EventPowerPath036OverLoadFailure, trouble-code-uds=Power_Path_036_Over_Load_Failure  # Event_Dtc_Map_Power_Path_036_Over_Load_Failure
  diagnostic event to operation cycle mapping EventOperCycleMapPowerPath036OverLoadFailure: diagnostic-event=EventPowerPath036OverLoadFailure, operation-cycle=DefaultOperationCycle  # Event_Oper_Cycle_Map_Power_Path_036_Over_Load_Failure
  diagnostic event to debounce algorithm mapping EventDebounceMapPowerPath036OverLoadFailure: debounce-algorithm=time_based, diagnostic-event=EventPowerPath036OverLoadFailure  # EventDebounceMap_Power_Path_036_Over_Load_Failure
package /ZeC/DTC/DTC/Power_Path_042_Over_Load_Failure
  diagnostic trouble code uds Power_Path_042_Over_Load_Failure: dtc-props=Dtc_Props_deda398, uds-dtc-value=0x00552a
  diagnostic event EventPowerPath042OverLoadFailure: aging-allowed=true, event-kind=SWC, prestorage-freeze-frame=false  # Event_Power_Path_042_Over_Load_Failure
  diagnostic event to trouble code uds mapping EventDtcMapPowerPath042OverLoadFailure: diagnostic-event=EventPowerPath042OverLoadFailure, trouble-code-uds=Power_Path_042_Over_Load_Failure  # Event_Dtc_Map_Power_Path_042_Over_Load_Failure
  diagnostic event to operation cycle mapping EventOperCycleMapPowerPath042OverLoadFailure: diagnostic-event=EventPowerPath042OverLoadFailure, operation-cycle=DefaultOperationCycle  # Event_Oper_Cycle_Map_Power_Path_042_Over_Load_Failure
  diagnostic event to debounce algorithm mapping EventDebounceMapPowerPath042OverLoadFailure: debounce-algorithm=time_based, diagnostic-event=EventPowerPath042OverLoadFailure  # EventDebounceMap_Power_Path_042_Over_Load_Failure
package /ZeC/DTC/DTC/LIN_9_Slave_2_Defect
  diagnostic trouble code uds LIN_9_Slave_2_Defect: dtc-props=Dtc_Props_358996c7, uds-dtc-value=0x03091e  # LIN 9 Slave 2_Defect
  diagnostic event EventLIN9Slave2Defect: aging-allowed=true, event-kind=SWC, prestorage-freeze-frame=false  # Event_LIN 9 Slave 2_Defect
  diagnostic event to trouble code uds mapping EventDtcMapLIN9Slave2Defect: diagnostic-event=EventLIN9Slave2Defect, trouble-code-uds=LIN_9_Slave_2_Defect  # Event_Dtc_Map_LIN 9 Slave 2_Defect
  diagnostic event to operation cycle mapping EventOperCycleMapLIN9Slave2Defect: diagnostic-event=EventLIN9Slave2Defect, operation-cycle=DefaultOperationCycle  # Event_Oper_Cycle_Map_LIN 9 Slave 2_Defect
  diagnostic event to debounce algorithm mapping EventDebounceMapLIN9Slave2Defect: debounce-algorithm=counter_based, diagnostic-event=EventLIN9Slave2Defect  # EventDebounceMap_LIN 9 Slave 2_Defect
package /ZeC/DTC/DTC/Power_Path_047_Over_Load_Failure
  diagnostic trouble code uds Power_Path_047_Over_Load_Failure: dtc-props=Dtc_Props_4d3937f, uds-dtc-value=0x00552f
  diagnostic event EventPowerPath047OverLoadFailure: aging-allowed=true, event-kind=SWC, prestorage-freeze-frame=false  # Event_Power_Path_047_Over_Load_Failure
  diagnostic event to trouble code uds mapping EventDtcMapPowerPath047OverLoadFailure: diagnostic-event=EventPowerPath047OverLoadFailure, trouble-code-uds=Power_Path_047_Over_Load_Failure  # Event_Dtc_Map_Power_Path_047_Over_Load_Failure
  diagnostic event to operation cycle mapping EventOperCycleMapPowerPath047OverLoadFailure: diagnostic-event=EventPowerPath047OverLoadFailure, operation-cycle=DefaultOperationCycle  # Event_Oper_Cycle_Map_Power_Path_047_Over_Load_Failure
  diagnostic event to debounce algorithm mapping EventDebounceMapPowerPath047OverLoadFailure: debounce-algorithm=time_based, diagnostic-event=EventPowerPath047OverLoadFailure  # EventDebounceMap_Power_Path_047_Over_Load_Failure
package /ZeC/DTC/DTC/Power_Path_044_Over_Load_Failure
  diagnostic trouble code uds Power_Path_044_Over_Load_Failure: dtc-props=Dtc_Props_81dfb7ec, uds-dtc-value=0x00552c
  diagnostic event EventPowerPath044OverLoadFailure: aging-allowed=true, event-kind=SWC, prestorage-freeze-frame=false  # Event_Power_Path_044_Over_Load_Failure
  diagnostic event to trouble code uds mapping EventDtcMapPowerPath044OverLoadFailure: diagnostic-event=EventPowerPath044OverLoadFailure, trouble-code-uds=Power_Path_044_Over_Load_Failure  # Event_Dtc_Map_Power_Path_044_Over_Load_Failure
  diagnostic event to operation cycle mapping EventOperCycleMapPowerPath044OverLoadFailure: diagnostic-event=EventPowerPath044OverLoadFailure, operation-cycle=DefaultOperationCycle  # Event_Oper_Cycle_Map_Power_Path_044_Over_Load_Failure
  diagnostic event to debounce algorithm mapping EventDebounceMapPowerPath044OverLoadFailure: debounce-algorithm=time_based, diagnostic-event=EventPowerPath044OverLoadFailure  # EventDebounceMap_Power_Path_044_Over_Load_Failure
package /ZeC/DTC/DTC/Power_Path_043_Over_Load_Failure
  diagnostic trouble code uds Power_Path_043_Over_Load_Failure: dtc-props=Dtc_Props_c7c6bdd6, uds-dtc-value=0x00552b
  diagnostic event EventPowerPath043OverLoadFailure: aging-allowed=true, event-kind=SWC, prestorage-freeze-frame=false  # Event_Power_Path_043_Over_Load_Failure
  diagnostic event to trouble code uds mapping EventDtcMapPowerPath043OverLoadFailure: diagnostic-event=EventPowerPath043OverLoadFailure, trouble-code-uds=Power_Path_043_Over_Load_Failure  # Event_Dtc_Map_Power_Path_043_Over_Load_Failure
  diagnostic event to operation cycle mapping EventOperCycleMapPowerPath043OverLoadFailure: diagnostic-event=EventPowerPath043OverLoadFailure, operation-cycle=DefaultOperationCycle  # Event_Oper_Cycle_Map_Power_Path_043_Over_Load_Failure
  diagnostic event to debounce algorithm mapping EventDebounceMapPowerPath043OverLoadFailure: debounce-algorithm=time_based, diagnostic-event=EventPowerPath043OverLoadFailure  # EventDebounceMap_Power_Path_043_Over_Load_Failure
package /ZeC/DTC/DTC/Power_Path_046_Over_Load_Failure
  diagnostic trouble code uds Power_Path_046_Over_Load_Failure: dtc-props=Dtc_Props_cef88d31, uds-dtc-value=0x00552e
  diagnostic event EventPowerPath046OverLoadFailure: aging-allowed=true, event-kind=SWC, prestorage-freeze-frame=false  # Event_Power_Path_046_Over_Load_Failure
  diagnostic event to trouble code uds mapping EventDtcMapPowerPath046OverLoadFailure: diagnostic-event=EventPowerPath046OverLoadFailure, trouble-code-uds=Power_Path_046_Over_Load_Failure  # Event_Dtc_Map_Power_Path_046_Over_Load_Failure
  diagnostic event to operation cycle mapping EventOperCycleMapPowerPath046OverLoadFailure: diagnostic-event=EventPowerPath046OverLoadFailure, operation-cycle=DefaultOperationCycle  # Event_Oper_Cycle_Map_Power_Path_046_Over_Load_Failure
  diagnostic event to debounce algorithm mapping EventDebounceMapPowerPath046OverLoadFailure: debounce-algorithm=time_based, diagnostic-event=EventPowerPath046OverLoadFailure  # EventDebounceMap_Power_Path_046_Over_Load_Failure
package /ZeC/DTC/DTC/Power_Path_045_Over_Load_Failure
  diagnostic trouble code uds Power_Path_045_Over_Load_Failure: dtc-props=Dtc_Props_88e1870b, uds-dtc-value=0x00552d
  diagnostic event EventPowerPath045OverLoadFailure: aging-allowed=true, event-kind=SWC, prestorage-freeze-frame=false  # Event_Power_Path_045_Over_Load_Failure
  diagnostic event to trouble code uds mapping EventDtcMapPowerPath045OverLoadFailure: diagnostic-event=EventPowerPath045OverLoadFailure, trouble-code-uds=Power_Path_045_Over_Load_Failure  # Event_Dtc_Map_Power_Path_045_Over_Load_Failure
  diagnostic event to operation cycle mapping EventOperCycleMapPowerPath045OverLoadFailure: diagnostic-event=EventPowerPath045OverLoadFailure, operation-cycle=DefaultOperationCycle  # Event_Oper_Cycle_Map_Power_Path_045_Over_Load_Failure
  diagnostic event to debounce algorithm mapping EventDebounceMapPowerPath045OverLoadFailure: debounce-algorithm=time_based, diagnostic-event=EventPowerPath045OverLoadFailure  # EventDebounceMap_Power_Path_045_Over_Load_Failure
package /ZeC/DTC/DTC/Power_Path_048_Over_Load_Failure
  diagnostic trouble code uds Power_Path_048_Over_Load_Failure: dtc-props=Dtc_Props_b0410d67, uds-dtc-value=0x005530
  diagnostic event EventPowerPath048OverLoadFailure: aging-allowed=true, event-kind=SWC, prestorage-freeze-frame=false  # Event_Power_Path_048_Over_Load_Failure
  diagnostic event to trouble code uds mapping EventDtcMapPowerPath048OverLoadFailure: diagnostic-event=EventPowerPath048OverLoadFailure, trouble-code-uds=Power_Path_048_Over_Load_Failure  # Event_Dtc_Map_Power_Path_048_Over_Load_Failure
  diagnostic event to operation cycle mapping EventOperCycleMapPowerPath048OverLoadFailure: diagnostic-event=EventPowerPath048OverLoadFailure, operation-cycle=DefaultOperationCycle  # Event_Oper_Cycle_Map_Power_Path_048_Over_Load_Failure
  diagnostic event to debounce algorithm mapping EventDebounceMapPowerPath048OverLoadFailure: debounce-algorithm=time_based, diagnostic-event=EventPowerPath048OverLoadFailure  # EventDebounceMap_Power_Path_048_Over_Load_Failure
package /ZeC/DTC/DTC/Power_Path_050_Over_Load_Failure
  diagnostic trouble code uds Power_Path_050_Over_Load_Failure: dtc-props=Dtc_Props_3c731913, uds-dtc-value=0x005532
  diagnostic event EventPowerPath050OverLoadFailure: aging-allowed=true, event-kind=SWC, prestorage-freeze-frame=false  # Event_Power_Path_050_Over_Load_Failure
  diagnostic event to trouble code uds mapping EventDtcMapPowerPath050OverLoadFailure: diagnostic-event=EventPowerPath050OverLoadFailure, trouble-code-uds=Power_Path_050_Over_Load_Failure  # Event_Dtc_Map_Power_Path_050_Over_Load_Failure
  diagnostic event to operation cycle mapping EventOperCycleMapPowerPath050OverLoadFailure: diagnostic-event=EventPowerPath050OverLoadFailure, operation-cycle=DefaultOperationCycle  # Event_Oper_Cycle_Map_Power_Path_050_Over_Load_Failure
  diagnostic event to debounce algorithm mapping EventDebounceMapPowerPath050OverLoadFailure: debounce-algorithm=time_based, diagnostic-event=EventPowerPath050OverLoadFailure  # EventDebounceMap_Power_Path_050_Over_Load_Failure
package /ZeC/DTC/DTC/Power_Path_049_Over_Load_Failure
  diagnostic trouble code uds Power_Path_049_Over_Load_Failure: dtc-props=Dtc_Props_f658075d, uds-dtc-value=0x005531
  diagnostic event EventPowerPath049OverLoadFailure: aging-allowed=true, event-kind=SWC, prestorage-freeze-frame=false  # Event_Power_Path_049_Over_Load_Failure
  diagnostic event to trouble code uds mapping EventDtcMapPowerPath049OverLoadFailure: diagnostic-event=EventPowerPath049OverLoadFailure, trouble-code-uds=Power_Path_049_Over_Load_Failure  # Event_Dtc_Map_Power_Path_049_Over_Load_Failure
  diagnostic event to operation cycle mapping EventOperCycleMapPowerPath049OverLoadFailure: diagnostic-event=EventPowerPath049OverLoadFailure, operation-cycle=DefaultOperationCycle  # Event_Oper_Cycle_Map_Power_Path_049_Over_Load_Failure
  diagnostic event to debounce algorithm mapping EventDebounceMapPowerPath049OverLoadFailure: debounce-algorithm=time_based, diagnostic-event=EventPowerPath049OverLoadFailure  # EventDebounceMap_Power_Path_049_Over_Load_Failure
package /ZeC/DTC/DTC/Power_Path_022_Over_Load_Failure
  diagnostic trouble code uds Power_Path_022_Over_Load_Failure: dtc-props=Dtc_Props_a882b08b, uds-dtc-value=0x005516
  diagnostic event EventPowerPath022OverLoadFailure: aging-allowed=true, event-kind=SWC, prestorage-freeze-frame=false  # Event_Power_Path_022_Over_Load_Failure
  diagnostic event to trouble code uds mapping EventDtcMapPowerPath022OverLoadFailure: diagnostic-event=EventPowerPath022OverLoadFailure, trouble-code-uds=Power_Path_022_Over_Load_Failure  # Event_Dtc_Map_Power_Path_022_Over_Load_Failure
  diagnostic event to operation cycle mapping EventOperCycleMapPowerPath022OverLoadFailure: diagnostic-event=EventPowerPath022OverLoadFailure, operation-cycle=DefaultOperationCycle  # Event_Oper_Cycle_Map_Power_Path_022_Over_Load_Failure
  diagnostic event to debounce algorithm mapping EventDebounceMapPowerPath022OverLoadFailure: debounce-algorithm=time_based, diagnostic-event=EventPowerPath022OverLoadFailure  # EventDebounceMap_Power_Path_022_Over_Load_Failure
package /ZeC/DTC/DTC/Power_Path_021_Over_Load_Failure
  diagnostic trouble code uds Power_Path_021_Over_Load_Failure: dtc-props=Dtc_Props_62a9aec5, uds-dtc-value=0x005515
  diagnostic event EventPowerPath021OverLoadFailure: aging-allowed=true, event-kind=SWC, prestorage-freeze-frame=false  # Event_Power_Path_021_Over_Load_Failure
  diagnostic event to trouble code uds mapping EventDtcMapPowerPath021OverLoadFailure: diagnostic-event=EventPowerPath021OverLoadFailure, trouble-code-uds=Power_Path_021_Over_Load_Failure  # Event_Dtc_Map_Power_Path_021_Over_Load_Failure
  diagnostic event to operation cycle mapping EventOperCycleMapPowerPath021OverLoadFailure: diagnostic-event=EventPowerPath021OverLoadFailure, operation-cycle=DefaultOperationCycle  # Event_Oper_Cycle_Map_Power_Path_021_Over_Load_Failure
  diagnostic event to debounce algorithm mapping EventDebounceMapPowerPath021OverLoadFailure: debounce-algorithm=time_based, diagnostic-event=EventPowerPath021OverLoadFailure  # EventDebounceMap_Power_Path_021_Over_Load_Failure
package /ZeC/DTC/DTC/Power_Path_153_Single_Device_Failure
  diagnostic trouble code uds Power_Path_153_Single_Device_Failure: dtc-props=Dtc_Props_7804c1fa, uds-dtc-value=0x005999
  diagnostic event EventPowerPath153SingleDeviceFailure: aging-allowed=true, event-kind=SWC, prestorage-freeze-frame=false  # Event_Power_Path_153_Single_Device_Failure
  diagnostic event to trouble code uds mapping EventDtcMapPowerPath153SingleDeviceFailure: diagnostic-event=EventPowerPath153SingleDeviceFailure, trouble-code-uds=Power_Path_153_Single_Device_Failure  # Event_Dtc_Map_Power_Path_153_Single_Device_Failure
  diagnostic event to operation cycle mapping EventOperCycleMapPowerPath153SingleDeviceFailure: diagnostic-event=EventPowerPath153SingleDeviceFailure, operation-cycle=DefaultOperationCycle  # Event_Oper_Cycle_Map_Power_Path_153_Single_Device_Failure
  diagnostic event to debounce algorithm mapping EventDebounceMapPowerPath153SingleDeviceFailure: debounce-algorithm=time_based, diagnostic-event=EventPowerPath153SingleDeviceFailure  # EventDebounceMap_Power_Path_153_Single_Device_Failure
package /ZeC/DTC/DTC/Power_Path_024_Over_Load_Failure
  diagnostic trouble code uds Power_Path_024_Over_Load_Failure: dtc-props=Dtc_Props_bafed145, uds-dtc-value=0x005518
  diagnostic event EventPowerPath024OverLoadFailure: aging-allowed=true, event-kind=SWC, prestorage-freeze-frame=false  # Event_Power_Path_024_Over_Load_Failure
  diagnostic event to trouble code uds mapping EventDtcMapPowerPath024OverLoadFailure: diagnostic-event=EventPowerPath024OverLoadFailure, trouble-code-uds=Power_Path_024_Over_Load_Failure  # Event_Dtc_Map_Power_Path_024_Over_Load_Failure
  diagnostic event to operation cycle mapping EventOperCycleMapPowerPath024OverLoadFailure: diagnostic-event=EventPowerPath024OverLoadFailure, operation-cycle=DefaultOperationCycle  # Event_Oper_Cycle_Map_Power_Path_024_Over_Load_Failure
  diagnostic event to debounce algorithm mapping EventDebounceMapPowerPath024OverLoadFailure: debounce-algorithm=time_based, diagnostic-event=EventPowerPath024OverLoadFailure  # EventDebounceMap_Power_Path_024_Over_Load_Failure
package /ZeC/DTC/DTC/Power_Path_023_Over_Load_Failure
  diagnostic trouble code uds Power_Path_023_Over_Load_Failure: dtc-props=Dtc_Props_ee9bbab1, uds-dtc-value=0x005517
  diagnostic event EventPowerPath023OverLoadFailure: aging-allowed=true, event-kind=SWC, prestorage-freeze-frame=false  # Event_Power_Path_023_Over_Load_Failure
  diagnostic event to trouble code uds mapping EventDtcMapPowerPath023OverLoadFailure: diagnostic-event=EventPowerPath023OverLoadFailure, trouble-code-uds=Power_Path_023_Over_Load_Failure  # Event_Dtc_Map_Power_Path_023_Over_Load_Failure
  diagnostic event to operation cycle mapping EventOperCycleMapPowerPath023OverLoadFailure: diagnostic-event=EventPowerPath023OverLoadFailure, operation-cycle=DefaultOperationCycle  # Event_Oper_Cycle_Map_Power_Path_023_Over_Load_Failure
  diagnostic event to debounce algorithm mapping EventDebounceMapPowerPath023OverLoadFailure: debounce-algorithm=time_based, diagnostic-event=EventPowerPath023OverLoadFailure  # EventDebounceMap_Power_Path_023_Over_Load_Failure
package /ZeC/DTC/DTC/Power_Path_150_Single_Device_Failure
  diagnostic trouble code uds Power_Path_150_Single_Device_Failure: dtc-props=Dtc_Props_2c61aa0e, uds-dtc-value=0x005996
  diagnostic event EventPowerPath150SingleDeviceFailure: aging-allowed=true, event-kind=SWC, prestorage-freeze-frame=false  # Event_Power_Path_150_Single_Device_Failure
  diagnostic event to trouble code uds mapping EventDtcMapPowerPath150SingleDeviceFailure: diagnostic-event=EventPowerPath150SingleDeviceFailure, trouble-code-uds=Power_Path_150_Single_Device_Failure  # Event_Dtc_Map_Power_Path_150_Single_Device_Failure
  diagnostic event to operation cycle mapping EventOperCycleMapPowerPath150SingleDeviceFailure: diagnostic-event=EventPowerPath150SingleDeviceFailure, operation-cycle=DefaultOperationCycle  # Event_Oper_Cycle_Map_Power_Path_150_Single_Device_Failure
  diagnostic event to debounce algorithm mapping EventDebounceMapPowerPath150SingleDeviceFailure: debounce-algorithm=time_based, diagnostic-event=EventPowerPath150SingleDeviceFailure  # EventDebounceMap_Power_Path_150_Single_Device_Failure
package /ZeC/DTC/DTC/Power_Path_018_Over_Load_Failure
  diagnostic trouble code uds Power_Path_018_Over_Load_Failure: dtc-props=Dtc_Props_6b979e22, uds-dtc-value=0x005512
  diagnostic event EventPowerPath018OverLoadFailure: aging-allowed=true, event-kind=SWC, prestorage-freeze-frame=false  # Event_Power_Path_018_Over_Load_Failure
  diagnostic event to trouble code uds mapping EventDtcMapPowerPath018OverLoadFailure: diagnostic-event=EventPowerPath018OverLoadFailure, trouble-code-uds=Power_Path_018_Over_Load_Failure  # Event_Dtc_Map_Power_Path_018_Over_Load_Failure
  diagnostic event to operation cycle mapping EventOperCycleMapPowerPath018OverLoadFailure: diagnostic-event=EventPowerPath018OverLoadFailure, operation-cycle=DefaultOperationCycle  # Event_Oper_Cycle_Map_Power_Path_018_Over_Load_Failure
  diagnostic event to debounce algorithm mapping EventDebounceMapPowerPath018OverLoadFailure: debounce-algorithm=time_based, diagnostic-event=EventPowerPath018OverLoadFailure  # EventDebounceMap_Power_Path_018_Over_Load_Failure
package /ZeC/DTC/DTC/Power_Path_149_Single_Device_Failure
  diagnostic trouble code uds Power_Path_149_Single_Device_Failure: dtc-props=Dtc_Props_e64ab440, uds-dtc-value=0x005995
  diagnostic event EventPowerPath149SingleDeviceFailure: aging-allowed=true, event-kind=SWC, prestorage-freeze-frame=false  # Event_Power_Path_149_Single_Device_Failure
  diagnostic event to trouble code uds mapping EventDtcMapPowerPath149SingleDeviceFailure: diagnostic-event=EventPowerPath149SingleDeviceFailure, trouble-code-uds=Power_Path_149_Single_Device_Failure  # Event_Dtc_Map_Power_Path_149_Single_Device_Failure
  diagnostic event to operation cycle mapping EventOperCycleMapPowerPath149SingleDeviceFailure: diagnostic-event=EventPowerPath149SingleDeviceFailure, operation-cycle=DefaultOperationCycle  # Event_Oper_Cycle_Map_Power_Path_149_Single_Device_Failure
  diagnostic event to debounce algorithm mapping EventDebounceMapPowerPath149SingleDeviceFailure: debounce-algorithm=time_based, diagnostic-event=EventPowerPath149SingleDeviceFailure  # EventDebounceMap_Power_Path_149_Single_Device_Failure
package /ZeC/DTC/DTC/Power_Path_017_Over_Load_Failure
  diagnostic trouble code uds Power_Path_017_Over_Load_Failure: dtc-props=Dtc_Props_a1bc806c, uds-dtc-value=0x005511
  diagnostic event EventPowerPath017OverLoadFailure: aging-allowed=true, event-kind=SWC, prestorage-freeze-frame=false  # Event_Power_Path_017_Over_Load_Failure
  diagnostic event to trouble code uds mapping EventDtcMapPowerPath017OverLoadFailure: diagnostic-event=EventPowerPath017OverLoadFailure, trouble-code-uds=Power_Path_017_Over_Load_Failure  # Event_Dtc_Map_Power_Path_017_Over_Load_Failure
  diagnostic event to operation cycle mapping EventOperCycleMapPowerPath017OverLoadFailure: diagnostic-event=EventPowerPath017OverLoadFailure, operation-cycle=DefaultOperationCycle  # Event_Oper_Cycle_Map_Power_Path_017_Over_Load_Failure
  diagnostic event to debounce algorithm mapping EventDebounceMapPowerPath017OverLoadFailure: debounce-algorithm=time_based, diagnostic-event=EventPowerPath017OverLoadFailure  # EventDebounceMap_Power_Path_017_Over_Load_Failure
package /ZeC/DTC/DTC/Power_Path_020_Over_Load_Failure
  diagnostic trouble code uds Power_Path_020_Over_Load_Failure: dtc-props=Dtc_Props_24b0a4ff, uds-dtc-value=0x005514
  diagnostic event EventPowerPath020OverLoadFailure: aging-allowed=true, event-kind=SWC, prestorage-freeze-frame=false  # Event_Power_Path_020_Over_Load_Failure
  diagnostic event to trouble code uds mapping EventDtcMapPowerPath020OverLoadFailure: diagnostic-event=EventPowerPath020OverLoadFailure, trouble-code-uds=Power_Path_020_Over_Load_Failure  # Event_Dtc_Map_Power_Path_020_Over_Load_Failure
  diagnostic event to operation cycle mapping EventOperCycleMapPowerPath020OverLoadFailure: diagnostic-event=EventPowerPath020OverLoadFailure, operation-cycle=DefaultOperationCycle  # Event_Oper_Cycle_Map_Power_Path_020_Over_Load_Failure
  diagnostic event to debounce algorithm mapping EventDebounceMapPowerPath020OverLoadFailure: debounce-algorithm=time_based, diagnostic-event=EventPowerPath020OverLoadFailure  # EventDebounceMap_Power_Path_020_Over_Load_Failure
package /ZeC/DTC/DTC/Power_Path_152_Single_Device_Failure
  diagnostic trouble code uds Power_Path_152_Single_Device_Failure: dtc-props=Dtc_Props_3e1dcbc0, uds-dtc-value=0x005998
  diagnostic event EventPowerPath152SingleDeviceFailure: aging-allowed=true, event-kind=SWC, prestorage-freeze-frame=false  # Event_Power_Path_152_Single_Device_Failure
  diagnostic event to trouble code uds mapping EventDtcMapPowerPath152SingleDeviceFailure: diagnostic-event=EventPowerPath152SingleDeviceFailure, trouble-code-uds=Power_Path_152_Single_Device_Failure  # Event_Dtc_Map_Power_Path_152_Single_Device_Failure
  diagnostic event to operation cycle mapping EventOperCycleMapPowerPath152SingleDeviceFailure: diagnostic-event=EventPowerPath152SingleDeviceFailure, operation-cycle=DefaultOperationCycle  # Event_Oper_Cycle_Map_Power_Path_152_Single_Device_Failure
  diagnostic event to debounce algorithm mapping EventDebounceMapPowerPath152SingleDeviceFailure: debounce-algorithm=time_based, diagnostic-event=EventPowerPath152SingleDeviceFailure  # EventDebounceMap_Power_Path_152_Single_Device_Failure
package /ZeC/DTC/DTC/Power_Path_019_Over_Load_Failure
  diagnostic trouble code uds Power_Path_019_Over_Load_Failure: dtc-props=Dtc_Props_2d8e9418, uds-dtc-value=0x005513
  diagnostic event EventPowerPath019OverLoadFailure: aging-allowed=true, event-kind=SWC, prestorage-freeze-frame=false  # Event_Power_Path_019_Over_Load_Failure
  diagnostic event to trouble code uds mapping EventDtcMapPowerPath019OverLoadFailure: diagnostic-event=EventPowerPath019OverLoadFailure, trouble-code-uds=Power_Path_019_Over_Load_Failure  # Event_Dtc_Map_Power_Path_019_Over_Load_Failure
  diagnostic event to operation cycle mapping EventOperCycleMapPowerPath019OverLoadFailure: diagnostic-event=EventPowerPath019OverLoadFailure, operation-cycle=DefaultOperationCycle  # Event_Oper_Cycle_Map_Power_Path_019_Over_Load_Failure
  diagnostic event to debounce algorithm mapping EventDebounceMapPowerPath019OverLoadFailure: debounce-algorithm=time_based, diagnostic-event=EventPowerPath019OverLoadFailure  # EventDebounceMap_Power_Path_019_Over_Load_Failure
package /ZeC/DTC/DTC/Power_Path_151_Single_Device_Failure
  diagnostic trouble code uds Power_Path_151_Single_Device_Failure: dtc-props=Dtc_Props_6a78a034, uds-dtc-value=0x005997
  diagnostic event EventPowerPath151SingleDeviceFailure: aging-allowed=true, event-kind=SWC, prestorage-freeze-frame=false  # Event_Power_Path_151_Single_Device_Failure
  diagnostic event to trouble code uds mapping EventDtcMapPowerPath151SingleDeviceFailure: diagnostic-event=EventPowerPath151SingleDeviceFailure, trouble-code-uds=Power_Path_151_Single_Device_Failure  # Event_Dtc_Map_Power_Path_151_Single_Device_Failure
  diagnostic event to operation cycle mapping EventOperCycleMapPowerPath151SingleDeviceFailure: diagnostic-event=EventPowerPath151SingleDeviceFailure, operation-cycle=DefaultOperationCycle  # Event_Oper_Cycle_Map_Power_Path_151_Single_Device_Failure
  diagnostic event to debounce algorithm mapping EventDebounceMapPowerPath151SingleDeviceFailure: debounce-algorithm=time_based, diagnostic-event=EventPowerPath151SingleDeviceFailure  # EventDebounceMap_Power_Path_151_Single_Device_Failure
package /ZeC/DTC/DTC/Power_Path_155_Single_Device_Failure
  diagnostic trouble code uds Power_Path_155_Single_Device_Failure: dtc-props=Dtc_Props_d28be0da, uds-dtc-value=0x00599b
  diagnostic event EventPowerPath155SingleDeviceFailure: aging-allowed=true, event-kind=SWC, prestorage-freeze-frame=false  # Event_Power_Path_155_Single_Device_Failure
  diagnostic event to trouble code uds mapping EventDtcMapPowerPath155SingleDeviceFailure: diagnostic-event=EventPowerPath155SingleDeviceFailure, trouble-code-uds=Power_Path_155_Single_Device_Failure  # Event_Dtc_Map_Power_Path_155_Single_Device_Failure
  diagnostic event to operation cycle mapping EventOperCycleMapPowerPath155SingleDeviceFailure: diagnostic-event=EventPowerPath155SingleDeviceFailure, operation-cycle=DefaultOperationCycle  # Event_Oper_Cycle_Map_Power_Path_155_Single_Device_Failure
  diagnostic event to debounce algorithm mapping EventDebounceMapPowerPath155SingleDeviceFailure: debounce-algorithm=time_based, diagnostic-event=EventPowerPath155SingleDeviceFailure  # EventDebounceMap_Power_Path_155_Single_Device_Failure
package /ZeC/DTC/DTC/Power_Path_154_Single_Device_Failure
  diagnostic trouble code uds Power_Path_154_Single_Device_Failure: dtc-props=Dtc_Props_18a0fe94, uds-dtc-value=0x00599a
  diagnostic event EventPowerPath154SingleDeviceFailure: aging-allowed=true, event-kind=SWC, prestorage-freeze-frame=false  # Event_Power_Path_154_Single_Device_Failure
  diagnostic event to trouble code uds mapping EventDtcMapPowerPath154SingleDeviceFailure: diagnostic-event=EventPowerPath154SingleDeviceFailure, trouble-code-uds=Power_Path_154_Single_Device_Failure  # Event_Dtc_Map_Power_Path_154_Single_Device_Failure
  diagnostic event to operation cycle mapping EventOperCycleMapPowerPath154SingleDeviceFailure: diagnostic-event=EventPowerPath154SingleDeviceFailure, operation-cycle=DefaultOperationCycle  # Event_Oper_Cycle_Map_Power_Path_154_Single_Device_Failure
  diagnostic event to debounce algorithm mapping EventDebounceMapPowerPath154SingleDeviceFailure: debounce-algorithm=time_based, diagnostic-event=EventPowerPath154SingleDeviceFailure  # EventDebounceMap_Power_Path_154_Single_Device_Failure
package /ZeC/DTC/DTC/Power_Path_157_Single_Device_Failure
  diagnostic trouble code uds Power_Path_157_Single_Device_Failure: dtc-props=Dtc_Props_9dacda07, uds-dtc-value=0x00599d
  diagnostic event EventPowerPath157SingleDeviceFailure: aging-allowed=true, event-kind=SWC, prestorage-freeze-frame=false  # Event_Power_Path_157_Single_Device_Failure
  diagnostic event to trouble code uds mapping EventDtcMapPowerPath157SingleDeviceFailure: diagnostic-event=EventPowerPath157SingleDeviceFailure, trouble-code-uds=Power_Path_157_Single_Device_Failure  # Event_Dtc_Map_Power_Path_157_Single_Device_Failure
  diagnostic event to operation cycle mapping EventOperCycleMapPowerPath157SingleDeviceFailure: diagnostic-event=EventPowerPath157SingleDeviceFailure, operation-cycle=DefaultOperationCycle  # Event_Oper_Cycle_Map_Power_Path_157_Single_Device_Failure
  diagnostic event to debounce algorithm mapping EventDebounceMapPowerPath157SingleDeviceFailure: debounce-algorithm=time_based, diagnostic-event=EventPowerPath157SingleDeviceFailure  # EventDebounceMap_Power_Path_157_Single_Device_Failure
package /ZeC/DTC/DTC/Power_Path_156_Single_Device_Failure
  diagnostic trouble code uds Power_Path_156_Single_Device_Failure: dtc-props=Dtc_Props_9492eae0, uds-dtc-value=0x00599c
  diagnostic event EventPowerPath156SingleDeviceFailure: aging-allowed=true, event-kind=SWC, prestorage-freeze-frame=false  # Event_Power_Path_156_Single_Device_Failure
  diagnostic event to trouble code uds mapping EventDtcMapPowerPath156SingleDeviceFailure: diagnostic-event=EventPowerPath156SingleDeviceFailure, trouble-code-uds=Power_Path_156_Single_Device_Failure  # Event_Dtc_Map_Power_Path_156_Single_Device_Failure
  diagnostic event to operation cycle mapping EventOperCycleMapPowerPath156SingleDeviceFailure: diagnostic-event=EventPowerPath156SingleDeviceFailure, operation-cycle=DefaultOperationCycle  # Event_Oper_Cycle_Map_Power_Path_156_Single_Device_Failure
  diagnostic event to debounce algorithm mapping EventDebounceMapPowerPath156SingleDeviceFailure: debounce-algorithm=time_based, diagnostic-event=EventPowerPath156SingleDeviceFailure  # EventDebounceMap_Power_Path_156_Single_Device_Failure
package /ZeC/DTC/DTC/Power_Path_025_Over_Load_Failure
  diagnostic trouble code uds Power_Path_025_Over_Load_Failure: dtc-props=Dtc_Props_fce7db7f, uds-dtc-value=0x005519
  diagnostic event EventPowerPath025OverLoadFailure: aging-allowed=true, event-kind=SWC, prestorage-freeze-frame=false  # Event_Power_Path_025_Over_Load_Failure
  diagnostic event to trouble code uds mapping EventDtcMapPowerPath025OverLoadFailure: diagnostic-event=EventPowerPath025OverLoadFailure, trouble-code-uds=Power_Path_025_Over_Load_Failure  # Event_Dtc_Map_Power_Path_025_Over_Load_Failure
  diagnostic event to operation cycle mapping EventOperCycleMapPowerPath025OverLoadFailure: diagnostic-event=EventPowerPath025OverLoadFailure, operation-cycle=DefaultOperationCycle  # Event_Oper_Cycle_Map_Power_Path_025_Over_Load_Failure
  diagnostic event to debounce algorithm mapping EventDebounceMapPowerPath025OverLoadFailure: debounce-algorithm=time_based, diagnostic-event=EventPowerPath025OverLoadFailure  # EventDebounceMap_Power_Path_025_Over_Load_Failure
package /ZeC/DTC/DTC/Power_Path_031_Over_Load_Failure
  diagnostic trouble code uds Power_Path_031_Over_Load_Failure: dtc-props=Dtc_Props_957dd4f6, uds-dtc-value=0x00551f
  diagnostic event EventPowerPath031OverLoadFailure: aging-allowed=true, event-kind=SWC, prestorage-freeze-frame=false  # Event_Power_Path_031_Over_Load_Failure
  diagnostic event to trouble code uds mapping EventDtcMapPowerPath031OverLoadFailure: diagnostic-event=EventPowerPath031OverLoadFailure, trouble-code-uds=Power_Path_031_Over_Load_Failure  # Event_Dtc_Map_Power_Path_031_Over_Load_Failure
  diagnostic event to operation cycle mapping EventOperCycleMapPowerPath031OverLoadFailure: diagnostic-event=EventPowerPath031OverLoadFailure, operation-cycle=DefaultOperationCycle  # Event_Oper_Cycle_Map_Power_Path_031_Over_Load_Failure
  diagnostic event to debounce algorithm mapping EventDebounceMapPowerPath031OverLoadFailure: debounce-algorithm=time_based, diagnostic-event=EventPowerPath031OverLoadFailure  # EventDebounceMap_Power_Path_031_Over_Load_Failure
package /ZeC/DTC/DTC/Power_Path_030_Over_Load_Failure
  diagnostic trouble code uds Power_Path_030_Over_Load_Failure: dtc-props=Dtc_Props_5f56cab8, uds-dtc-value=0x00551e
  diagnostic event EventPowerPath030OverLoadFailure: aging-allowed=true, event-kind=SWC, prestorage-freeze-frame=false  # Event_Power_Path_030_Over_Load_Failure
  diagnostic event to trouble code uds mapping EventDtcMapPowerPath030OverLoadFailure: diagnostic-event=EventPowerPath030OverLoadFailure, trouble-code-uds=Power_Path_030_Over_Load_Failure  # Event_Dtc_Map_Power_Path_030_Over_Load_Failure
  diagnostic event to operation cycle mapping EventOperCycleMapPowerPath030OverLoadFailure: diagnostic-event=EventPowerPath030OverLoadFailure, operation-cycle=DefaultOperationCycle  # Event_Oper_Cycle_Map_Power_Path_030_Over_Load_Failure
  diagnostic event to debounce algorithm mapping EventDebounceMapPowerPath030OverLoadFailure: debounce-algorithm=time_based, diagnostic-event=EventPowerPath030OverLoadFailure  # EventDebounceMap_Power_Path_030_Over_Load_Failure
package /ZeC/DTC/DTC/Power_Path_027_Over_Load_Failure
  diagnostic trouble code uds Power_Path_027_Over_Load_Failure: dtc-props=Dtc_Props_5668fa5f, uds-dtc-value=0x00551b
  diagnostic event EventPowerPath027OverLoadFailure: aging-allowed=true, event-kind=SWC, prestorage-freeze-frame=false  # Event_Power_Path_027_Over_Load_Failure
  diagnostic event to trouble code uds mapping EventDtcMapPowerPath027OverLoadFailure: diagnostic-event=EventPowerPath027OverLoadFailure, trouble-code-uds=Power_Path_027_Over_Load_Failure  # Event_Dtc_Map_Power_Path_027_Over_Load_Failure
  diagnostic event to operation cycle mapping EventOperCycleMapPowerPath027OverLoadFailure: diagnostic-event=EventPowerPath027OverLoadFailure, operation-cycle=DefaultOperationCycle  # Event_Oper_Cycle_Map_Power_Path_027_Over_Load_Failure
  diagnostic event to debounce algorithm mapping EventDebounceMapPowerPath027OverLoadFailure: debounce-algorithm=time_based, diagnostic-event=EventPowerPath027OverLoadFailure  # EventDebounceMap_Power_Path_027_Over_Load_Failure
package /ZeC/DTC/DTC/Power_Path_159_Single_Device_Failure
  diagnostic trouble code uds Power_Path_159_Single_Device_Failure: dtc-props=Dtc_Props_119ece73, uds-dtc-value=0x00599f
  diagnostic event EventPowerPath159SingleDeviceFailure: aging-allowed=true, event-kind=SWC, prestorage-freeze-frame=false  # Event_Power_Path_159_Single_Device_Failure
  diagnostic event to trouble code uds mapping EventDtcMapPowerPath159SingleDeviceFailure: diagnostic-event=EventPowerPath159SingleDeviceFailure, trouble-code-uds=Power_Path_159_Single_Device_Failure  # Event_Dtc_Map_Power_Path_159_Single_Device_Failure
  diagnostic event to operation cycle mapping EventOperCycleMapPowerPath159SingleDeviceFailure: diagnostic-event=EventPowerPath159SingleDeviceFailure, operation-cycle=DefaultOperationCycle  # Event_Oper_Cycle_Map_Power_Path_159_Single_Device_Failure
  diagnostic event to debounce algorithm mapping EventDebounceMapPowerPath159SingleDeviceFailure: debounce-algorithm=time_based, diagnostic-event=EventPowerPath159SingleDeviceFailure  # EventDebounceMap_Power_Path_159_Single_Device_Failure
package /ZeC/DTC/DTC/Power_Path_026_Over_Load_Failure
  diagnostic trouble code uds Power_Path_026_Over_Load_Failure: dtc-props=Dtc_Props_9c43e411, uds-dtc-value=0x00551a
  diagnostic event EventPowerPath026OverLoadFailure: aging-allowed=true, event-kind=SWC, prestorage-freeze-frame=false  # Event_Power_Path_026_Over_Load_Failure
  diagnostic event to trouble code uds mapping EventDtcMapPowerPath026OverLoadFailure: diagnostic-event=EventPowerPath026OverLoadFailure, trouble-code-uds=Power_Path_026_Over_Load_Failure  # Event_Dtc_Map_Power_Path_026_Over_Load_Failure
  diagnostic event to operation cycle mapping EventOperCycleMapPowerPath026OverLoadFailure: diagnostic-event=EventPowerPath026OverLoadFailure, operation-cycle=DefaultOperationCycle  # Event_Oper_Cycle_Map_Power_Path_026_Over_Load_Failure
  diagnostic event to debounce algorithm mapping EventDebounceMapPowerPath026OverLoadFailure: debounce-algorithm=time_based, diagnostic-event=EventPowerPath026OverLoadFailure  # EventDebounceMap_Power_Path_026_Over_Load_Failure
package /ZeC/DTC/DTC/Power_Path_158_Single_Device_Failure
  diagnostic trouble code uds Power_Path_158_Single_Device_Failure: dtc-props=Dtc_Props_dbb5d03d, uds-dtc-value=0x00599e
  diagnostic event EventPowerPath158SingleDeviceFailure: aging-allowed=true, event-kind=SWC, prestorage-freeze-frame=false  # Event_Power_Path_158_Single_Device_Failure
  diagnostic event to trouble code uds mapping EventDtcMapPowerPath158SingleDeviceFailure: diagnostic-event=EventPowerPath158SingleDeviceFailure, trouble-code-uds=Power_Path_158_Single_Device_Failure  # Event_Dtc_Map_Power_Path_158_Single_Device_Failure
  diagnostic event to operation cycle mapping EventOperCycleMapPowerPath158SingleDeviceFailure: diagnostic-event=EventPowerPath158SingleDeviceFailure, operation-cycle=DefaultOperationCycle  # Event_Oper_Cycle_Map_Power_Path_158_Single_Device_Failure
  diagnostic event to debounce algorithm mapping EventDebounceMapPowerPath158SingleDeviceFailure: debounce-algorithm=time_based, diagnostic-event=EventPowerPath158SingleDeviceFailure  # EventDebounceMap_Power_Path_158_Single_Device_Failure
package /ZeC/DTC/DTC/Power_Path_029_Over_Load_Failure
  diagnostic trouble code uds Power_Path_029_Over_Load_Failure: dtc-props=Dtc_Props_194fc082, uds-dtc-value=0x00551d
  diagnostic event EventPowerPath029OverLoadFailure: aging-allowed=true, event-kind=SWC, prestorage-freeze-frame=false  # Event_Power_Path_029_Over_Load_Failure
  diagnostic event to trouble code uds mapping EventDtcMapPowerPath029OverLoadFailure: diagnostic-event=EventPowerPath029OverLoadFailure, trouble-code-uds=Power_Path_029_Over_Load_Failure  # Event_Dtc_Map_Power_Path_029_Over_Load_Failure
  diagnostic event to operation cycle mapping EventOperCycleMapPowerPath029OverLoadFailure: diagnostic-event=EventPowerPath029OverLoadFailure, operation-cycle=DefaultOperationCycle  # Event_Oper_Cycle_Map_Power_Path_029_Over_Load_Failure
  diagnostic event to debounce algorithm mapping EventDebounceMapPowerPath029OverLoadFailure: debounce-algorithm=time_based, diagnostic-event=EventPowerPath029OverLoadFailure  # EventDebounceMap_Power_Path_029_Over_Load_Failure
package /ZeC/DTC/DTC/Power_Path_028_Over_Load_Failure
  diagnostic trouble code uds Power_Path_028_Over_Load_Failure: dtc-props=Dtc_Props_1071f065, uds-dtc-value=0x00551c
  diagnostic event EventPowerPath028OverLoadFailure: aging-allowed=true, event-kind=SWC, prestorage-freeze-frame=false  # Event_Power_Path_028_Over_Load_Failure
  diagnostic event to trouble code uds mapping EventDtcMapPowerPath028OverLoadFailure: diagnostic-event=EventPowerPath028OverLoadFailure, trouble-code-uds=Power_Path_028_Over_Load_Failure  # Event_Dtc_Map_Power_Path_028_Over_Load_Failure
  diagnostic event to operation cycle mapping EventOperCycleMapPowerPath028OverLoadFailure: diagnostic-event=EventPowerPath028OverLoadFailure, operation-cycle=DefaultOperationCycle  # Event_Oper_Cycle_Map_Power_Path_028_Over_Load_Failure
  diagnostic event to debounce algorithm mapping EventDebounceMapPowerPath028OverLoadFailure: debounce-algorithm=time_based, diagnostic-event=EventPowerPath028OverLoadFailure  # EventDebounceMap_Power_Path_028_Over_Load_Failure
package /ZeC/DTC/DTC/Power_Path_033_Over_Load_Failure
  diagnostic trouble code uds Power_Path_033_Over_Load_Failure: dtc-props=Dtc_Props_3012c7e5, uds-dtc-value=0x005521
  diagnostic event EventPowerPath033OverLoadFailure: aging-allowed=true, event-kind=SWC, prestorage-freeze-frame=false  # Event_Power_Path_033_Over_Load_Failure
  diagnostic event to trouble code uds mapping EventDtcMapPowerPath033OverLoadFailure: diagnostic-event=EventPowerPath033OverLoadFailure, trouble-code-uds=Power_Path_033_Over_Load_Failure  # Event_Dtc_Map_Power_Path_033_Over_Load_Failure
  diagnostic event to operation cycle mapping EventOperCycleMapPowerPath033OverLoadFailure: diagnostic-event=EventPowerPath033OverLoadFailure, operation-cycle=DefaultOperationCycle  # Event_Oper_Cycle_Map_Power_Path_033_Over_Load_Failure
  diagnostic event to debounce algorithm mapping EventDebounceMapPowerPath033OverLoadFailure: debounce-algorithm=time_based, diagnostic-event=EventPowerPath033OverLoadFailure  # EventDebounceMap_Power_Path_033_Over_Load_Failure
package /ZeC/DTC/DTC/Power_Path_032_Over_Load_Failure
  diagnostic trouble code uds Power_Path_032_Over_Load_Failure: dtc-props=Dtc_Props_760bcddf, uds-dtc-value=0x005520
  diagnostic event EventPowerPath032OverLoadFailure: aging-allowed=true, event-kind=SWC, prestorage-freeze-frame=false  # Event_Power_Path_032_Over_Load_Failure
  diagnostic event to trouble code uds mapping EventDtcMapPowerPath032OverLoadFailure: diagnostic-event=EventPowerPath032OverLoadFailure, trouble-code-uds=Power_Path_032_Over_Load_Failure  # Event_Dtc_Map_Power_Path_032_Over_Load_Failure
  diagnostic event to operation cycle mapping EventOperCycleMapPowerPath032OverLoadFailure: diagnostic-event=EventPowerPath032OverLoadFailure, operation-cycle=DefaultOperationCycle  # Event_Oper_Cycle_Map_Power_Path_032_Over_Load_Failure
  diagnostic event to debounce algorithm mapping EventDebounceMapPowerPath032OverLoadFailure: debounce-algorithm=time_based, diagnostic-event=EventPowerPath032OverLoadFailure  # EventDebounceMap_Power_Path_032_Over_Load_Failure
package /ZeC/DTC/DTC/LIN_9_Slave_2_NoCommunication
  diagnostic trouble code uds LIN_9_Slave_2_NoCommunication: dtc-props=Dtc_Props_358996c7, uds-dtc-value=0x030901  # LIN 9 Slave 2_NoCommunication
  diagnostic event EventLIN9Slave2NoCommunication: aging-allowed=true, event-kind=SWC, prestorage-freeze-frame=false  # Event_LIN 9 Slave 2_NoCommunication
  diagnostic event to trouble code uds mapping EventDtcMapLIN9Slave2NoCommunication: diagnostic-event=EventLIN9Slave2NoCommunication, trouble-code-uds=LIN_9_Slave_2_NoCommunication  # Event_Dtc_Map_LIN 9 Slave 2_NoCommunication
  diagnostic event to operation cycle mapping EventOperCycleMapLIN9Slave2NoCommunication: diagnostic-event=EventLIN9Slave2NoCommunication, operation-cycle=DefaultOperationCycle  # Event_Oper_Cycle_Map_LIN 9 Slave 2_NoCommunication
  diagnostic event to debounce algorithm mapping EventDebounceMapLIN9Slave2NoCommunication: debounce-algorithm=counter_based, diagnostic-event=EventLIN9Slave2NoCommunication  # EventDebounceMap_LIN 9 Slave 2_NoCommunication
package /ZeC/DTC/DTC/Power_Path_069_Single_Device_Failure
  diagnostic trouble code uds Power_Path_069_Single_Device_Failure: dtc-props=Dtc_Props_b2a601f, uds-dtc-value=0x005945
  diagnostic event EventPowerPath069SingleDeviceFailure: aging-allowed=true, event-kind=SWC, prestorage-freeze-frame=false  # Event_Power_Path_069_Single_Device_Failure
  diagnostic event to trouble code uds mapping EventDtcMapPowerPath069SingleDeviceFailure: diagnostic-event=EventPowerPath069SingleDeviceFailure, trouble-code-uds=Power_Path_069_Single_Device_Failure  # Event_Dtc_Map_Power_Path_069_Single_Device_Failure
  diagnostic event to operation cycle mapping EventOperCycleMapPowerPath069SingleDeviceFailure: diagnostic-event=EventPowerPath069SingleDeviceFailure, operation-cycle=DefaultOperationCycle  # Event_Oper_Cycle_Map_Power_Path_069_Single_Device_Failure
  diagnostic event to debounce algorithm mapping EventDebounceMapPowerPath069SingleDeviceFailure: debounce-algorithm=time_based, diagnostic-event=EventPowerPath069SingleDeviceFailure  # EventDebounceMap_Power_Path_069_Single_Device_Failure
package /ZeC/DTC/DTC/Power_Path_068_Single_Device_Failure
  diagnostic trouble code uds Power_Path_068_Single_Device_Failure: dtc-props=Dtc_Props_4d336a25, uds-dtc-value=0x005944
  diagnostic event EventPowerPath068SingleDeviceFailure: aging-allowed=true, event-kind=SWC, prestorage-freeze-frame=false  # Event_Power_Path_068_Single_Device_Failure
  diagnostic event to trouble code uds mapping EventDtcMapPowerPath068SingleDeviceFailure: diagnostic-event=EventPowerPath068SingleDeviceFailure, trouble-code-uds=Power_Path_068_Single_Device_Failure  # Event_Dtc_Map_Power_Path_068_Single_Device_Failure
  diagnostic event to operation cycle mapping EventOperCycleMapPowerPath068SingleDeviceFailure: diagnostic-event=EventPowerPath068SingleDeviceFailure, operation-cycle=DefaultOperationCycle  # Event_Oper_Cycle_Map_Power_Path_068_Single_Device_Failure
  diagnostic event to debounce algorithm mapping EventDebounceMapPowerPath068SingleDeviceFailure: debounce-algorithm=time_based, diagnostic-event=EventPowerPath068SingleDeviceFailure  # EventDebounceMap_Power_Path_068_Single_Device_Failure
package /ZeC/DTC/DTC/LIN_9_Slave_3_NoCommunication
  diagnostic trouble code uds LIN_9_Slave_3_NoCommunication: dtc-props=Dtc_Props_358996c7, uds-dtc-value=0x030903  # LIN 9 Slave 3_NoCommunication
  diagnostic event EventLIN9Slave3NoCommunication: aging-allowed=true, event-kind=SWC, prestorage-freeze-frame=false  # Event_LIN 9 Slave 3_NoCommunication
  diagnostic event to trouble code uds mapping EventDtcMapLIN9Slave3NoCommunication: diagnostic-event=EventLIN9Slave3NoCommunication, trouble-code-uds=LIN_9_Slave_3_NoCommunication  # Event_Dtc_Map_LIN 9 Slave 3_NoCommunication
  diagnostic event to operation cycle mapping EventOperCycleMapLIN9Slave3NoCommunication: diagnostic-event=EventLIN9Slave3NoCommunication, operation-cycle=DefaultOperationCycle  # Event_Oper_Cycle_Map_LIN 9 Slave 3_NoCommunication
  diagnostic event to debounce algorithm mapping EventDebounceMapLIN9Slave3NoCommunication: debounce-algorithm=counter_based, diagnostic-event=EventLIN9Slave3NoCommunication  # EventDebounceMap_LIN 9 Slave 3_NoCommunication
package /ZeC/DTC/DTC/Power_Path_071_Single_Device_Failure
  diagnostic trouble code uds Power_Path_071_Single_Device_Failure: dtc-props=Dtc_Props_8718746b, uds-dtc-value=0x005947
  diagnostic event EventPowerPath071SingleDeviceFailure: aging-allowed=true, event-kind=SWC, prestorage-freeze-frame=false  # Event_Power_Path_071_Single_Device_Failure
  diagnostic event to trouble code uds mapping EventDtcMapPowerPath071SingleDeviceFailure: diagnostic-event=EventPowerPath071SingleDeviceFailure, trouble-code-uds=Power_Path_071_Single_Device_Failure  # Event_Dtc_Map_Power_Path_071_Single_Device_Failure
  diagnostic event to operation cycle mapping EventOperCycleMapPowerPath071SingleDeviceFailure: diagnostic-event=EventPowerPath071SingleDeviceFailure, operation-cycle=DefaultOperationCycle  # Event_Oper_Cycle_Map_Power_Path_071_Single_Device_Failure
  diagnostic event to debounce algorithm mapping EventDebounceMapPowerPath071SingleDeviceFailure: debounce-algorithm=time_based, diagnostic-event=EventPowerPath071SingleDeviceFailure  # EventDebounceMap_Power_Path_071_Single_Device_Failure
package /ZeC/DTC/DTC/LIN_9_Slave_3_Defect
  diagnostic trouble code uds LIN_9_Slave_3_Defect: dtc-props=Dtc_Props_358996c7, uds-dtc-value=0x030902  # LIN 9 Slave 3_Defect
  diagnostic event EventLIN9Slave3Defect: aging-allowed=true, event-kind=SWC, prestorage-freeze-frame=false  # Event_LIN 9 Slave 3_Defect
  diagnostic event to trouble code uds mapping EventDtcMapLIN9Slave3Defect: diagnostic-event=EventLIN9Slave3Defect, trouble-code-uds=LIN_9_Slave_3_Defect  # Event_Dtc_Map_LIN 9 Slave 3_Defect
  diagnostic event to operation cycle mapping EventOperCycleMapLIN9Slave3Defect: diagnostic-event=EventLIN9Slave3Defect, operation-cycle=DefaultOperationCycle  # Event_Oper_Cycle_Map_LIN 9 Slave 3_Defect
  diagnostic event to debounce algorithm mapping EventDebounceMapLIN9Slave3Defect: debounce-algorithm=counter_based, diagnostic-event=EventLIN9Slave3Defect  # EventDebounceMap_LIN 9 Slave 3_Defect
package /ZeC/DTC/DTC/Power_Path_070_Single_Device_Failure
  diagnostic trouble code uds Power_Path_070_Single_Device_Failure: dtc-props=Dtc_Props_c1017e51, uds-dtc-value=0x005946
  diagnostic event EventPowerPath070SingleDeviceFailure: aging-allowed=true, event-kind=SWC, prestorage-freeze-frame=false  # Event_Power_Path_070_Single_Device_Failure
  diagnostic event to trouble code uds mapping EventDtcMapPowerPath070SingleDeviceFailure: diagnostic-event=EventPowerPath070SingleDeviceFailure, trouble-code-uds=Power_Path_070_Single_Device_Failure  # Event_Dtc_Map_Power_Path_070_Single_Device_Failure
  diagnostic event to operation cycle mapping EventOperCycleMapPowerPath070SingleDeviceFailure: diagnostic-event=EventPowerPath070SingleDeviceFailure, operation-cycle=DefaultOperationCycle  # Event_Oper_Cycle_Map_Power_Path_070_Single_Device_Failure
  diagnostic event to debounce algorithm mapping EventDebounceMapPowerPath070SingleDeviceFailure: debounce-algorithm=time_based, diagnostic-event=EventPowerPath070SingleDeviceFailure  # EventDebounceMap_Power_Path_070_Single_Device_Failure
package /ZeC/DTC/DTC/Power_Path_065_Single_Device_Failure
  diagnostic trouble code uds Power_Path_065_Single_Device_Failure: dtc-props=Dtc_Props_c83f4eb6, uds-dtc-value=0x005941
  diagnostic event EventPowerPath065SingleDeviceFailure: aging-allowed=true, event-kind=SWC, prestorage-freeze-frame=false  # Event_Power_Path_065_Single_Device_Failure
  diagnostic event to trouble code uds mapping EventDtcMapPowerPath065SingleDeviceFailure: diagnostic-event=EventPowerPath065SingleDeviceFailure, trouble-code-uds=Power_Path_065_Single_Device_Failure  # Event_Dtc_Map_Power_Path_065_Single_Device_Failure
  diagnostic event to operation cycle mapping EventOperCycleMapPowerPath065SingleDeviceFailure: diagnostic-event=EventPowerPath065SingleDeviceFailure, operation-cycle=DefaultOperationCycle  # Event_Oper_Cycle_Map_Power_Path_065_Single_Device_Failure
  diagnostic event to debounce algorithm mapping EventDebounceMapPowerPath065SingleDeviceFailure: debounce-algorithm=time_based, diagnostic-event=EventPowerPath065SingleDeviceFailure  # EventDebounceMap_Power_Path_065_Single_Device_Failure
package /ZeC/DTC/DTC/Power_Path_064_Single_Device_Failure
  diagnostic trouble code uds Power_Path_064_Single_Device_Failure: dtc-props=Dtc_Props_8e26448c, uds-dtc-value=0x005940
  diagnostic event EventPowerPath064SingleDeviceFailure: aging-allowed=true, event-kind=SWC, prestorage-freeze-frame=false  # Event_Power_Path_064_Single_Device_Failure
  diagnostic event to trouble code uds mapping EventDtcMapPowerPath064SingleDeviceFailure: diagnostic-event=EventPowerPath064SingleDeviceFailure, trouble-code-uds=Power_Path_064_Single_Device_Failure  # Event_Dtc_Map_Power_Path_064_Single_Device_Failure
  diagnostic event to operation cycle mapping EventOperCycleMapPowerPath064SingleDeviceFailure: diagnostic-event=EventPowerPath064SingleDeviceFailure, operation-cycle=DefaultOperationCycle  # Event_Oper_Cycle_Map_Power_Path_064_Single_Device_Failure
  diagnostic event to debounce algorithm mapping EventDebounceMapPowerPath064SingleDeviceFailure: debounce-algorithm=time_based, diagnostic-event=EventPowerPath064SingleDeviceFailure  # EventDebounceMap_Power_Path_064_Single_Device_Failure
package /ZeC/DTC/DTC/Power_Path_067_Single_Device_Failure
  diagnostic trouble code uds Power_Path_067_Single_Device_Failure: dtc-props=Dtc_Props_440d5ac2, uds-dtc-value=0x005943
  diagnostic event EventPowerPath067SingleDeviceFailure: aging-allowed=true, event-kind=SWC, prestorage-freeze-frame=false  # Event_Power_Path_067_Single_Device_Failure
  diagnostic event to trouble code uds mapping EventDtcMapPowerPath067SingleDeviceFailure: diagnostic-event=EventPowerPath067SingleDeviceFailure, trouble-code-uds=Power_Path_067_Single_Device_Failure  # Event_Dtc_Map_Power_Path_067_Single_Device_Failure
  diagnostic event to operation cycle mapping EventOperCycleMapPowerPath067SingleDeviceFailure: diagnostic-event=EventPowerPath067SingleDeviceFailure, operation-cycle=DefaultOperationCycle  # Event_Oper_Cycle_Map_Power_Path_067_Single_Device_Failure
  diagnostic event to debounce algorithm mapping EventDebounceMapPowerPath067SingleDeviceFailure: debounce-algorithm=time_based, diagnostic-event=EventPowerPath067SingleDeviceFailure  # EventDebounceMap_Power_Path_067_Single_Device_Failure
package /ZeC/DTC/DTC/Power_Path_066_Single_Device_Failure
  diagnostic trouble code uds Power_Path_066_Single_Device_Failure: dtc-props=Dtc_Props_21450f8, uds-dtc-value=0x005942
  diagnostic event EventPowerPath066SingleDeviceFailure: aging-allowed=true, event-kind=SWC, prestorage-freeze-frame=false  # Event_Power_Path_066_Single_Device_Failure
  diagnostic event to trouble code uds mapping EventDtcMapPowerPath066SingleDeviceFailure: diagnostic-event=EventPowerPath066SingleDeviceFailure, trouble-code-uds=Power_Path_066_Single_Device_Failure  # Event_Dtc_Map_Power_Path_066_Single_Device_Failure
  diagnostic event to operation cycle mapping EventOperCycleMapPowerPath066SingleDeviceFailure: diagnostic-event=EventPowerPath066SingleDeviceFailure, operation-cycle=DefaultOperationCycle  # Event_Oper_Cycle_Map_Power_Path_066_Single_Device_Failure
  diagnostic event to debounce algorithm mapping EventDebounceMapPowerPath066SingleDeviceFailure: debounce-algorithm=time_based, diagnostic-event=EventPowerPath066SingleDeviceFailure  # EventDebounceMap_Power_Path_066_Single_Device_Failure
package /ZeC/DTC/DTC/Power_Path_073_Single_Device_Failure
  diagnostic trouble code uds Power_Path_073_Single_Device_Failure: dtc-props=Dtc_Props_956415a5, uds-dtc-value=0x005949
  diagnostic event EventPowerPath073SingleDeviceFailure: aging-allowed=true, event-kind=SWC, prestorage-freeze-frame=false  # Event_Power_Path_073_Single_Device_Failure
  diagnostic event to trouble code uds mapping EventDtcMapPowerPath073SingleDeviceFailure: diagnostic-event=EventPowerPath073SingleDeviceFailure, trouble-code-uds=Power_Path_073_Single_Device_Failure  # Event_Dtc_Map_Power_Path_073_Single_Device_Failure
  diagnostic event to operation cycle mapping EventOperCycleMapPowerPath073SingleDeviceFailure: diagnostic-event=EventPowerPath073SingleDeviceFailure, operation-cycle=DefaultOperationCycle  # Event_Oper_Cycle_Map_Power_Path_073_Single_Device_Failure
  diagnostic event to debounce algorithm mapping EventDebounceMapPowerPath073SingleDeviceFailure: debounce-algorithm=time_based, diagnostic-event=EventPowerPath073SingleDeviceFailure  # EventDebounceMap_Power_Path_073_Single_Device_Failure
package /ZeC/DTC/DTC/Power_Path_072_Single_Device_Failure
  diagnostic trouble code uds Power_Path_072_Single_Device_Failure: dtc-props=Dtc_Props_d37d1f9f, uds-dtc-value=0x005948
  diagnostic event EventPowerPath072SingleDeviceFailure: aging-allowed=true, event-kind=SWC, prestorage-freeze-frame=false  # Event_Power_Path_072_Single_Device_Failure
  diagnostic event to trouble code uds mapping EventDtcMapPowerPath072SingleDeviceFailure: diagnostic-event=EventPowerPath072SingleDeviceFailure, trouble-code-uds=Power_Path_072_Single_Device_Failure  # Event_Dtc_Map_Power_Path_072_Single_Device_Failure
  diagnostic event to operation cycle mapping EventOperCycleMapPowerPath072SingleDeviceFailure: diagnostic-event=EventPowerPath072SingleDeviceFailure, operation-cycle=DefaultOperationCycle  # Event_Oper_Cycle_Map_Power_Path_072_Single_Device_Failure
  diagnostic event to debounce algorithm mapping EventDebounceMapPowerPath072SingleDeviceFailure: debounce-algorithm=time_based, diagnostic-event=EventPowerPath072SingleDeviceFailure  # EventDebounceMap_Power_Path_072_Single_Device_Failure
package /ZeC/DTC/DTC/LIN_9_Slave_7_Defect
  diagnostic trouble code uds LIN_9_Slave_7_Defect: dtc-props=Dtc_Props_358996c7, uds-dtc-value=0x03090a  # LIN 9 Slave 7_Defect
  diagnostic event EventLIN9Slave7Defect: aging-allowed=true, event-kind=SWC, prestorage-freeze-frame=false  # Event_LIN 9 Slave 7_Defect
  diagnostic event to trouble code uds mapping EventDtcMapLIN9Slave7Defect: diagnostic-event=EventLIN9Slave7Defect, trouble-code-uds=LIN_9_Slave_7_Defect  # Event_Dtc_Map_LIN 9 Slave 7_Defect
  diagnostic event to operation cycle mapping EventOperCycleMapLIN9Slave7Defect: diagnostic-event=EventLIN9Slave7Defect, operation-cycle=DefaultOperationCycle  # Event_Oper_Cycle_Map_LIN 9 Slave 7_Defect
  diagnostic event to debounce algorithm mapping EventDebounceMapLIN9Slave7Defect: debounce-algorithm=counter_based, diagnostic-event=EventLIN9Slave7Defect  # EventDebounceMap_LIN 9 Slave 7_Defect
package /ZeC/DTC/DTC/Power_Path_078_Single_Device_Failure
  diagnostic trouble code uds Power_Path_078_Single_Device_Failure: dtc-props=Dtc_Props_36d50462, uds-dtc-value=0x00594e
  diagnostic event EventPowerPath078SingleDeviceFailure: aging-allowed=true, event-kind=SWC, prestorage-freeze-frame=false  # Event_Power_Path_078_Single_Device_Failure
  diagnostic event to trouble code uds mapping EventDtcMapPowerPath078SingleDeviceFailure: diagnostic-event=EventPowerPath078SingleDeviceFailure, trouble-code-uds=Power_Path_078_Single_Device_Failure  # Event_Dtc_Map_Power_Path_078_Single_Device_Failure
  diagnostic event to operation cycle mapping EventOperCycleMapPowerPath078SingleDeviceFailure: diagnostic-event=EventPowerPath078SingleDeviceFailure, operation-cycle=DefaultOperationCycle  # Event_Oper_Cycle_Map_Power_Path_078_Single_Device_Failure
  diagnostic event to debounce algorithm mapping EventDebounceMapPowerPath078SingleDeviceFailure: debounce-algorithm=time_based, diagnostic-event=EventPowerPath078SingleDeviceFailure  # EventDebounceMap_Power_Path_078_Single_Device_Failure
package /ZeC/DTC/DTC/Power_Path_077_Single_Device_Failure
  diagnostic trouble code uds Power_Path_077_Single_Device_Failure: dtc-props=Dtc_Props_70cc0e58, uds-dtc-value=0x00594d
  diagnostic event EventPowerPath077SingleDeviceFailure: aging-allowed=true, event-kind=SWC, prestorage-freeze-frame=false  # Event_Power_Path_077_Single_Device_Failure
  diagnostic event to trouble code uds mapping EventDtcMapPowerPath077SingleDeviceFailure: diagnostic-event=EventPowerPath077SingleDeviceFailure, trouble-code-uds=Power_Path_077_Single_Device_Failure  # Event_Dtc_Map_Power_Path_077_Single_Device_Failure
  diagnostic event to operation cycle mapping EventOperCycleMapPowerPath077SingleDeviceFailure: diagnostic-event=EventPowerPath077SingleDeviceFailure, operation-cycle=DefaultOperationCycle  # Event_Oper_Cycle_Map_Power_Path_077_Single_Device_Failure
  diagnostic event to debounce algorithm mapping EventDebounceMapPowerPath077SingleDeviceFailure: debounce-algorithm=time_based, diagnostic-event=EventPowerPath077SingleDeviceFailure  # EventDebounceMap_Power_Path_077_Single_Device_Failure
package /ZeC/DTC/DTC/LIN_9_Slave_8_Defect
  diagnostic trouble code uds LIN_9_Slave_8_Defect: dtc-props=Dtc_Props_358996c7, uds-dtc-value=0x03090c  # LIN 9 Slave 8_Defect
  diagnostic event EventLIN9Slave8Defect: aging-allowed=true, event-kind=SWC, prestorage-freeze-frame=false  # Event_LIN 9 Slave 8_Defect
  diagnostic event to trouble code uds mapping EventDtcMapLIN9Slave8Defect: diagnostic-event=EventLIN9Slave8Defect, trouble-code-uds=LIN_9_Slave_8_Defect  # Event_Dtc_Map_LIN 9 Slave 8_Defect
  diagnostic event to operation cycle mapping EventOperCycleMapLIN9Slave8Defect: diagnostic-event=EventLIN9Slave8Defect, operation-cycle=DefaultOperationCycle  # Event_Oper_Cycle_Map_LIN 9 Slave 8_Defect
  diagnostic event to debounce algorithm mapping EventDebounceMapLIN9Slave8Defect: debounce-algorithm=counter_based, diagnostic-event=EventLIN9Slave8Defect  # EventDebounceMap_LIN 9 Slave 8_Defect
package /ZeC/DTC/DTC/LIN_9_Slave_7_NoCommunication
  diagnostic trouble code uds LIN_9_Slave_7_NoCommunication: dtc-props=Dtc_Props_358996c7, uds-dtc-value=0x03090b  # LIN 9 Slave 7_NoCommunication
  diagnostic event EventLIN9Slave7NoCommunication: aging-allowed=true, event-kind=SWC, prestorage-freeze-frame=false  # Event_LIN 9 Slave 7_NoCommunication
  diagnostic event to trouble code uds mapping EventDtcMapLIN9Slave7NoCommunication: diagnostic-event=EventLIN9Slave7NoCommunication, trouble-code-uds=LIN_9_Slave_7_NoCommunication  # Event_Dtc_Map_LIN 9 Slave 7_NoCommunication
  diagnostic event to operation cycle mapping EventOperCycleMapLIN9Slave7NoCommunication: diagnostic-event=EventLIN9Slave7NoCommunication, operation-cycle=DefaultOperationCycle  # Event_Oper_Cycle_Map_LIN 9 Slave 7_NoCommunication
  diagnostic event to debounce algorithm mapping EventDebounceMapLIN9Slave7NoCommunication: debounce-algorithm=counter_based, diagnostic-event=EventLIN9Slave7NoCommunication  # EventDebounceMap_LIN 9 Slave 7_NoCommunication
package /ZeC/DTC/DTC/Power_Path_079_Single_Device_Failure
  diagnostic trouble code uds Power_Path_079_Single_Device_Failure: dtc-props=Dtc_Props_fcfe1a2c, uds-dtc-value=0x00594f
  diagnostic event EventPowerPath079SingleDeviceFailure: aging-allowed=true, event-kind=SWC, prestorage-freeze-frame=false  # Event_Power_Path_079_Single_Device_Failure
  diagnostic event to trouble code uds mapping EventDtcMapPowerPath079SingleDeviceFailure: diagnostic-event=EventPowerPath079SingleDeviceFailure, trouble-code-uds=Power_Path_079_Single_Device_Failure  # Event_Dtc_Map_Power_Path_079_Single_Device_Failure
  diagnostic event to operation cycle mapping EventOperCycleMapPowerPath079SingleDeviceFailure: diagnostic-event=EventPowerPath079SingleDeviceFailure, operation-cycle=DefaultOperationCycle  # Event_Oper_Cycle_Map_Power_Path_079_Single_Device_Failure
  diagnostic event to debounce algorithm mapping EventDebounceMapPowerPath079SingleDeviceFailure: debounce-algorithm=time_based, diagnostic-event=EventPowerPath079SingleDeviceFailure  # EventDebounceMap_Power_Path_079_Single_Device_Failure
package /ZeC/DTC/DTC/Power_Path_074_Single_Device_Failure
  diagnostic trouble code uds Power_Path_074_Single_Device_Failure: dtc-props=Dtc_Props_f5c02acb, uds-dtc-value=0x00594a
  diagnostic event EventPowerPath074SingleDeviceFailure: aging-allowed=true, event-kind=SWC, prestorage-freeze-frame=false  # Event_Power_Path_074_Single_Device_Failure
  diagnostic event to trouble code uds mapping EventDtcMapPowerPath074SingleDeviceFailure: diagnostic-event=EventPowerPath074SingleDeviceFailure, trouble-code-uds=Power_Path_074_Single_Device_Failure  # Event_Dtc_Map_Power_Path_074_Single_Device_Failure
  diagnostic event to operation cycle mapping EventOperCycleMapPowerPath074SingleDeviceFailure: diagnostic-event=EventPowerPath074SingleDeviceFailure, operation-cycle=DefaultOperationCycle  # Event_Oper_Cycle_Map_Power_Path_074_Single_Device_Failure
  diagnostic event to debounce algorithm mapping EventDebounceMapPowerPath074SingleDeviceFailure: debounce-algorithm=time_based, diagnostic-event=EventPowerPath074SingleDeviceFailure  # EventDebounceMap_Power_Path_074_Single_Device_Failure
package /ZeC/DTC/DTC/Power_Path_076_Single_Device_Failure
  diagnostic trouble code uds Power_Path_076_Single_Device_Failure: dtc-props=Dtc_Props_79f23ebf, uds-dtc-value=0x00594c
  diagnostic event EventPowerPath076SingleDeviceFailure: aging-allowed=true, event-kind=SWC, prestorage-freeze-frame=false  # Event_Power_Path_076_Single_Device_Failure
  diagnostic event to trouble code uds mapping EventDtcMapPowerPath076SingleDeviceFailure: diagnostic-event=EventPowerPath076SingleDeviceFailure, trouble-code-uds=Power_Path_076_Single_Device_Failure  # Event_Dtc_Map_Power_Path_076_Single_Device_Failure
  diagnostic event to operation cycle mapping EventOperCycleMapPowerPath076SingleDeviceFailure: diagnostic-event=EventPowerPath076SingleDeviceFailure, operation-cycle=DefaultOperationCycle  # Event_Oper_Cycle_Map_Power_Path_076_Single_Device_Failure
  diagnostic event to debounce algorithm mapping EventDebounceMapPowerPath076SingleDeviceFailure: debounce-algorithm=time_based, diagnostic-event=EventPowerPath076SingleDeviceFailure  # EventDebounceMap_Power_Path_076_Single_Device_Failure
package /ZeC/DTC/DTC/Power_Path_075_Single_Device_Failure
  diagnostic trouble code uds Power_Path_075_Single_Device_Failure: dtc-props=Dtc_Props_3feb3485, uds-dtc-value=0x00594b
  diagnostic event EventPowerPath075SingleDeviceFailure: aging-allowed=true, event-kind=SWC, prestorage-freeze-frame=false  # Event_Power_Path_075_Single_Device_Failure
  diagnostic event to trouble code uds mapping EventDtcMapPowerPath075SingleDeviceFailure: diagnostic-event=EventPowerPath075SingleDeviceFailure, trouble-code-uds=Power_Path_075_Single_Device_Failure  # Event_Dtc_Map_Power_Path_075_Single_Device_Failure
  diagnostic event to operation cycle mapping EventOperCycleMapPowerPath075SingleDeviceFailure: diagnostic-event=EventPowerPath075SingleDeviceFailure, operation-cycle=DefaultOperationCycle  # Event_Oper_Cycle_Map_Power_Path_075_Single_Device_Failure
  diagnostic event to debounce algorithm mapping EventDebounceMapPowerPath075SingleDeviceFailure: debounce-algorithm=time_based, diagnostic-event=EventPowerPath075SingleDeviceFailure  # EventDebounceMap_Power_Path_075_Single_Device_Failure
package /ZeC/DTC/DTC/LIN_9_Slave_6_NoCommunication
  diagnostic trouble code uds LIN_9_Slave_6_NoCommunication: dtc-props=Dtc_Props_358996c7, uds-dtc-value=0x030909  # LIN 9 Slave 6_NoCommunication
  diagnostic event EventLIN9Slave6NoCommunication: aging-allowed=true, event-kind=SWC, prestorage-freeze-frame=false  # Event_LIN 9 Slave 6_NoCommunication
  diagnostic event to trouble code uds mapping EventDtcMapLIN9Slave6NoCommunication: diagnostic-event=EventLIN9Slave6NoCommunication, trouble-code-uds=LIN_9_Slave_6_NoCommunication  # Event_Dtc_Map_LIN 9 Slave 6_NoCommunication
  diagnostic event to operation cycle mapping EventOperCycleMapLIN9Slave6NoCommunication: diagnostic-event=EventLIN9Slave6NoCommunication, operation-cycle=DefaultOperationCycle  # Event_Oper_Cycle_Map_LIN 9 Slave 6_NoCommunication
  diagnostic event to debounce algorithm mapping EventDebounceMapLIN9Slave6NoCommunication: debounce-algorithm=counter_based, diagnostic-event=EventLIN9Slave6NoCommunication  # EventDebounceMap_LIN 9 Slave 6_NoCommunication
package /ZeC/DTC/DTC/LIN_9_Slave_6_Defect
  diagnostic trouble code uds LIN_9_Slave_6_Defect: dtc-props=Dtc_Props_358996c7, uds-dtc-value=0x030908  # LIN 9 Slave 6_Defect
  diagnostic event EventLIN9Slave6Defect: aging-allowed=true, event-kind=SWC, prestorage-freeze-frame=false  # Event_LIN 9 Slave 6_Defect
  diagnostic event to trouble code uds mapping EventDtcMapLIN9Slave6Defect: diagnostic-event=EventLIN9Slave6Defect, trouble-code-uds=LIN_9_Slave_6_Defect  # Event_Dtc_Map_LIN 9 Slave 6_Defect
  diagnostic event to operation cycle mapping EventOperCycleMapLIN9Slave6Defect: diagnostic-event=EventLIN9Slave6Defect, operation-cycle=DefaultOperationCycle  # Event_Oper_Cycle_Map_LIN 9 Slave 6_Defect
  diagnostic event to debounce algorithm mapping EventDebounceMapLIN9Slave6Defect: debounce-algorithm=counter_based, diagnostic-event=EventLIN9Slave6Defect  # EventDebounceMap_LIN 9 Slave 6_Defect
package /ZeC/DTC/DTC/Power_Path_080_Single_Device_Failure
  diagnostic trouble code uds Power_Path_080_Single_Device_Failure: dtc-props=Dtc_Props_486c8434, uds-dtc-value=0x005950
  diagnostic event EventPowerPath080SingleDeviceFailure: aging-allowed=true, event-kind=SWC, prestorage-freeze-frame=false  # Event_Power_Path_080_Single_Device_Failure
  diagnostic event to trouble code uds mapping EventDtcMapPowerPath080SingleDeviceFailure: diagnostic-event=EventPowerPath080SingleDeviceFailure, trouble-code-uds=Power_Path_080_Single_Device_Failure  # Event_Dtc_Map_Power_Path_080_Single_Device_Failure
  diagnostic event to operation cycle mapping EventOperCycleMapPowerPath080SingleDeviceFailure: diagnostic-event=EventPowerPath080SingleDeviceFailure, operation-cycle=DefaultOperationCycle  # Event_Oper_Cycle_Map_Power_Path_080_Single_Device_Failure
  diagnostic event to debounce algorithm mapping EventDebounceMapPowerPath080SingleDeviceFailure: debounce-algorithm=time_based, diagnostic-event=EventPowerPath080SingleDeviceFailure  # EventDebounceMap_Power_Path_080_Single_Device_Failure
package /ZeC/DTC/DTC/LIN_9_Slave_4_NoCommunication
  diagnostic trouble code uds LIN_9_Slave_4_NoCommunication: dtc-props=Dtc_Props_358996c7, uds-dtc-value=0x030905  # LIN 9 Slave 4_NoCommunication
  diagnostic event EventLIN9Slave4NoCommunication: aging-allowed=true, event-kind=SWC, prestorage-freeze-frame=false  # Event_LIN 9 Slave 4_NoCommunication
  diagnostic event to trouble code uds mapping EventDtcMapLIN9Slave4NoCommunication: diagnostic-event=EventLIN9Slave4NoCommunication, trouble-code-uds=LIN_9_Slave_4_NoCommunication  # Event_Dtc_Map_LIN 9 Slave 4_NoCommunication
  diagnostic event to operation cycle mapping EventOperCycleMapLIN9Slave4NoCommunication: diagnostic-event=EventLIN9Slave4NoCommunication, operation-cycle=DefaultOperationCycle  # Event_Oper_Cycle_Map_LIN 9 Slave 4_NoCommunication
  diagnostic event to debounce algorithm mapping EventDebounceMapLIN9Slave4NoCommunication: debounce-algorithm=counter_based, diagnostic-event=EventLIN9Slave4NoCommunication  # EventDebounceMap_LIN 9 Slave 4_NoCommunication
package /ZeC/DTC/DTC/LIN_9_Slave_4_Defect
  diagnostic trouble code uds LIN_9_Slave_4_Defect: dtc-props=Dtc_Props_358996c7, uds-dtc-value=0x030904  # LIN 9 Slave 4_Defect
  diagnostic event EventLIN9Slave4Defect: aging-allowed=true, event-kind=SWC, prestorage-freeze-frame=false  # Event_LIN 9 Slave 4_Defect
  diagnostic event to trouble code uds mapping EventDtcMapLIN9Slave4Defect: diagnostic-event=EventLIN9Slave4Defect, trouble-code-uds=LIN_9_Slave_4_Defect  # Event_Dtc_Map_LIN 9 Slave 4_Defect
  diagnostic event to operation cycle mapping EventOperCycleMapLIN9Slave4Defect: diagnostic-event=EventLIN9Slave4Defect, operation-cycle=DefaultOperationCycle  # Event_Oper_Cycle_Map_LIN 9 Slave 4_Defect
  diagnostic event to debounce algorithm mapping EventDebounceMapLIN9Slave4Defect: debounce-algorithm=counter_based, diagnostic-event=EventLIN9Slave4Defect  # EventDebounceMap_LIN 9 Slave 4_Defect
package /ZeC/DTC/DTC/LIN_9_Slave_5_NoCommunication
  diagnostic trouble code uds LIN_9_Slave_5_NoCommunication: dtc-props=Dtc_Props_358996c7, uds-dtc-value=0x030907  # LIN 9 Slave 5_NoCommunication
  diagnostic event EventLIN9Slave5NoCommunication: aging-allowed=true, event-kind=SWC, prestorage-freeze-frame=false  # Event_LIN 9 Slave 5_NoCommunication
  diagnostic event to trouble code uds mapping EventDtcMapLIN9Slave5NoCommunication: diagnostic-event=EventLIN9Slave5NoCommunication, trouble-code-uds=LIN_9_Slave_5_NoCommunication  # Event_Dtc_Map_LIN 9 Slave 5_NoCommunication
  diagnostic event to operation cycle mapping EventOperCycleMapLIN9Slave5NoCommunication: diagnostic-event=EventLIN9Slave5NoCommunication, operation-cycle=DefaultOperationCycle  # Event_Oper_Cycle_Map_LIN 9 Slave 5_NoCommunication
  diagnostic event to debounce algorithm mapping EventDebounceMapLIN9Slave5NoCommunication: debounce-algorithm=counter_based, diagnostic-event=EventLIN9Slave5NoCommunication  # EventDebounceMap_LIN 9 Slave 5_NoCommunication
package /ZeC/DTC/DTC/LIN_9_Slave_5_Defect
  diagnostic trouble code uds LIN_9_Slave_5_Defect: dtc-props=Dtc_Props_358996c7, uds-dtc-value=0x030906  # LIN 9 Slave 5_Defect
  diagnostic event EventLIN9Slave5Defect: aging-allowed=true, event-kind=SWC, prestorage-freeze-frame=false  # Event_LIN 9 Slave 5_Defect
  diagnostic event to trouble code uds mapping EventDtcMapLIN9Slave5Defect: diagnostic-event=EventLIN9Slave5Defect, trouble-code-uds=LIN_9_Slave_5_Defect  # Event_Dtc_Map_LIN 9 Slave 5_Defect
  diagnostic event to operation cycle mapping EventOperCycleMapLIN9Slave5Defect: diagnostic-event=EventLIN9Slave5Defect, operation-cycle=DefaultOperationCycle  # Event_Oper_Cycle_Map_LIN 9 Slave 5_Defect
  diagnostic event to debounce algorithm mapping EventDebounceMapLIN9Slave5Defect: debounce-algorithm=counter_based, diagnostic-event=EventLIN9Slave5Defect  # EventDebounceMap_LIN 9 Slave 5_Defect
package /ZeC/DTC/DTC/LIN_9_Slave_10_Defect
  diagnostic trouble code uds LIN_9_Slave_10_Defect: dtc-props=Dtc_Props_358996c7, uds-dtc-value=0x030912  # LIN 9 Slave 10_Defect
  diagnostic event EventLIN9Slave10Defect: aging-allowed=true, event-kind=SWC, prestorage-freeze-frame=false  # Event_LIN 9 Slave 10_Defect
  diagnostic event to trouble code uds mapping EventDtcMapLIN9Slave10Defect: diagnostic-event=EventLIN9Slave10Defect, trouble-code-uds=LIN_9_Slave_10_Defect  # Event_Dtc_Map_LIN 9 Slave 10_Defect
  diagnostic event to operation cycle mapping EventOperCycleMapLIN9Slave10Defect: diagnostic-event=EventLIN9Slave10Defect, operation-cycle=DefaultOperationCycle  # Event_Oper_Cycle_Map_LIN 9 Slave 10_Defect
  diagnostic event to debounce algorithm mapping EventDebounceMapLIN9Slave10Defect: debounce-algorithm=counter_based, diagnostic-event=EventLIN9Slave10Defect  # EventDebounceMap_LIN 9 Slave 10_Defect
package /ZeC/DTC/DTC/Power_Path_052_Single_Device_Failure
  diagnostic trouble code uds Power_Path_052_Single_Device_Failure: dtc-props=Dtc_Props_735423ce, uds-dtc-value=0x005934
  diagnostic event EventPowerPath052SingleDeviceFailure: aging-allowed=true, event-kind=SWC, prestorage-freeze-frame=false  # Event_Power_Path_052_Single_Device_Failure
  diagnostic event to trouble code uds mapping EventDtcMapPowerPath052SingleDeviceFailure: diagnostic-event=EventPowerPath052SingleDeviceFailure, trouble-code-uds=Power_Path_052_Single_Device_Failure  # Event_Dtc_Map_Power_Path_052_Single_Device_Failure
  diagnostic event to operation cycle mapping EventOperCycleMapPowerPath052SingleDeviceFailure: diagnostic-event=EventPowerPath052SingleDeviceFailure, operation-cycle=DefaultOperationCycle  # Event_Oper_Cycle_Map_Power_Path_052_Single_Device_Failure
  diagnostic event to debounce algorithm mapping EventDebounceMapPowerPath052SingleDeviceFailure: debounce-algorithm=time_based, diagnostic-event=EventPowerPath052SingleDeviceFailure  # EventDebounceMap_Power_Path_052_Single_Device_Failure
package /ZeC/DTC/DTC/LIN_9_Slave_1_NoCommunication
  diagnostic trouble code uds LIN_9_Slave_1_NoCommunication: dtc-props=Dtc_Props_358996c7, uds-dtc-value=0x030911  # LIN 9 Slave 1_NoCommunication
  diagnostic event EventLIN9Slave1NoCommunication: aging-allowed=true, event-kind=SWC, prestorage-freeze-frame=false  # Event_LIN 9 Slave 1_NoCommunication
  diagnostic event to trouble code uds mapping EventDtcMapLIN9Slave1NoCommunication: diagnostic-event=EventLIN9Slave1NoCommunication, trouble-code-uds=LIN_9_Slave_1_NoCommunication  # Event_Dtc_Map_LIN 9 Slave 1_NoCommunication
  diagnostic event to operation cycle mapping EventOperCycleMapLIN9Slave1NoCommunication: diagnostic-event=EventLIN9Slave1NoCommunication, operation-cycle=DefaultOperationCycle  # Event_Oper_Cycle_Map_LIN 9 Slave 1_NoCommunication
  diagnostic event to debounce algorithm mapping EventDebounceMapLIN9Slave1NoCommunication: debounce-algorithm=counter_based, diagnostic-event=EventLIN9Slave1NoCommunication  # EventDebounceMap_LIN 9 Slave 1_NoCommunication
package /ZeC/DTC/DTC/Power_Path_051_Single_Device_Failure
  diagnostic trouble code uds Power_Path_051_Single_Device_Failure: dtc-props=Dtc_Props_7a6a1329, uds-dtc-value=0x005933
  diagnostic event EventPowerPath051SingleDeviceFailure: aging-allowed=true, event-kind=SWC, prestorage-freeze-frame=false  # Event_Power_Path_051_Single_Device_Failure
  diagnostic event to trouble code uds mapping EventDtcMapPowerPath051SingleDeviceFailure: diagnostic-event=EventPowerPath051SingleDeviceFailure, trouble-code-uds=Power_Path_051_Single_Device_Failure  # Event_Dtc_Map_Power_Path_051_Single_Device_Failure
  diagnostic event to operation cycle mapping EventOperCycleMapPowerPath051SingleDeviceFailure: diagnostic-event=EventPowerPath051SingleDeviceFailure, operation-cycle=DefaultOperationCycle  # Event_Oper_Cycle_Map_Power_Path_051_Single_Device_Failure
  diagnostic event to debounce algorithm mapping EventDebounceMapPowerPath051SingleDeviceFailure: debounce-algorithm=time_based, diagnostic-event=EventPowerPath051SingleDeviceFailure  # EventDebounceMap_Power_Path_051_Single_Device_Failure
package /ZeC/DTC/DTC/LIN_9_Slave_11_Defect
  diagnostic trouble code uds LIN_9_Slave_11_Defect: dtc-props=Dtc_Props_358996c7, uds-dtc-value=0x030914  # LIN 9 Slave 11_Defect
  diagnostic event EventLIN9Slave11Defect: aging-allowed=true, event-kind=SWC, prestorage-freeze-frame=false  # Event_LIN 9 Slave 11_Defect
  diagnostic event to trouble code uds mapping EventDtcMapLIN9Slave11Defect: diagnostic-event=EventLIN9Slave11Defect, trouble-code-uds=LIN_9_Slave_11_Defect  # Event_Dtc_Map_LIN 9 Slave 11_Defect
  diagnostic event to operation cycle mapping EventOperCycleMapLIN9Slave11Defect: diagnostic-event=EventLIN9Slave11Defect, operation-cycle=DefaultOperationCycle  # Event_Oper_Cycle_Map_LIN 9 Slave 11_Defect
  diagnostic event to debounce algorithm mapping EventDebounceMapLIN9Slave11Defect: debounce-algorithm=counter_based, diagnostic-event=EventLIN9Slave11Defect  # EventDebounceMap_LIN 9 Slave 11_Defect
package /ZeC/DTC/DTC/Power_Path_054_Single_Device_Failure
  diagnostic trouble code uds Power_Path_054_Single_Device_Failure: dtc-props=Dtc_Props_ff6637ba, uds-dtc-value=0x005936
  diagnostic event EventPowerPath054SingleDeviceFailure: aging-allowed=true, event-kind=SWC, prestorage-freeze-frame=false  # Event_Power_Path_054_Single_Device_Failure
  diagnostic event to trouble code uds mapping EventDtcMapPowerPath054SingleDeviceFailure: diagnostic-event=EventPowerPath054SingleDeviceFailure, trouble-code-uds=Power_Path_054_Single_Device_Failure  # Event_Dtc_Map_Power_Path_054_Single_Device_Failure
  diagnostic event to operation cycle mapping EventOperCycleMapPowerPath054SingleDeviceFailure: diagnostic-event=EventPowerPath054SingleDeviceFailure, operation-cycle=DefaultOperationCycle  # Event_Oper_Cycle_Map_Power_Path_054_Single_Device_Failure
  diagnostic event to debounce algorithm mapping EventDebounceMapPowerPath054SingleDeviceFailure: debounce-algorithm=time_based, diagnostic-event=EventPowerPath054SingleDeviceFailure  # EventDebounceMap_Power_Path_054_Single_Device_Failure
package /ZeC/DTC/DTC/LIN_9_Slave_10_NoCommunication
  diagnostic trouble code uds LIN_9_Slave_10_NoCommunication: dtc-props=Dtc_Props_358996c7, uds-dtc-value=0x030913  # LIN 9 Slave 10_NoCommunication
  diagnostic event EventLIN9Slave10NoCommunication: aging-allowed=true, event-kind=SWC, prestorage-freeze-frame=false  # Event_LIN 9 Slave 10_NoCommunication
  diagnostic event to trouble code uds mapping EventDtcMapLIN9Slave10NoCommunication: diagnostic-event=EventLIN9Slave10NoCommunication, trouble-code-uds=LIN_9_Slave_10_NoCommunication  # Event_Dtc_Map_LIN 9 Slave 10_NoCommunication
  diagnostic event to operation cycle mapping EventOperCycleMapLIN9Slave10NoCommunication: diagnostic-event=EventLIN9Slave10NoCommunication, operation-cycle=DefaultOperationCycle  # Event_Oper_Cycle_Map_LIN 9 Slave 10_NoCommunication
  diagnostic event to debounce algorithm mapping EventDebounceMapLIN9Slave10NoCommunication: debounce-algorithm=counter_based, diagnostic-event=EventLIN9Slave10NoCommunication  # EventDebounceMap_LIN 9 Slave 10_NoCommunication
package /ZeC/DTC/DTC/Power_Path_053_Single_Device_Failure
  diagnostic trouble code uds Power_Path_053_Single_Device_Failure: dtc-props=Dtc_Props_354d29f4, uds-dtc-value=0x005935
  diagnostic event EventPowerPath053SingleDeviceFailure: aging-allowed=true, event-kind=SWC, prestorage-freeze-frame=false  # Event_Power_Path_053_Single_Device_Failure
  diagnostic event to trouble code uds mapping EventDtcMapPowerPath053SingleDeviceFailure: diagnostic-event=EventPowerPath053SingleDeviceFailure, trouble-code-uds=Power_Path_053_Single_Device_Failure  # Event_Dtc_Map_Power_Path_053_Single_Device_Failure
  diagnostic event to operation cycle mapping EventOperCycleMapPowerPath053SingleDeviceFailure: diagnostic-event=EventPowerPath053SingleDeviceFailure, operation-cycle=DefaultOperationCycle  # Event_Oper_Cycle_Map_Power_Path_053_Single_Device_Failure
  diagnostic event to debounce algorithm mapping EventDebounceMapPowerPath053SingleDeviceFailure: debounce-algorithm=time_based, diagnostic-event=EventPowerPath053SingleDeviceFailure  # EventDebounceMap_Power_Path_053_Single_Device_Failure
package /ZeC/DTC/DTC/Power_Path_048_Single_Device_Failure
  diagnostic trouble code uds Power_Path_048_Single_Device_Failure: dtc-props=Dtc_Props_b0410d67, uds-dtc-value=0x005930
  diagnostic event EventPowerPath048SingleDeviceFailure: aging-allowed=true, event-kind=SWC, prestorage-freeze-frame=false  # Event_Power_Path_048_Single_Device_Failure
  diagnostic event to trouble code uds mapping EventDtcMapPowerPath048SingleDeviceFailure: diagnostic-event=EventPowerPath048SingleDeviceFailure, trouble-code-uds=Power_Path_048_Single_Device_Failure  # Event_Dtc_Map_Power_Path_048_Single_Device_Failure
  diagnostic event to operation cycle mapping EventOperCycleMapPowerPath048SingleDeviceFailure: diagnostic-event=EventPowerPath048SingleDeviceFailure, operation-cycle=DefaultOperationCycle  # Event_Oper_Cycle_Map_Power_Path_048_Single_Device_Failure
  diagnostic event to debounce algorithm mapping EventDebounceMapPowerPath048SingleDeviceFailure: debounce-algorithm=time_based, diagnostic-event=EventPowerPath048SingleDeviceFailure  # EventDebounceMap_Power_Path_048_Single_Device_Failure
package /ZeC/DTC/DTC/LIN_9_Slave_1_Defect
  diagnostic trouble code uds LIN_9_Slave_1_Defect: dtc-props=Dtc_Props_358996c7, uds-dtc-value=0x030910  # LIN 9 Slave 1_Defect
  diagnostic event EventLIN9Slave1Defect: aging-allowed=true, event-kind=SWC, prestorage-freeze-frame=false  # Event_LIN 9 Slave 1_Defect
  diagnostic event to trouble code uds mapping EventDtcMapLIN9Slave1Defect: diagnostic-event=EventLIN9Slave1Defect, trouble-code-uds=LIN_9_Slave_1_Defect  # Event_Dtc_Map_LIN 9 Slave 1_Defect
  diagnostic event to operation cycle mapping EventOperCycleMapLIN9Slave1Defect: diagnostic-event=EventLIN9Slave1Defect, operation-cycle=DefaultOperationCycle  # Event_Oper_Cycle_Map_LIN 9 Slave 1_Defect
  diagnostic event to debounce algorithm mapping EventDebounceMapLIN9Slave1Defect: debounce-algorithm=counter_based, diagnostic-event=EventLIN9Slave1Defect  # EventDebounceMap_LIN 9 Slave 1_Defect
package /ZeC/DTC/DTC/Power_Path_050_Single_Device_Failure
  diagnostic trouble code uds Power_Path_050_Single_Device_Failure: dtc-props=Dtc_Props_3c731913, uds-dtc-value=0x005932
  diagnostic event EventPowerPath050SingleDeviceFailure: aging-allowed=true, event-kind=SWC, prestorage-freeze-frame=false  # Event_Power_Path_050_Single_Device_Failure
  diagnostic event to trouble code uds mapping EventDtcMapPowerPath050SingleDeviceFailure: diagnostic-event=EventPowerPath050SingleDeviceFailure, trouble-code-uds=Power_Path_050_Single_Device_Failure  # Event_Dtc_Map_Power_Path_050_Single_Device_Failure
  diagnostic event to operation cycle mapping EventOperCycleMapPowerPath050SingleDeviceFailure: diagnostic-event=EventPowerPath050SingleDeviceFailure, operation-cycle=DefaultOperationCycle  # Event_Oper_Cycle_Map_Power_Path_050_Single_Device_Failure
  diagnostic event to debounce algorithm mapping EventDebounceMapPowerPath050SingleDeviceFailure: debounce-algorithm=time_based, diagnostic-event=EventPowerPath050SingleDeviceFailure  # EventDebounceMap_Power_Path_050_Single_Device_Failure
package /ZeC/DTC/DTC/Power_Path_049_Single_Device_Failure
  diagnostic trouble code uds Power_Path_049_Single_Device_Failure: dtc-props=Dtc_Props_f658075d, uds-dtc-value=0x005931
  diagnostic event EventPowerPath049SingleDeviceFailure: aging-allowed=true, event-kind=SWC, prestorage-freeze-frame=false  # Event_Power_Path_049_Single_Device_Failure
  diagnostic event to trouble code uds mapping EventDtcMapPowerPath049SingleDeviceFailure: diagnostic-event=EventPowerPath049SingleDeviceFailure, trouble-code-uds=Power_Path_049_Single_Device_Failure  # Event_Dtc_Map_Power_Path_049_Single_Device_Failure
  diagnostic event to operation cycle mapping EventOperCycleMapPowerPath049SingleDeviceFailure: diagnostic-event=EventPowerPath049SingleDeviceFailure, operation-cycle=DefaultOperationCycle  # Event_Oper_Cycle_Map_Power_Path_049_Single_Device_Failure
  diagnostic event to debounce algorithm mapping EventDebounceMapPowerPath049SingleDeviceFailure: debounce-algorithm=time_based, diagnostic-event=EventPowerPath049SingleDeviceFailure  # EventDebounceMap_Power_Path_049_Single_Device_Failure
package /ZeC/DTC/DTC/LIN_9_Slave_9_Defect
  diagnostic trouble code uds LIN_9_Slave_9_Defect: dtc-props=Dtc_Props_358996c7, uds-dtc-value=0x03090e  # LIN 9 Slave 9_Defect
  diagnostic event EventLIN9Slave9Defect: aging-allowed=true, event-kind=SWC, prestorage-freeze-frame=false  # Event_LIN 9 Slave 9_Defect
  diagnostic event to trouble code uds mapping EventDtcMapLIN9Slave9Defect: diagnostic-event=EventLIN9Slave9Defect, trouble-code-uds=LIN_9_Slave_9_Defect  # Event_Dtc_Map_LIN 9 Slave 9_Defect
  diagnostic event to operation cycle mapping EventOperCycleMapLIN9Slave9Defect: diagnostic-event=EventLIN9Slave9Defect, operation-cycle=DefaultOperationCycle  # Event_Oper_Cycle_Map_LIN 9 Slave 9_Defect
  diagnostic event to debounce algorithm mapping EventDebounceMapLIN9Slave9Defect: debounce-algorithm=counter_based, diagnostic-event=EventLIN9Slave9Defect  # EventDebounceMap_LIN 9 Slave 9_Defect
package /ZeC/DTC/DTC/Power_Path_056_Single_Device_Failure
  diagnostic trouble code uds Power_Path_056_Single_Device_Failure: dtc-props=Dtc_Props_ed1a5674, uds-dtc-value=0x005938
  diagnostic event EventPowerPath056SingleDeviceFailure: aging-allowed=true, event-kind=SWC, prestorage-freeze-frame=false  # Event_Power_Path_056_Single_Device_Failure
  diagnostic event to trouble code uds mapping EventDtcMapPowerPath056SingleDeviceFailure: diagnostic-event=EventPowerPath056SingleDeviceFailure, trouble-code-uds=Power_Path_056_Single_Device_Failure  # Event_Dtc_Map_Power_Path_056_Single_Device_Failure
  diagnostic event to operation cycle mapping EventOperCycleMapPowerPath056SingleDeviceFailure: diagnostic-event=EventPowerPath056SingleDeviceFailure, operation-cycle=DefaultOperationCycle  # Event_Oper_Cycle_Map_Power_Path_056_Single_Device_Failure
  diagnostic event to debounce algorithm mapping EventDebounceMapPowerPath056SingleDeviceFailure: debounce-algorithm=time_based, diagnostic-event=EventPowerPath056SingleDeviceFailure  # EventDebounceMap_Power_Path_056_Single_Device_Failure
package /ZeC/DTC/DTC/LIN_9_Slave_8_NoCommunication
  diagnostic trouble code uds LIN_9_Slave_8_NoCommunication: dtc-props=Dtc_Props_358996c7, uds-dtc-value=0x03090d  # LIN 9 Slave 8_NoCommunication
  diagnostic event EventLIN9Slave8NoCommunication: aging-allowed=true, event-kind=SWC, prestorage-freeze-frame=false  # Event_LIN 9 Slave 8_NoCommunication
  diagnostic event to trouble code uds mapping EventDtcMapLIN9Slave8NoCommunication: diagnostic-event=EventLIN9Slave8NoCommunication, trouble-code-uds=LIN_9_Slave_8_NoCommunication  # Event_Dtc_Map_LIN 9 Slave 8_NoCommunication
  diagnostic event to operation cycle mapping EventOperCycleMapLIN9Slave8NoCommunication: diagnostic-event=EventLIN9Slave8NoCommunication, operation-cycle=DefaultOperationCycle  # Event_Oper_Cycle_Map_LIN 9 Slave 8_NoCommunication
  diagnostic event to debounce algorithm mapping EventDebounceMapLIN9Slave8NoCommunication: debounce-algorithm=counter_based, diagnostic-event=EventLIN9Slave8NoCommunication  # EventDebounceMap_LIN 9 Slave 8_NoCommunication
package /ZeC/DTC/DTC/Power_Path_055_Single_Device_Failure
  diagnostic trouble code uds Power_Path_055_Single_Device_Failure: dtc-props=Dtc_Props_b97f3d80, uds-dtc-value=0x005937
  diagnostic event EventPowerPath055SingleDeviceFailure: aging-allowed=true, event-kind=SWC, prestorage-freeze-frame=false  # Event_Power_Path_055_Single_Device_Failure
  diagnostic event to trouble code uds mapping EventDtcMapPowerPath055SingleDeviceFailure: diagnostic-event=EventPowerPath055SingleDeviceFailure, trouble-code-uds=Power_Path_055_Single_Device_Failure  # Event_Dtc_Map_Power_Path_055_Single_Device_Failure
  diagnostic event to operation cycle mapping EventOperCycleMapPowerPath055SingleDeviceFailure: diagnostic-event=EventPowerPath055SingleDeviceFailure, operation-cycle=DefaultOperationCycle  # Event_Oper_Cycle_Map_Power_Path_055_Single_Device_Failure
  diagnostic event to debounce algorithm mapping EventDebounceMapPowerPath055SingleDeviceFailure: debounce-algorithm=time_based, diagnostic-event=EventPowerPath055SingleDeviceFailure  # EventDebounceMap_Power_Path_055_Single_Device_Failure
package /ZeC/DTC/DTC/LIN_9_Slave_9_NoCommunication
  diagnostic trouble code uds LIN_9_Slave_9_NoCommunication: dtc-props=Dtc_Props_358996c7, uds-dtc-value=0x03090f  # LIN 9 Slave 9_NoCommunication
  diagnostic event EventLIN9Slave9NoCommunication: aging-allowed=true, event-kind=SWC, prestorage-freeze-frame=false  # Event_LIN 9 Slave 9_NoCommunication
  diagnostic event to trouble code uds mapping EventDtcMapLIN9Slave9NoCommunication: diagnostic-event=EventLIN9Slave9NoCommunication, trouble-code-uds=LIN_9_Slave_9_NoCommunication  # Event_Dtc_Map_LIN 9 Slave 9_NoCommunication
  diagnostic event to operation cycle mapping EventOperCycleMapLIN9Slave9NoCommunication: diagnostic-event=EventLIN9Slave9NoCommunication, operation-cycle=DefaultOperationCycle  # Event_Oper_Cycle_Map_LIN 9 Slave 9_NoCommunication
  diagnostic event to debounce algorithm mapping EventDebounceMapLIN9Slave9NoCommunication: debounce-algorithm=counter_based, diagnostic-event=EventLIN9Slave9NoCommunication  # EventDebounceMap_LIN 9 Slave 9_NoCommunication
package /ZeC/DTC/DTC/Power_Path_057_Single_Device_Failure
  diagnostic trouble code uds Power_Path_057_Single_Device_Failure: dtc-props=Dtc_Props_ab035c4e, uds-dtc-value=0x005939
  diagnostic event EventPowerPath057SingleDeviceFailure: aging-allowed=true, event-kind=SWC, prestorage-freeze-frame=false  # Event_Power_Path_057_Single_Device_Failure
  diagnostic event to trouble code uds mapping EventDtcMapPowerPath057SingleDeviceFailure: diagnostic-event=EventPowerPath057SingleDeviceFailure, trouble-code-uds=Power_Path_057_Single_Device_Failure  # Event_Dtc_Map_Power_Path_057_Single_Device_Failure
  diagnostic event to operation cycle mapping EventOperCycleMapPowerPath057SingleDeviceFailure: diagnostic-event=EventPowerPath057SingleDeviceFailure, operation-cycle=DefaultOperationCycle  # Event_Oper_Cycle_Map_Power_Path_057_Single_Device_Failure
  diagnostic event to debounce algorithm mapping EventDebounceMapPowerPath057SingleDeviceFailure: debounce-algorithm=time_based, diagnostic-event=EventPowerPath057SingleDeviceFailure  # EventDebounceMap_Power_Path_057_Single_Device_Failure
package /ZeC/DTC/DTC/LIN_9_Slave_14_NoCommunication
  diagnostic trouble code uds LIN_9_Slave_14_NoCommunication: dtc-props=Dtc_Props_358996c7, uds-dtc-value=0x03091b  # LIN 9 Slave 14_NoCommunication
  diagnostic event EventLIN9Slave14NoCommunication: aging-allowed=true, event-kind=SWC, prestorage-freeze-frame=false  # Event_LIN 9 Slave 14_NoCommunication
  diagnostic event to trouble code uds mapping EventDtcMapLIN9Slave14NoCommunication: diagnostic-event=EventLIN9Slave14NoCommunication, trouble-code-uds=LIN_9_Slave_14_NoCommunication  # Event_Dtc_Map_LIN 9 Slave 14_NoCommunication
  diagnostic event to operation cycle mapping EventOperCycleMapLIN9Slave14NoCommunication: diagnostic-event=EventLIN9Slave14NoCommunication, operation-cycle=DefaultOperationCycle  # Event_Oper_Cycle_Map_LIN 9 Slave 14_NoCommunication
  diagnostic event to debounce algorithm mapping EventDebounceMapLIN9Slave14NoCommunication: debounce-algorithm=counter_based, diagnostic-event=EventLIN9Slave14NoCommunication  # EventDebounceMap_LIN 9 Slave 14_NoCommunication
package /ZeC/DTC/DTC/Power_Path_061_Single_Device_Failure
  diagnostic trouble code uds Power_Path_061_Single_Device_Failure: dtc-props=Dtc_Props_4eab47b3, uds-dtc-value=0x00593d
  diagnostic event EventPowerPath061SingleDeviceFailure: aging-allowed=true, event-kind=SWC, prestorage-freeze-frame=false  # Event_Power_Path_061_Single_Device_Failure
  diagnostic event to trouble code uds mapping EventDtcMapPowerPath061SingleDeviceFailure: diagnostic-event=EventPowerPath061SingleDeviceFailure, trouble-code-uds=Power_Path_061_Single_Device_Failure  # Event_Dtc_Map_Power_Path_061_Single_Device_Failure
  diagnostic event to operation cycle mapping EventOperCycleMapPowerPath061SingleDeviceFailure: diagnostic-event=EventPowerPath061SingleDeviceFailure, operation-cycle=DefaultOperationCycle  # Event_Oper_Cycle_Map_Power_Path_061_Single_Device_Failure
  diagnostic event to debounce algorithm mapping EventDebounceMapPowerPath061SingleDeviceFailure: debounce-algorithm=time_based, diagnostic-event=EventPowerPath061SingleDeviceFailure  # EventDebounceMap_Power_Path_061_Single_Device_Failure
package /ZeC/DTC/DTC/LIN_9_Slave_14_Defect
  diagnostic trouble code uds LIN_9_Slave_14_Defect: dtc-props=Dtc_Props_358996c7, uds-dtc-value=0x03091a  # LIN 9 Slave 14_Defect
  diagnostic event EventLIN9Slave14Defect: aging-allowed=true, event-kind=SWC, prestorage-freeze-frame=false  # Event_LIN 9 Slave 14_Defect
  diagnostic event to trouble code uds mapping EventDtcMapLIN9Slave14Defect: diagnostic-event=EventLIN9Slave14Defect, trouble-code-uds=LIN_9_Slave_14_Defect  # Event_Dtc_Map_LIN 9 Slave 14_Defect
  diagnostic event to operation cycle mapping EventOperCycleMapLIN9Slave14Defect: diagnostic-event=EventLIN9Slave14Defect, operation-cycle=DefaultOperationCycle  # Event_Oper_Cycle_Map_LIN 9 Slave 14_Defect
  diagnostic event to debounce algorithm mapping EventDebounceMapLIN9Slave14Defect: debounce-algorithm=counter_based, diagnostic-event=EventLIN9Slave14Defect  # EventDebounceMap_LIN 9 Slave 14_Defect
package /ZeC/DTC/DTC/Power_Path_060_Single_Device_Failure
  diagnostic trouble code uds Power_Path_060_Single_Device_Failure: dtc-props=Dtc_Props_47957754, uds-dtc-value=0x00593c
  diagnostic event EventPowerPath060SingleDeviceFailure: aging-allowed=true, event-kind=SWC, prestorage-freeze-frame=false  # Event_Power_Path_060_Single_Device_Failure
  diagnostic event to trouble code uds mapping EventDtcMapPowerPath060SingleDeviceFailure: diagnostic-event=EventPowerPath060SingleDeviceFailure, trouble-code-uds=Power_Path_060_Single_Device_Failure  # Event_Dtc_Map_Power_Path_060_Single_Device_Failure
  diagnostic event to operation cycle mapping EventOperCycleMapPowerPath060SingleDeviceFailure: diagnostic-event=EventPowerPath060SingleDeviceFailure, operation-cycle=DefaultOperationCycle  # Event_Oper_Cycle_Map_Power_Path_060_Single_Device_Failure
  diagnostic event to debounce algorithm mapping EventDebounceMapPowerPath060SingleDeviceFailure: debounce-algorithm=time_based, diagnostic-event=EventPowerPath060SingleDeviceFailure  # EventDebounceMap_Power_Path_060_Single_Device_Failure
package /ZeC/DTC/DTC/LIN_9_Slave_15_NoCommunication
  diagnostic trouble code uds LIN_9_Slave_15_NoCommunication: dtc-props=Dtc_Props_358996c7, uds-dtc-value=0x03091d  # LIN 9 Slave 15_NoCommunication
  diagnostic event EventLIN9Slave15NoCommunication: aging-allowed=true, event-kind=SWC, prestorage-freeze-frame=false  # Event_LIN 9 Slave 15_NoCommunication
  diagnostic event to trouble code uds mapping EventDtcMapLIN9Slave15NoCommunication: diagnostic-event=EventLIN9Slave15NoCommunication, trouble-code-uds=LIN_9_Slave_15_NoCommunication  # Event_Dtc_Map_LIN 9 Slave 15_NoCommunication
  diagnostic event to operation cycle mapping EventOperCycleMapLIN9Slave15NoCommunication: diagnostic-event=EventLIN9Slave15NoCommunication, operation-cycle=DefaultOperationCycle  # Event_Oper_Cycle_Map_LIN 9 Slave 15_NoCommunication
  diagnostic event to debounce algorithm mapping EventDebounceMapLIN9Slave15NoCommunication: debounce-algorithm=counter_based, diagnostic-event=EventLIN9Slave15NoCommunication  # EventDebounceMap_LIN 9 Slave 15_NoCommunication
package /ZeC/DTC/DTC/Power_Path_063_Single_Device_Failure
  diagnostic trouble code uds Power_Path_063_Single_Device_Failure: dtc-props=Dtc_Props_c29953c7, uds-dtc-value=0x00593f
  diagnostic event EventPowerPath063SingleDeviceFailure: aging-allowed=true, event-kind=SWC, prestorage-freeze-frame=false  # Event_Power_Path_063_Single_Device_Failure
  diagnostic event to trouble code uds mapping EventDtcMapPowerPath063SingleDeviceFailure: diagnostic-event=EventPowerPath063SingleDeviceFailure, trouble-code-uds=Power_Path_063_Single_Device_Failure  # Event_Dtc_Map_Power_Path_063_Single_Device_Failure
  diagnostic event to operation cycle mapping EventOperCycleMapPowerPath063SingleDeviceFailure: diagnostic-event=EventPowerPath063SingleDeviceFailure, operation-cycle=DefaultOperationCycle  # Event_Oper_Cycle_Map_Power_Path_063_Single_Device_Failure
  diagnostic event to debounce algorithm mapping EventDebounceMapPowerPath063SingleDeviceFailure: debounce-algorithm=time_based, diagnostic-event=EventPowerPath063SingleDeviceFailure  # EventDebounceMap_Power_Path_063_Single_Device_Failure
package /ZeC/DTC/DTC/LIN_9_Slave_15_Defect
  diagnostic trouble code uds LIN_9_Slave_15_Defect: dtc-props=Dtc_Props_358996c7, uds-dtc-value=0x03091c  # LIN 9 Slave 15_Defect
  diagnostic event EventLIN9Slave15Defect: aging-allowed=true, event-kind=SWC, prestorage-freeze-frame=false  # Event_LIN 9 Slave 15_Defect
  diagnostic event to trouble code uds mapping EventDtcMapLIN9Slave15Defect: diagnostic-event=EventLIN9Slave15Defect, trouble-code-uds=LIN_9_Slave_15_Defect  # Event_Dtc_Map_LIN 9 Slave 15_Defect
  diagnostic event to operation cycle mapping EventOperCycleMapLIN9Slave15Defect: diagnostic-event=EventLIN9Slave15Defect, operation-cycle=DefaultOperationCycle  # Event_Oper_Cycle_Map_LIN 9 Slave 15_Defect
  diagnostic event to debounce algorithm mapping EventDebounceMapLIN9Slave15Defect: debounce-algorithm=counter_based, diagnostic-event=EventLIN9Slave15Defect  # EventDebounceMap_LIN 9 Slave 15_Defect
package /ZeC/DTC/DTC/Power_Path_062_Single_Device_Failure
  diagnostic trouble code uds Power_Path_062_Single_Device_Failure: dtc-props=Dtc_Props_8b24d89, uds-dtc-value=0x00593e
  diagnostic event EventPowerPath062SingleDeviceFailure: aging-allowed=true, event-kind=SWC, prestorage-freeze-frame=false  # Event_Power_Path_062_Single_Device_Failure
  diagnostic event to trouble code uds mapping EventDtcMapPowerPath062SingleDeviceFailure: diagnostic-event=EventPowerPath062SingleDeviceFailure, trouble-code-uds=Power_Path_062_Single_Device_Failure  # Event_Dtc_Map_Power_Path_062_Single_Device_Failure
  diagnostic event to operation cycle mapping EventOperCycleMapPowerPath062SingleDeviceFailure: diagnostic-event=EventPowerPath062SingleDeviceFailure, operation-cycle=DefaultOperationCycle  # Event_Oper_Cycle_Map_Power_Path_062_Single_Device_Failure
  diagnostic event to debounce algorithm mapping EventDebounceMapPowerPath062SingleDeviceFailure: debounce-algorithm=time_based, diagnostic-event=EventPowerPath062SingleDeviceFailure  # EventDebounceMap_Power_Path_062_Single_Device_Failure
package /ZeC/DTC/DTC/Power_Path_059_Single_Device_Failure
  diagnostic trouble code uds Power_Path_059_Single_Device_Failure: dtc-props=Dtc_Props_18c7d6e, uds-dtc-value=0x00593b
  diagnostic event EventPowerPath059SingleDeviceFailure: aging-allowed=true, event-kind=SWC, prestorage-freeze-frame=false  # Event_Power_Path_059_Single_Device_Failure
  diagnostic event to trouble code uds mapping EventDtcMapPowerPath059SingleDeviceFailure: diagnostic-event=EventPowerPath059SingleDeviceFailure, trouble-code-uds=Power_Path_059_Single_Device_Failure  # Event_Dtc_Map_Power_Path_059_Single_Device_Failure
  diagnostic event to operation cycle mapping EventOperCycleMapPowerPath059SingleDeviceFailure: diagnostic-event=EventPowerPath059SingleDeviceFailure, operation-cycle=DefaultOperationCycle  # Event_Oper_Cycle_Map_Power_Path_059_Single_Device_Failure
  diagnostic event to debounce algorithm mapping EventDebounceMapPowerPath059SingleDeviceFailure: debounce-algorithm=time_based, diagnostic-event=EventPowerPath059SingleDeviceFailure  # EventDebounceMap_Power_Path_059_Single_Device_Failure
package /ZeC/DTC/DTC/Power_Path_058_Single_Device_Failure
  diagnostic trouble code uds Power_Path_058_Single_Device_Failure: dtc-props=Dtc_Props_cba76320, uds-dtc-value=0x00593a
  diagnostic event EventPowerPath058SingleDeviceFailure: aging-allowed=true, event-kind=SWC, prestorage-freeze-frame=false  # Event_Power_Path_058_Single_Device_Failure
  diagnostic event to trouble code uds mapping EventDtcMapPowerPath058SingleDeviceFailure: diagnostic-event=EventPowerPath058SingleDeviceFailure, trouble-code-uds=Power_Path_058_Single_Device_Failure  # Event_Dtc_Map_Power_Path_058_Single_Device_Failure
  diagnostic event to operation cycle mapping EventOperCycleMapPowerPath058SingleDeviceFailure: diagnostic-event=EventPowerPath058SingleDeviceFailure, operation-cycle=DefaultOperationCycle  # Event_Oper_Cycle_Map_Power_Path_058_Single_Device_Failure
  diagnostic event to debounce algorithm mapping EventDebounceMapPowerPath058SingleDeviceFailure: debounce-algorithm=time_based, diagnostic-event=EventPowerPath058SingleDeviceFailure  # EventDebounceMap_Power_Path_058_Single_Device_Failure
package /ZeC/DTC/DTC/LIN_9_Slave_13_NoCommunication
  diagnostic trouble code uds LIN_9_Slave_13_NoCommunication: dtc-props=Dtc_Props_358996c7, uds-dtc-value=0x030919  # LIN 9 Slave 13_NoCommunication
  diagnostic event EventLIN9Slave13NoCommunication: aging-allowed=true, event-kind=SWC, prestorage-freeze-frame=false  # Event_LIN 9 Slave 13_NoCommunication
  diagnostic event to trouble code uds mapping EventDtcMapLIN9Slave13NoCommunication: diagnostic-event=EventLIN9Slave13NoCommunication, trouble-code-uds=LIN_9_Slave_13_NoCommunication  # Event_Dtc_Map_LIN 9 Slave 13_NoCommunication
  diagnostic event to operation cycle mapping EventOperCycleMapLIN9Slave13NoCommunication: diagnostic-event=EventLIN9Slave13NoCommunication, operation-cycle=DefaultOperationCycle  # Event_Oper_Cycle_Map_LIN 9 Slave 13_NoCommunication
  diagnostic event to debounce algorithm mapping EventDebounceMapLIN9Slave13NoCommunication: debounce-algorithm=counter_based, diagnostic-event=EventLIN9Slave13NoCommunication  # EventDebounceMap_LIN 9 Slave 13_NoCommunication
package /ZeC/DTC/DTC/LIN_9_Slave_12_Defect
  diagnostic trouble code uds LIN_9_Slave_12_Defect: dtc-props=Dtc_Props_358996c7, uds-dtc-value=0x030916  # LIN 9 Slave 12_Defect
  diagnostic event EventLIN9Slave12Defect: aging-allowed=true, event-kind=SWC, prestorage-freeze-frame=false  # Event_LIN 9 Slave 12_Defect
  diagnostic event to trouble code uds mapping EventDtcMapLIN9Slave12Defect: diagnostic-event=EventLIN9Slave12Defect, trouble-code-uds=LIN_9_Slave_12_Defect  # Event_Dtc_Map_LIN 9 Slave 12_Defect
  diagnostic event to operation cycle mapping EventOperCycleMapLIN9Slave12Defect: diagnostic-event=EventLIN9Slave12Defect, operation-cycle=DefaultOperationCycle  # Event_Oper_Cycle_Map_LIN 9 Slave 12_Defect
  diagnostic event to debounce algorithm mapping EventDebounceMapLIN9Slave12Defect: debounce-algorithm=counter_based, diagnostic-event=EventLIN9Slave12Defect  # EventDebounceMap_LIN 9 Slave 12_Defect
package /ZeC/DTC/DTC/LIN_9_Slave_11_NoCommunication
  diagnostic trouble code uds LIN_9_Slave_11_NoCommunication: dtc-props=Dtc_Props_358996c7, uds-dtc-value=0x030915  # LIN 9 Slave 11_NoCommunication
  diagnostic event EventLIN9Slave11NoCommunication: aging-allowed=true, event-kind=SWC, prestorage-freeze-frame=false  # Event_LIN 9 Slave 11_NoCommunication
  diagnostic event to trouble code uds mapping EventDtcMapLIN9Slave11NoCommunication: diagnostic-event=EventLIN9Slave11NoCommunication, trouble-code-uds=LIN_9_Slave_11_NoCommunication  # Event_Dtc_Map_LIN 9 Slave 11_NoCommunication
  diagnostic event to operation cycle mapping EventOperCycleMapLIN9Slave11NoCommunication: diagnostic-event=EventLIN9Slave11NoCommunication, operation-cycle=DefaultOperationCycle  # Event_Oper_Cycle_Map_LIN 9 Slave 11_NoCommunication
  diagnostic event to debounce algorithm mapping EventDebounceMapLIN9Slave11NoCommunication: debounce-algorithm=counter_based, diagnostic-event=EventLIN9Slave11NoCommunication  # EventDebounceMap_LIN 9 Slave 11_NoCommunication
package /ZeC/DTC/DTC/LIN_9_Slave_13_Defect
  diagnostic trouble code uds LIN_9_Slave_13_Defect: dtc-props=Dtc_Props_358996c7, uds-dtc-value=0x030918  # LIN 9 Slave 13_Defect
  diagnostic event EventLIN9Slave13Defect: aging-allowed=true, event-kind=SWC, prestorage-freeze-frame=false  # Event_LIN 9 Slave 13_Defect
  diagnostic event to trouble code uds mapping EventDtcMapLIN9Slave13Defect: diagnostic-event=EventLIN9Slave13Defect, trouble-code-uds=LIN_9_Slave_13_Defect  # Event_Dtc_Map_LIN 9 Slave 13_Defect
  diagnostic event to operation cycle mapping EventOperCycleMapLIN9Slave13Defect: diagnostic-event=EventLIN9Slave13Defect, operation-cycle=DefaultOperationCycle  # Event_Oper_Cycle_Map_LIN 9 Slave 13_Defect
  diagnostic event to debounce algorithm mapping EventDebounceMapLIN9Slave13Defect: debounce-algorithm=counter_based, diagnostic-event=EventLIN9Slave13Defect  # EventDebounceMap_LIN 9 Slave 13_Defect
package /ZeC/DTC/DTC/LIN_9_Slave_12_NoCommunication
  diagnostic trouble code uds LIN_9_Slave_12_NoCommunication: dtc-props=Dtc_Props_358996c7, uds-dtc-value=0x030917  # LIN 9 Slave 12_NoCommunication
  diagnostic event EventLIN9Slave12NoCommunication: aging-allowed=true, event-kind=SWC, prestorage-freeze-frame=false  # Event_LIN 9 Slave 12_NoCommunication
  diagnostic event to trouble code uds mapping EventDtcMapLIN9Slave12NoCommunication: diagnostic-event=EventLIN9Slave12NoCommunication, trouble-code-uds=LIN_9_Slave_12_NoCommunication  # Event_Dtc_Map_LIN 9 Slave 12_NoCommunication
  diagnostic event to operation cycle mapping EventOperCycleMapLIN9Slave12NoCommunication: diagnostic-event=EventLIN9Slave12NoCommunication, operation-cycle=DefaultOperationCycle  # Event_Oper_Cycle_Map_LIN 9 Slave 12_NoCommunication
  diagnostic event to debounce algorithm mapping EventDebounceMapLIN9Slave12NoCommunication: debounce-algorithm=counter_based, diagnostic-event=EventLIN9Slave12NoCommunication  # EventDebounceMap_LIN 9 Slave 12_NoCommunication
package /ZeC/DTC/DTC/Power_Path_103_Single_Device_Failure
  diagnostic trouble code uds Power_Path_103_Single_Device_Failure: dtc-props=Dtc_Props_d0fcf35a, uds-dtc-value=0x005967
  diagnostic event EventPowerPath103SingleDeviceFailure: aging-allowed=true, event-kind=SWC, prestorage-freeze-frame=false  # Event_Power_Path_103_Single_Device_Failure
  diagnostic event to trouble code uds mapping EventDtcMapPowerPath103SingleDeviceFailure: diagnostic-event=EventPowerPath103SingleDeviceFailure, trouble-code-uds=Power_Path_103_Single_Device_Failure  # Event_Dtc_Map_Power_Path_103_Single_Device_Failure
  diagnostic event to operation cycle mapping EventOperCycleMapPowerPath103SingleDeviceFailure: diagnostic-event=EventPowerPath103SingleDeviceFailure, operation-cycle=DefaultOperationCycle  # Event_Oper_Cycle_Map_Power_Path_103_Single_Device_Failure
  diagnostic event to debounce algorithm mapping EventDebounceMapPowerPath103SingleDeviceFailure: debounce-algorithm=time_based, diagnostic-event=EventPowerPath103SingleDeviceFailure  # EventDebounceMap_Power_Path_103_Single_Device_Failure
package /ZeC/DTC/DTC/Power_Path_102_Single_Device_Failure
  diagnostic trouble code uds Power_Path_102_Single_Device_Failure: dtc-props=Dtc_Props_96e5f960, uds-dtc-value=0x005966
  diagnostic event EventPowerPath102SingleDeviceFailure: aging-allowed=true, event-kind=SWC, prestorage-freeze-frame=false  # Event_Power_Path_102_Single_Device_Failure
  diagnostic event to trouble code uds mapping EventDtcMapPowerPath102SingleDeviceFailure: diagnostic-event=EventPowerPath102SingleDeviceFailure, trouble-code-uds=Power_Path_102_Single_Device_Failure  # Event_Dtc_Map_Power_Path_102_Single_Device_Failure
  diagnostic event to operation cycle mapping EventOperCycleMapPowerPath102SingleDeviceFailure: diagnostic-event=EventPowerPath102SingleDeviceFailure, operation-cycle=DefaultOperationCycle  # Event_Oper_Cycle_Map_Power_Path_102_Single_Device_Failure
  diagnostic event to debounce algorithm mapping EventDebounceMapPowerPath102SingleDeviceFailure: debounce-algorithm=time_based, diagnostic-event=EventPowerPath102SingleDeviceFailure  # EventDebounceMap_Power_Path_102_Single_Device_Failure
package /ZeC/DTC/DTC/Power_Path_105_Single_Device_Failure
  diagnostic trouble code uds Power_Path_105_Single_Device_Failure: dtc-props=Dtc_Props_c2809294, uds-dtc-value=0x005969
  diagnostic event EventPowerPath105SingleDeviceFailure: aging-allowed=true, event-kind=SWC, prestorage-freeze-frame=false  # Event_Power_Path_105_Single_Device_Failure
  diagnostic event to trouble code uds mapping EventDtcMapPowerPath105SingleDeviceFailure: diagnostic-event=EventPowerPath105SingleDeviceFailure, trouble-code-uds=Power_Path_105_Single_Device_Failure  # Event_Dtc_Map_Power_Path_105_Single_Device_Failure
  diagnostic event to operation cycle mapping EventOperCycleMapPowerPath105SingleDeviceFailure: diagnostic-event=EventPowerPath105SingleDeviceFailure, operation-cycle=DefaultOperationCycle  # Event_Oper_Cycle_Map_Power_Path_105_Single_Device_Failure
  diagnostic event to debounce algorithm mapping EventDebounceMapPowerPath105SingleDeviceFailure: debounce-algorithm=time_based, diagnostic-event=EventPowerPath105SingleDeviceFailure  # EventDebounceMap_Power_Path_105_Single_Device_Failure
package /ZeC/DTC/DTC/Power_Path_104_Single_Device_Failure
  diagnostic trouble code uds Power_Path_104_Single_Device_Failure: dtc-props=Dtc_Props_849998ae, uds-dtc-value=0x005968
  diagnostic event EventPowerPath104SingleDeviceFailure: aging-allowed=true, event-kind=SWC, prestorage-freeze-frame=false  # Event_Power_Path_104_Single_Device_Failure
  diagnostic event to trouble code uds mapping EventDtcMapPowerPath104SingleDeviceFailure: diagnostic-event=EventPowerPath104SingleDeviceFailure, trouble-code-uds=Power_Path_104_Single_Device_Failure  # Event_Dtc_Map_Power_Path_104_Single_Device_Failure
  diagnostic event to operation cycle mapping EventOperCycleMapPowerPath104SingleDeviceFailure: diagnostic-event=EventPowerPath104SingleDeviceFailure, operation-cycle=DefaultOperationCycle  # Event_Oper_Cycle_Map_Power_Path_104_Single_Device_Failure
  diagnostic event to debounce algorithm mapping EventDebounceMapPowerPath104SingleDeviceFailure: debounce-algorithm=time_based, diagnostic-event=EventPowerPath104SingleDeviceFailure  # EventDebounceMap_Power_Path_104_Single_Device_Failure
package /ZeC/DTC/DTC/Power_Path_099_Single_Device_Failure
  diagnostic trouble code uds Power_Path_099_Single_Device_Failure: dtc-props=Dtc_Props_13e9ddf3, uds-dtc-value=0x005963
  diagnostic event EventPowerPath099SingleDeviceFailure: aging-allowed=true, event-kind=SWC, prestorage-freeze-frame=false  # Event_Power_Path_099_Single_Device_Failure
  diagnostic event to trouble code uds mapping EventDtcMapPowerPath099SingleDeviceFailure: diagnostic-event=EventPowerPath099SingleDeviceFailure, trouble-code-uds=Power_Path_099_Single_Device_Failure  # Event_Dtc_Map_Power_Path_099_Single_Device_Failure
  diagnostic event to operation cycle mapping EventOperCycleMapPowerPath099SingleDeviceFailure: diagnostic-event=EventPowerPath099SingleDeviceFailure, operation-cycle=DefaultOperationCycle  # Event_Oper_Cycle_Map_Power_Path_099_Single_Device_Failure
  diagnostic event to debounce algorithm mapping EventDebounceMapPowerPath099SingleDeviceFailure: debounce-algorithm=time_based, diagnostic-event=EventPowerPath099SingleDeviceFailure  # EventDebounceMap_Power_Path_099_Single_Device_Failure
package /ZeC/DTC/DTC/Power_Path_098_Single_Device_Failure
  diagnostic trouble code uds Power_Path_098_Single_Device_Failure: dtc-props=Dtc_Props_55f0d7c9, uds-dtc-value=0x005962
  diagnostic event EventPowerPath098SingleDeviceFailure: aging-allowed=true, event-kind=SWC, prestorage-freeze-frame=false  # Event_Power_Path_098_Single_Device_Failure
  diagnostic event to trouble code uds mapping EventDtcMapPowerPath098SingleDeviceFailure: diagnostic-event=EventPowerPath098SingleDeviceFailure, trouble-code-uds=Power_Path_098_Single_Device_Failure  # Event_Dtc_Map_Power_Path_098_Single_Device_Failure
  diagnostic event to operation cycle mapping EventOperCycleMapPowerPath098SingleDeviceFailure: diagnostic-event=EventPowerPath098SingleDeviceFailure, operation-cycle=DefaultOperationCycle  # Event_Oper_Cycle_Map_Power_Path_098_Single_Device_Failure
  diagnostic event to debounce algorithm mapping EventDebounceMapPowerPath098SingleDeviceFailure: debounce-algorithm=time_based, diagnostic-event=EventPowerPath098SingleDeviceFailure  # EventDebounceMap_Power_Path_098_Single_Device_Failure
package /ZeC/DTC/DTC/Power_Path_101_Single_Device_Failure
  diagnostic trouble code uds Power_Path_101_Single_Device_Failure: dtc-props=Dtc_Props_5ccee72e, uds-dtc-value=0x005965
  diagnostic event EventPowerPath101SingleDeviceFailure: aging-allowed=true, event-kind=SWC, prestorage-freeze-frame=false  # Event_Power_Path_101_Single_Device_Failure
  diagnostic event to trouble code uds mapping EventDtcMapPowerPath101SingleDeviceFailure: diagnostic-event=EventPowerPath101SingleDeviceFailure, trouble-code-uds=Power_Path_101_Single_Device_Failure  # Event_Dtc_Map_Power_Path_101_Single_Device_Failure
  diagnostic event to operation cycle mapping EventOperCycleMapPowerPath101SingleDeviceFailure: diagnostic-event=EventPowerPath101SingleDeviceFailure, operation-cycle=DefaultOperationCycle  # Event_Oper_Cycle_Map_Power_Path_101_Single_Device_Failure
  diagnostic event to debounce algorithm mapping EventDebounceMapPowerPath101SingleDeviceFailure: debounce-algorithm=time_based, diagnostic-event=EventPowerPath101SingleDeviceFailure  # EventDebounceMap_Power_Path_101_Single_Device_Failure
package /ZeC/DTC/DTC/Power_Path_100_Single_Device_Failure
  diagnostic trouble code uds Power_Path_100_Single_Device_Failure: dtc-props=Dtc_Props_1ad7ed14, uds-dtc-value=0x005964
  diagnostic event EventPowerPath100SingleDeviceFailure: aging-allowed=true, event-kind=SWC, prestorage-freeze-frame=false  # Event_Power_Path_100_Single_Device_Failure
  diagnostic event to trouble code uds mapping EventDtcMapPowerPath100SingleDeviceFailure: diagnostic-event=EventPowerPath100SingleDeviceFailure, trouble-code-uds=Power_Path_100_Single_Device_Failure  # Event_Dtc_Map_Power_Path_100_Single_Device_Failure
  diagnostic event to operation cycle mapping EventOperCycleMapPowerPath100SingleDeviceFailure: diagnostic-event=EventPowerPath100SingleDeviceFailure, operation-cycle=DefaultOperationCycle  # Event_Oper_Cycle_Map_Power_Path_100_Single_Device_Failure
  diagnostic event to debounce algorithm mapping EventDebounceMapPowerPath100SingleDeviceFailure: debounce-algorithm=time_based, diagnostic-event=EventPowerPath100SingleDeviceFailure  # EventDebounceMap_Power_Path_100_Single_Device_Failure
package /ZeC/DTC/DTC/Power_Path_106_Single_Device_Failure
  diagnostic trouble code uds Power_Path_106_Single_Device_Failure: dtc-props=Dtc_Props_a224adfa, uds-dtc-value=0x00596a
  diagnostic event EventPowerPath106SingleDeviceFailure: aging-allowed=true, event-kind=SWC, prestorage-freeze-frame=false  # Event_Power_Path_106_Single_Device_Failure
  diagnostic event to trouble code uds mapping EventDtcMapPowerPath106SingleDeviceFailure: diagnostic-event=EventPowerPath106SingleDeviceFailure, trouble-code-uds=Power_Path_106_Single_Device_Failure  # Event_Dtc_Map_Power_Path_106_Single_Device_Failure
  diagnostic event to operation cycle mapping EventOperCycleMapPowerPath106SingleDeviceFailure: diagnostic-event=EventPowerPath106SingleDeviceFailure, operation-cycle=DefaultOperationCycle  # Event_Oper_Cycle_Map_Power_Path_106_Single_Device_Failure
  diagnostic event to debounce algorithm mapping EventDebounceMapPowerPath106SingleDeviceFailure: debounce-algorithm=time_based, diagnostic-event=EventPowerPath106SingleDeviceFailure  # EventDebounceMap_Power_Path_106_Single_Device_Failure
package /ZeC/DTC/DTC/Power_Path_111_Single_Device_Failure
  diagnostic trouble code uds Power_Path_111_Single_Device_Failure: dtc-props=Dtc_Props_ab1a9d1d, uds-dtc-value=0x00596f
  diagnostic event EventPowerPath111SingleDeviceFailure: aging-allowed=true, event-kind=SWC, prestorage-freeze-frame=false  # Event_Power_Path_111_Single_Device_Failure
  diagnostic event to trouble code uds mapping EventDtcMapPowerPath111SingleDeviceFailure: diagnostic-event=EventPowerPath111SingleDeviceFailure, trouble-code-uds=Power_Path_111_Single_Device_Failure  # Event_Dtc_Map_Power_Path_111_Single_Device_Failure
  diagnostic event to operation cycle mapping EventOperCycleMapPowerPath111SingleDeviceFailure: diagnostic-event=EventPowerPath111SingleDeviceFailure, operation-cycle=DefaultOperationCycle  # Event_Oper_Cycle_Map_Power_Path_111_Single_Device_Failure
  diagnostic event to debounce algorithm mapping EventDebounceMapPowerPath111SingleDeviceFailure: debounce-algorithm=time_based, diagnostic-event=EventPowerPath111SingleDeviceFailure  # EventDebounceMap_Power_Path_111_Single_Device_Failure
package /ZeC/DTC/DTC/Power_Path_108_Single_Device_Failure
  diagnostic trouble code uds Power_Path_108_Single_Device_Failure: dtc-props=Dtc_Props_2e16b98e, uds-dtc-value=0x00596c
  diagnostic event EventPowerPath108SingleDeviceFailure: aging-allowed=true, event-kind=SWC, prestorage-freeze-frame=false  # Event_Power_Path_108_Single_Device_Failure
  diagnostic event to trouble code uds mapping EventDtcMapPowerPath108SingleDeviceFailure: diagnostic-event=EventPowerPath108SingleDeviceFailure, trouble-code-uds=Power_Path_108_Single_Device_Failure  # Event_Dtc_Map_Power_Path_108_Single_Device_Failure
  diagnostic event to operation cycle mapping EventOperCycleMapPowerPath108SingleDeviceFailure: diagnostic-event=EventPowerPath108SingleDeviceFailure, operation-cycle=DefaultOperationCycle  # Event_Oper_Cycle_Map_Power_Path_108_Single_Device_Failure
  diagnostic event to debounce algorithm mapping EventDebounceMapPowerPath108SingleDeviceFailure: debounce-algorithm=time_based, diagnostic-event=EventPowerPath108SingleDeviceFailure  # EventDebounceMap_Power_Path_108_Single_Device_Failure
package /ZeC/DTC/DTC/Power_Path_107_Single_Device_Failure
  diagnostic trouble code uds Power_Path_107_Single_Device_Failure: dtc-props=Dtc_Props_680fb3b4, uds-dtc-value=0x00596b
  diagnostic event EventPowerPath107SingleDeviceFailure: aging-allowed=true, event-kind=SWC, prestorage-freeze-frame=false  # Event_Power_Path_107_Single_Device_Failure
  diagnostic event to trouble code uds mapping EventDtcMapPowerPath107SingleDeviceFailure: diagnostic-event=EventPowerPath107SingleDeviceFailure, trouble-code-uds=Power_Path_107_Single_Device_Failure  # Event_Dtc_Map_Power_Path_107_Single_Device_Failure
  diagnostic event to operation cycle mapping EventOperCycleMapPowerPath107SingleDeviceFailure: diagnostic-event=EventPowerPath107SingleDeviceFailure, operation-cycle=DefaultOperationCycle  # Event_Oper_Cycle_Map_Power_Path_107_Single_Device_Failure
  diagnostic event to debounce algorithm mapping EventDebounceMapPowerPath107SingleDeviceFailure: debounce-algorithm=time_based, diagnostic-event=EventPowerPath107SingleDeviceFailure  # EventDebounceMap_Power_Path_107_Single_Device_Failure
package /ZeC/DTC/DTC/Power_Path_110_Single_Device_Failure
  diagnostic trouble code uds Power_Path_110_Single_Device_Failure: dtc-props=Dtc_Props_61318353, uds-dtc-value=0x00596e
  diagnostic event EventPowerPath110SingleDeviceFailure: aging-allowed=true, event-kind=SWC, prestorage-freeze-frame=false  # Event_Power_Path_110_Single_Device_Failure
  diagnostic event to trouble code uds mapping EventDtcMapPowerPath110SingleDeviceFailure: diagnostic-event=EventPowerPath110SingleDeviceFailure, trouble-code-uds=Power_Path_110_Single_Device_Failure  # Event_Dtc_Map_Power_Path_110_Single_Device_Failure
  diagnostic event to operation cycle mapping EventOperCycleMapPowerPath110SingleDeviceFailure: diagnostic-event=EventPowerPath110SingleDeviceFailure, operation-cycle=DefaultOperationCycle  # Event_Oper_Cycle_Map_Power_Path_110_Single_Device_Failure
  diagnostic event to debounce algorithm mapping EventDebounceMapPowerPath110SingleDeviceFailure: debounce-algorithm=time_based, diagnostic-event=EventPowerPath110SingleDeviceFailure  # EventDebounceMap_Power_Path_110_Single_Device_Failure
package /ZeC/DTC/DTC/Power_Path_109_Single_Device_Failure
  diagnostic trouble code uds Power_Path_109_Single_Device_Failure: dtc-props=Dtc_Props_27288969, uds-dtc-value=0x00596d
  diagnostic event EventPowerPath109SingleDeviceFailure: aging-allowed=true, event-kind=SWC, prestorage-freeze-frame=false  # Event_Power_Path_109_Single_Device_Failure
  diagnostic event to trouble code uds mapping EventDtcMapPowerPath109SingleDeviceFailure: diagnostic-event=EventPowerPath109SingleDeviceFailure, trouble-code-uds=Power_Path_109_Single_Device_Failure  # Event_Dtc_Map_Power_Path_109_Single_Device_Failure
  diagnostic event to operation cycle mapping EventOperCycleMapPowerPath109SingleDeviceFailure: diagnostic-event=EventPowerPath109SingleDeviceFailure, operation-cycle=DefaultOperationCycle  # Event_Oper_Cycle_Map_Power_Path_109_Single_Device_Failure
  diagnostic event to debounce algorithm mapping EventDebounceMapPowerPath109SingleDeviceFailure: debounce-algorithm=time_based, diagnostic-event=EventPowerPath109SingleDeviceFailure  # EventDebounceMap_Power_Path_109_Single_Device_Failure
package /ZeC/DTC/DTC/Power_Path_112_Single_Device_Failure
  diagnostic trouble code uds Power_Path_112_Single_Device_Failure: dtc-props=Dtc_Props_1f880305, uds-dtc-value=0x005970
  diagnostic event EventPowerPath112SingleDeviceFailure: aging-allowed=true, event-kind=SWC, prestorage-freeze-frame=false  # Event_Power_Path_112_Single_Device_Failure
  diagnostic event to trouble code uds mapping EventDtcMapPowerPath112SingleDeviceFailure: diagnostic-event=EventPowerPath112SingleDeviceFailure, trouble-code-uds=Power_Path_112_Single_Device_Failure  # Event_Dtc_Map_Power_Path_112_Single_Device_Failure
  diagnostic event to operation cycle mapping EventOperCycleMapPowerPath112SingleDeviceFailure: diagnostic-event=EventPowerPath112SingleDeviceFailure, operation-cycle=DefaultOperationCycle  # Event_Oper_Cycle_Map_Power_Path_112_Single_Device_Failure
  diagnostic event to debounce algorithm mapping EventDebounceMapPowerPath112SingleDeviceFailure: debounce-algorithm=time_based, diagnostic-event=EventPowerPath112SingleDeviceFailure  # EventDebounceMap_Power_Path_112_Single_Device_Failure
package /ZeC/DTC/DTC/Power_Path_114_Single_Device_Failure
  diagnostic trouble code uds Power_Path_114_Single_Device_Failure: dtc-props=Dtc_Props_93ba1771, uds-dtc-value=0x005972
  diagnostic event EventPowerPath114SingleDeviceFailure: aging-allowed=true, event-kind=SWC, prestorage-freeze-frame=false  # Event_Power_Path_114_Single_Device_Failure
  diagnostic event to trouble code uds mapping EventDtcMapPowerPath114SingleDeviceFailure: diagnostic-event=EventPowerPath114SingleDeviceFailure, trouble-code-uds=Power_Path_114_Single_Device_Failure  # Event_Dtc_Map_Power_Path_114_Single_Device_Failure
  diagnostic event to operation cycle mapping EventOperCycleMapPowerPath114SingleDeviceFailure: diagnostic-event=EventPowerPath114SingleDeviceFailure, operation-cycle=DefaultOperationCycle  # Event_Oper_Cycle_Map_Power_Path_114_Single_Device_Failure
  diagnostic event to debounce algorithm mapping EventDebounceMapPowerPath114SingleDeviceFailure: debounce-algorithm=time_based, diagnostic-event=EventPowerPath114SingleDeviceFailure  # EventDebounceMap_Power_Path_114_Single_Device_Failure
package /ZeC/DTC/DTC/Power_Path_113_Single_Device_Failure
  diagnostic trouble code uds Power_Path_113_Single_Device_Failure: dtc-props=Dtc_Props_5991093f, uds-dtc-value=0x005971
  diagnostic event EventPowerPath113SingleDeviceFailure: aging-allowed=true, event-kind=SWC, prestorage-freeze-frame=false  # Event_Power_Path_113_Single_Device_Failure
  diagnostic event to trouble code uds mapping EventDtcMapPowerPath113SingleDeviceFailure: diagnostic-event=EventPowerPath113SingleDeviceFailure, trouble-code-uds=Power_Path_113_Single_Device_Failure  # Event_Dtc_Map_Power_Path_113_Single_Device_Failure
  diagnostic event to operation cycle mapping EventOperCycleMapPowerPath113SingleDeviceFailure: diagnostic-event=EventPowerPath113SingleDeviceFailure, operation-cycle=DefaultOperationCycle  # Event_Oper_Cycle_Map_Power_Path_113_Single_Device_Failure
  diagnostic event to debounce algorithm mapping EventDebounceMapPowerPath113SingleDeviceFailure: debounce-algorithm=time_based, diagnostic-event=EventPowerPath113SingleDeviceFailure  # EventDebounceMap_Power_Path_113_Single_Device_Failure
package /ZeC/DTC/DTC/Power_Path_086_Single_Device_Failure
  diagnostic trouble code uds Power_Path_086_Single_Device_Failure: dtc-props=Dtc_Props_74bbee9, uds-dtc-value=0x005956
  diagnostic event EventPowerPath086SingleDeviceFailure: aging-allowed=true, event-kind=SWC, prestorage-freeze-frame=false  # Event_Power_Path_086_Single_Device_Failure
  diagnostic event to trouble code uds mapping EventDtcMapPowerPath086SingleDeviceFailure: diagnostic-event=EventPowerPath086SingleDeviceFailure, trouble-code-uds=Power_Path_086_Single_Device_Failure  # Event_Dtc_Map_Power_Path_086_Single_Device_Failure
  diagnostic event to operation cycle mapping EventOperCycleMapPowerPath086SingleDeviceFailure: diagnostic-event=EventPowerPath086SingleDeviceFailure, operation-cycle=DefaultOperationCycle  # Event_Oper_Cycle_Map_Power_Path_086_Single_Device_Failure
  diagnostic event to debounce algorithm mapping EventDebounceMapPowerPath086SingleDeviceFailure: debounce-algorithm=time_based, diagnostic-event=EventPowerPath086SingleDeviceFailure  # EventDebounceMap_Power_Path_086_Single_Device_Failure
package /ZeC/DTC/DTC/Power_Path_085_Single_Device_Failure
  diagnostic trouble code uds Power_Path_085_Single_Device_Failure: dtc-props=Dtc_Props_cd60a0a7, uds-dtc-value=0x005955
  diagnostic event EventPowerPath085SingleDeviceFailure: aging-allowed=true, event-kind=SWC, prestorage-freeze-frame=false  # Event_Power_Path_085_Single_Device_Failure
  diagnostic event to trouble code uds mapping EventDtcMapPowerPath085SingleDeviceFailure: diagnostic-event=EventPowerPath085SingleDeviceFailure, trouble-code-uds=Power_Path_085_Single_Device_Failure  # Event_Dtc_Map_Power_Path_085_Single_Device_Failure
  diagnostic event to operation cycle mapping EventOperCycleMapPowerPath085SingleDeviceFailure: diagnostic-event=EventPowerPath085SingleDeviceFailure, operation-cycle=DefaultOperationCycle  # Event_Oper_Cycle_Map_Power_Path_085_Single_Device_Failure
  diagnostic event to debounce algorithm mapping EventDebounceMapPowerPath085SingleDeviceFailure: debounce-algorithm=time_based, diagnostic-event=EventPowerPath085SingleDeviceFailure  # EventDebounceMap_Power_Path_085_Single_Device_Failure
package /ZeC/DTC/DTC/Power_Path_088_Single_Device_Failure
  diagnostic trouble code uds Power_Path_088_Single_Device_Failure: dtc-props=Dtc_Props_1537df27, uds-dtc-value=0x005958
  diagnostic event EventPowerPath088SingleDeviceFailure: aging-allowed=true, event-kind=SWC, prestorage-freeze-frame=false  # Event_Power_Path_088_Single_Device_Failure
  diagnostic event to trouble code uds mapping EventDtcMapPowerPath088SingleDeviceFailure: diagnostic-event=EventPowerPath088SingleDeviceFailure, trouble-code-uds=Power_Path_088_Single_Device_Failure  # Event_Dtc_Map_Power_Path_088_Single_Device_Failure
  diagnostic event to operation cycle mapping EventOperCycleMapPowerPath088SingleDeviceFailure: diagnostic-event=EventPowerPath088SingleDeviceFailure, operation-cycle=DefaultOperationCycle  # Event_Oper_Cycle_Map_Power_Path_088_Single_Device_Failure
  diagnostic event to debounce algorithm mapping EventDebounceMapPowerPath088SingleDeviceFailure: debounce-algorithm=time_based, diagnostic-event=EventPowerPath088SingleDeviceFailure  # EventDebounceMap_Power_Path_088_Single_Device_Failure
package /ZeC/DTC/DTC/Power_Path_087_Single_Device_Failure
  diagnostic trouble code uds Power_Path_087_Single_Device_Failure: dtc-props=Dtc_Props_4152b4d3, uds-dtc-value=0x005957
  diagnostic event EventPowerPath087SingleDeviceFailure: aging-allowed=true, event-kind=SWC, prestorage-freeze-frame=false  # Event_Power_Path_087_Single_Device_Failure
  diagnostic event to trouble code uds mapping EventDtcMapPowerPath087SingleDeviceFailure: diagnostic-event=EventPowerPath087SingleDeviceFailure, trouble-code-uds=Power_Path_087_Single_Device_Failure  # Event_Dtc_Map_Power_Path_087_Single_Device_Failure
  diagnostic event to operation cycle mapping EventOperCycleMapPowerPath087SingleDeviceFailure: diagnostic-event=EventPowerPath087SingleDeviceFailure, operation-cycle=DefaultOperationCycle  # Event_Oper_Cycle_Map_Power_Path_087_Single_Device_Failure
  diagnostic event to debounce algorithm mapping EventDebounceMapPowerPath087SingleDeviceFailure: debounce-algorithm=time_based, diagnostic-event=EventPowerPath087SingleDeviceFailure  # EventDebounceMap_Power_Path_087_Single_Device_Failure
package /ZeC/DTC/DTC/Power_Path_082_Single_Device_Failure
  diagnostic trouble code uds Power_Path_082_Single_Device_Failure: dtc-props=Dtc_Props_c45e9040, uds-dtc-value=0x005952
  diagnostic event EventPowerPath082SingleDeviceFailure: aging-allowed=true, event-kind=SWC, prestorage-freeze-frame=false  # Event_Power_Path_082_Single_Device_Failure
  diagnostic event to trouble code uds mapping EventDtcMapPowerPath082SingleDeviceFailure: diagnostic-event=EventPowerPath082SingleDeviceFailure, trouble-code-uds=Power_Path_082_Single_Device_Failure  # Event_Dtc_Map_Power_Path_082_Single_Device_Failure
  diagnostic event to operation cycle mapping EventOperCycleMapPowerPath082SingleDeviceFailure: diagnostic-event=EventPowerPath082SingleDeviceFailure, operation-cycle=DefaultOperationCycle  # Event_Oper_Cycle_Map_Power_Path_082_Single_Device_Failure
  diagnostic event to debounce algorithm mapping EventDebounceMapPowerPath082SingleDeviceFailure: debounce-algorithm=time_based, diagnostic-event=EventPowerPath082SingleDeviceFailure  # EventDebounceMap_Power_Path_082_Single_Device_Failure
package /ZeC/DTC/DTC/Power_Path_081_Single_Device_Failure
  diagnostic trouble code uds Power_Path_081_Single_Device_Failure: dtc-props=Dtc_Props_e758e0e, uds-dtc-value=0x005951
  diagnostic event EventPowerPath081SingleDeviceFailure: aging-allowed=true, event-kind=SWC, prestorage-freeze-frame=false  # Event_Power_Path_081_Single_Device_Failure
  diagnostic event to trouble code uds mapping EventDtcMapPowerPath081SingleDeviceFailure: diagnostic-event=EventPowerPath081SingleDeviceFailure, trouble-code-uds=Power_Path_081_Single_Device_Failure  # Event_Dtc_Map_Power_Path_081_Single_Device_Failure
  diagnostic event to operation cycle mapping EventOperCycleMapPowerPath081SingleDeviceFailure: diagnostic-event=EventPowerPath081SingleDeviceFailure, operation-cycle=DefaultOperationCycle  # Event_Oper_Cycle_Map_Power_Path_081_Single_Device_Failure
  diagnostic event to debounce algorithm mapping EventDebounceMapPowerPath081SingleDeviceFailure: debounce-algorithm=time_based, diagnostic-event=EventPowerPath081SingleDeviceFailure  # EventDebounceMap_Power_Path_081_Single_Device_Failure
package /ZeC/DTC/DTC/Power_Path_084_Single_Device_Failure
  diagnostic trouble code uds Power_Path_084_Single_Device_Failure: dtc-props=Dtc_Props_8b79aa9d, uds-dtc-value=0x005954
  diagnostic event EventPowerPath084SingleDeviceFailure: aging-allowed=true, event-kind=SWC, prestorage-freeze-frame=false  # Event_Power_Path_084_Single_Device_Failure
  diagnostic event to trouble code uds mapping EventDtcMapPowerPath084SingleDeviceFailure: diagnostic-event=EventPowerPath084SingleDeviceFailure, trouble-code-uds=Power_Path_084_Single_Device_Failure  # Event_Dtc_Map_Power_Path_084_Single_Device_Failure
  diagnostic event to operation cycle mapping EventOperCycleMapPowerPath084SingleDeviceFailure: diagnostic-event=EventPowerPath084SingleDeviceFailure, operation-cycle=DefaultOperationCycle  # Event_Oper_Cycle_Map_Power_Path_084_Single_Device_Failure
  diagnostic event to debounce algorithm mapping EventDebounceMapPowerPath084SingleDeviceFailure: debounce-algorithm=time_based, diagnostic-event=EventPowerPath084SingleDeviceFailure  # EventDebounceMap_Power_Path_084_Single_Device_Failure
package /ZeC/DTC/DTC/Power_Path_083_Single_Device_Failure
  diagnostic trouble code uds Power_Path_083_Single_Device_Failure: dtc-props=Dtc_Props_82479a7a, uds-dtc-value=0x005953
  diagnostic event EventPowerPath083SingleDeviceFailure: aging-allowed=true, event-kind=SWC, prestorage-freeze-frame=false  # Event_Power_Path_083_Single_Device_Failure
  diagnostic event to trouble code uds mapping EventDtcMapPowerPath083SingleDeviceFailure: diagnostic-event=EventPowerPath083SingleDeviceFailure, trouble-code-uds=Power_Path_083_Single_Device_Failure  # Event_Dtc_Map_Power_Path_083_Single_Device_Failure
  diagnostic event to operation cycle mapping EventOperCycleMapPowerPath083SingleDeviceFailure: diagnostic-event=EventPowerPath083SingleDeviceFailure, operation-cycle=DefaultOperationCycle  # Event_Oper_Cycle_Map_Power_Path_083_Single_Device_Failure
  diagnostic event to debounce algorithm mapping EventDebounceMapPowerPath083SingleDeviceFailure: debounce-algorithm=time_based, diagnostic-event=EventPowerPath083SingleDeviceFailure  # EventDebounceMap_Power_Path_083_Single_Device_Failure
package /ZeC/DTC/DTC/Power_Path_089_Single_Device_Failure
  diagnostic trouble code uds Power_Path_089_Single_Device_Failure: dtc-props=Dtc_Props_532ed51d, uds-dtc-value=0x005959
  diagnostic event EventPowerPath089SingleDeviceFailure: aging-allowed=true, event-kind=SWC, prestorage-freeze-frame=false  # Event_Power_Path_089_Single_Device_Failure
  diagnostic event to trouble code uds mapping EventDtcMapPowerPath089SingleDeviceFailure: diagnostic-event=EventPowerPath089SingleDeviceFailure, trouble-code-uds=Power_Path_089_Single_Device_Failure  # Event_Dtc_Map_Power_Path_089_Single_Device_Failure
  diagnostic event to operation cycle mapping EventOperCycleMapPowerPath089SingleDeviceFailure: diagnostic-event=EventPowerPath089SingleDeviceFailure, operation-cycle=DefaultOperationCycle  # Event_Oper_Cycle_Map_Power_Path_089_Single_Device_Failure
  diagnostic event to debounce algorithm mapping EventDebounceMapPowerPath089SingleDeviceFailure: debounce-algorithm=time_based, diagnostic-event=EventPowerPath089SingleDeviceFailure  # EventDebounceMap_Power_Path_089_Single_Device_Failure
package /ZeC/DTC/DTC/Power_Path_095_Single_Device_Failure
  diagnostic trouble code uds Power_Path_095_Single_Device_Failure: dtc-props=Dtc_Props_3ab4da94, uds-dtc-value=0x00595f
  diagnostic event EventPowerPath095SingleDeviceFailure: aging-allowed=true, event-kind=SWC, prestorage-freeze-frame=false  # Event_Power_Path_095_Single_Device_Failure
  diagnostic event to trouble code uds mapping EventDtcMapPowerPath095SingleDeviceFailure: diagnostic-event=EventPowerPath095SingleDeviceFailure, trouble-code-uds=Power_Path_095_Single_Device_Failure  # Event_Dtc_Map_Power_Path_095_Single_Device_Failure
  diagnostic event to operation cycle mapping EventOperCycleMapPowerPath095SingleDeviceFailure: diagnostic-event=EventPowerPath095SingleDeviceFailure, operation-cycle=DefaultOperationCycle  # Event_Oper_Cycle_Map_Power_Path_095_Single_Device_Failure
  diagnostic event to debounce algorithm mapping EventDebounceMapPowerPath095SingleDeviceFailure: debounce-algorithm=time_based, diagnostic-event=EventPowerPath095SingleDeviceFailure  # EventDebounceMap_Power_Path_095_Single_Device_Failure
package /ZeC/DTC/DTC/Power_Path_094_Single_Device_Failure
  diagnostic trouble code uds Power_Path_094_Single_Device_Failure: dtc-props=Dtc_Props_f09fc4da, uds-dtc-value=0x00595e
  diagnostic event EventPowerPath094SingleDeviceFailure: aging-allowed=true, event-kind=SWC, prestorage-freeze-frame=false  # Event_Power_Path_094_Single_Device_Failure
  diagnostic event to trouble code uds mapping EventDtcMapPowerPath094SingleDeviceFailure: diagnostic-event=EventPowerPath094SingleDeviceFailure, trouble-code-uds=Power_Path_094_Single_Device_Failure  # Event_Dtc_Map_Power_Path_094_Single_Device_Failure
  diagnostic event to operation cycle mapping EventOperCycleMapPowerPath094SingleDeviceFailure: diagnostic-event=EventPowerPath094SingleDeviceFailure, operation-cycle=DefaultOperationCycle  # Event_Oper_Cycle_Map_Power_Path_094_Single_Device_Failure
  diagnostic event to debounce algorithm mapping EventDebounceMapPowerPath094SingleDeviceFailure: debounce-algorithm=time_based, diagnostic-event=EventPowerPath094SingleDeviceFailure  # EventDebounceMap_Power_Path_094_Single_Device_Failure
package /ZeC/DTC/DTC/Power_Path_091_Single_Device_Failure
  diagnostic trouble code uds Power_Path_091_Single_Device_Failure: dtc-props=Dtc_Props_f9a1f43d, uds-dtc-value=0x00595b
  diagnostic event EventPowerPath091SingleDeviceFailure: aging-allowed=true, event-kind=SWC, prestorage-freeze-frame=false  # Event_Power_Path_091_Single_Device_Failure
  diagnostic event to trouble code uds mapping EventDtcMapPowerPath091SingleDeviceFailure: diagnostic-event=EventPowerPath091SingleDeviceFailure, trouble-code-uds=Power_Path_091_Single_Device_Failure  # Event_Dtc_Map_Power_Path_091_Single_Device_Failure
  diagnostic event to operation cycle mapping EventOperCycleMapPowerPath091SingleDeviceFailure: diagnostic-event=EventPowerPath091SingleDeviceFailure, operation-cycle=DefaultOperationCycle  # Event_Oper_Cycle_Map_Power_Path_091_Single_Device_Failure
  diagnostic event to debounce algorithm mapping EventDebounceMapPowerPath091SingleDeviceFailure: debounce-algorithm=time_based, diagnostic-event=EventPowerPath091SingleDeviceFailure  # EventDebounceMap_Power_Path_091_Single_Device_Failure
package /ZeC/DTC/DTC/Power_Path_090_Single_Device_Failure
  diagnostic trouble code uds Power_Path_090_Single_Device_Failure: dtc-props=Dtc_Props_338aea73, uds-dtc-value=0x00595a
  diagnostic event EventPowerPath090SingleDeviceFailure: aging-allowed=true, event-kind=SWC, prestorage-freeze-frame=false  # Event_Power_Path_090_Single_Device_Failure
  diagnostic event to trouble code uds mapping EventDtcMapPowerPath090SingleDeviceFailure: diagnostic-event=EventPowerPath090SingleDeviceFailure, trouble-code-uds=Power_Path_090_Single_Device_Failure  # Event_Dtc_Map_Power_Path_090_Single_Device_Failure
  diagnostic event to operation cycle mapping EventOperCycleMapPowerPath090SingleDeviceFailure: diagnostic-event=EventPowerPath090SingleDeviceFailure, operation-cycle=DefaultOperationCycle  # Event_Oper_Cycle_Map_Power_Path_090_Single_Device_Failure
  diagnostic event to debounce algorithm mapping EventDebounceMapPowerPath090SingleDeviceFailure: debounce-algorithm=time_based, diagnostic-event=EventPowerPath090SingleDeviceFailure  # EventDebounceMap_Power_Path_090_Single_Device_Failure
package /ZeC/DTC/DTC/Power_Path_093_Single_Device_Failure
  diagnostic trouble code uds Power_Path_093_Single_Device_Failure: dtc-props=Dtc_Props_b686cee0, uds-dtc-value=0x00595d
  diagnostic event EventPowerPath093SingleDeviceFailure: aging-allowed=true, event-kind=SWC, prestorage-freeze-frame=false  # Event_Power_Path_093_Single_Device_Failure
  diagnostic event to trouble code uds mapping EventDtcMapPowerPath093SingleDeviceFailure: diagnostic-event=EventPowerPath093SingleDeviceFailure, trouble-code-uds=Power_Path_093_Single_Device_Failure  # Event_Dtc_Map_Power_Path_093_Single_Device_Failure
  diagnostic event to operation cycle mapping EventOperCycleMapPowerPath093SingleDeviceFailure: diagnostic-event=EventPowerPath093SingleDeviceFailure, operation-cycle=DefaultOperationCycle  # Event_Oper_Cycle_Map_Power_Path_093_Single_Device_Failure
  diagnostic event to debounce algorithm mapping EventDebounceMapPowerPath093SingleDeviceFailure: debounce-algorithm=time_based, diagnostic-event=EventPowerPath093SingleDeviceFailure  # EventDebounceMap_Power_Path_093_Single_Device_Failure
package /ZeC/DTC/DTC/Power_Path_092_Single_Device_Failure
  diagnostic trouble code uds Power_Path_092_Single_Device_Failure: dtc-props=Dtc_Props_bfb8fe07, uds-dtc-value=0x00595c
  diagnostic event EventPowerPath092SingleDeviceFailure: aging-allowed=true, event-kind=SWC, prestorage-freeze-frame=false  # Event_Power_Path_092_Single_Device_Failure
  diagnostic event to trouble code uds mapping EventDtcMapPowerPath092SingleDeviceFailure: diagnostic-event=EventPowerPath092SingleDeviceFailure, trouble-code-uds=Power_Path_092_Single_Device_Failure  # Event_Dtc_Map_Power_Path_092_Single_Device_Failure
  diagnostic event to operation cycle mapping EventOperCycleMapPowerPath092SingleDeviceFailure: diagnostic-event=EventPowerPath092SingleDeviceFailure, operation-cycle=DefaultOperationCycle  # Event_Oper_Cycle_Map_Power_Path_092_Single_Device_Failure
  diagnostic event to debounce algorithm mapping EventDebounceMapPowerPath092SingleDeviceFailure: debounce-algorithm=time_based, diagnostic-event=EventPowerPath092SingleDeviceFailure  # EventDebounceMap_Power_Path_092_Single_Device_Failure
package /ZeC/DTC/DTC/Power_Path_097_Single_Device_Failure
  diagnostic trouble code uds Power_Path_097_Single_Device_Failure: dtc-props=Dtc_Props_9fdbc987, uds-dtc-value=0x005961
  diagnostic event EventPowerPath097SingleDeviceFailure: aging-allowed=true, event-kind=SWC, prestorage-freeze-frame=false  # Event_Power_Path_097_Single_Device_Failure
  diagnostic event to trouble code uds mapping EventDtcMapPowerPath097SingleDeviceFailure: diagnostic-event=EventPowerPath097SingleDeviceFailure, trouble-code-uds=Power_Path_097_Single_Device_Failure  # Event_Dtc_Map_Power_Path_097_Single_Device_Failure
  diagnostic event to operation cycle mapping EventOperCycleMapPowerPath097SingleDeviceFailure: diagnostic-event=EventPowerPath097SingleDeviceFailure, operation-cycle=DefaultOperationCycle  # Event_Oper_Cycle_Map_Power_Path_097_Single_Device_Failure
  diagnostic event to debounce algorithm mapping EventDebounceMapPowerPath097SingleDeviceFailure: debounce-algorithm=time_based, diagnostic-event=EventPowerPath097SingleDeviceFailure  # EventDebounceMap_Power_Path_097_Single_Device_Failure
package /ZeC/DTC/DTC/Power_Path_096_Single_Device_Failure
  diagnostic trouble code uds Power_Path_096_Single_Device_Failure: dtc-props=Dtc_Props_d9c2c3bd, uds-dtc-value=0x005960
  diagnostic event EventPowerPath096SingleDeviceFailure: aging-allowed=true, event-kind=SWC, prestorage-freeze-frame=false  # Event_Power_Path_096_Single_Device_Failure
  diagnostic event to trouble code uds mapping EventDtcMapPowerPath096SingleDeviceFailure: diagnostic-event=EventPowerPath096SingleDeviceFailure, trouble-code-uds=Power_Path_096_Single_Device_Failure  # Event_Dtc_Map_Power_Path_096_Single_Device_Failure
  diagnostic event to operation cycle mapping EventOperCycleMapPowerPath096SingleDeviceFailure: diagnostic-event=EventPowerPath096SingleDeviceFailure, operation-cycle=DefaultOperationCycle  # Event_Oper_Cycle_Map_Power_Path_096_Single_Device_Failure
  diagnostic event to debounce algorithm mapping EventDebounceMapPowerPath096SingleDeviceFailure: debounce-algorithm=time_based, diagnostic-event=EventPowerPath096SingleDeviceFailure  # EventDebounceMap_Power_Path_096_Single_Device_Failure
package /ZeC/DTC/DTC/Power_Path_009_Short_to_BAT_Failure
  diagnostic trouble code uds Power_Path_009_Short_to_BAT_Failure: dtc-props=Dtc_Props_3aad1bc7, uds-dtc-value=0x005109
  diagnostic event EventPowerPath009ShortToBATFailure: aging-allowed=true, event-kind=SWC, prestorage-freeze-frame=false  # Event_Power_Path_009_Short_to_BAT_Failure
  diagnostic event to trouble code uds mapping EventDtcMapPowerPath009ShortToBATFailure: diagnostic-event=EventPowerPath009ShortToBATFailure, trouble-code-uds=Power_Path_009_Short_to_BAT_Failure  # Event_Dtc_Map_Power_Path_009_Short_to_BAT_Failure
  diagnostic event to operation cycle mapping EventOperCycleMapPowerPath009ShortToBATFailure: diagnostic-event=EventPowerPath009ShortToBATFailure, operation-cycle=DefaultOperationCycle  # Event_Oper_Cycle_Map_Power_Path_009_Short_to_BAT_Failure
  diagnostic event to debounce algorithm mapping EventDebounceMapPowerPath009ShortToBATFailure: debounce-algorithm=time_based, diagnostic-event=EventPowerPath009ShortToBATFailure  # EventDebounceMap_Power_Path_009_Short_to_BAT_Failure
package /ZeC/DTC/DTC/Power_Path_008_Short_to_BAT_Failure
  diagnostic trouble code uds Power_Path_008_Short_to_BAT_Failure: dtc-props=Dtc_Props_7cb411fd, uds-dtc-value=0x005108
  diagnostic event EventPowerPath008ShortToBATFailure: aging-allowed=true, event-kind=SWC, prestorage-freeze-frame=false  # Event_Power_Path_008_Short_to_BAT_Failure
  diagnostic event to trouble code uds mapping EventDtcMapPowerPath008ShortToBATFailure: diagnostic-event=EventPowerPath008ShortToBATFailure, trouble-code-uds=Power_Path_008_Short_to_BAT_Failure  # Event_Dtc_Map_Power_Path_008_Short_to_BAT_Failure
  diagnostic event to operation cycle mapping EventOperCycleMapPowerPath008ShortToBATFailure: diagnostic-event=EventPowerPath008ShortToBATFailure, operation-cycle=DefaultOperationCycle  # Event_Oper_Cycle_Map_Power_Path_008_Short_to_BAT_Failure
  diagnostic event to debounce algorithm mapping EventDebounceMapPowerPath008ShortToBATFailure: debounce-algorithm=time_based, diagnostic-event=EventPowerPath008ShortToBATFailure  # EventDebounceMap_Power_Path_008_Short_to_BAT_Failure
package /ZeC/DTC/DTC/Power_Path_005_Short_to_BAT_Failure
  diagnostic trouble code uds Power_Path_005_Short_to_BAT_Failure: dtc-props=Dtc_Props_a4e36e7d, uds-dtc-value=0x005105
  diagnostic event EventPowerPath005ShortToBATFailure: aging-allowed=true, event-kind=SWC, prestorage-freeze-frame=false  # Event_Power_Path_005_Short_to_BAT_Failure
  diagnostic event to trouble code uds mapping EventDtcMapPowerPath005ShortToBATFailure: diagnostic-event=EventPowerPath005ShortToBATFailure, trouble-code-uds=Power_Path_005_Short_to_BAT_Failure  # Event_Dtc_Map_Power_Path_005_Short_to_BAT_Failure
  diagnostic event to operation cycle mapping EventOperCycleMapPowerPath005ShortToBATFailure: diagnostic-event=EventPowerPath005ShortToBATFailure, operation-cycle=DefaultOperationCycle  # Event_Oper_Cycle_Map_Power_Path_005_Short_to_BAT_Failure
  diagnostic event to debounce algorithm mapping EventDebounceMapPowerPath005ShortToBATFailure: debounce-algorithm=time_based, diagnostic-event=EventPowerPath005ShortToBATFailure  # EventDebounceMap_Power_Path_005_Short_to_BAT_Failure
package /ZeC/DTC/DTC/Power_Path_137_Over_Load_Failure
  diagnostic trouble code uds Power_Path_137_Over_Load_Failure: dtc-props=Dtc_Props_be4e0142, uds-dtc-value=0x005589
  diagnostic event EventPowerPath137OverLoadFailure: aging-allowed=true, event-kind=SWC, prestorage-freeze-frame=false  # Event_Power_Path_137_Over_Load_Failure
  diagnostic event to trouble code uds mapping EventDtcMapPowerPath137OverLoadFailure: diagnostic-event=EventPowerPath137OverLoadFailure, trouble-code-uds=Power_Path_137_Over_Load_Failure  # Event_Dtc_Map_Power_Path_137_Over_Load_Failure
  diagnostic event to operation cycle mapping EventOperCycleMapPowerPath137OverLoadFailure: diagnostic-event=EventPowerPath137OverLoadFailure, operation-cycle=DefaultOperationCycle  # Event_Oper_Cycle_Map_Power_Path_137_Over_Load_Failure
  diagnostic event to debounce algorithm mapping EventDebounceMapPowerPath137OverLoadFailure: debounce-algorithm=time_based, diagnostic-event=EventPowerPath137OverLoadFailure  # EventDebounceMap_Power_Path_137_Over_Load_Failure
package /ZeC/DTC/DTC/Power_Path_004_Short_to_BAT_Failure
  diagnostic trouble code uds Power_Path_004_Short_to_BAT_Failure: dtc-props=Dtc_Props_e2fa6447, uds-dtc-value=0x005104
  diagnostic event EventPowerPath004ShortToBATFailure: aging-allowed=true, event-kind=SWC, prestorage-freeze-frame=false  # Event_Power_Path_004_Short_to_BAT_Failure
  diagnostic event to trouble code uds mapping EventDtcMapPowerPath004ShortToBATFailure: diagnostic-event=EventPowerPath004ShortToBATFailure, trouble-code-uds=Power_Path_004_Short_to_BAT_Failure  # Event_Dtc_Map_Power_Path_004_Short_to_BAT_Failure
  diagnostic event to operation cycle mapping EventOperCycleMapPowerPath004ShortToBATFailure: diagnostic-event=EventPowerPath004ShortToBATFailure, operation-cycle=DefaultOperationCycle  # Event_Oper_Cycle_Map_Power_Path_004_Short_to_BAT_Failure
  diagnostic event to debounce algorithm mapping EventDebounceMapPowerPath004ShortToBATFailure: debounce-algorithm=time_based, diagnostic-event=EventPowerPath004ShortToBATFailure  # EventDebounceMap_Power_Path_004_Short_to_BAT_Failure
package /ZeC/DTC/DTC/Power_Path_136_Over_Load_Failure
  diagnostic trouble code uds Power_Path_136_Over_Load_Failure: dtc-props=Dtc_Props_f8570b78, uds-dtc-value=0x005588
  diagnostic event EventPowerPath136OverLoadFailure: aging-allowed=true, event-kind=SWC, prestorage-freeze-frame=false  # Event_Power_Path_136_Over_Load_Failure
  diagnostic event to trouble code uds mapping EventDtcMapPowerPath136OverLoadFailure: diagnostic-event=EventPowerPath136OverLoadFailure, trouble-code-uds=Power_Path_136_Over_Load_Failure  # Event_Dtc_Map_Power_Path_136_Over_Load_Failure
  diagnostic event to operation cycle mapping EventOperCycleMapPowerPath136OverLoadFailure: diagnostic-event=EventPowerPath136OverLoadFailure, operation-cycle=DefaultOperationCycle  # Event_Oper_Cycle_Map_Power_Path_136_Over_Load_Failure
  diagnostic event to debounce algorithm mapping EventDebounceMapPowerPath136OverLoadFailure: debounce-algorithm=time_based, diagnostic-event=EventPowerPath136OverLoadFailure  # EventDebounceMap_Power_Path_136_Over_Load_Failure
