[part 12 of 19: packages /ZeC/DTC/DTC/Power_Path_038_Open_Load_Failure to /ZeC/DTC/DTC/LIN_20_Slave_7_NoCommunication]
AUTOSAR XML (schema 00047)
package /ZeC/DTC/DTC/Power_Path_038_Open_Load_Failure
  diagnostic trouble code uds Power_Path_038_Open_Load_Failure: dtc-props=Dtc_Props_392cf702, uds-dtc-value=0x005326
  diagnostic event EventPowerPath038OpenLoadFailure: aging-allowed=true, event-kind=SWC, prestorage-freeze-frame=false  # Event_Power_Path_038_Open_Load_Failure
  diagnostic event to trouble code uds mapping EventDtcMapPowerPath038OpenLoadFailure: diagnostic-event=EventPowerPath038OpenLoadFailure, trouble-code-uds=Power_Path_038_Open_Load_Failure  # Event_Dtc_Map_Power_Path_038_Open_Load_Failure
  diagnostic event to operation cycle mapping EventOperCycleMapPowerPath038OpenLoadFailure: diagnostic-event=EventPowerPath038OpenLoadFailure, operation-cycle=DefaultOperationCycle  # Event_Oper_Cycle_Map_Power_Path_038_Open_Load_Failure
  diagnostic event to debounce algorithm mapping EventDebounceMapPowerPath038OpenLoadFailure: debounce-algorithm=time_based, diagnostic-event=EventPowerPath038OpenLoadFailure  # EventDebounceMap_Power_Path_038_Open_Load_Failure
package /ZeC/DTC/DTC/Power_Path_042_Open_Load_Failure
  diagnostic trouble code uds Power_Path_042_Open_Load_Failure: dtc-props=Dtc_Props_deda398, uds-dtc-value=0x00532a
  diagnostic event EventPowerPath042OpenLoadFailure: aging-allowed=true, event-kind=SWC, prestorage-freeze-frame=false  # Event_Power_Path_042_Open_Load_Failure
  diagnostic event to trouble code uds mapping EventDtcMapPowerPath042OpenLoadFailure: diagnostic-event=EventPowerPath042OpenLoadFailure, trouble-code-uds=Power_Path_042_Open_Load_Failure  # Event_Dtc_Map_Power_Path_042_Open_Load_Failure
  diagnostic event to operation cycle mapping EventOperCycleMapPowerPath042OpenLoadFailure: diagnostic-event=EventPowerPath042OpenLoadFailure, operation-cycle=DefaultOperationCycle  # Event_Oper_Cycle_Map_Power_Path_042_Open_Load_Failure
  diagnostic event to debounce algorithm mapping EventDebounceMapPowerPath042OpenLoadFailure: debounce-algorithm=time_based, diagnostic-event=EventPowerPath042OpenLoadFailure  # EventDebounceMap_Power_Path_042_Open_Load_Failure
package /ZeC/DTC/DTC/Power_Path_044_Open_Load_Failure
  diagnostic trouble code uds Power_Path_044_Open_Load_Failure: dtc-props=Dtc_Props_81dfb7ec, uds-dtc-value=0x00532c
  diagnostic event EventPowerPath044OpenLoadFailure: aging-allowed=true, event-kind=SWC, prestorage-freeze-frame=false  # Event_Power_Path_044_Open_Load_Failure
  diagnostic event to trouble code uds mapping EventDtcMapPowerPath044OpenLoadFailure: diagnostic-event=EventPowerPath044OpenLoadFailure, trouble-code-uds=Power_Path_044_Open_Load_Failure  # Event_Dtc_Map_Power_Path_044_Open_Load_Failure
  diagnostic event to operation cycle mapping EventOperCycleMapPowerPath044OpenLoadFailure: diagnostic-event=EventPowerPath044OpenLoadFailure, operation-cycle=DefaultOperationCycle  # Event_Oper_Cycle_Map_Power_Path_044_Open_Load_Failure
  diagnostic event to debounce algorithm mapping EventDebounceMapPowerPath044OpenLoadFailure: debounce-algorithm=time_based, diagnostic-event=EventPowerPath044OpenLoadFailure  # EventDebounceMap_Power_Path_044_Open_Load_Failure
package /ZeC/DTC/DTC/Power_Path_043_Open_Load_Failure
  diagnostic trouble code uds Power_Path_043_Open_Load_Failure: dtc-props=Dtc_Props_c7c6bdd6, uds-dtc-value=0x00532b
  diagnostic event EventPowerPath043OpenLoadFailure: aging-allowed=true, event-kind=SWC, prestorage-freeze-frame=false  # Event_Power_Path_043_Open_Load_Failure
  diagnostic event to trouble code uds mapping EventDtcMapPowerPath043OpenLoadFailure: diagnostic-event=EventPowerPath043OpenLoadFailure, trouble-code-uds=Power_Path_043_Open_Load_Failure  # Event_Dtc_Map_Power_Path_043_Open_Load_Failure
  diagnostic event to operation cycle mapping EventOperCycleMapPowerPath043OpenLoadFailure: diagnostic-event=EventPowerPath043OpenLoadFailure, operation-cycle=DefaultOperationCycle  # Event_Oper_Cycle_Map_Power_Path_043_Open_Load_Failure
  diagnostic event to debounce algorithm mapping EventDebounceMapPowerPath043OpenLoadFailure: debounce-algorithm=time_based, diagnostic-event=EventPowerPath043OpenLoadFailure  # EventDebounceMap_Power_Path_043_Open_Load_Failure
package /ZeC/DTC/DTC/Power_Path_046_Open_Load_Failure
  diagnostic trouble code uds Power_Path_046_Open_Load_Failure: dtc-props=Dtc_Props_cef88d31, uds-dtc-value=0x00532e
  diagnostic event EventPowerPath046OpenLoadFailure: aging-allowed=true, event-kind=SWC, prestorage-freeze-frame=false  # Event_Power_Path_046_Open_Load_Failure
  diagnostic event to trouble code uds mapping EventDtcMapPowerPath046OpenLoadFailure: diagnostic-event=EventPowerPath046OpenLoadFailure, trouble-code-uds=Power_Path_046_Open_Load_Failure  # Event_Dtc_Map_Power_Path_046_Open_Load_Failure
  diagnostic event to operation cycle mapping EventOperCycleMapPowerPath046OpenLoadFailure: diagnostic-event=EventPowerPath046OpenLoadFailure, operation-cycle=DefaultOperationCycle  # Event_Oper_Cycle_Map_Power_Path_046_Open_Load_Failure
  diagnostic event to debounce algorithm mapping EventDebounceMapPowerPath046OpenLoadFailure: debounce-algorithm=time_based, diagnostic-event=EventPowerPath046OpenLoadFailure  # EventDebounceMap_Power_Path_046_Open_Load_Failure
package /ZeC/DTC/DTC/Power_Path_045_Open_Load_Failure
  diagnostic trouble code uds Power_Path_045_Open_Load_Failure: dtc-props=Dtc_Props_88e1870b, uds-dtc-value=0x00532d
  diagnostic event EventPowerPath045OpenLoadFailure: aging-allowed=true, event-kind=SWC, prestorage-freeze-frame=false  # Event_Power_Path_045_Open_Load_Failure
  diagnostic event to trouble code uds mapping EventDtcMapPowerPath045OpenLoadFailure: diagnostic-event=EventPowerPath045OpenLoadFailure, trouble-code-uds=Power_Path_045_Open_Load_Failure  # Event_Dtc_Map_Power_Path_045_Open_Load_Failure
  diagnostic event to operation cycle mapping EventOperCycleMapPowerPath045OpenLoadFailure: diagnostic-event=EventPowerPath045OpenLoadFailure, operation-cycle=DefaultOperationCycle  # Event_Oper_Cycle_Map_Power_Path_045_Open_Load_Failure
  diagnostic event to debounce algorithm mapping EventDebounceMapPowerPath045OpenLoadFailure: debounce-algorithm=time_based, diagnostic-event=EventPowerPath045OpenLoadFailure  # EventDebounceMap_Power_Path_045_Open_Load_Failure
package /ZeC/DTC/DTC/Power_Path_047_Open_Load_Failure
  diagnostic trouble code uds Power_Path_047_Open_Load_Failure: dtc-props=Dtc_Props_4d3937f, uds-dtc-value=0x00532f
  diagnostic event EventPowerPath047OpenLoadFailure: aging-allowed=true, event-kind=SWC, prestorage-freeze-frame=false  # Event_Power_Path_047_Open_Load_Failure
  diagnostic event to trouble code uds mapping EventDtcMapPowerPath047OpenLoadFailure: diagnostic-event=EventPowerPath047OpenLoadFailure, trouble-code-uds=Power_Path_047_Open_Load_Failure  # Event_Dtc_Map_Power_Path_047_Open_Load_Failure
  diagnostic event to operation cycle mapping EventOperCycleMapPowerPath047OpenLoadFailure: diagnostic-event=EventPowerPath047OpenLoadFailure, operation-cycle=DefaultOperationCycle  # Event_Oper_Cycle_Map_Power_Path_047_Open_Load_Failure
  diagnostic event to debounce algorithm mapping EventDebounceMapPowerPath047OpenLoadFailure: debounce-algorithm=time_based, diagnostic-event=EventPowerPath047OpenLoadFailure  # EventDebounceMap_Power_Path_047_Open_Load_Failure
package /ZeC/DTC/DTC/Power_Path_050_Open_Load_Failure
  diagnostic trouble code uds Power_Path_050_Open_Load_Failure: dtc-props=Dtc_Props_3c731913, uds-dtc-value=0x005332
  diagnostic event EventPowerPath050OpenLoadFailure: aging-allowed=true, event-kind=SWC, prestorage-freeze-frame=false  # Event_Power_Path_050_Open_Load_Failure
  diagnostic event to trouble code uds mapping EventDtcMapPowerPath050OpenLoadFailure: diagnostic-event=EventPowerPath050OpenLoadFailure, trouble-code-uds=Power_Path_050_Open_Load_Failure  # Event_Dtc_Map_Power_Path_050_Open_Load_Failure
  diagnostic event to operation cycle mapping EventOperCycleMapPowerPath050OpenLoadFailure: diagnostic-event=EventPowerPath050OpenLoadFailure, operation-cycle=DefaultOperationCycle  # Event_Oper_Cycle_Map_Power_Path_050_Open_Load_Failure
  diagnostic event to debounce algorithm mapping EventDebounceMapPowerPath050OpenLoadFailure: debounce-algorithm=time_based, diagnostic-event=EventPowerPath050OpenLoadFailure  # EventDebounceMap_Power_Path_050_Open_Load_Failure
package /ZeC/DTC/DTC/Power_Path_049_Open_Load_Failure
  diagnostic trouble code uds Power_Path_049_Open_Load_Failure: dtc-props=Dtc_Props_f658075d, uds-dtc-value=0x005331
  diagnostic event EventPowerPath049OpenLoadFailure: aging-allowed=true, event-kind=SWC, prestorage-freeze-frame=false  # Event_Power_Path_049_Open_Load_Failure
  diagnostic event to trouble code uds mapping EventDtcMapPowerPath049OpenLoadFailure: diagnostic-event=EventPowerPath049OpenLoadFailure, trouble-code-uds=Power_Path_049_Open_Load_Failure  # Event_Dtc_Map_Power_Path_049_Open_Load_Failure
  diagnostic event to operation cycle mapping EventOperCycleMapPowerPath049OpenLoadFailure: diagnostic-event=EventPowerPath049OpenLoadFailure, operation-cycle=DefaultOperationCycle  # Event_Oper_Cycle_Map_Power_Path_049_Open_Load_Failure
  diagnostic event to debounce algorithm mapping EventDebounceMapPowerPath049OpenLoadFailure: debounce-algorithm=time_based, diagnostic-event=EventPowerPath049OpenLoadFailure  # EventDebounceMap_Power_Path_049_Open_Load_Failure
package /ZeC/DTC/DTC/Power_Path_052_Open_Load_Failure
  diagnostic trouble code uds Power_Path_052_Open_Load_Failure: dtc-props=Dtc_Props_735423ce, uds-dtc-value=0x005334
  diagnostic event EventPowerPath052OpenLoadFailure: aging-allowed=true, event-kind=SWC, prestorage-freeze-frame=false  # Event_Power_Path_052_Open_Load_Failure
  diagnostic event to trouble code uds mapping EventDtcMapPowerPath052OpenLoadFailure: diagnostic-event=EventPowerPath052OpenLoadFailure, trouble-code-uds=Power_Path_052_Open_Load_Failure  # Event_Dtc_Map_Power_Path_052_Open_Load_Failure
  diagnostic event to operation cycle mapping EventOperCycleMapPowerPath052OpenLoadFailure: diagnostic-event=EventPowerPath052OpenLoadFailure, operation-cycle=DefaultOperationCycle  # Event_Oper_Cycle_Map_Power_Path_052_Open_Load_Failure
  diagnostic event to debounce algorithm mapping EventDebounceMapPowerPath052OpenLoadFailure: debounce-algorithm=time_based, diagnostic-event=EventPowerPath052OpenLoadFailure  # EventDebounceMap_Power_Path_052_Open_Load_Failure
package /ZeC/DTC/DTC/Power_Path_051_Open_Load_Failure
  diagnostic trouble code uds Power_Path_051_Open_Load_Failure: dtc-props=Dtc_Props_7a6a1329, uds-dtc-value=0x005333
  diagnostic event EventPowerPath051OpenLoadFailure: aging-allowed=true, event-kind=SWC, prestorage-freeze-frame=false  # Event_Power_Path_051_Open_Load_Failure
  diagnostic event to trouble code uds mapping EventDtcMapPowerPath051OpenLoadFailure: diagnostic-event=EventPowerPath051OpenLoadFailure, trouble-code-uds=Power_Path_051_Open_Load_Failure  # Event_Dtc_Map_Power_Path_051_Open_Load_Failure
  diagnostic event to operation cycle mapping EventOperCycleMapPowerPath051OpenLoadFailure: diagnostic-event=EventPowerPath051OpenLoadFailure, operation-cycle=DefaultOperationCycle  # Event_Oper_Cycle_Map_Power_Path_051_Open_Load_Failure
  diagnostic event to debounce algorithm mapping EventDebounceMapPowerPath051OpenLoadFailure: debounce-algorithm=time_based, diagnostic-event=EventPowerPath051OpenLoadFailure  # EventDebounceMap_Power_Path_051_Open_Load_Failure
package /ZeC/DTC/DTC/CAN_09_ECU_4_No_Communication
  diagnostic trouble code uds CAN_09_ECU_4_No_Communication: dtc-props=Dtc_Props_14158306, uds-dtc-value=0x032908
  diagnostic event EventCAN09ECU4NoCommunication: aging-allowed=true, event-kind=SWC, prestorage-freeze-frame=false  # Event_CAN_09_ECU_4_No_Communication
  diagnostic event to trouble code uds mapping EventDtcMapCAN09ECU4NoCommunication: diagnostic-event=EventCAN09ECU4NoCommunication, trouble-code-uds=CAN_09_ECU_4_No_Communication  # Event_Dtc_Map_CAN_09_ECU_4_No_Communication
  diagnostic event to operation cycle mapping EventOperCycleMapCAN09ECU4NoCommunication: diagnostic-event=EventCAN09ECU4NoCommunication, operation-cycle=DefaultOperationCycle  # Event_Oper_Cycle_Map_CAN_09_ECU_4_No_Communication
  diagnostic event to debounce algorithm mapping EventDebounceMapCAN09ECU4NoCommunication: debounce-algorithm=counter_based, diagnostic-event=EventCAN09ECU4NoCommunication  # EventDebounceMap_CAN_09_ECU_4_No_Communication
package /ZeC/DTC/DTC/CAN_09_ECU_5_No_Communication
  diagnostic trouble code uds CAN_09_ECU_5_No_Communication: dtc-props=Dtc_Props_14158306, uds-dtc-value=0x032909
  diagnostic event EventCAN09ECU5NoCommunication: aging-allowed=true, event-kind=SWC, prestorage-freeze-frame=false  # Event_CAN_09_ECU_5_No_Communication
  diagnostic event to trouble code uds mapping EventDtcMapCAN09ECU5NoCommunication: diagnostic-event=EventCAN09ECU5NoCommunication, trouble-code-uds=CAN_09_ECU_5_No_Communication  # Event_Dtc_Map_CAN_09_ECU_5_No_Communication
  diagnostic event to operation cycle mapping EventOperCycleMapCAN09ECU5NoCommunication: diagnostic-event=EventCAN09ECU5NoCommunication, operation-cycle=DefaultOperationCycle  # Event_Oper_Cycle_Map_CAN_09_ECU_5_No_Communication
  diagnostic event to debounce algorithm mapping EventDebounceMapCAN09ECU5NoCommunication: debounce-algorithm=counter_based, diagnostic-event=EventCAN09ECU5NoCommunication  # EventDebounceMap_CAN_09_ECU_5_No_Communication
package /ZeC/DTC/DTC/Power_Path_048_Open_Load_Failure
  diagnostic trouble code uds Power_Path_048_Open_Load_Failure: dtc-props=Dtc_Props_b0410d67, uds-dtc-value=0x005330
  diagnostic event EventPowerPath048OpenLoadFailure: aging-allowed=true, event-kind=SWC, prestorage-freeze-frame=false  # Event_Power_Path_048_Open_Load_Failure
  diagnostic event to trouble code uds mapping EventDtcMapPowerPath048OpenLoadFailure: diagnostic-event=EventPowerPath048OpenLoadFailure, trouble-code-uds=Power_Path_048_Open_Load_Failure  # Event_Dtc_Map_Power_Path_048_Open_Load_Failure
  diagnostic event to operation cycle mapping EventOperCycleMapPowerPath048OpenLoadFailure: diagnostic-event=EventPowerPath048OpenLoadFailure, operation-cycle=DefaultOperationCycle  # Event_Oper_Cycle_Map_Power_Path_048_Open_Load_Failure
  diagnostic event to debounce algorithm mapping EventDebounceMapPowerPath048OpenLoadFailure: debounce-algorithm=time_based, diagnostic-event=EventPowerPath048OpenLoadFailure  # EventDebounceMap_Power_Path_048_Open_Load_Failure
package /ZeC/DTC/DTC/CAN_09_ECU_2_No_Communication
  diagnostic trouble code uds CAN_09_ECU_2_No_Communication: dtc-props=Dtc_Props_14158306, uds-dtc-value=0x032906
  diagnostic event EventCAN09ECU2NoCommunication: aging-allowed=true, event-kind=SWC, prestorage-freeze-frame=false  # Event_CAN_09_ECU_2_No_Communication
  diagnostic event to trouble code uds mapping EventDtcMapCAN09ECU2NoCommunication: diagnostic-event=EventCAN09ECU2NoCommunication, trouble-code-uds=CAN_09_ECU_2_No_Communication  # Event_Dtc_Map_CAN_09_ECU_2_No_Communication
  diagnostic event to operation cycle mapping EventOperCycleMapCAN09ECU2NoCommunication: diagnostic-event=EventCAN09ECU2NoCommunication, operation-cycle=DefaultOperationCycle  # Event_Oper_Cycle_Map_CAN_09_ECU_2_No_Communication
  diagnostic event to debounce algorithm mapping EventDebounceMapCAN09ECU2NoCommunication: debounce-algorithm=counter_based, diagnostic-event=EventCAN09ECU2NoCommunication  # EventDebounceMap_CAN_09_ECU_2_No_Communication
package /ZeC/DTC/DTC/CAN_09_ECU_3_No_Communication
  diagnostic trouble code uds CAN_09_ECU_3_No_Communication: dtc-props=Dtc_Props_14158306, uds-dtc-value=0x032907
  diagnostic event EventCAN09ECU3NoCommunication: aging-allowed=true, event-kind=SWC, prestorage-freeze-frame=false  # Event_CAN_09_ECU_3_No_Communication
  diagnostic event to trouble code uds mapping EventDtcMapCAN09ECU3NoCommunication: diagnostic-event=EventCAN09ECU3NoCommunication, trouble-code-uds=CAN_09_ECU_3_No_Communication  # Event_Dtc_Map_CAN_09_ECU_3_No_Communication
  diagnostic event to operation cycle mapping EventOperCycleMapCAN09ECU3NoCommunication: diagnostic-event=EventCAN09ECU3NoCommunication, operation-cycle=DefaultOperationCycle  # Event_Oper_Cycle_Map_CAN_09_ECU_3_No_Communication
  diagnostic event to debounce algorithm mapping EventDebounceMapCAN09ECU3NoCommunication: debounce-algorithm=counter_based, diagnostic-event=EventCAN09ECU3NoCommunication  # EventDebounceMap_CAN_09_ECU_3_No_Communication
package /ZeC/DTC/DTC/Power_Path_024_Open_Load_Failure
  diagnostic trouble code uds Power_Path_024_Open_Load_Failure: dtc-props=Dtc_Props_bafed145, uds-dtc-value=0x005318
  diagnostic event EventPowerPath024OpenLoadFailure: aging-allowed=true, event-kind=SWC, prestorage-freeze-frame=false  # Event_Power_Path_024_Open_Load_Failure
  diagnostic event to trouble code uds mapping EventDtcMapPowerPath024OpenLoadFailure: diagnostic-event=EventPowerPath024OpenLoadFailure, trouble-code-uds=Power_Path_024_Open_Load_Failure  # Event_Dtc_Map_Power_Path_024_Open_Load_Failure
  diagnostic event to operation cycle mapping EventOperCycleMapPowerPath024OpenLoadFailure: diagnostic-event=EventPowerPath024OpenLoadFailure, operation-cycle=DefaultOperationCycle  # Event_Oper_Cycle_Map_Power_Path_024_Open_Load_Failure
  diagnostic event to debounce algorithm mapping EventDebounceMapPowerPath024OpenLoadFailure: debounce-algorithm=time_based, diagnostic-event=EventPowerPath024OpenLoadFailure  # EventDebounceMap_Power_Path_024_Open_Load_Failure
package /ZeC/DTC/DTC/Power_Path_023_Open_Load_Failure
  diagnostic trouble code uds Power_Path_023_Open_Load_Failure: dtc-props=Dtc_Props_ee9bbab1, uds-dtc-value=0x005317
  diagnostic event EventPowerPath023OpenLoadFailure: aging-allowed=true, event-kind=SWC, prestorage-freeze-frame=false  # Event_Power_Path_023_Open_Load_Failure
  diagnostic event to trouble code uds mapping EventDtcMapPowerPath023OpenLoadFailure: diagnostic-event=EventPowerPath023OpenLoadFailure, trouble-code-uds=Power_Path_023_Open_Load_Failure  # Event_Dtc_Map_Power_Path_023_Open_Load_Failure
  diagnostic event to operation cycle mapping EventOperCycleMapPowerPath023OpenLoadFailure: diagnostic-event=EventPowerPath023OpenLoadFailure, operation-cycle=DefaultOperationCycle  # Event_Oper_Cycle_Map_Power_Path_023_Open_Load_Failure
  diagnostic event to debounce algorithm mapping EventDebounceMapPowerPath023OpenLoadFailure: debounce-algorithm=time_based, diagnostic-event=EventPowerPath023OpenLoadFailure  # EventDebounceMap_Power_Path_023_Open_Load_Failure
package /ZeC/DTC/DTC/Power_Path_025_Open_Load_Failure
  diagnostic trouble code uds Power_Path_025_Open_Load_Failure: dtc-props=Dtc_Props_fce7db7f, uds-dtc-value=0x005319
  diagnostic event EventPowerPath025OpenLoadFailure: aging-allowed=true, event-kind=SWC, prestorage-freeze-frame=false  # Event_Power_Path_025_Open_Load_Failure
  diagnostic event to trouble code uds mapping EventDtcMapPowerPath025OpenLoadFailure: diagnostic-event=EventPowerPath025OpenLoadFailure, trouble-code-uds=Power_Path_025_Open_Load_Failure  # Event_Dtc_Map_Power_Path_025_Open_Load_Failure
  diagnostic event to operation cycle mapping EventOperCycleMapPowerPath025OpenLoadFailure: diagnostic-event=EventPowerPath025OpenLoadFailure, operation-cycle=DefaultOperationCycle  # Event_Oper_Cycle_Map_Power_Path_025_Open_Load_Failure
  diagnostic event to debounce algorithm mapping EventDebounceMapPowerPath025OpenLoadFailure: debounce-algorithm=time_based, diagnostic-event=EventPowerPath025OpenLoadFailure  # EventDebounceMap_Power_Path_025_Open_Load_Failure
package /ZeC/DTC/DTC/Power_Path_020_Open_Load_Failure
  diagnostic trouble code uds Power_Path_020_Open_Load_Failure: dtc-props=Dtc_Props_24b0a4ff, uds-dtc-value=0x005314
  diagnostic event EventPowerPath020OpenLoadFailure: aging-allowed=true, event-kind=SWC, prestorage-freeze-frame=false  # Event_Power_Path_020_Open_Load_Failure
  diagnostic event to trouble code uds mapping EventDtcMapPowerPath020OpenLoadFailure: diagnostic-event=EventPowerPath020OpenLoadFailure, trouble-code-uds=Power_Path_020_Open_Load_Failure  # Event_Dtc_Map_Power_Path_020_Open_Load_Failure
  diagnostic event to operation cycle mapping EventOperCycleMapPowerPath020OpenLoadFailure: diagnostic-event=EventPowerPath020OpenLoadFailure, operation-cycle=DefaultOperationCycle  # Event_Oper_Cycle_Map_Power_Path_020_Open_Load_Failure
  diagnostic event to debounce algorithm mapping EventDebounceMapPowerPath020OpenLoadFailure: debounce-algorithm=time_based, diagnostic-event=EventPowerPath020OpenLoadFailure  # EventDebounceMap_Power_Path_020_Open_Load_Failure
package /ZeC/DTC/DTC/Power_Path_152_Over_Temperature_Failure
  diagnostic trouble code uds Power_Path_152_Over_Temperature_Failure: dtc-props=Dtc_Props_3e1dcbc0, uds-dtc-value=0x005798
  diagnostic event EventPowerPath152OverTemperatureFailure: aging-allowed=true, event-kind=SWC, prestorage-freeze-frame=false  # Event_Power_Path_152_Over_Temperature_Failure
  diagnostic event to trouble code uds mapping EventDtcMapPowerPath152OverTemperatureFailure: diagnostic-event=EventPowerPath152OverTemperatureFailure, trouble-code-uds=Power_Path_152_Over_Temperature_Failure  # Event_Dtc_Map_Power_Path_152_Over_Temperature_Failure
  diagnostic event to operation cycle mapping EventOperCycleMapPowerPath152OverTemperatureFailure: diagnostic-event=EventPowerPath152OverTemperatureFailure, operation-cycle=DefaultOperationCycle  # Event_Oper_Cycle_Map_Power_Path_152_Over_Temperature_Failure
  diagnostic event to debounce algorithm mapping EventDebounceMapPowerPath152OverTemperatureFailure: debounce-algorithm=time_based, diagnostic-event=EventPowerPath152OverTemperatureFailure  # EventDebounceMap_Power_Path_152_Over_Temperature_Failure
package /ZeC/DTC/DTC/Power_Path_019_Open_Load_Failure
  diagnostic trouble code uds Power_Path_019_Open_Load_Failure: dtc-props=Dtc_Props_2d8e9418, uds-dtc-value=0x005313
  diagnostic event EventPowerPath019OpenLoadFailure: aging-allowed=true, event-kind=SWC, prestorage-freeze-frame=false  # Event_Power_Path_019_Open_Load_Failure
  diagnostic event to trouble code uds mapping EventDtcMapPowerPath019OpenLoadFailure: diagnostic-event=EventPowerPath019OpenLoadFailure, trouble-code-uds=Power_Path_019_Open_Load_Failure  # Event_Dtc_Map_Power_Path_019_Open_Load_Failure
  diagnostic event to operation cycle mapping EventOperCycleMapPowerPath019OpenLoadFailure: diagnostic-event=EventPowerPath019OpenLoadFailure, operation-cycle=DefaultOperationCycle  # Event_Oper_Cycle_Map_Power_Path_019_Open_Load_Failure
  diagnostic event to debounce algorithm mapping EventDebounceMapPowerPath019OpenLoadFailure: debounce-algorithm=time_based, diagnostic-event=EventPowerPath019OpenLoadFailure  # EventDebounceMap_Power_Path_019_Open_Load_Failure
package /ZeC/DTC/DTC/Power_Path_151_Over_Temperature_Failure
  diagnostic trouble code uds Power_Path_151_Over_Temperature_Failure: dtc-props=Dtc_Props_6a78a034, uds-dtc-value=0x005797
  diagnostic event EventPowerPath151OverTemperatureFailure: aging-allowed=true, event-kind=SWC, prestorage-freeze-frame=false  # Event_Power_Path_151_Over_Temperature_Failure
  diagnostic event to trouble code uds mapping EventDtcMapPowerPath151OverTemperatureFailure: diagnostic-event=EventPowerPath151OverTemperatureFailure, trouble-code-uds=Power_Path_151_Over_Temperature_Failure  # Event_Dtc_Map_Power_Path_151_Over_Temperature_Failure
  diagnostic event to operation cycle mapping EventOperCycleMapPowerPath151OverTemperatureFailure: diagnostic-event=EventPowerPath151OverTemperatureFailure, operation-cycle=DefaultOperationCycle  # Event_Oper_Cycle_Map_Power_Path_151_Over_Temperature_Failure
  diagnostic event to debounce algorithm mapping EventDebounceMapPowerPath151OverTemperatureFailure: debounce-algorithm=time_based, diagnostic-event=EventPowerPath151OverTemperatureFailure  # EventDebounceMap_Power_Path_151_Over_Temperature_Failure
package /ZeC/DTC/DTC/Power_Path_022_Open_Load_Failure
  diagnostic trouble code uds Power_Path_022_Open_Load_Failure: dtc-props=Dtc_Props_a882b08b, uds-dtc-value=0x005316
  diagnostic event EventPowerPath022OpenLoadFailure: aging-allowed=true, event-kind=SWC, prestorage-freeze-frame=false  # Event_Power_Path_022_Open_Load_Failure
  diagnostic event to trouble code uds mapping EventDtcMapPowerPath022OpenLoadFailure: diagnostic-event=EventPowerPath022OpenLoadFailure, trouble-code-uds=Power_Path_022_Open_Load_Failure  # Event_Dtc_Map_Power_Path_022_Open_Load_Failure
  diagnostic event to operation cycle mapping EventOperCycleMapPowerPath022OpenLoadFailure: diagnostic-event=EventPowerPath022OpenLoadFailure, operation-cycle=DefaultOperationCycle  # Event_Oper_Cycle_Map_Power_Path_022_Open_Load_Failure
  diagnostic event to debounce algorithm mapping EventDebounceMapPowerPath022OpenLoadFailure: debounce-algorithm=time_based, diagnostic-event=EventPowerPath022OpenLoadFailure  # EventDebounceMap_Power_Path_022_Open_Load_Failure
package /ZeC/DTC/DTC/Power_Path_021_Open_Load_Failure
  diagnostic trouble code uds Power_Path_021_Open_Load_Failure: dtc-props=Dtc_Props_62a9aec5, uds-dtc-value=0x005315
  diagnostic event EventPowerPath021OpenLoadFailure: aging-allowed=true, event-kind=SWC, prestorage-freeze-frame=false  # Event_Power_Path_021_Open_Load_Failure
  diagnostic event to trouble code uds mapping EventDtcMapPowerPath021OpenLoadFailure: diagnostic-event=EventPowerPath021OpenLoadFailure, trouble-code-uds=Power_Path_021_Open_Load_Failure  # Event_Dtc_Map_Power_Path_021_Open_Load_Failure
  diagnostic event to operation cycle mapping EventOperCycleMapPowerPath021OpenLoadFailure: diagnostic-event=EventPowerPath021OpenLoadFailure, operation-cycle=DefaultOperationCycle  # Event_Oper_Cycle_Map_Power_Path_021_Open_Load_Failure
  diagnostic event to debounce algorithm mapping EventDebounceMapPowerPath021OpenLoadFailure: debounce-algorithm=time_based, diagnostic-event=EventPowerPath021OpenLoadFailure  # EventDebounceMap_Power_Path_021_Open_Load_Failure
package /ZeC/DTC/DTC/Power_Path_153_Over_Temperature_Failure
  diagnostic trouble code uds Power_Path_153_Over_Temperature_Failure: dtc-props=Dtc_Props_7804c1fa, uds-dtc-value=0x005799
  diagnostic event EventPowerPath153OverTemperatureFailure: aging-allowed=true, event-kind=SWC, prestorage-freeze-frame=false  # Event_Power_Path_153_Over_Temperature_Failure
  diagnostic event to trouble code uds mapping EventDtcMapPowerPath153OverTemperatureFailure: diagnostic-event=EventPowerPath153OverTemperatureFailure, trouble-code-uds=Power_Path_153_Over_Temperature_Failure  # Event_Dtc_Map_Power_Path_153_Over_Temperature_Failure
  diagnostic event to operation cycle mapping EventOperCycleMapPowerPath153OverTemperatureFailure: diagnostic-event=EventPowerPath153OverTemperatureFailure, operation-cycle=DefaultOperationCycle  # Event_Oper_Cycle_Map_Power_Path_153_Over_Temperature_Failure
  diagnostic event to debounce algorithm mapping EventDebounceMapPowerPath153OverTemperatureFailure: debounce-algorithm=time_based, diagnostic-event=EventPowerPath153OverTemperatureFailure  # EventDebounceMap_Power_Path_153_Over_Temperature_Failure
package /ZeC/DTC/DTC/CAN_09_ECU_6_No_Communication
  diagnostic trouble code uds CAN_09_ECU_6_No_Communication: dtc-props=Dtc_Props_14158306, uds-dtc-value=0x032910
  diagnostic event EventCAN09ECU6NoCommunication: aging-allowed=true, event-kind=SWC, prestorage-freeze-frame=false  # Event_CAN_09_ECU_6_No_Communication
  diagnostic event to trouble code uds mapping EventDtcMapCAN09ECU6NoCommunication: diagnostic-event=EventCAN09ECU6NoCommunication, trouble-code-uds=CAN_09_ECU_6_No_Communication  # Event_Dtc_Map_CAN_09_ECU_6_No_Communication
  diagnostic event to operation cycle mapping EventOperCycleMapCAN09ECU6NoCommunication: diagnostic-event=EventCAN09ECU6NoCommunication, operation-cycle=DefaultOperationCycle  # Event_Oper_Cycle_Map_CAN_09_ECU_6_No_Communication
  diagnostic event to debounce algorithm mapping EventDebounceMapCAN09ECU6NoCommunication: debounce-algorithm=counter_based, diagnostic-event=EventCAN09ECU6NoCommunication  # EventDebounceMap_CAN_09_ECU_6_No_Communication
package /ZeC/DTC/DTC/Power_Path_157_Over_Temperature_Failure
  diagnostic trouble code uds Power_Path_157_Over_Temperature_Failure: dtc-props=Dtc_Props_9dacda07, uds-dtc-value=0x00579d
  diagnostic event EventPowerPath157OverTemperatureFailure: aging-allowed=true, event-kind=SWC, prestorage-freeze-frame=false  # Event_Power_Path_157_Over_Temperature_Failure
  diagnostic event to trouble code uds mapping EventDtcMapPowerPath157OverTemperatureFailure: diagnostic-event=EventPowerPath157OverTemperatureFailure, trouble-code-uds=Power_Path_157_Over_Temperature_Failure  # Event_Dtc_Map_Power_Path_157_Over_Temperature_Failure
  diagnostic event to operation cycle mapping EventOperCycleMapPowerPath157OverTemperatureFailure: diagnostic-event=EventPowerPath157OverTemperatureFailure, operation-cycle=DefaultOperationCycle  # Event_Oper_Cycle_Map_Power_Path_157_Over_Temperature_Failure
  diagnostic event to debounce algorithm mapping EventDebounceMapPowerPath157OverTemperatureFailure: debounce-algorithm=time_based, diagnostic-event=EventPowerPath157OverTemperatureFailure  # EventDebounceMap_Power_Path_157_Over_Temperature_Failure
package /ZeC/DTC/DTC/Power_Path_156_Over_Temperature_Failure
  diagnostic trouble code uds Power_Path_156_Over_Temperature_Failure: dtc-props=Dtc_Props_9492eae0, uds-dtc-value=0x00579c
  diagnostic event EventPowerPath156OverTemperatureFailure: aging-allowed=true, event-kind=SWC, prestorage-freeze-frame=false  # Event_Power_Path_156_Over_Temperature_Failure
  diagnostic event to trouble code uds mapping EventDtcMapPowerPath156OverTemperatureFailure: diagnostic-event=EventPowerPath156OverTemperatureFailure, trouble-code-uds=Power_Path_156_Over_Temperature_Failure  # Event_Dtc_Map_Power_Path_156_Over_Temperature_Failure
  diagnostic event to operation cycle mapping EventOperCycleMapPowerPath156OverTemperatureFailure: diagnostic-event=EventPowerPath156OverTemperatureFailure, operation-cycle=DefaultOperationCycle  # Event_Oper_Cycle_Map_Power_Path_156_Over_Temperature_Failure
  diagnostic event to debounce algorithm mapping EventDebounceMapPowerPath156OverTemperatureFailure: debounce-algorithm=time_based, diagnostic-event=EventPowerPath156OverTemperatureFailure  # EventDebounceMap_Power_Path_156_Over_Temperature_Failure
package /ZeC/DTC/DTC/Power_Path_027_Open_Load_Failure
  diagnostic trouble code uds Power_Path_027_Open_Load_Failure: dtc-props=Dtc_Props_5668fa5f, uds-dtc-value=0x00531b
  diagnostic event EventPowerPath027OpenLoadFailure: aging-allowed=true, event-kind=SWC, prestorage-freeze-frame=false  # Event_Power_Path_027_Open_Load_Failure
  diagnostic event to trouble code uds mapping EventDtcMapPowerPath027OpenLoadFailure: diagnostic-event=EventPowerPath027OpenLoadFailure, trouble-code-uds=Power_Path_027_Open_Load_Failure  # Event_Dtc_Map_Power_Path_027_Open_Load_Failure
  diagnostic event to operation cycle mapping EventOperCycleMapPowerPath027OpenLoadFailure: diagnostic-event=EventPowerPath027OpenLoadFailure, operation-cycle=DefaultOperationCycle  # Event_Oper_Cycle_Map_Power_Path_027_Open_Load_Failure
  diagnostic event to debounce algorithm mapping EventDebounceMapPowerPath027OpenLoadFailure: debounce-algorithm=time_based, diagnostic-event=EventPowerPath027OpenLoadFailure  # EventDebounceMap_Power_Path_027_Open_Load_Failure
package /ZeC/DTC/DTC/Power_Path_159_Over_Temperature_Failure
  diagnostic trouble code uds Power_Path_159_Over_Temperature_Failure: dtc-props=Dtc_Props_119ece73, uds-dtc-value=0x00579f
  diagnostic event EventPowerPath159OverTemperatureFailure: aging-allowed=true, event-kind=SWC, prestorage-freeze-frame=false  # Event_Power_Path_159_Over_Temperature_Failure
  diagnostic event to trouble code uds mapping EventDtcMapPowerPath159OverTemperatureFailure: diagnostic-event=EventPowerPath159OverTemperatureFailure, trouble-code-uds=Power_Path_159_Over_Temperature_Failure  # Event_Dtc_Map_Power_Path_159_Over_Temperature_Failure
  diagnostic event to operation cycle mapping EventOperCycleMapPowerPath159OverTemperatureFailure: diagnostic-event=EventPowerPath159OverTemperatureFailure, operation-cycle=DefaultOperationCycle  # Event_Oper_Cycle_Map_Power_Path_159_Over_Temperature_Failure
  diagnostic event to debounce algorithm mapping EventDebounceMapPowerPath159OverTemperatureFailure: debounce-algorithm=time_based, diagnostic-event=EventPowerPath159OverTemperatureFailure  # EventDebounceMap_Power_Path_159_Over_Temperature_Failure
package /ZeC/DTC/DTC/Power_Path_026_Open_Load_Failure
  diagnostic trouble code uds Power_Path_026_Open_Load_Failure: dtc-props=Dtc_Props_9c43e411, uds-dtc-value=0x00531a
  diagnostic event EventPowerPath026OpenLoadFailure: aging-allowed=true, event-kind=SWC, prestorage-freeze-frame=false  # Event_Power_Path_026_Open_Load_Failure
  diagnostic event to trouble code uds mapping EventDtcMapPowerPath026OpenLoadFailure: diagnostic-event=EventPowerPath026OpenLoadFailure, trouble-code-uds=Power_Path_026_Open_Load_Failure  # Event_Dtc_Map_Power_Path_026_Open_Load_Failure
  diagnostic event to operation cycle mapping EventOperCycleMapPowerPath026OpenLoadFailure: diagnostic-event=EventPowerPath026OpenLoadFailure, operation-cycle=DefaultOperationCycle  # Event_Oper_Cycle_Map_Power_Path_026_Open_Load_Failure
  diagnostic event to debounce algorithm mapping EventDebounceMapPowerPath026OpenLoadFailure: debounce-algorithm=time_based, diagnostic-event=EventPowerPath026OpenLoadFailure  # EventDebounceMap_Power_Path_026_Open_Load_Failure
package /ZeC/DTC/DTC/Power_Path_158_Over_Temperature_Failure
  diagnostic trouble code uds Power_Path_158_Over_Temperature_Failure: dtc-props=Dtc_Props_dbb5d03d, uds-dtc-value=0x00579e
  diagnostic event EventPowerPath158OverTemperatureFailure: aging-allowed=true, event-kind=SWC, prestorage-freeze-frame=false  # Event_Power_Path_158_Over_Temperature_Failure
  diagnostic event to trouble code uds mapping EventDtcMapPowerPath158OverTemperatureFailure: diagnostic-event=EventPowerPath158OverTemperatureFailure, trouble-code-uds=Power_Path_158_Over_Temperature_Failure  # Event_Dtc_Map_Power_Path_158_Over_Temperature_Failure
  diagnostic event to operation cycle mapping EventOperCycleMapPowerPath158OverTemperatureFailure: diagnostic-event=EventPowerPath158OverTemperatureFailure, operation-cycle=DefaultOperationCycle  # Event_Oper_Cycle_Map_Power_Path_158_Over_Temperature_Failure
  diagnostic event to debounce algorithm mapping EventDebounceMapPowerPath158OverTemperatureFailure: debounce-algorithm=time_based, diagnostic-event=EventPowerPath158OverTemperatureFailure  # EventDebounceMap_Power_Path_158_Over_Temperature_Failure
package /ZeC/DTC/DTC/Power_Path_155_Over_Temperature_Failure
  diagnostic trouble code uds Power_Path_155_Over_Temperature_Failure: dtc-props=Dtc_Props_d28be0da, uds-dtc-value=0x00579b
  diagnostic event EventPowerPath155OverTemperatureFailure: aging-allowed=true, event-kind=SWC, prestorage-freeze-frame=false  # Event_Power_Path_155_Over_Temperature_Failure
  diagnostic event to trouble code uds mapping EventDtcMapPowerPath155OverTemperatureFailure: diagnostic-event=EventPowerPath155OverTemperatureFailure, trouble-code-uds=Power_Path_155_Over_Temperature_Failure  # Event_Dtc_Map_Power_Path_155_Over_Temperature_Failure
  diagnostic event to operation cycle mapping EventOperCycleMapPowerPath155OverTemperatureFailure: diagnostic-event=EventPowerPath155OverTemperatureFailure, operation-cycle=DefaultOperationCycle  # Event_Oper_Cycle_Map_Power_Path_155_Over_Temperature_Failure
  diagnostic event to debounce algorithm mapping EventDebounceMapPowerPath155OverTemperatureFailure: debounce-algorithm=time_based, diagnostic-event=EventPowerPath155OverTemperatureFailure  # EventDebounceMap_Power_Path_155_Over_Temperature_Failure
package /ZeC/DTC/DTC/Power_Path_154_Over_Temperature_Failure
  diagnostic trouble code uds Power_Path_154_Over_Temperature_Failure: dtc-props=Dtc_Props_18a0fe94, uds-dtc-value=0x00579a
  diagnostic event EventPowerPath154OverTemperatureFailure: aging-allowed=true, event-kind=SWC, prestorage-freeze-frame=false  # Event_Power_Path_154_Over_Temperature_Failure
  diagnostic event to trouble code uds mapping EventDtcMapPowerPath154OverTemperatureFailure: diagnostic-event=EventPowerPath154OverTemperatureFailure, trouble-code-uds=Power_Path_154_Over_Temperature_Failure  # Event_Dtc_Map_Power_Path_154_Over_Temperature_Failure
  diagnostic event to operation cycle mapping EventOperCycleMapPowerPath154OverTemperatureFailure: diagnostic-event=EventPowerPath154OverTemperatureFailure, operation-cycle=DefaultOperationCycle  # Event_Oper_Cycle_Map_Power_Path_154_Over_Temperature_Failure
  diagnostic event to debounce algorithm mapping EventDebounceMapPowerPath154OverTemperatureFailure: debounce-algorithm=time_based, diagnostic-event=EventPowerPath154OverTemperatureFailure  # EventDebounceMap_Power_Path_154_Over_Temperature_Failure
package /ZeC/DTC/DTC/Power_Path_029_Open_Load_Failure
  diagnostic trouble code uds Power_Path_029_Open_Load_Failure: dtc-props=Dtc_Props_194fc082, uds-dtc-value=0x00531d
  diagnostic event EventPowerPath029OpenLoadFailure: aging-allowed=true, event-kind=SWC, prestorage-freeze-frame=false  # Event_Power_Path_029_Open_Load_Failure
  diagnostic event to trouble code uds mapping EventDtcMapPowerPath029OpenLoadFailure: diagnostic-event=EventPowerPath029OpenLoadFailure, trouble-code-uds=Power_Path_029_Open_Load_Failure  # Event_Dtc_Map_Power_Path_029_Open_Load_Failure
  diagnostic event to operation cycle mapping EventOperCycleMapPowerPath029OpenLoadFailure: diagnostic-event=EventPowerPath029OpenLoadFailure, operation-cycle=DefaultOperationCycle  # Event_Oper_Cycle_Map_Power_Path_029_Open_Load_Failure
  diagnostic event to debounce algorithm mapping EventDebounceMapPowerPath029OpenLoadFailure: debounce-algorithm=time_based, diagnostic-event=EventPowerPath029OpenLoadFailure  # EventDebounceMap_Power_Path_029_Open_Load_Failure
package /ZeC/DTC/DTC/Power_Path_028_Open_Load_Failure
  diagnostic trouble code uds Power_Path_028_Open_Load_Failure: dtc-props=Dtc_Props_1071f065, uds-dtc-value=0x00531c
  diagnostic event EventPowerPath028OpenLoadFailure: aging-allowed=true, event-kind=SWC, prestorage-freeze-frame=false  # Event_Power_Path_028_Open_Load_Failure
  diagnostic event to trouble code uds mapping EventDtcMapPowerPath028OpenLoadFailure: diagnostic-event=EventPowerPath028OpenLoadFailure, trouble-code-uds=Power_Path_028_Open_Load_Failure  # Event_Dtc_Map_Power_Path_028_Open_Load_Failure
  diagnostic event to operation cycle mapping EventOperCycleMapPowerPath028OpenLoadFailure: diagnostic-event=EventPowerPath028OpenLoadFailure, operation-cycle=DefaultOperationCycle  # Event_Oper_Cycle_Map_Power_Path_028_Open_Load_Failure
  diagnostic event to debounce algorithm mapping EventDebounceMapPowerPath028OpenLoadFailure: debounce-algorithm=time_based, diagnostic-event=EventPowerPath028OpenLoadFailure  # EventDebounceMap_Power_Path_028_Open_Load_Failure
package /ZeC/DTC/DTC/Power_Path_031_Open_Load_Failure
  diagnostic trouble code uds Power_Path_031_Open_Load_Failure: dtc-props=Dtc_Props_957dd4f6, uds-dtc-value=0x00531f
  diagnostic event EventPowerPath031OpenLoadFailure: aging-allowed=true, event-kind=SWC, prestorage-freeze-frame=false  # Event_Power_Path_031_Open_Load_Failure
  diagnostic event to trouble code uds mapping EventDtcMapPowerPath031OpenLoadFailure: diagnostic-event=EventPowerPath031OpenLoadFailure, trouble-code-uds=Power_Path_031_Open_Load_Failure  # Event_Dtc_Map_Power_Path_031_Open_Load_Failure
  diagnostic event to operation cycle mapping EventOperCycleMapPowerPath031OpenLoadFailure: diagnostic-event=EventPowerPath031OpenLoadFailure, operation-cycle=DefaultOperationCycle  # Event_Oper_Cycle_Map_Power_Path_031_Open_Load_Failure
  diagnostic event to debounce algorithm mapping EventDebounceMapPowerPath031OpenLoadFailure: debounce-algorithm=time_based, diagnostic-event=EventPowerPath031OpenLoadFailure  # EventDebounceMap_Power_Path_031_Open_Load_Failure
package /ZeC/DTC/DTC/Power_Path_030_Open_Load_Failure
  diagnostic trouble code uds Power_Path_030_Open_Load_Failure: dtc-props=Dtc_Props_5f56cab8, uds-dtc-value=0x00531e
  diagnostic event EventPowerPath030OpenLoadFailure: aging-allowed=true, event-kind=SWC, prestorage-freeze-frame=false  # Event_Power_Path_030_Open_Load_Failure
  diagnostic event to trouble code uds mapping EventDtcMapPowerPath030OpenLoadFailure: diagnostic-event=EventPowerPath030OpenLoadFailure, trouble-code-uds=Power_Path_030_Open_Load_Failure  # Event_Dtc_Map_Power_Path_030_Open_Load_Failure
  diagnostic event to operation cycle mapping EventOperCycleMapPowerPath030OpenLoadFailure: diagnostic-event=EventPowerPath030OpenLoadFailure, operation-cycle=DefaultOperationCycle  # Event_Oper_Cycle_Map_Power_Path_030_Open_Load_Failure
  diagnostic event to debounce algorithm mapping EventDebounceMapPowerPath030OpenLoadFailure: debounce-algorithm=time_based, diagnostic-event=EventPowerPath030OpenLoadFailure  # EventDebounceMap_Power_Path_030_Open_Load_Failure
package /ZeC/DTC/DTC/Power_Path_033_Open_Load_Failure
  diagnostic trouble code uds Power_Path_033_Open_Load_Failure: dtc-props=Dtc_Props_3012c7e5, uds-dtc-value=0x005321
  diagnostic event EventPowerPath033OpenLoadFailure: aging-allowed=true, event-kind=SWC, prestorage-freeze-frame=false  # Event_Power_Path_033_Open_Load_Failure
  diagnostic event to trouble code uds mapping EventDtcMapPowerPath033OpenLoadFailure: diagnostic-event=EventPowerPath033OpenLoadFailure, trouble-code-uds=Power_Path_033_Open_Load_Failure  # Event_Dtc_Map_Power_Path_033_Open_Load_Failure
  diagnostic event to operation cycle mapping EventOperCycleMapPowerPath033OpenLoadFailure: diagnostic-event=EventPowerPath033OpenLoadFailure, operation-cycle=DefaultOperationCycle  # Event_Oper_Cycle_Map_Power_Path_033_Open_Load_Failure
  diagnostic event to debounce algorithm mapping EventDebounceMapPowerPath033OpenLoadFailure: debounce-algorithm=time_based, diagnostic-event=EventPowerPath033OpenLoadFailure  # EventDebounceMap_Power_Path_033_Open_Load_Failure
package /ZeC/DTC/DTC/Power_Path_032_Open_Load_Failure
  diagnostic trouble code uds Power_Path_032_Open_Load_Failure: dtc-props=Dtc_Props_760bcddf, uds-dtc-value=0x005320
  diagnostic event EventPowerPath032OpenLoadFailure: aging-allowed=true, event-kind=SWC, prestorage-freeze-frame=false  # Event_Power_Path_032_Open_Load_Failure
  diagnostic event to trouble code uds mapping EventDtcMapPowerPath032OpenLoadFailure: diagnostic-event=EventPowerPath032OpenLoadFailure, trouble-code-uds=Power_Path_032_Open_Load_Failure  # Event_Dtc_Map_Power_Path_032_Open_Load_Failure
  diagnostic event to operation cycle mapping EventOperCycleMapPowerPath032OpenLoadFailure: diagnostic-event=EventPowerPath032OpenLoadFailure, operation-cycle=DefaultOperationCycle  # Event_Oper_Cycle_Map_Power_Path_032_Open_Load_Failure
  diagnostic event to debounce algorithm mapping EventDebounceMapPowerPath032OpenLoadFailure: debounce-algorithm=time_based, diagnostic-event=EventPowerPath032OpenLoadFailure  # EventDebounceMap_Power_Path_032_Open_Load_Failure
package /ZeC/DTC/DTC/Power_Path_035_Open_Load_Failure
  diagnostic trouble code uds Power_Path_035_Open_Load_Failure: dtc-props=Dtc_Props_bc20d391, uds-dtc-value=0x005323
  diagnostic event EventPowerPath035OpenLoadFailure: aging-allowed=true, event-kind=SWC, prestorage-freeze-frame=false  # Event_Power_Path_035_Open_Load_Failure
  diagnostic event to trouble code uds mapping EventDtcMapPowerPath035OpenLoadFailure: diagnostic-event=EventPowerPath035OpenLoadFailure, trouble-code-uds=Power_Path_035_Open_Load_Failure  # Event_Dtc_Map_Power_Path_035_Open_Load_Failure
  diagnostic event to operation cycle mapping EventOperCycleMapPowerPath035OpenLoadFailure: diagnostic-event=EventPowerPath035OpenLoadFailure, operation-cycle=DefaultOperationCycle  # Event_Oper_Cycle_Map_Power_Path_035_Open_Load_Failure
  diagnostic event to debounce algorithm mapping EventDebounceMapPowerPath035OpenLoadFailure: debounce-algorithm=time_based, diagnostic-event=EventPowerPath035OpenLoadFailure  # EventDebounceMap_Power_Path_035_Open_Load_Failure
package /ZeC/DTC/DTC/Power_Path_034_Open_Load_Failure
  diagnostic trouble code uds Power_Path_034_Open_Load_Failure: dtc-props=Dtc_Props_fa39d9ab, uds-dtc-value=0x005322
  diagnostic event EventPowerPath034OpenLoadFailure: aging-allowed=true, event-kind=SWC, prestorage-freeze-frame=false  # Event_Power_Path_034_Open_Load_Failure
  diagnostic event to trouble code uds mapping EventDtcMapPowerPath034OpenLoadFailure: diagnostic-event=EventPowerPath034OpenLoadFailure, trouble-code-uds=Power_Path_034_Open_Load_Failure  # Event_Dtc_Map_Power_Path_034_Open_Load_Failure
  diagnostic event to operation cycle mapping EventOperCycleMapPowerPath034OpenLoadFailure: diagnostic-event=EventPowerPath034OpenLoadFailure, operation-cycle=DefaultOperationCycle  # Event_Oper_Cycle_Map_Power_Path_034_Open_Load_Failure
  diagnostic event to debounce algorithm mapping EventDebounceMapPowerPath034OpenLoadFailure: debounce-algorithm=time_based, diagnostic-event=EventPowerPath034OpenLoadFailure  # EventDebounceMap_Power_Path_034_Open_Load_Failure
package /ZeC/DTC/DTC/Power_Path_138_Short_to_BAT_Failure
  diagnostic trouble code uds Power_Path_138_Short_to_BAT_Failure: dtc-props=Dtc_Props_deea3e2c, uds-dtc-value=0x00518a
  diagnostic event EventPowerPath138ShortToBATFailure: aging-allowed=true, event-kind=SWC, prestorage-freeze-frame=false  # Event_Power_Path_138_Short_to_BAT_Failure
  diagnostic event to trouble code uds mapping EventDtcMapPowerPath138ShortToBATFailure: diagnostic-event=EventPowerPath138ShortToBATFailure, trouble-code-uds=Power_Path_138_Short_to_BAT_Failure  # Event_Dtc_Map_Power_Path_138_Short_to_BAT_Failure
  diagnostic event to operation cycle mapping EventOperCycleMapPowerPath138ShortToBATFailure: diagnostic-event=EventPowerPath138ShortToBATFailure, operation-cycle=DefaultOperationCycle  # Event_Oper_Cycle_Map_Power_Path_138_Short_to_BAT_Failure
  diagnostic event to debounce algorithm mapping EventDebounceMapPowerPath138ShortToBATFailure: debounce-algorithm=time_based, diagnostic-event=EventPowerPath138ShortToBATFailure  # EventDebounceMap_Power_Path_138_Short_to_BAT_Failure
package /ZeC/DTC/DTC/Power_Path_140_Short_to_BAT_Failure
  diagnostic trouble code uds Power_Path_140_Short_to_BAT_Failure: dtc-props=Dtc_Props_52d82a58, uds-dtc-value=0x00518c
  diagnostic event EventPowerPath140ShortToBATFailure: aging-allowed=true, event-kind=SWC, prestorage-freeze-frame=false  # Event_Power_Path_140_Short_to_BAT_Failure
  diagnostic event to trouble code uds mapping EventDtcMapPowerPath140ShortToBATFailure: diagnostic-event=EventPowerPath140ShortToBATFailure, trouble-code-uds=Power_Path_140_Short_to_BAT_Failure  # Event_Dtc_Map_Power_Path_140_Short_to_BAT_Failure
  diagnostic event to operation cycle mapping EventOperCycleMapPowerPath140ShortToBATFailure: diagnostic-event=EventPowerPath140ShortToBATFailure, operation-cycle=DefaultOperationCycle  # Event_Oper_Cycle_Map_Power_Path_140_Short_to_BAT_Failure
  diagnostic event to debounce algorithm mapping EventDebounceMapPowerPath140ShortToBATFailure: debounce-algorithm=time_based, diagnostic-event=EventPowerPath140ShortToBATFailure  # EventDebounceMap_Power_Path_140_Short_to_BAT_Failure
package /ZeC/DTC/DTC/Power_Path_139_Short_to_BAT_Failure
  diagnostic trouble code uds Power_Path_139_Short_to_BAT_Failure: dtc-props=Dtc_Props_14c12062, uds-dtc-value=0x00518b
  diagnostic event EventPowerPath139ShortToBATFailure: aging-allowed=true, event-kind=SWC, prestorage-freeze-frame=false  # Event_Power_Path_139_Short_to_BAT_Failure
  diagnostic event to trouble code uds mapping EventDtcMapPowerPath139ShortToBATFailure: diagnostic-event=EventPowerPath139ShortToBATFailure, trouble-code-uds=Power_Path_139_Short_to_BAT_Failure  # Event_Dtc_Map_Power_Path_139_Short_to_BAT_Failure
  diagnostic event to operation cycle mapping EventOperCycleMapPowerPath139ShortToBATFailure: diagnostic-event=EventPowerPath139ShortToBATFailure, operation-cycle=DefaultOperationCycle  # Event_Oper_Cycle_Map_Power_Path_139_Short_to_BAT_Failure
  diagnostic event to debounce algorithm mapping EventDebounceMapPowerPath139ShortToBATFailure: debounce-algorithm=time_based, diagnostic-event=EventPowerPath139ShortToBATFailure  # EventDebounceMap_Power_Path_139_Short_to_BAT_Failure
package /ZeC/DTC/DTC/Power_Path_160_Over_Load_Failure
  diagnostic trouble code uds Power_Path_160_Over_Load_Failure: dtc-props=Dtc_Props_c92c78b3, uds-dtc-value=0x0055a0
  diagnostic event EventPowerPath160OverLoadFailure: aging-allowed=true, event-kind=SWC, prestorage-freeze-frame=false  # Event_Power_Path_160_Over_Load_Failure
  diagnostic event to trouble code uds mapping EventDtcMapPowerPath160OverLoadFailure: diagnostic-event=EventPowerPath160OverLoadFailure, trouble-code-uds=Power_Path_160_Over_Load_Failure  # Event_Dtc_Map_Power_Path_160_Over_Load_Failure
  diagnostic event to operation cycle mapping EventOperCycleMapPowerPath160OverLoadFailure: diagnostic-event=EventPowerPath160OverLoadFailure, operation-cycle=DefaultOperationCycle  # Event_Oper_Cycle_Map_Power_Path_160_Over_Load_Failure
  diagnostic event to debounce algorithm mapping EventDebounceMapPowerPath160OverLoadFailure: debounce-algorithm=time_based, diagnostic-event=EventPowerPath160OverLoadFailure  # EventDebounceMap_Power_Path_160_Over_Load_Failure
package /ZeC/DTC/DTC/Power_Path_142_Short_to_BAT_Failure
  diagnostic trouble code uds Power_Path_142_Short_to_BAT_Failure: dtc-props=Dtc_Props_1dff1085, uds-dtc-value=0x00518e
  diagnostic event EventPowerPath142ShortToBATFailure: aging-allowed=true, event-kind=SWC, prestorage-freeze-frame=false  # Event_Power_Path_142_Short_to_BAT_Failure
  diagnostic event to trouble code uds mapping EventDtcMapPowerPath142ShortToBATFailure: diagnostic-event=EventPowerPath142ShortToBATFailure, trouble-code-uds=Power_Path_142_Short_to_BAT_Failure  # Event_Dtc_Map_Power_Path_142_Short_to_BAT_Failure
  diagnostic event to operation cycle mapping EventOperCycleMapPowerPath142ShortToBATFailure: diagnostic-event=EventPowerPath142ShortToBATFailure, operation-cycle=DefaultOperationCycle  # Event_Oper_Cycle_Map_Power_Path_142_Short_to_BAT_Failure
  diagnostic event to debounce algorithm mapping EventDebounceMapPowerPath142ShortToBATFailure: debounce-algorithm=time_based, diagnostic-event=EventPowerPath142ShortToBATFailure  # EventDebounceMap_Power_Path_142_Short_to_BAT_Failure
package /ZeC/DTC/DTC/Power_Path_141_Short_to_BAT_Failure
  diagnostic trouble code uds Power_Path_141_Short_to_BAT_Failure: dtc-props=Dtc_Props_5be61abf, uds-dtc-value=0x00518d
  diagnostic event EventPowerPath141ShortToBATFailure: aging-allowed=true, event-kind=SWC, prestorage-freeze-frame=false  # Event_Power_Path_141_Short_to_BAT_Failure
  diagnostic event to trouble code uds mapping EventDtcMapPowerPath141ShortToBATFailure: diagnostic-event=EventPowerPath141ShortToBATFailure, trouble-code-uds=Power_Path_141_Short_to_BAT_Failure  # Event_Dtc_Map_Power_Path_141_Short_to_BAT_Failure
  diagnostic event to operation cycle mapping EventOperCycleMapPowerPath141ShortToBATFailure: diagnostic-event=EventPowerPath141ShortToBATFailure, operation-cycle=DefaultOperationCycle  # Event_Oper_Cycle_Map_Power_Path_141_Short_to_BAT_Failure
  diagnostic event to debounce algorithm mapping EventDebounceMapPowerPath141ShortToBATFailure: debounce-algorithm=time_based, diagnostic-event=EventPowerPath141ShortToBATFailure  # EventDebounceMap_Power_Path_141_Short_to_BAT_Failure
package /ZeC/DTC/DTC/Power_Path_143_Short_to_BAT_Failure
  diagnostic trouble code uds Power_Path_143_Short_to_BAT_Failure: dtc-props=Dtc_Props_d7d40ecb, uds-dtc-value=0x00518f
  diagnostic event EventPowerPath143ShortToBATFailure: aging-allowed=true, event-kind=SWC, prestorage-freeze-frame=false  # Event_Power_Path_143_Short_to_BAT_Failure
  diagnostic event to trouble code uds mapping EventDtcMapPowerPath143ShortToBATFailure: diagnostic-event=EventPowerPath143ShortToBATFailure, trouble-code-uds=Power_Path_143_Short_to_BAT_Failure  # Event_Dtc_Map_Power_Path_143_Short_to_BAT_Failure
  diagnostic event to operation cycle mapping EventOperCycleMapPowerPath143ShortToBATFailure: diagnostic-event=EventPowerPath143ShortToBATFailure, operation-cycle=DefaultOperationCycle  # Event_Oper_Cycle_Map_Power_Path_143_Short_to_BAT_Failure
  diagnostic event to debounce algorithm mapping EventDebounceMapPowerPath143ShortToBATFailure: debounce-algorithm=time_based, diagnostic-event=EventPowerPath143ShortToBATFailure  # EventDebounceMap_Power_Path_143_Short_to_BAT_Failure
package /ZeC/DTC/DTC/Power_Path_146_Short_to_BAT_Failure
  diagnostic trouble code uds Power_Path_146_Short_to_BAT_Failure: dtc-props=Dtc_Props_ef7484a7, uds-dtc-value=0x005192
  diagnostic event EventPowerPath146ShortToBATFailure: aging-allowed=true, event-kind=SWC, prestorage-freeze-frame=false  # Event_Power_Path_146_Short_to_BAT_Failure
  diagnostic event to trouble code uds mapping EventDtcMapPowerPath146ShortToBATFailure: diagnostic-event=EventPowerPath146ShortToBATFailure, trouble-code-uds=Power_Path_146_Short_to_BAT_Failure  # Event_Dtc_Map_Power_Path_146_Short_to_BAT_Failure
  diagnostic event to operation cycle mapping EventOperCycleMapPowerPath146ShortToBATFailure: diagnostic-event=EventPowerPath146ShortToBATFailure, operation-cycle=DefaultOperationCycle  # Event_Oper_Cycle_Map_Power_Path_146_Short_to_BAT_Failure
  diagnostic event to debounce algorithm mapping EventDebounceMapPowerPath146ShortToBATFailure: debounce-algorithm=time_based, diagnostic-event=EventPowerPath146ShortToBATFailure  # EventDebounceMap_Power_Path_146_Short_to_BAT_Failure
package /ZeC/DTC/DTC/Power_Path_145_Short_to_BAT_Failure
  diagnostic trouble code uds Power_Path_145_Short_to_BAT_Failure: dtc-props=Dtc_Props_255f9ae9, uds-dtc-value=0x005191
  diagnostic event EventPowerPath145ShortToBATFailure: aging-allowed=true, event-kind=SWC, prestorage-freeze-frame=false  # Event_Power_Path_145_Short_to_BAT_Failure
  diagnostic event to trouble code uds mapping EventDtcMapPowerPath145ShortToBATFailure: diagnostic-event=EventPowerPath145ShortToBATFailure, trouble-code-uds=Power_Path_145_Short_to_BAT_Failure  # Event_Dtc_Map_Power_Path_145_Short_to_BAT_Failure
  diagnostic event to operation cycle mapping EventOperCycleMapPowerPath145ShortToBATFailure: diagnostic-event=EventPowerPath145ShortToBATFailure, operation-cycle=DefaultOperationCycle  # Event_Oper_Cycle_Map_Power_Path_145_Short_to_BAT_Failure
  diagnostic event to debounce algorithm mapping EventDebounceMapPowerPath145ShortToBATFailure: debounce-algorithm=time_based, diagnostic-event=EventPowerPath145ShortToBATFailure  # EventDebounceMap_Power_Path_145_Short_to_BAT_Failure
package /ZeC/DTC/DTC/Power_Path_148_Short_to_BAT_Failure
  diagnostic trouble code uds Power_Path_148_Short_to_BAT_Failure: dtc-props=Dtc_Props_a053be7a, uds-dtc-value=0x005194
  diagnostic event EventPowerPath148ShortToBATFailure: aging-allowed=true, event-kind=SWC, prestorage-freeze-frame=false  # Event_Power_Path_148_Short_to_BAT_Failure
  diagnostic event to trouble code uds mapping EventDtcMapPowerPath148ShortToBATFailure: diagnostic-event=EventPowerPath148ShortToBATFailure, trouble-code-uds=Power_Path_148_Short_to_BAT_Failure  # Event_Dtc_Map_Power_Path_148_Short_to_BAT_Failure
  diagnostic event to operation cycle mapping EventOperCycleMapPowerPath148ShortToBATFailure: diagnostic-event=EventPowerPath148ShortToBATFailure, operation-cycle=DefaultOperationCycle  # Event_Oper_Cycle_Map_Power_Path_148_Short_to_BAT_Failure
  diagnostic event to debounce algorithm mapping EventDebounceMapPowerPath148ShortToBATFailure: debounce-algorithm=time_based, diagnostic-event=EventPowerPath148ShortToBATFailure  # EventDebounceMap_Power_Path_148_Short_to_BAT_Failure
package /ZeC/DTC/DTC/Power_Path_147_Short_to_BAT_Failure
  diagnostic trouble code uds Power_Path_147_Short_to_BAT_Failure: dtc-props=Dtc_Props_a96d8e9d, uds-dtc-value=0x005193
  diagnostic event EventPowerPath147ShortToBATFailure: aging-allowed=true, event-kind=SWC, prestorage-freeze-frame=false  # Event_Power_Path_147_Short_to_BAT_Failure
  diagnostic event to trouble code uds mapping EventDtcMapPowerPath147ShortToBATFailure: diagnostic-event=EventPowerPath147ShortToBATFailure, trouble-code-uds=Power_Path_147_Short_to_BAT_Failure  # Event_Dtc_Map_Power_Path_147_Short_to_BAT_Failure
  diagnostic event to operation cycle mapping EventOperCycleMapPowerPath147ShortToBATFailure: diagnostic-event=EventPowerPath147ShortToBATFailure, operation-cycle=DefaultOperationCycle  # Event_Oper_Cycle_Map_Power_Path_147_Short_to_BAT_Failure
  diagnostic event to debounce algorithm mapping EventDebounceMapPowerPath147ShortToBATFailure: debounce-algorithm=time_based, diagnostic-event=EventPowerPath147ShortToBATFailure  # EventDebounceMap_Power_Path_147_Short_to_BAT_Failure
package /ZeC/DTC/DTC/Power_Path_144_Short_to_BAT_Failure
  diagnostic trouble code uds Power_Path_144_Short_to_BAT_Failure: dtc-props=Dtc_Props_634690d3, uds-dtc-value=0x005190
  diagnostic event EventPowerPath144ShortToBATFailure: aging-allowed=true, event-kind=SWC, prestorage-freeze-frame=false  # Event_Power_Path_144_Short_to_BAT_Failure
  diagnostic event to trouble code uds mapping EventDtcMapPowerPath144ShortToBATFailure: diagnostic-event=EventPowerPath144ShortToBATFailure, trouble-code-uds=Power_Path_144_Short_to_BAT_Failure  # Event_Dtc_Map_Power_Path_144_Short_to_BAT_Failure
  diagnostic event to operation cycle mapping EventOperCycleMapPowerPath144ShortToBATFailure: diagnostic-event=EventPowerPath144ShortToBATFailure, operation-cycle=DefaultOperationCycle  # Event_Oper_Cycle_Map_Power_Path_144_Short_to_BAT_Failure
  diagnostic event to debounce algorithm mapping EventDebounceMapPowerPath144ShortToBATFailure: debounce-algorithm=time_based, diagnostic-event=EventPowerPath144ShortToBATFailure  # EventDebounceMap_Power_Path_144_Short_to_BAT_Failure
package /ZeC/DTC/DTC/Power_Path_153_Short_to_BAT_Failure
  diagnostic trouble code uds Power_Path_153_Short_to_BAT_Failure: dtc-props=Dtc_Props_7804c1fa, uds-dtc-value=0x005199
  diagnostic event EventPowerPath153ShortToBATFailure: aging-allowed=true, event-kind=SWC, prestorage-freeze-frame=false  # Event_Power_Path_153_Short_to_BAT_Failure
  diagnostic event to trouble code uds mapping EventDtcMapPowerPath153ShortToBATFailure: diagnostic-event=EventPowerPath153ShortToBATFailure, trouble-code-uds=Power_Path_153_Short_to_BAT_Failure  # Event_Dtc_Map_Power_Path_153_Short_to_BAT_Failure
  diagnostic event to operation cycle mapping EventOperCycleMapPowerPath153ShortToBATFailure: diagnostic-event=EventPowerPath153ShortToBATFailure, operation-cycle=DefaultOperationCycle  # Event_Oper_Cycle_Map_Power_Path_153_Short_to_BAT_Failure
  diagnostic event to debounce algorithm mapping EventDebounceMapPowerPath153ShortToBATFailure: debounce-algorithm=time_based, diagnostic-event=EventPowerPath153ShortToBATFailure  # EventDebounceMap_Power_Path_153_Short_to_BAT_Failure
package /ZeC/DTC/DTC/Power_Path_150_Short_to_BAT_Failure
  diagnostic trouble code uds Power_Path_150_Short_to_BAT_Failure: dtc-props=Dtc_Props_2c61aa0e, uds-dtc-value=0x005196
  diagnostic event EventPowerPath150ShortToBATFailure: aging-allowed=true, event-kind=SWC, prestorage-freeze-frame=false  # Event_Power_Path_150_Short_to_BAT_Failure
  diagnostic event to trouble code uds mapping EventDtcMapPowerPath150ShortToBATFailure: diagnostic-event=EventPowerPath150ShortToBATFailure, trouble-code-uds=Power_Path_150_Short_to_BAT_Failure  # Event_Dtc_Map_Power_Path_150_Short_to_BAT_Failure
  diagnostic event to operation cycle mapping EventOperCycleMapPowerPath150ShortToBATFailure: diagnostic-event=EventPowerPath150ShortToBATFailure, operation-cycle=DefaultOperationCycle  # Event_Oper_Cycle_Map_Power_Path_150_Short_to_BAT_Failure
  diagnostic event to debounce algorithm mapping EventDebounceMapPowerPath150ShortToBATFailure: debounce-algorithm=time_based, diagnostic-event=EventPowerPath150ShortToBATFailure  # EventDebounceMap_Power_Path_150_Short_to_BAT_Failure
package /ZeC/DTC/DTC/Power_Path_149_Short_to_BAT_Failure
  diagnostic trouble code uds Power_Path_149_Short_to_BAT_Failure: dtc-props=Dtc_Props_e64ab440, uds-dtc-value=0x005195
  diagnostic event EventPowerPath149ShortToBATFailure: aging-allowed=true, event-kind=SWC, prestorage-freeze-frame=false  # Event_Power_Path_149_Short_to_BAT_Failure
  diagnostic event to trouble code uds mapping EventDtcMapPowerPath149ShortToBATFailure: diagnostic-event=EventPowerPath149ShortToBATFailure, trouble-code-uds=Power_Path_149_Short_to_BAT_Failure  # Event_Dtc_Map_Power_Path_149_Short_to_BAT_Failure
  diagnostic event to operation cycle mapping EventOperCycleMapPowerPath149ShortToBATFailure: diagnostic-event=EventPowerPath149ShortToBATFailure, operation-cycle=DefaultOperationCycle  # Event_Oper_Cycle_Map_Power_Path_149_Short_to_BAT_Failure
  diagnostic event to debounce algorithm mapping EventDebounceMapPowerPath149ShortToBATFailure: debounce-algorithm=time_based, diagnostic-event=EventPowerPath149ShortToBATFailure  # EventDebounceMap_Power_Path_149_Short_to_BAT_Failure
package /ZeC/DTC/DTC/Power_Path_152_Short_to_BAT_Failure
  diagnostic trouble code uds Power_Path_152_Short_to_BAT_Failure: dtc-props=Dtc_Props_3e1dcbc0, uds-dtc-value=0x005198
  diagnostic event EventPowerPath152ShortToBATFailure: aging-allowed=true, event-kind=SWC, prestorage-freeze-frame=false  # Event_Power_Path_152_Short_to_BAT_Failure
  diagnostic event to trouble code uds mapping EventDtcMapPowerPath152ShortToBATFailure: diagnostic-event=EventPowerPath152ShortToBATFailure, trouble-code-uds=Power_Path_152_Short_to_BAT_Failure  # Event_Dtc_Map_Power_Path_152_Short_to_BAT_Failure
  diagnostic event to operation cycle mapping EventOperCycleMapPowerPath152ShortToBATFailure: diagnostic-event=EventPowerPath152ShortToBATFailure, operation-cycle=DefaultOperationCycle  # Event_Oper_Cycle_Map_Power_Path_152_Short_to_BAT_Failure
  diagnostic event to debounce algorithm mapping EventDebounceMapPowerPath152ShortToBATFailure: debounce-algorithm=time_based, diagnostic-event=EventPowerPath152ShortToBATFailure  # EventDebounceMap_Power_Path_152_Short_to_BAT_Failure
package /ZeC/DTC/DTC/Power_Path_151_Short_to_BAT_Failure
  diagnostic trouble code uds Power_Path_151_Short_to_BAT_Failure: dtc-props=Dtc_Props_6a78a034, uds-dtc-value=0x005197
  diagnostic event EventPowerPath151ShortToBATFailure: aging-allowed=true, event-kind=SWC, prestorage-freeze-frame=false  # Event_Power_Path_151_Short_to_BAT_Failure
  diagnostic event to trouble code uds mapping EventDtcMapPowerPath151ShortToBATFailure: diagnostic-event=EventPowerPath151ShortToBATFailure, trouble-code-uds=Power_Path_151_Short_to_BAT_Failure  # Event_Dtc_Map_Power_Path_151_Short_to_BAT_Failure
  diagnostic event to operation cycle mapping EventOperCycleMapPowerPath151ShortToBATFailure: diagnostic-event=EventPowerPath151ShortToBATFailure, operation-cycle=DefaultOperationCycle  # Event_Oper_Cycle_Map_Power_Path_151_Short_to_BAT_Failure
  diagnostic event to debounce algorithm mapping EventDebounceMapPowerPath151ShortToBATFailure: debounce-algorithm=time_based, diagnostic-event=EventPowerPath151ShortToBATFailure  # EventDebounceMap_Power_Path_151_Short_to_BAT_Failure
package /ZeC/DTC/DTC/Power_Path_123_Short_to_BAT_Failure
  diagnostic trouble code uds Power_Path_123_Short_to_BAT_Failure: dtc-props=Dtc_Props_ae45730c, uds-dtc-value=0x00517b
  diagnostic event EventPowerPath123ShortToBATFailure: aging-allowed=true, event-kind=SWC, prestorage-freeze-frame=false  # Event_Power_Path_123_Short_to_BAT_Failure
  diagnostic event to trouble code uds mapping EventDtcMapPowerPath123ShortToBATFailure: diagnostic-event=EventPowerPath123ShortToBATFailure, trouble-code-uds=Power_Path_123_Short_to_BAT_Failure  # Event_Dtc_Map_Power_Path_123_Short_to_BAT_Failure
  diagnostic event to operation cycle mapping EventOperCycleMapPowerPath123ShortToBATFailure: diagnostic-event=EventPowerPath123ShortToBATFailure, operation-cycle=DefaultOperationCycle  # Event_Oper_Cycle_Map_Power_Path_123_Short_to_BAT_Failure
  diagnostic event to debounce algorithm mapping EventDebounceMapPowerPath123ShortToBATFailure: debounce-algorithm=time_based, diagnostic-event=EventPowerPath123ShortToBATFailure  # EventDebounceMap_Power_Path_123_Short_to_BAT_Failure
package /ZeC/DTC/DTC/Power_Path_122_Short_to_BAT_Failure
  diagnostic trouble code uds Power_Path_122_Short_to_BAT_Failure: dtc-props=Dtc_Props_646e6d42, uds-dtc-value=0x00517a
  diagnostic event EventPowerPath122ShortToBATFailure: aging-allowed=true, event-kind=SWC, prestorage-freeze-frame=false  # Event_Power_Path_122_Short_to_BAT_Failure
  diagnostic event to trouble code uds mapping EventDtcMapPowerPath122ShortToBATFailure: diagnostic-event=EventPowerPath122ShortToBATFailure, trouble-code-uds=Power_Path_122_Short_to_BAT_Failure  # Event_Dtc_Map_Power_Path_122_Short_to_BAT_Failure
  diagnostic event to operation cycle mapping EventOperCycleMapPowerPath122ShortToBATFailure: diagnostic-event=EventPowerPath122ShortToBATFailure, operation-cycle=DefaultOperationCycle  # Event_Oper_Cycle_Map_Power_Path_122_Short_to_BAT_Failure
  diagnostic event to debounce algorithm mapping EventDebounceMapPowerPath122ShortToBATFailure: debounce-algorithm=time_based, diagnostic-event=EventPowerPath122ShortToBATFailure  # EventDebounceMap_Power_Path_122_Short_to_BAT_Failure
package /ZeC/DTC/DTC/LIN_16_Slave_7_Defect
  diagnostic trouble code uds LIN_16_Slave_7_Defect: dtc-props=Dtc_Props_358996c7, uds-dtc-value=0x031008  # LIN 16 Slave 7_Defect
  diagnostic event EventLIN16Slave7Defect: aging-allowed=true, event-kind=SWC, prestorage-freeze-frame=false  # Event_LIN 16 Slave 7_Defect
  diagnostic event to trouble code uds mapping EventDtcMapLIN16Slave7Defect: diagnostic-event=EventLIN16Slave7Defect, trouble-code-uds=LIN_16_Slave_7_Defect  # Event_Dtc_Map_LIN 16 Slave 7_Defect
  diagnostic event to operation cycle mapping EventOperCycleMapLIN16Slave7Defect: diagnostic-event=EventLIN16Slave7Defect, operation-cycle=DefaultOperationCycle  # Event_Oper_Cycle_Map_LIN 16 Slave 7_Defect
  diagnostic event to debounce algorithm mapping EventDebounceMapLIN16Slave7Defect: debounce-algorithm=counter_based, diagnostic-event=EventLIN16Slave7Defect  # EventDebounceMap_LIN 16 Slave 7_Defect
package /ZeC/DTC/DTC/LIN_16_Slave_7_NoCommunication
  diagnostic trouble code uds LIN_16_Slave_7_NoCommunication: dtc-props=Dtc_Props_358996c7, uds-dtc-value=0x031009  # LIN 16 Slave 7_NoCommunication
  diagnostic event EventLIN16Slave7NoCommunication: aging-allowed=true, event-kind=SWC, prestorage-freeze-frame=false  # Event_LIN 16 Slave 7_NoCommunication
  diagnostic event to trouble code uds mapping EventDtcMapLIN16Slave7NoCommunication: diagnostic-event=EventLIN16Slave7NoCommunication, trouble-code-uds=LIN_16_Slave_7_NoCommunication  # Event_Dtc_Map_LIN 16 Slave 7_NoCommunication
  diagnostic event to operation cycle mapping EventOperCycleMapLIN16Slave7NoCommunication: diagnostic-event=EventLIN16Slave7NoCommunication, operation-cycle=DefaultOperationCycle  # Event_Oper_Cycle_Map_LIN 16 Slave 7_NoCommunication
  diagnostic event to debounce algorithm mapping EventDebounceMapLIN16Slave7NoCommunication: debounce-algorithm=counter_based, diagnostic-event=EventLIN16Slave7NoCommunication  # EventDebounceMap_LIN 16 Slave 7_NoCommunication
package /ZeC/DTC/DTC/LIN_16_Slave_6_Defect
  diagnostic trouble code uds LIN_16_Slave_6_Defect: dtc-props=Dtc_Props_358996c7, uds-dtc-value=0x031006  # LIN 16 Slave 6_Defect
  diagnostic event EventLIN16Slave6Defect: aging-allowed=true, event-kind=SWC, prestorage-freeze-frame=false  # Event_LIN 16 Slave 6_Defect
  diagnostic event to trouble code uds mapping EventDtcMapLIN16Slave6Defect: diagnostic-event=EventLIN16Slave6Defect, trouble-code-uds=LIN_16_Slave_6_Defect  # Event_Dtc_Map_LIN 16 Slave 6_Defect
  diagnostic event to operation cycle mapping EventOperCycleMapLIN16Slave6Defect: diagnostic-event=EventLIN16Slave6Defect, operation-cycle=DefaultOperationCycle  # Event_Oper_Cycle_Map_LIN 16 Slave 6_Defect
  diagnostic event to debounce algorithm mapping EventDebounceMapLIN16Slave6Defect: debounce-algorithm=counter_based, diagnostic-event=EventLIN16Slave6Defect  # EventDebounceMap_LIN 16 Slave 6_Defect
package /ZeC/DTC/DTC/LIN_16_Slave_6_NoCommunication
  diagnostic trouble code uds LIN_16_Slave_6_NoCommunication: dtc-props=Dtc_Props_358996c7, uds-dtc-value=0x031007  # LIN 16 Slave 6_NoCommunication
  diagnostic event EventLIN16Slave6NoCommunication: aging-allowed=true, event-kind=SWC, prestorage-freeze-frame=false  # Event_LIN 16 Slave 6_NoCommunication
  diagnostic event to trouble code uds mapping EventDtcMapLIN16Slave6NoCommunication: diagnostic-event=EventLIN16Slave6NoCommunication, trouble-code-uds=LIN_16_Slave_6_NoCommunication  # Event_Dtc_Map_LIN 16 Slave 6_NoCommunication
  diagnostic event to operation cycle mapping EventOperCycleMapLIN16Slave6NoCommunication: diagnostic-event=EventLIN16Slave6NoCommunication, operation-cycle=DefaultOperationCycle  # Event_Oper_Cycle_Map_LIN 16 Slave 6_NoCommunication
  diagnostic event to debounce algorithm mapping EventDebounceMapLIN16Slave6NoCommunication: debounce-algorithm=counter_based, diagnostic-event=EventLIN16Slave6NoCommunication  # EventDebounceMap_LIN 16 Slave 6_NoCommunication
package /ZeC/DTC/DTC/LIN_16_Slave_5_Defect
  diagnostic trouble code uds LIN_16_Slave_5_Defect: dtc-props=Dtc_Props_358996c7, uds-dtc-value=0x031004  # LIN 16 Slave 5_Defect
  diagnostic event EventLIN16Slave5Defect: aging-allowed=true, event-kind=SWC, prestorage-freeze-frame=false  # Event_LIN 16 Slave 5_Defect
  diagnostic event to trouble code uds mapping EventDtcMapLIN16Slave5Defect: diagnostic-event=EventLIN16Slave5Defect, trouble-code-uds=LIN_16_Slave_5_Defect  # Event_Dtc_Map_LIN 16 Slave 5_Defect
  diagnostic event to operation cycle mapping EventOperCycleMapLIN16Slave5Defect: diagnostic-event=EventLIN16Slave5Defect, operation-cycle=DefaultOperationCycle  # Event_Oper_Cycle_Map_LIN 16 Slave 5_Defect
  diagnostic event to debounce algorithm mapping EventDebounceMapLIN16Slave5Defect: debounce-algorithm=counter_based, diagnostic-event=EventLIN16Slave5Defect  # EventDebounceMap_LIN 16 Slave 5_Defect
package /ZeC/DTC/DTC/LIN_16_Slave_5_NoCommunication
  diagnostic trouble code uds LIN_16_Slave_5_NoCommunication: dtc-props=Dtc_Props_358996c7, uds-dtc-value=0x031005  # LIN 16 Slave 5_NoCommunication
  diagnostic event EventLIN16Slave5NoCommunication: aging-allowed=true, event-kind=SWC, prestorage-freeze-frame=false  # Event_LIN 16 Slave 5_NoCommunication
  diagnostic event to trouble code uds mapping EventDtcMapLIN16Slave5NoCommunication: diagnostic-event=EventLIN16Slave5NoCommunication, trouble-code-uds=LIN_16_Slave_5_NoCommunication  # Event_Dtc_Map_LIN 16 Slave 5_NoCommunication
  diagnostic event to operation cycle mapping EventOperCycleMapLIN16Slave5NoCommunication: diagnostic-event=EventLIN16Slave5NoCommunication, operation-cycle=DefaultOperationCycle  # Event_Oper_Cycle_Map_LIN 16 Slave 5_NoCommunication
  diagnostic event to debounce algorithm mapping EventDebounceMapLIN16Slave5NoCommunication: debounce-algorithm=counter_based, diagnostic-event=EventLIN16Slave5NoCommunication  # EventDebounceMap_LIN 16 Slave 5_NoCommunication
package /ZeC/DTC/DTC/LIN_16_Slave_4_Defect
  diagnostic trouble code uds LIN_16_Slave_4_Defect: dtc-props=Dtc_Props_358996c7, uds-dtc-value=0x031002  # LIN 16 Slave 4_Defect
  diagnostic event EventLIN16Slave4Defect: aging-allowed=true, event-kind=SWC, prestorage-freeze-frame=false  # Event_LIN 16 Slave 4_Defect
  diagnostic event to trouble code uds mapping EventDtcMapLIN16Slave4Defect: diagnostic-event=EventLIN16Slave4Defect, trouble-code-uds=LIN_16_Slave_4_Defect  # Event_Dtc_Map_LIN 16 Slave 4_Defect
  diagnostic event to operation cycle mapping EventOperCycleMapLIN16Slave4Defect: diagnostic-event=EventLIN16Slave4Defect, operation-cycle=DefaultOperationCycle  # Event_Oper_Cycle_Map_LIN 16 Slave 4_Defect
  diagnostic event to debounce algorithm mapping EventDebounceMapLIN16Slave4Defect: debounce-algorithm=counter_based, diagnostic-event=EventLIN16Slave4Defect  # EventDebounceMap_LIN 16 Slave 4_Defect
package /ZeC/DTC/DTC/LIN_16_Slave_4_NoCommunication
  diagnostic trouble code uds LIN_16_Slave_4_NoCommunication: dtc-props=Dtc_Props_358996c7, uds-dtc-value=0x031003  # LIN 16 Slave 4_NoCommunication
  diagnostic event EventLIN16Slave4NoCommunication: aging-allowed=true, event-kind=SWC, prestorage-freeze-frame=false  # Event_LIN 16 Slave 4_NoCommunication
  diagnostic event to trouble code uds mapping EventDtcMapLIN16Slave4NoCommunication: diagnostic-event=EventLIN16Slave4NoCommunication, trouble-code-uds=LIN_16_Slave_4_NoCommunication  # Event_Dtc_Map_LIN 16 Slave 4_NoCommunication
  diagnostic event to operation cycle mapping EventOperCycleMapLIN16Slave4NoCommunication: diagnostic-event=EventLIN16Slave4NoCommunication, operation-cycle=DefaultOperationCycle  # Event_Oper_Cycle_Map_LIN 16 Slave 4_NoCommunication
  diagnostic event to debounce algorithm mapping EventDebounceMapLIN16Slave4NoCommunication: debounce-algorithm=counter_based, diagnostic-event=EventLIN16Slave4NoCommunication  # EventDebounceMap_LIN 16 Slave 4_NoCommunication
package /ZeC/DTC/DTC/Power_Path_125_Short_to_BAT_Failure
  diagnostic trouble code uds Power_Path_125_Short_to_BAT_Failure: dtc-props=Dtc_Props_e16249d1, uds-dtc-value=0x00517d
  diagnostic event EventPowerPath125ShortToBATFailure: aging-allowed=true, event-kind=SWC, prestorage-freeze-frame=false  # Event_Power_Path_125_Short_to_BAT_Failure
  diagnostic event to trouble code uds mapping EventDtcMapPowerPath125ShortToBATFailure: diagnostic-event=EventPowerPath125ShortToBATFailure, trouble-code-uds=Power_Path_125_Short_to_BAT_Failure  # Event_Dtc_Map_Power_Path_125_Short_to_BAT_Failure
  diagnostic event to operation cycle mapping EventOperCycleMapPowerPath125ShortToBATFailure: diagnostic-event=EventPowerPath125ShortToBATFailure, operation-cycle=DefaultOperationCycle  # Event_Oper_Cycle_Map_Power_Path_125_Short_to_BAT_Failure
  diagnostic event to debounce algorithm mapping EventDebounceMapPowerPath125ShortToBATFailure: debounce-algorithm=time_based, diagnostic-event=EventPowerPath125ShortToBATFailure  # EventDebounceMap_Power_Path_125_Short_to_BAT_Failure
package /ZeC/DTC/DTC/LIN_16_Slave_3_NoCommunication
  diagnostic trouble code uds LIN_16_Slave_3_NoCommunication: dtc-props=Dtc_Props_358996c7, uds-dtc-value=0x031001  # LIN 16 Slave 3_NoCommunication
  diagnostic event EventLIN16Slave3NoCommunication: aging-allowed=true, event-kind=SWC, prestorage-freeze-frame=false  # Event_LIN 16 Slave 3_NoCommunication
  diagnostic event to trouble code uds mapping EventDtcMapLIN16Slave3NoCommunication: diagnostic-event=EventLIN16Slave3NoCommunication, trouble-code-uds=LIN_16_Slave_3_NoCommunication  # Event_Dtc_Map_LIN 16 Slave 3_NoCommunication
  diagnostic event to operation cycle mapping EventOperCycleMapLIN16Slave3NoCommunication: diagnostic-event=EventLIN16Slave3NoCommunication, operation-cycle=DefaultOperationCycle  # Event_Oper_Cycle_Map_LIN 16 Slave 3_NoCommunication
  diagnostic event to debounce algorithm mapping EventDebounceMapLIN16Slave3NoCommunication: debounce-algorithm=counter_based, diagnostic-event=EventLIN16Slave3NoCommunication  # EventDebounceMap_LIN 16 Slave 3_NoCommunication
package /ZeC/DTC/DTC/Power_Path_124_Short_to_BAT_Failure
  diagnostic trouble code uds Power_Path_124_Short_to_BAT_Failure: dtc-props=Dtc_Props_e85c7936, uds-dtc-value=0x00517c
  diagnostic event EventPowerPath124ShortToBATFailure: aging-allowed=true, event-kind=SWC, prestorage-freeze-frame=false  # Event_Power_Path_124_Short_to_BAT_Failure
  diagnostic event to trouble code uds mapping EventDtcMapPowerPath124ShortToBATFailure: diagnostic-event=EventPowerPath124ShortToBATFailure, trouble-code-uds=Power_Path_124_Short_to_BAT_Failure  # Event_Dtc_Map_Power_Path_124_Short_to_BAT_Failure
  diagnostic event to operation cycle mapping EventOperCycleMapPowerPath124ShortToBATFailure: diagnostic-event=EventPowerPath124ShortToBATFailure, operation-cycle=DefaultOperationCycle  # Event_Oper_Cycle_Map_Power_Path_124_Short_to_BAT_Failure
  diagnostic event to debounce algorithm mapping EventDebounceMapPowerPath124ShortToBATFailure: debounce-algorithm=time_based, diagnostic-event=EventPowerPath124ShortToBATFailure  # EventDebounceMap_Power_Path_124_Short_to_BAT_Failure
package /ZeC/DTC/DTC/Power_Path_127_Short_to_BAT_Failure
  diagnostic trouble code uds Power_Path_127_Short_to_BAT_Failure: dtc-props=Dtc_Props_6d505da5, uds-dtc-value=0x00517f
  diagnostic event EventPowerPath127ShortToBATFailure: aging-allowed=true, event-kind=SWC, prestorage-freeze-frame=false  # Event_Power_Path_127_Short_to_BAT_Failure
  diagnostic event to trouble code uds mapping EventDtcMapPowerPath127ShortToBATFailure: diagnostic-event=EventPowerPath127ShortToBATFailure, trouble-code-uds=Power_Path_127_Short_to_BAT_Failure  # Event_Dtc_Map_Power_Path_127_Short_to_BAT_Failure
  diagnostic event to operation cycle mapping EventOperCycleMapPowerPath127ShortToBATFailure: diagnostic-event=EventPowerPath127ShortToBATFailure, operation-cycle=DefaultOperationCycle  # Event_Oper_Cycle_Map_Power_Path_127_Short_to_BAT_Failure
  diagnostic event to debounce algorithm mapping EventDebounceMapPowerPath127ShortToBATFailure: debounce-algorithm=time_based, diagnostic-event=EventPowerPath127ShortToBATFailure  # EventDebounceMap_Power_Path_127_Short_to_BAT_Failure
package /ZeC/DTC/DTC/Power_Path_126_Short_to_BAT_Failure
  diagnostic trouble code uds Power_Path_126_Short_to_BAT_Failure: dtc-props=Dtc_Props_a77b43eb, uds-dtc-value=0x00517e
  diagnostic event EventPowerPath126ShortToBATFailure: aging-allowed=true, event-kind=SWC, prestorage-freeze-frame=false  # Event_Power_Path_126_Short_to_BAT_Failure
  diagnostic event to trouble code uds mapping EventDtcMapPowerPath126ShortToBATFailure: diagnostic-event=EventPowerPath126ShortToBATFailure, trouble-code-uds=Power_Path_126_Short_to_BAT_Failure  # Event_Dtc_Map_Power_Path_126_Short_to_BAT_Failure
  diagnostic event to operation cycle mapping EventOperCycleMapPowerPath126ShortToBATFailure: diagnostic-event=EventPowerPath126ShortToBATFailure, operation-cycle=DefaultOperationCycle  # Event_Oper_Cycle_Map_Power_Path_126_Short_to_BAT_Failure
  diagnostic event to debounce algorithm mapping EventDebounceMapPowerPath126ShortToBATFailure: debounce-algorithm=time_based, diagnostic-event=EventPowerPath126ShortToBATFailure  # EventDebounceMap_Power_Path_126_Short_to_BAT_Failure
package /ZeC/DTC/DTC/Power_Path_129_Short_to_BAT_Failure
  diagnostic trouble code uds Power_Path_129_Short_to_BAT_Failure: dtc-props=Dtc_Props_e3155a51, uds-dtc-value=0x005181
  diagnostic event EventPowerPath129ShortToBATFailure: aging-allowed=true, event-kind=SWC, prestorage-freeze-frame=false  # Event_Power_Path_129_Short_to_BAT_Failure
  diagnostic event to trouble code uds mapping EventDtcMapPowerPath129ShortToBATFailure: diagnostic-event=EventPowerPath129ShortToBATFailure, trouble-code-uds=Power_Path_129_Short_to_BAT_Failure  # Event_Dtc_Map_Power_Path_129_Short_to_BAT_Failure
  diagnostic event to operation cycle mapping EventOperCycleMapPowerPath129ShortToBATFailure: diagnostic-event=EventPowerPath129ShortToBATFailure, operation-cycle=DefaultOperationCycle  # Event_Oper_Cycle_Map_Power_Path_129_Short_to_BAT_Failure
  diagnostic event to debounce algorithm mapping EventDebounceMapPowerPath129ShortToBATFailure: debounce-algorithm=time_based, diagnostic-event=EventPowerPath129ShortToBATFailure  # EventDebounceMap_Power_Path_129_Short_to_BAT_Failure
package /ZeC/DTC/DTC/Power_Path_128_Short_to_BAT_Failure
  diagnostic trouble code uds Power_Path_128_Short_to_BAT_Failure: dtc-props=Dtc_Props_a50c506b, uds-dtc-value=0x005180
  diagnostic event EventPowerPath128ShortToBATFailure: aging-allowed=true, event-kind=SWC, prestorage-freeze-frame=false  # Event_Power_Path_128_Short_to_BAT_Failure
  diagnostic event to trouble code uds mapping EventDtcMapPowerPath128ShortToBATFailure: diagnostic-event=EventPowerPath128ShortToBATFailure, trouble-code-uds=Power_Path_128_Short_to_BAT_Failure  # Event_Dtc_Map_Power_Path_128_Short_to_BAT_Failure
  diagnostic event to operation cycle mapping EventOperCycleMapPowerPath128ShortToBATFailure: diagnostic-event=EventPowerPath128ShortToBATFailure, operation-cycle=DefaultOperationCycle  # Event_Oper_Cycle_Map_Power_Path_128_Short_to_BAT_Failure
  diagnostic event to debounce algorithm mapping EventDebounceMapPowerPath128ShortToBATFailure: debounce-algorithm=time_based, diagnostic-event=EventPowerPath128ShortToBATFailure  # EventDebounceMap_Power_Path_128_Short_to_BAT_Failure
package /ZeC/DTC/DTC/Power_Path_131_Short_to_BAT_Failure
  diagnostic trouble code uds Power_Path_131_Short_to_BAT_Failure: dtc-props=Dtc_Props_6f274e25, uds-dtc-value=0x005183
  diagnostic event EventPowerPath131ShortToBATFailure: aging-allowed=true, event-kind=SWC, prestorage-freeze-frame=false  # Event_Power_Path_131_Short_to_BAT_Failure
  diagnostic event to trouble code uds mapping EventDtcMapPowerPath131ShortToBATFailure: diagnostic-event=EventPowerPath131ShortToBATFailure, trouble-code-uds=Power_Path_131_Short_to_BAT_Failure  # Event_Dtc_Map_Power_Path_131_Short_to_BAT_Failure
  diagnostic event to operation cycle mapping EventOperCycleMapPowerPath131ShortToBATFailure: diagnostic-event=EventPowerPath131ShortToBATFailure, operation-cycle=DefaultOperationCycle  # Event_Oper_Cycle_Map_Power_Path_131_Short_to_BAT_Failure
  diagnostic event to debounce algorithm mapping EventDebounceMapPowerPath131ShortToBATFailure: debounce-algorithm=time_based, diagnostic-event=EventPowerPath131ShortToBATFailure  # EventDebounceMap_Power_Path_131_Short_to_BAT_Failure
package /ZeC/DTC/DTC/Power_Path_130_Short_to_BAT_Failure
  diagnostic trouble code uds Power_Path_130_Short_to_BAT_Failure: dtc-props=Dtc_Props_293e441f, uds-dtc-value=0x005182
  diagnostic event EventPowerPath130ShortToBATFailure: aging-allowed=true, event-kind=SWC, prestorage-freeze-frame=false  # Event_Power_Path_130_Short_to_BAT_Failure
  diagnostic event to trouble code uds mapping EventDtcMapPowerPath130ShortToBATFailure: diagnostic-event=EventPowerPath130ShortToBATFailure, trouble-code-uds=Power_Path_130_Short_to_BAT_Failure  # Event_Dtc_Map_Power_Path_130_Short_to_BAT_Failure
  diagnostic event to operation cycle mapping EventOperCycleMapPowerPath130ShortToBATFailure: diagnostic-event=EventPowerPath130ShortToBATFailure, operation-cycle=DefaultOperationCycle  # Event_Oper_Cycle_Map_Power_Path_130_Short_to_BAT_Failure
  diagnostic event to debounce algorithm mapping EventDebounceMapPowerPath130ShortToBATFailure: debounce-algorithm=time_based, diagnostic-event=EventPowerPath130ShortToBATFailure  # EventDebounceMap_Power_Path_130_Short_to_BAT_Failure
package /ZeC/DTC/DTC/LIN_16_Slave_1_NoCommunication
  diagnostic trouble code uds LIN_16_Slave_1_NoCommunication: dtc-props=Dtc_Props_358996c7, uds-dtc-value=0x03100f  # LIN 16 Slave 1_NoCommunication
  diagnostic event EventLIN16Slave1NoCommunication: aging-allowed=true, event-kind=SWC, prestorage-freeze-frame=false  # Event_LIN 16 Slave 1_NoCommunication
  diagnostic event to trouble code uds mapping EventDtcMapLIN16Slave1NoCommunication: diagnostic-event=EventLIN16Slave1NoCommunication, trouble-code-uds=LIN_16_Slave_1_NoCommunication  # Event_Dtc_Map_LIN 16 Slave 1_NoCommunication
  diagnostic event to operation cycle mapping EventOperCycleMapLIN16Slave1NoCommunication: diagnostic-event=EventLIN16Slave1NoCommunication, operation-cycle=DefaultOperationCycle  # Event_Oper_Cycle_Map_LIN 16 Slave 1_NoCommunication
  diagnostic event to debounce algorithm mapping EventDebounceMapLIN16Slave1NoCommunication: debounce-algorithm=counter_based, diagnostic-event=EventLIN16Slave1NoCommunication  # EventDebounceMap_LIN 16 Slave 1_NoCommunication
package /ZeC/DTC/DTC/LIN_16_Slave_9_NoCommunication
  diagnostic trouble code uds LIN_16_Slave_9_NoCommunication: dtc-props=Dtc_Props_358996c7, uds-dtc-value=0x03100d  # LIN 16 Slave 9_NoCommunication
  diagnostic event EventLIN16Slave9NoCommunication: aging-allowed=true, event-kind=SWC, prestorage-freeze-frame=false  # Event_LIN 16 Slave 9_NoCommunication
  diagnostic event to trouble code uds mapping EventDtcMapLIN16Slave9NoCommunication: diagnostic-event=EventLIN16Slave9NoCommunication, trouble-code-uds=LIN_16_Slave_9_NoCommunication  # Event_Dtc_Map_LIN 16 Slave 9_NoCommunication
  diagnostic event to operation cycle mapping EventOperCycleMapLIN16Slave9NoCommunication: diagnostic-event=EventLIN16Slave9NoCommunication, operation-cycle=DefaultOperationCycle  # Event_Oper_Cycle_Map_LIN 16 Slave 9_NoCommunication
  diagnostic event to debounce algorithm mapping EventDebounceMapLIN16Slave9NoCommunication: debounce-algorithm=counter_based, diagnostic-event=EventLIN16Slave9NoCommunication  # EventDebounceMap_LIN 16 Slave 9_NoCommunication
package /ZeC/DTC/DTC/Power_Path_137_Short_to_BAT_Failure
  diagnostic trouble code uds Power_Path_137_Short_to_BAT_Failure: dtc-props=Dtc_Props_be4e0142, uds-dtc-value=0x005189
  diagnostic event EventPowerPath137ShortToBATFailure: aging-allowed=true, event-kind=SWC, prestorage-freeze-frame=false  # Event_Power_Path_137_Short_to_BAT_Failure
  diagnostic event to trouble code uds mapping EventDtcMapPowerPath137ShortToBATFailure: diagnostic-event=EventPowerPath137ShortToBATFailure, trouble-code-uds=Power_Path_137_Short_to_BAT_Failure  # Event_Dtc_Map_Power_Path_137_Short_to_BAT_Failure
  diagnostic event to operation cycle mapping EventOperCycleMapPowerPath137ShortToBATFailure: diagnostic-event=EventPowerPath137ShortToBATFailure, operation-cycle=DefaultOperationCycle  # Event_Oper_Cycle_Map_Power_Path_137_Short_to_BAT_Failure
  diagnostic event to debounce algorithm mapping EventDebounceMapPowerPath137ShortToBATFailure: debounce-algorithm=time_based, diagnostic-event=EventPowerPath137ShortToBATFailure  # EventDebounceMap_Power_Path_137_Short_to_BAT_Failure
package /ZeC/DTC/DTC/LIN_16_Slave_1_Defect
  diagnostic trouble code uds LIN_16_Slave_1_Defect: dtc-props=Dtc_Props_358996c7, uds-dtc-value=0x03100e  # LIN 16 Slave 1_Defect
  diagnostic event EventLIN16Slave1Defect: aging-allowed=true, event-kind=SWC, prestorage-freeze-frame=false  # Event_LIN 16 Slave 1_Defect
  diagnostic event to trouble code uds mapping EventDtcMapLIN16Slave1Defect: diagnostic-event=EventLIN16Slave1Defect, trouble-code-uds=LIN_16_Slave_1_Defect  # Event_Dtc_Map_LIN 16 Slave 1_Defect
  diagnostic event to operation cycle mapping EventOperCycleMapLIN16Slave1Defect: diagnostic-event=EventLIN16Slave1Defect, operation-cycle=DefaultOperationCycle  # Event_Oper_Cycle_Map_LIN 16 Slave 1_Defect
  diagnostic event to debounce algorithm mapping EventDebounceMapLIN16Slave1Defect: debounce-algorithm=counter_based, diagnostic-event=EventLIN16Slave1Defect  # EventDebounceMap_LIN 16 Slave 1_Defect
package /ZeC/DTC/DTC/Power_Path_136_Short_to_BAT_Failure
  diagnostic trouble code uds Power_Path_136_Short_to_BAT_Failure: dtc-props=Dtc_Props_f8570b78, uds-dtc-value=0x005188
  diagnostic event EventPowerPath136ShortToBATFailure: aging-allowed=true, event-kind=SWC, prestorage-freeze-frame=false  # Event_Power_Path_136_Short_to_BAT_Failure
  diagnostic event to trouble code uds mapping EventDtcMapPowerPath136ShortToBATFailure: diagnostic-event=EventPowerPath136ShortToBATFailure, trouble-code-uds=Power_Path_136_Short_to_BAT_Failure  # Event_Dtc_Map_Power_Path_136_Short_to_BAT_Failure
  diagnostic event to operation cycle mapping EventOperCycleMapPowerPath136ShortToBATFailure: diagnostic-event=EventPowerPath136ShortToBATFailure, operation-cycle=DefaultOperationCycle  # Event_Oper_Cycle_Map_Power_Path_136_Short_to_BAT_Failure
  diagnostic event to debounce algorithm mapping EventDebounceMapPowerPath136ShortToBATFailure: debounce-algorithm=time_based, diagnostic-event=EventPowerPath136ShortToBATFailure  # EventDebounceMap_Power_Path_136_Short_to_BAT_Failure
package /ZeC/DTC/DTC/LIN_16_Slave_8_NoCommunication
  diagnostic trouble code uds LIN_16_Slave_8_NoCommunication: dtc-props=Dtc_Props_358996c7, uds-dtc-value=0x03100b  # LIN 16 Slave 8_NoCommunication
  diagnostic event EventLIN16Slave8NoCommunication: aging-allowed=true, event-kind=SWC, prestorage-freeze-frame=false  # Event_LIN 16 Slave 8_NoCommunication
  diagnostic event to trouble code uds mapping EventDtcMapLIN16Slave8NoCommunication: diagnostic-event=EventLIN16Slave8NoCommunication, trouble-code-uds=LIN_16_Slave_8_NoCommunication  # Event_Dtc_Map_LIN 16 Slave 8_NoCommunication
  diagnostic event to operation cycle mapping EventOperCycleMapLIN16Slave8NoCommunication: diagnostic-event=EventLIN16Slave8NoCommunication, operation-cycle=DefaultOperationCycle  # Event_Oper_Cycle_Map_LIN 16 Slave 8_NoCommunication
  diagnostic event to debounce algorithm mapping EventDebounceMapLIN16Slave8NoCommunication: debounce-algorithm=counter_based, diagnostic-event=EventLIN16Slave8NoCommunication  # EventDebounceMap_LIN 16 Slave 8_NoCommunication
package /ZeC/DTC/DTC/LIN_16_Slave_9_Defect
  diagnostic trouble code uds LIN_16_Slave_9_Defect: dtc-props=Dtc_Props_358996c7, uds-dtc-value=0x03100c  # LIN 16 Slave 9_Defect
  diagnostic event EventLIN16Slave9Defect: aging-allowed=true, event-kind=SWC, prestorage-freeze-frame=false  # Event_LIN 16 Slave 9_Defect
  diagnostic event to trouble code uds mapping EventDtcMapLIN16Slave9Defect: diagnostic-event=EventLIN16Slave9Defect, trouble-code-uds=LIN_16_Slave_9_Defect  # Event_Dtc_Map_LIN 16 Slave 9_Defect
  diagnostic event to operation cycle mapping EventOperCycleMapLIN16Slave9Defect: diagnostic-event=EventLIN16Slave9Defect, operation-cycle=DefaultOperationCycle  # Event_Oper_Cycle_Map_LIN 16 Slave 9_Defect
  diagnostic event to debounce algorithm mapping EventDebounceMapLIN16Slave9Defect: debounce-algorithm=counter_based, diagnostic-event=EventLIN16Slave9Defect  # EventDebounceMap_LIN 16 Slave 9_Defect
package /ZeC/DTC/DTC/Power_Path_133_Short_to_BAT_Failure
  diagnostic trouble code uds Power_Path_133_Short_to_BAT_Failure: dtc-props=Dtc_Props_200074f8, uds-dtc-value=0x005185
  diagnostic event EventPowerPath133ShortToBATFailure: aging-allowed=true, event-kind=SWC, prestorage-freeze-frame=false  # Event_Power_Path_133_Short_to_BAT_Failure
  diagnostic event to trouble code uds mapping EventDtcMapPowerPath133ShortToBATFailure: diagnostic-event=EventPowerPath133ShortToBATFailure, trouble-code-uds=Power_Path_133_Short_to_BAT_Failure  # Event_Dtc_Map_Power_Path_133_Short_to_BAT_Failure
  diagnostic event to operation cycle mapping EventOperCycleMapPowerPath133ShortToBATFailure: diagnostic-event=EventPowerPath133ShortToBATFailure, operation-cycle=DefaultOperationCycle  # Event_Oper_Cycle_Map_Power_Path_133_Short_to_BAT_Failure
  diagnostic event to debounce algorithm mapping EventDebounceMapPowerPath133ShortToBATFailure: debounce-algorithm=time_based, diagnostic-event=EventPowerPath133ShortToBATFailure  # EventDebounceMap_Power_Path_133_Short_to_BAT_Failure
package /ZeC/DTC/DTC/LIN_16_Slave_8_Defect
  diagnostic trouble code uds LIN_16_Slave_8_Defect: dtc-props=Dtc_Props_358996c7, uds-dtc-value=0x03100a  # LIN 16 Slave 8_Defect
  diagnostic event EventLIN16Slave8Defect: aging-allowed=true, event-kind=SWC, prestorage-freeze-frame=false  # Event_LIN 16 Slave 8_Defect
  diagnostic event to trouble code uds mapping EventDtcMapLIN16Slave8Defect: diagnostic-event=EventLIN16Slave8Defect, trouble-code-uds=LIN_16_Slave_8_Defect  # Event_Dtc_Map_LIN 16 Slave 8_Defect
  diagnostic event to operation cycle mapping EventOperCycleMapLIN16Slave8Defect: diagnostic-event=EventLIN16Slave8Defect, operation-cycle=DefaultOperationCycle  # Event_Oper_Cycle_Map_LIN 16 Slave 8_Defect
  diagnostic event to debounce algorithm mapping EventDebounceMapLIN16Slave8Defect: debounce-algorithm=counter_based, diagnostic-event=EventLIN16Slave8Defect  # EventDebounceMap_LIN 16 Slave 8_Defect
package /ZeC/DTC/DTC/Power_Path_132_Short_to_BAT_Failure
  diagnostic trouble code uds Power_Path_132_Short_to_BAT_Failure: dtc-props=Dtc_Props_66197ec2, uds-dtc-value=0x005184
  diagnostic event EventPowerPath132ShortToBATFailure: aging-allowed=true, event-kind=SWC, prestorage-freeze-frame=false  # Event_Power_Path_132_Short_to_BAT_Failure
  diagnostic event to trouble code uds mapping EventDtcMapPowerPath132ShortToBATFailure: diagnostic-event=EventPowerPath132ShortToBATFailure, trouble-code-uds=Power_Path_132_Short_to_BAT_Failure  # Event_Dtc_Map_Power_Path_132_Short_to_BAT_Failure
  diagnostic event to operation cycle mapping EventOperCycleMapPowerPath132ShortToBATFailure: diagnostic-event=EventPowerPath132ShortToBATFailure, operation-cycle=DefaultOperationCycle  # Event_Oper_Cycle_Map_Power_Path_132_Short_to_BAT_Failure
  diagnostic event to debounce algorithm mapping EventDebounceMapPowerPath132ShortToBATFailure: debounce-algorithm=time_based, diagnostic-event=EventPowerPath132ShortToBATFailure  # EventDebounceMap_Power_Path_132_Short_to_BAT_Failure
package /ZeC/DTC/DTC/Power_Path_135_Short_to_BAT_Failure
  diagnostic trouble code uds Power_Path_135_Short_to_BAT_Failure: dtc-props=Dtc_Props_ac32608c, uds-dtc-value=0x005187
  diagnostic event EventPowerPath135ShortToBATFailure: aging-allowed=true, event-kind=SWC, prestorage-freeze-frame=false  # Event_Power_Path_135_Short_to_BAT_Failure
  diagnostic event to trouble code uds mapping EventDtcMapPowerPath135ShortToBATFailure: diagnostic-event=EventPowerPath135ShortToBATFailure, trouble-code-uds=Power_Path_135_Short_to_BAT_Failure  # Event_Dtc_Map_Power_Path_135_Short_to_BAT_Failure
  diagnostic event to operation cycle mapping EventOperCycleMapPowerPath135ShortToBATFailure: diagnostic-event=EventPowerPath135ShortToBATFailure, operation-cycle=DefaultOperationCycle  # Event_Oper_Cycle_Map_Power_Path_135_Short_to_BAT_Failure
  diagnostic event to debounce algorithm mapping EventDebounceMapPowerPath135ShortToBATFailure: debounce-algorithm=time_based, diagnostic-event=EventPowerPath135ShortToBATFailure  # EventDebounceMap_Power_Path_135_Short_to_BAT_Failure
package /ZeC/DTC/DTC/Power_Path_134_Short_to_BAT_Failure
  diagnostic trouble code uds Power_Path_134_Short_to_BAT_Failure: dtc-props=Dtc_Props_ea2b6ab6, uds-dtc-value=0x005186
  diagnostic event EventPowerPath134ShortToBATFailure: aging-allowed=true, event-kind=SWC, prestorage-freeze-frame=false  # Event_Power_Path_134_Short_to_BAT_Failure
  diagnostic event to trouble code uds mapping EventDtcMapPowerPath134ShortToBATFailure: diagnostic-event=EventPowerPath134ShortToBATFailure, trouble-code-uds=Power_Path_134_Short_to_BAT_Failure  # Event_Dtc_Map_Power_Path_134_Short_to_BAT_Failure
  diagnostic event to operation cycle mapping EventOperCycleMapPowerPath134ShortToBATFailure: diagnostic-event=EventPowerPath134ShortToBATFailure, operation-cycle=DefaultOperationCycle  # Event_Oper_Cycle_Map_Power_Path_134_Short_to_BAT_Failure
  diagnostic event to debounce algorithm mapping EventDebounceMapPowerPath134ShortToBATFailure: debounce-algorithm=time_based, diagnostic-event=EventPowerPath134ShortToBATFailure  # EventDebounceMap_Power_Path_134_Short_to_BAT_Failure
package /ZeC/DTC/DTC/CAN_03_ECU_4_No_Communication
  diagnostic trouble code uds CAN_03_ECU_4_No_Communication: dtc-props=Dtc_Props_14158306, uds-dtc-value=0x032308
  diagnostic event EventCAN03ECU4NoCommunication: aging-allowed=true, event-kind=SWC, prestorage-freeze-frame=false  # Event_CAN_03_ECU_4_No_Communication
  diagnostic event to trouble code uds mapping EventDtcMapCAN03ECU4NoCommunication: diagnostic-event=EventCAN03ECU4NoCommunication, trouble-code-uds=CAN_03_ECU_4_No_Communication  # Event_Dtc_Map_CAN_03_ECU_4_No_Communication
  diagnostic event to operation cycle mapping EventOperCycleMapCAN03ECU4NoCommunication: diagnostic-event=EventCAN03ECU4NoCommunication, operation-cycle=DefaultOperationCycle  # Event_Oper_Cycle_Map_CAN_03_ECU_4_No_Communication
  diagnostic event to debounce algorithm mapping EventDebounceMapCAN03ECU4NoCommunication: debounce-algorithm=counter_based, diagnostic-event=EventCAN03ECU4NoCommunication  # EventDebounceMap_CAN_03_ECU_4_No_Communication
package /ZeC/DTC/DTC/CAN_03_ECU_5_No_Communication
  diagnostic trouble code uds CAN_03_ECU_5_No_Communication: dtc-props=Dtc_Props_14158306, uds-dtc-value=0x032309
  diagnostic event EventCAN03ECU5NoCommunication: aging-allowed=true, event-kind=SWC, prestorage-freeze-frame=false  # Event_CAN_03_ECU_5_No_Communication
  diagnostic event to trouble code uds mapping EventDtcMapCAN03ECU5NoCommunication: diagnostic-event=EventCAN03ECU5NoCommunication, trouble-code-uds=CAN_03_ECU_5_No_Communication  # Event_Dtc_Map_CAN_03_ECU_5_No_Communication
  diagnostic event to operation cycle mapping EventOperCycleMapCAN03ECU5NoCommunication: diagnostic-event=EventCAN03ECU5NoCommunication, operation-cycle=DefaultOperationCycle  # Event_Oper_Cycle_Map_CAN_03_ECU_5_No_Communication
  diagnostic event to debounce algorithm mapping EventDebounceMapCAN03ECU5NoCommunication: debounce-algorithm=counter_based, diagnostic-event=EventCAN03ECU5NoCommunication  # EventDebounceMap_CAN_03_ECU_5_No_Communication
package /ZeC/DTC/DTC/CAN_03_ECU_2_No_Communication
  diagnostic trouble code uds CAN_03_ECU_2_No_Communication: dtc-props=Dtc_Props_14158306, uds-dtc-value=0x032306
  diagnostic event EventCAN03ECU2NoCommunication: aging-allowed=true, event-kind=SWC, prestorage-freeze-frame=false  # Event_CAN_03_ECU_2_No_Communication
  diagnostic event to trouble code uds mapping EventDtcMapCAN03ECU2NoCommunication: diagnostic-event=EventCAN03ECU2NoCommunication, trouble-code-uds=CAN_03_ECU_2_No_Communication  # Event_Dtc_Map_CAN_03_ECU_2_No_Communication
  diagnostic event to operation cycle mapping EventOperCycleMapCAN03ECU2NoCommunication: diagnostic-event=EventCAN03ECU2NoCommunication, operation-cycle=DefaultOperationCycle  # Event_Oper_Cycle_Map_CAN_03_ECU_2_No_Communication
  diagnostic event to debounce algorithm mapping EventDebounceMapCAN03ECU2NoCommunication: debounce-algorithm=counter_based, diagnostic-event=EventCAN03ECU2NoCommunication  # EventDebounceMap_CAN_03_ECU_2_No_Communication
package /ZeC/DTC/DTC/CAN_03_ECU_3_No_Communication
  diagnostic trouble code uds CAN_03_ECU_3_No_Communication: dtc-props=Dtc_Props_14158306, uds-dtc-value=0x032307
  diagnostic event EventCAN03ECU3NoCommunication: aging-allowed=true, event-kind=SWC, prestorage-freeze-frame=false  # Event_CAN_03_ECU_3_No_Communication
  diagnostic event to trouble code uds mapping EventDtcMapCAN03ECU3NoCommunication: diagnostic-event=EventCAN03ECU3NoCommunication, trouble-code-uds=CAN_03_ECU_3_No_Communication  # Event_Dtc_Map_CAN_03_ECU_3_No_Communication
  diagnostic event to operation cycle mapping EventOperCycleMapCAN03ECU3NoCommunication: diagnostic-event=EventCAN03ECU3NoCommunication, operation-cycle=DefaultOperationCycle  # Event_Oper_Cycle_Map_CAN_03_ECU_3_No_Communication
  diagnostic event to debounce algorithm mapping EventDebounceMapCAN03ECU3NoCommunication: debounce-algorithm=counter_based, diagnostic-event=EventCAN03ECU3NoCommunication  # EventDebounceMap_CAN_03_ECU_3_No_Communication
package /ZeC/DTC/DTC/DB_CANFD_03_Error_Received_Value
  diagnostic trouble code uds DB_CANFD_03_Error_Received_Value: dtc-props=Dtc_Props_b618fb9, uds-dtc-value=0x032304
  diagnostic event EventDBCANFD03ErrorReceivedValue: aging-allowed=true, event-kind=SWC, prestorage-freeze-frame=false  # Event_DB_CANFD_03_Error_Received_Value
  diagnostic event to trouble code uds mapping EventDtcMapDBCANFD03ErrorReceivedValue: diagnostic-event=EventDBCANFD03ErrorReceivedValue, trouble-code-uds=DB_CANFD_03_Error_Received_Value  # Event_Dtc_Map_DB_CANFD_03_Error_Received_Value
  diagnostic event to operation cycle mapping EventOperCycleMapDBCANFD03ErrorReceivedValue: diagnostic-event=EventDBCANFD03ErrorReceivedValue, operation-cycle=DefaultOperationCycle  # Event_Oper_Cycle_Map_DB_CANFD_03_Error_Received_Value
  diagnostic event to debounce algorithm mapping EventDebounceMapDBCANFD03ErrorReceivedValue: debounce-algorithm=counter_based, diagnostic-event=EventDBCANFD03ErrorReceivedValue  # EventDebounceMap_DB_CANFD_03_Error_Received_Value
package /ZeC/DTC/DTC/CAN_03_ECU_1_No_Communication
  diagnostic trouble code uds CAN_03_ECU_1_No_Communication: dtc-props=Dtc_Props_14158306, uds-dtc-value=0x032305
  diagnostic event EventCAN03ECU1NoCommunication: aging-allowed=true, event-kind=SWC, prestorage-freeze-frame=false  # Event_CAN_03_ECU_1_No_Communication
  diagnostic event to trouble code uds mapping EventDtcMapCAN03ECU1NoCommunication: diagnostic-event=EventCAN03ECU1NoCommunication, trouble-code-uds=CAN_03_ECU_1_No_Communication  # Event_Dtc_Map_CAN_03_ECU_1_No_Communication
  diagnostic event to operation cycle mapping EventOperCycleMapCAN03ECU1NoCommunication: diagnostic-event=EventCAN03ECU1NoCommunication, operation-cycle=DefaultOperationCycle  # Event_Oper_Cycle_Map_CAN_03_ECU_1_No_Communication
  diagnostic event to debounce algorithm mapping EventDebounceMapCAN03ECU1NoCommunication: debounce-algorithm=counter_based, diagnostic-event=EventCAN03ECU1NoCommunication  # EventDebounceMap_CAN_03_ECU_1_No_Communication
package /ZeC/DTC/DTC/DB_CANFD_03_No_Communication
  diagnostic trouble code uds DB_CANFD_03_No_Communication: dtc-props=Dtc_Props_14158306, uds-dtc-value=0x032302
  diagnostic event EventDBCANFD03NoCommunication: aging-allowed=true, event-kind=SWC, prestorage-freeze-frame=false  # Event_DB_CANFD_03_No_Communication
  diagnostic event to trouble code uds mapping EventDtcMapDBCANFD03NoCommunication: diagnostic-event=EventDBCANFD03NoCommunication, trouble-code-uds=DB_CANFD_03_No_Communication  # Event_Dtc_Map_DB_CANFD_03_No_Communication
  diagnostic event to operation cycle mapping EventOperCycleMapDBCANFD03NoCommunication: diagnostic-event=EventDBCANFD03NoCommunication, operation-cycle=DefaultOperationCycle  # Event_Oper_Cycle_Map_DB_CANFD_03_No_Communication
  diagnostic event to debounce algorithm mapping EventDebounceMapDBCANFD03NoCommunication: debounce-algorithm=counter_based, diagnostic-event=EventDBCANFD03NoCommunication  # EventDebounceMap_DB_CANFD_03_No_Communication
package /ZeC/DTC/DTC/DB_CANFD_03_Single_Wire_Mode
  diagnostic trouble code uds DB_CANFD_03_Single_Wire_Mode: dtc-props=Dtc_Props_14158306, uds-dtc-value=0x032303
  diagnostic event EventDBCANFD03SingleWireMode: aging-allowed=true, event-kind=SWC, prestorage-freeze-frame=false  # Event_DB_CANFD_03_Single_Wire_Mode
  diagnostic event to trouble code uds mapping EventDtcMapDBCANFD03SingleWireMode: diagnostic-event=EventDBCANFD03SingleWireMode, trouble-code-uds=DB_CANFD_03_Single_Wire_Mode  # Event_Dtc_Map_DB_CANFD_03_Single_Wire_Mode
  diagnostic event to operation cycle mapping EventOperCycleMapDBCANFD03SingleWireMode: diagnostic-event=EventDBCANFD03SingleWireMode, operation-cycle=DefaultOperationCycle  # Event_Oper_Cycle_Map_DB_CANFD_03_Single_Wire_Mode
  diagnostic event to debounce algorithm mapping EventDebounceMapDBCANFD03SingleWireMode: debounce-algorithm=counter_based, diagnostic-event=EventDBCANFD03SingleWireMode  # EventDebounceMap_DB_CANFD_03_Single_Wire_Mode
package /ZeC/DTC/DTC/DB_CANFD_03_Defect
  diagnostic trouble code uds DB_CANFD_03_Defect: dtc-props=Dtc_Props_14158306, uds-dtc-value=0x032301
  diagnostic event EventDBCANFD03Defect: aging-allowed=true, event-kind=SWC, prestorage-freeze-frame=false  # Event_DB_CANFD_03_Defect
  diagnostic event to trouble code uds mapping EventDtcMapDBCANFD03Defect: diagnostic-event=EventDBCANFD03Defect, trouble-code-uds=DB_CANFD_03_Defect  # Event_Dtc_Map_DB_CANFD_03_Defect
  diagnostic event to operation cycle mapping EventOperCycleMapDBCANFD03Defect: diagnostic-event=EventDBCANFD03Defect, operation-cycle=DefaultOperationCycle  # Event_Oper_Cycle_Map_DB_CANFD_03_Defect
  diagnostic event to debounce algorithm mapping EventDebounceMapDBCANFD03Defect: debounce-algorithm=counter_based, diagnostic-event=EventDBCANFD03Defect  # EventDebounceMap_DB_CANFD_03_Defect
package /ZeC/DTC/DTC/LIN_1_Local_Databus_Electrical_Failure
  diagnostic trouble code uds LIN_1_Local_Databus_Electrical_Failure: dtc-props=Dtc_Props_358996c7, uds-dtc-value=0x030121  # LIN 1 Local_Databus_Electrical_Failure
  diagnostic event EventLIN1LocalDatabusElectricalFailure: aging-allowed=true, event-kind=SWC, prestorage-freeze-frame=false  # Event_LIN 1 Local_Databus_Electrical_Failure
  diagnostic event to trouble code uds mapping EventDtcMapLIN1LocalDatabusElectricalFailure: diagnostic-event=EventLIN1LocalDatabusElectricalFailure, trouble-code-uds=LIN_1_Local_Databus_Electrical_Failure  # Event_Dtc_Map_LIN 1 Local_Databus_Electrical_Failure
  diagnostic event to operation cycle mapping EventOperCycleMapLIN1LocalDatabusElectricalFailure: diagnostic-event=EventLIN1LocalDatabusElectricalFailure, operation-cycle=DefaultOperationCycle  # Event_Oper_Cycle_Map_LIN 1 Local_Databus_Electrical_Failure
  diagnostic event to debounce algorithm mapping EventDebounceMapLIN1LocalDatabusElectricalFailure: debounce-algorithm=counter_based, diagnostic-event=EventLIN1LocalDatabusElectricalFailure  # EventDebounceMap_LIN 1 Local_Databus_Electrical_Failure
package /ZeC/DTC/DTC/LIN_1_Databus_No_Comm
  diagnostic trouble code uds LIN_1_Databus_No_Comm: dtc-props=Dtc_Props_358996c7, uds-dtc-value=0x030120  # LIN 1 Databus_No_Comm
  diagnostic event EventLIN1DatabusNoComm: aging-allowed=true, event-kind=SWC, prestorage-freeze-frame=false  # Event_LIN 1 Databus_No_Comm
  diagnostic event to trouble code uds mapping EventDtcMapLIN1DatabusNoComm: diagnostic-event=EventLIN1DatabusNoComm, trouble-code-uds=LIN_1_Databus_No_Comm  # Event_Dtc_Map_LIN 1 Databus_No_Comm
  diagnostic event to operation cycle mapping EventOperCycleMapLIN1DatabusNoComm: diagnostic-event=EventLIN1DatabusNoComm, operation-cycle=DefaultOperationCycle  # Event_Oper_Cycle_Map_LIN 1 Databus_No_Comm
  diagnostic event to debounce algorithm mapping EventDebounceMapLIN1DatabusNoComm: debounce-algorithm=counter_based, diagnostic-event=EventLIN1DatabusNoComm  # EventDebounceMap_LIN 1 Databus_No_Comm
package /ZeC/DTC/DTC/Power_Path_155_Short_to_BAT_Failure
  diagnostic trouble code uds Power_Path_155_Short_to_BAT_Failure: dtc-props=Dtc_Props_d28be0da, uds-dtc-value=0x00519b
  diagnostic event EventPowerPath155ShortToBATFailure: aging-allowed=true, event-kind=SWC, prestorage-freeze-frame=false  # Event_Power_Path_155_Short_to_BAT_Failure
  diagnostic event to trouble code uds mapping EventDtcMapPowerPath155ShortToBATFailure: diagnostic-event=EventPowerPath155ShortToBATFailure, trouble-code-uds=Power_Path_155_Short_to_BAT_Failure  # Event_Dtc_Map_Power_Path_155_Short_to_BAT_Failure
  diagnostic event to operation cycle mapping EventOperCycleMapPowerPath155ShortToBATFailure: diagnostic-event=EventPowerPath155ShortToBATFailure, operation-cycle=DefaultOperationCycle  # Event_Oper_Cycle_Map_Power_Path_155_Short_to_BAT_Failure
  diagnostic event to debounce algorithm mapping EventDebounceMapPowerPath155ShortToBATFailure: debounce-algorithm=time_based, diagnostic-event=EventPowerPath155ShortToBATFailure  # EventDebounceMap_Power_Path_155_Short_to_BAT_Failure
package /ZeC/DTC/DTC/Power_Path_154_Short_to_BAT_Failure
  diagnostic trouble code uds Power_Path_154_Short_to_BAT_Failure: dtc-props=Dtc_Props_18a0fe94, uds-dtc-value=0x00519a
  diagnostic event EventPowerPath154ShortToBATFailure: aging-allowed=true, event-kind=SWC, prestorage-freeze-frame=false  # Event_Power_Path_154_Short_to_BAT_Failure
  diagnostic event to trouble code uds mapping EventDtcMapPowerPath154ShortToBATFailure: diagnostic-event=EventPowerPath154ShortToBATFailure, trouble-code-uds=Power_Path_154_Short_to_BAT_Failure  # Event_Dtc_Map_Power_Path_154_Short_to_BAT_Failure
  diagnostic event to operation cycle mapping EventOperCycleMapPowerPath154ShortToBATFailure: diagnostic-event=EventPowerPath154ShortToBATFailure, operation-cycle=DefaultOperationCycle  # Event_Oper_Cycle_Map_Power_Path_154_Short_to_BAT_Failure
  diagnostic event to debounce algorithm mapping EventDebounceMapPowerPath154ShortToBATFailure: debounce-algorithm=time_based, diagnostic-event=EventPowerPath154ShortToBATFailure  # EventDebounceMap_Power_Path_154_Short_to_BAT_Failure
package /ZeC/DTC/DTC/Power_Path_157_Short_to_BAT_Failure
  diagnostic trouble code uds Power_Path_157_Short_to_BAT_Failure: dtc-props=Dtc_Props_9dacda07, uds-dtc-value=0x00519d
  diagnostic event EventPowerPath157ShortToBATFailure: aging-allowed=true, event-kind=SWC, prestorage-freeze-frame=false  # Event_Power_Path_157_Short_to_BAT_Failure
  diagnostic event to trouble code uds mapping EventDtcMapPowerPath157ShortToBATFailure: diagnostic-event=EventPowerPath157ShortToBATFailure, trouble-code-uds=Power_Path_157_Short_to_BAT_Failure  # Event_Dtc_Map_Power_Path_157_Short_to_BAT_Failure
  diagnostic event to operation cycle mapping EventOperCycleMapPowerPath157ShortToBATFailure: diagnostic-event=EventPowerPath157ShortToBATFailure, operation-cycle=DefaultOperationCycle  # Event_Oper_Cycle_Map_Power_Path_157_Short_to_BAT_Failure
  diagnostic event to debounce algorithm mapping EventDebounceMapPowerPath157ShortToBATFailure: debounce-algorithm=time_based, diagnostic-event=EventPowerPath157ShortToBATFailure  # EventDebounceMap_Power_Path_157_Short_to_BAT_Failure
package /ZeC/DTC/DTC/Power_Path_156_Short_to_BAT_Failure
  diagnostic trouble code uds Power_Path_156_Short_to_BAT_Failure: dtc-props=Dtc_Props_9492eae0, uds-dtc-value=0x00519c
  diagnostic event EventPowerPath156ShortToBATFailure: aging-allowed=true, event-kind=SWC, prestorage-freeze-frame=false  # Event_Power_Path_156_Short_to_BAT_Failure
  diagnostic event to trouble code uds mapping EventDtcMapPowerPath156ShortToBATFailure: diagnostic-event=EventPowerPath156ShortToBATFailure, trouble-code-uds=Power_Path_156_Short_to_BAT_Failure  # Event_Dtc_Map_Power_Path_156_Short_to_BAT_Failure
  diagnostic event to operation cycle mapping EventOperCycleMapPowerPath156ShortToBATFailure: diagnostic-event=EventPowerPath156ShortToBATFailure, operation-cycle=DefaultOperationCycle  # Event_Oper_Cycle_Map_Power_Path_156_Short_to_BAT_Failure
  diagnostic event to debounce algorithm mapping EventDebounceMapPowerPath156ShortToBATFailure: debounce-algorithm=time_based, diagnostic-event=EventPowerPath156ShortToBATFailure  # EventDebounceMap_Power_Path_156_Short_to_BAT_Failure
package /ZeC/DTC/DTC/Power_Path_159_Short_to_BAT_Failure
  diagnostic trouble code uds Power_Path_159_Short_to_BAT_Failure: dtc-props=Dtc_Props_119ece73, uds-dtc-value=0x00519f
  diagnostic event EventPowerPath159ShortToBATFailure: aging-allowed=true, event-kind=SWC, prestorage-freeze-frame=false  # Event_Power_Path_159_Short_to_BAT_Failure
  diagnostic event to trouble code uds mapping EventDtcMapPowerPath159ShortToBATFailure: diagnostic-event=EventPowerPath159ShortToBATFailure, trouble-code-uds=Power_Path_159_Short_to_BAT_Failure  # Event_Dtc_Map_Power_Path_159_Short_to_BAT_Failure
  diagnostic event to operation cycle mapping EventOperCycleMapPowerPath159ShortToBATFailure: diagnostic-event=EventPowerPath159ShortToBATFailure, operation-cycle=DefaultOperationCycle  # Event_Oper_Cycle_Map_Power_Path_159_Short_to_BAT_Failure
  diagnostic event to debounce algorithm mapping EventDebounceMapPowerPath159ShortToBATFailure: debounce-algorithm=time_based, diagnostic-event=EventPowerPath159ShortToBATFailure  # EventDebounceMap_Power_Path_159_Short_to_BAT_Failure
package /ZeC/DTC/DTC/Power_Path_158_Short_to_BAT_Failure
  diagnostic trouble code uds Power_Path_158_Short_to_BAT_Failure: dtc-props=Dtc_Props_dbb5d03d, uds-dtc-value=0x00519e
  diagnostic event EventPowerPath158ShortToBATFailure: aging-allowed=true, event-kind=SWC, prestorage-freeze-frame=false  # Event_Power_Path_158_Short_to_BAT_Failure
  diagnostic event to trouble code uds mapping EventDtcMapPowerPath158ShortToBATFailure: diagnostic-event=EventPowerPath158ShortToBATFailure, trouble-code-uds=Power_Path_158_Short_to_BAT_Failure  # Event_Dtc_Map_Power_Path_158_Short_to_BAT_Failure
  diagnostic event to operation cycle mapping EventOperCycleMapPowerPath158ShortToBATFailure: diagnostic-event=EventPowerPath158ShortToBATFailure, operation-cycle=DefaultOperationCycle  # Event_Oper_Cycle_Map_Power_Path_158_Short_to_BAT_Failure
  diagnostic event to debounce algorithm mapping EventDebounceMapPowerPath158ShortToBATFailure: debounce-algorithm=time_based, diagnostic-event=EventPowerPath158ShortToBATFailure  # EventDebounceMap_Power_Path_158_Short_to_BAT_Failure
package /ZeC/DTC/DTC/CAN_03_ECU_6_No_Communication
  diagnostic trouble code uds CAN_03_ECU_6_No_Communication: dtc-props=Dtc_Props_14158306, uds-dtc-value=0x032310
  diagnostic event EventCAN03ECU6NoCommunication: aging-allowed=true, event-kind=SWC, prestorage-freeze-frame=false  # Event_CAN_03_ECU_6_No_Communication
  diagnostic event to trouble code uds mapping EventDtcMapCAN03ECU6NoCommunication: diagnostic-event=EventCAN03ECU6NoCommunication, trouble-code-uds=CAN_03_ECU_6_No_Communication  # Event_Dtc_Map_CAN_03_ECU_6_No_Communication
  diagnostic event to operation cycle mapping EventOperCycleMapCAN03ECU6NoCommunication: diagnostic-event=EventCAN03ECU6NoCommunication, operation-cycle=DefaultOperationCycle  # Event_Oper_Cycle_Map_CAN_03_ECU_6_No_Communication
  diagnostic event to debounce algorithm mapping EventDebounceMapCAN03ECU6NoCommunication: debounce-algorithm=counter_based, diagnostic-event=EventCAN03ECU6NoCommunication  # EventDebounceMap_CAN_03_ECU_6_No_Communication
package /ZeC/DTC/DTC/LIN_1_Slave_13_Defekt
  diagnostic trouble code uds LIN_1_Slave_13_Defekt: dtc-props=Dtc_Props_358996c7, uds-dtc-value=0x030109  # LIN 1 Slave 13_Defekt
  diagnostic event EventLIN1Slave13Defekt: aging-allowed=true, event-kind=SWC, prestorage-freeze-frame=false  # Event_LIN 1 Slave 13_Defekt
  diagnostic event to trouble code uds mapping EventDtcMapLIN1Slave13Defekt: diagnostic-event=EventLIN1Slave13Defekt, trouble-code-uds=LIN_1_Slave_13_Defekt  # Event_Dtc_Map_LIN 1 Slave 13_Defekt
  diagnostic event to operation cycle mapping EventOperCycleMapLIN1Slave13Defekt: diagnostic-event=EventLIN1Slave13Defekt, operation-cycle=DefaultOperationCycle  # Event_Oper_Cycle_Map_LIN 1 Slave 13_Defekt
  diagnostic event to debounce algorithm mapping EventDebounceMapLIN1Slave13Defekt: debounce-algorithm=counter_based, diagnostic-event=EventLIN1Slave13Defekt  # EventDebounceMap_LIN 1 Slave 13_Defekt
package /ZeC/DTC/DTC/LIN_1_Slave_12_NoCommunication
  diagnostic trouble code uds LIN_1_Slave_12_NoCommunication: dtc-props=Dtc_Props_358996c7, uds-dtc-value=0x030108  # LIN 1 Slave 12_NoCommunication
  diagnostic event EventLIN1Slave12NoCommunication: aging-allowed=true, event-kind=SWC, prestorage-freeze-frame=false  # Event_LIN 1 Slave 12_NoCommunication
  diagnostic event to trouble code uds mapping EventDtcMapLIN1Slave12NoCommunication: diagnostic-event=EventLIN1Slave12NoCommunication, trouble-code-uds=LIN_1_Slave_12_NoCommunication  # Event_Dtc_Map_LIN 1 Slave 12_NoCommunication
  diagnostic event to operation cycle mapping EventOperCycleMapLIN1Slave12NoCommunication: diagnostic-event=EventLIN1Slave12NoCommunication, operation-cycle=DefaultOperationCycle  # Event_Oper_Cycle_Map_LIN 1 Slave 12_NoCommunication
  diagnostic event to debounce algorithm mapping EventDebounceMapLIN1Slave12NoCommunication: debounce-algorithm=counter_based, diagnostic-event=EventLIN1Slave12NoCommunication  # EventDebounceMap_LIN 1 Slave 12_NoCommunication
package /ZeC/DTC/DTC/LIN_1_Slave_11_Defekt
  diagnostic trouble code uds LIN_1_Slave_11_Defekt: dtc-props=Dtc_Props_358996c7, uds-dtc-value=0x030105  # LIN 1 Slave 11_Defekt
  diagnostic event EventLIN1Slave11Defekt: aging-allowed=true, event-kind=SWC, prestorage-freeze-frame=false  # Event_LIN 1 Slave 11_Defekt
  diagnostic event to trouble code uds mapping EventDtcMapLIN1Slave11Defekt: diagnostic-event=EventLIN1Slave11Defekt, trouble-code-uds=LIN_1_Slave_11_Defekt  # Event_Dtc_Map_LIN 1 Slave 11_Defekt
  diagnostic event to operation cycle mapping EventOperCycleMapLIN1Slave11Defekt: diagnostic-event=EventLIN1Slave11Defekt, operation-cycle=DefaultOperationCycle  # Event_Oper_Cycle_Map_LIN 1 Slave 11_Defekt
  diagnostic event to debounce algorithm mapping EventDebounceMapLIN1Slave11Defekt: debounce-algorithm=counter_based, diagnostic-event=EventLIN1Slave11Defekt  # EventDebounceMap_LIN 1 Slave 11_Defekt
package /ZeC/DTC/DTC/Power_Path_073_Short_to_BAT_Failure
  diagnostic trouble code uds Power_Path_073_Short_to_BAT_Failure: dtc-props=Dtc_Props_956415a5, uds-dtc-value=0x005149
  diagnostic event EventPowerPath073ShortToBATFailure: aging-allowed=true, event-kind=SWC, prestorage-freeze-frame=false  # Event_Power_Path_073_Short_to_BAT_Failure
  diagnostic event to trouble code uds mapping EventDtcMapPowerPath073ShortToBATFailure: diagnostic-event=EventPowerPath073ShortToBATFailure, trouble-code-uds=Power_Path_073_Short_to_BAT_Failure  # Event_Dtc_Map_Power_Path_073_Short_to_BAT_Failure
  diagnostic event to operation cycle mapping EventOperCycleMapPowerPath073ShortToBATFailure: diagnostic-event=EventPowerPath073ShortToBATFailure, operation-cycle=DefaultOperationCycle  # Event_Oper_Cycle_Map_Power_Path_073_Short_to_BAT_Failure
  diagnostic event to debounce algorithm mapping EventDebounceMapPowerPath073ShortToBATFailure: debounce-algorithm=time_based, diagnostic-event=EventPowerPath073ShortToBATFailure  # EventDebounceMap_Power_Path_073_Short_to_BAT_Failure
package /ZeC/DTC/DTC/LIN_1_Slave_10_NoCommunication
  diagnostic trouble code uds LIN_1_Slave_10_NoCommunication: dtc-props=Dtc_Props_358996c7, uds-dtc-value=0x030104  # LIN 1 Slave 10_NoCommunication
  diagnostic event EventLIN1Slave10NoCommunication: aging-allowed=true, event-kind=SWC, prestorage-freeze-frame=false  # Event_LIN 1 Slave 10_NoCommunication
  diagnostic event to trouble code uds mapping EventDtcMapLIN1Slave10NoCommunication: diagnostic-event=EventLIN1Slave10NoCommunication, trouble-code-uds=LIN_1_Slave_10_NoCommunication  # Event_Dtc_Map_LIN 1 Slave 10_NoCommunication
  diagnostic event to operation cycle mapping EventOperCycleMapLIN1Slave10NoCommunication: diagnostic-event=EventLIN1Slave10NoCommunication, operation-cycle=DefaultOperationCycle  # Event_Oper_Cycle_Map_LIN 1 Slave 10_NoCommunication
  diagnostic event to debounce algorithm mapping EventDebounceMapLIN1Slave10NoCommunication: debounce-algorithm=counter_based, diagnostic-event=EventLIN1Slave10NoCommunication  # EventDebounceMap_LIN 1 Slave 10_NoCommunication
package /ZeC/DTC/DTC/Power_Path_072_Short_to_BAT_Failure
  diagnostic trouble code uds Power_Path_072_Short_to_BAT_Failure: dtc-props=Dtc_Props_d37d1f9f, uds-dtc-value=0x005148
  diagnostic event EventPowerPath072ShortToBATFailure: aging-allowed=true, event-kind=SWC, prestorage-freeze-frame=false  # Event_Power_Path_072_Short_to_BAT_Failure
  diagnostic event to trouble code uds mapping EventDtcMapPowerPath072ShortToBATFailure: diagnostic-event=EventPowerPath072ShortToBATFailure, trouble-code-uds=Power_Path_072_Short_to_BAT_Failure  # Event_Dtc_Map_Power_Path_072_Short_to_BAT_Failure
  diagnostic event to operation cycle mapping EventOperCycleMapPowerPath072ShortToBATFailure: diagnostic-event=EventPowerPath072ShortToBATFailure, operation-cycle=DefaultOperationCycle  # Event_Oper_Cycle_Map_Power_Path_072_Short_to_BAT_Failure
  diagnostic event to debounce algorithm mapping EventDebounceMapPowerPath072ShortToBATFailure: debounce-algorithm=time_based, diagnostic-event=EventPowerPath072ShortToBATFailure  # EventDebounceMap_Power_Path_072_Short_to_BAT_Failure
package /ZeC/DTC/DTC/LIN_1_Slave_12_Defekt
  diagnostic trouble code uds LIN_1_Slave_12_Defekt: dtc-props=Dtc_Props_358996c7, uds-dtc-value=0x030107  # LIN 1 Slave 12_Defekt
  diagnostic event EventLIN1Slave12Defekt: aging-allowed=true, event-kind=SWC, prestorage-freeze-frame=false  # Event_LIN 1 Slave 12_Defekt
  diagnostic event to trouble code uds mapping EventDtcMapLIN1Slave12Defekt: diagnostic-event=EventLIN1Slave12Defekt, trouble-code-uds=LIN_1_Slave_12_Defekt  # Event_Dtc_Map_LIN 1 Slave 12_Defekt
  diagnostic event to operation cycle mapping EventOperCycleMapLIN1Slave12Defekt: diagnostic-event=EventLIN1Slave12Defekt, operation-cycle=DefaultOperationCycle  # Event_Oper_Cycle_Map_LIN 1 Slave 12_Defekt
  diagnostic event to debounce algorithm mapping EventDebounceMapLIN1Slave12Defekt: debounce-algorithm=counter_based, diagnostic-event=EventLIN1Slave12Defekt  # EventDebounceMap_LIN 1 Slave 12_Defekt
package /ZeC/DTC/DTC/LIN_11_Slave_7_Defect
  diagnostic trouble code uds LIN_11_Slave_7_Defect: dtc-props=Dtc_Props_358996c7, uds-dtc-value=0x030b1d  # LIN 11 Slave 7_Defect
  diagnostic event EventLIN11Slave7Defect: aging-allowed=true, event-kind=SWC, prestorage-freeze-frame=false  # Event_LIN 11 Slave 7_Defect
  diagnostic event to trouble code uds mapping EventDtcMapLIN11Slave7Defect: diagnostic-event=EventLIN11Slave7Defect, trouble-code-uds=LIN_11_Slave_7_Defect  # Event_Dtc_Map_LIN 11 Slave 7_Defect
  diagnostic event to operation cycle mapping EventOperCycleMapLIN11Slave7Defect: diagnostic-event=EventLIN11Slave7Defect, operation-cycle=DefaultOperationCycle  # Event_Oper_Cycle_Map_LIN 11 Slave 7_Defect
  diagnostic event to debounce algorithm mapping EventDebounceMapLIN11Slave7Defect: debounce-algorithm=counter_based, diagnostic-event=EventLIN11Slave7Defect  # EventDebounceMap_LIN 11 Slave 7_Defect
package /ZeC/DTC/DTC/LIN_1_Slave_11_NoCommunication
  diagnostic trouble code uds LIN_1_Slave_11_NoCommunication: dtc-props=Dtc_Props_358996c7, uds-dtc-value=0x030106  # LIN 1 Slave 11_NoCommunication
  diagnostic event EventLIN1Slave11NoCommunication: aging-allowed=true, event-kind=SWC, prestorage-freeze-frame=false  # Event_LIN 1 Slave 11_NoCommunication
  diagnostic event to trouble code uds mapping EventDtcMapLIN1Slave11NoCommunication: diagnostic-event=EventLIN1Slave11NoCommunication, trouble-code-uds=LIN_1_Slave_11_NoCommunication  # Event_Dtc_Map_LIN 1 Slave 11_NoCommunication
  diagnostic event to operation cycle mapping EventOperCycleMapLIN1Slave11NoCommunication: diagnostic-event=EventLIN1Slave11NoCommunication, operation-cycle=DefaultOperationCycle  # Event_Oper_Cycle_Map_LIN 1 Slave 11_NoCommunication
  diagnostic event to debounce algorithm mapping EventDebounceMapLIN1Slave11NoCommunication: debounce-algorithm=counter_based, diagnostic-event=EventLIN1Slave11NoCommunication  # EventDebounceMap_LIN 1 Slave 11_NoCommunication
package /ZeC/DTC/DTC/LIN_11_Slave_7_NoCommunication
  diagnostic trouble code uds LIN_11_Slave_7_NoCommunication: dtc-props=Dtc_Props_358996c7, uds-dtc-value=0x030b1e  # LIN 11 Slave 7_NoCommunication
  diagnostic event EventLIN11Slave7NoCommunication: aging-allowed=true, event-kind=SWC, prestorage-freeze-frame=false  # Event_LIN 11 Slave 7_NoCommunication
  diagnostic event to trouble code uds mapping EventDtcMapLIN11Slave7NoCommunication: diagnostic-event=EventLIN11Slave7NoCommunication, trouble-code-uds=LIN_11_Slave_7_NoCommunication  # Event_Dtc_Map_LIN 11 Slave 7_NoCommunication
  diagnostic event to operation cycle mapping EventOperCycleMapLIN11Slave7NoCommunication: diagnostic-event=EventLIN11Slave7NoCommunication, operation-cycle=DefaultOperationCycle  # Event_Oper_Cycle_Map_LIN 11 Slave 7_NoCommunication
  diagnostic event to debounce algorithm mapping EventDebounceMapLIN11Slave7NoCommunication: debounce-algorithm=counter_based, diagnostic-event=EventLIN11Slave7NoCommunication  # EventDebounceMap_LIN 11 Slave 7_NoCommunication
package /ZeC/DTC/DTC/LIN_1_Slave_1_Defekt
  diagnostic trouble code uds LIN_1_Slave_1_Defekt: dtc-props=Dtc_Props_358996c7, uds-dtc-value=0x030101  # LIN 1 Slave 1_Defekt
  diagnostic event EventLIN1Slave1Defekt: aging-allowed=true, event-kind=SWC, prestorage-freeze-frame=false  # Event_LIN 1 Slave 1_Defekt
  diagnostic event to trouble code uds mapping EventDtcMapLIN1Slave1Defekt: diagnostic-event=EventLIN1Slave1Defekt, trouble-code-uds=LIN_1_Slave_1_Defekt  # Event_Dtc_Map_LIN 1 Slave 1_Defekt
  diagnostic event to operation cycle mapping EventOperCycleMapLIN1Slave1Defekt: diagnostic-event=EventLIN1Slave1Defekt, operation-cycle=DefaultOperationCycle  # Event_Oper_Cycle_Map_LIN 1 Slave 1_Defekt
  diagnostic event to debounce algorithm mapping EventDebounceMapLIN1Slave1Defekt: debounce-algorithm=counter_based, diagnostic-event=EventLIN1Slave1Defekt  # EventDebounceMap_LIN 1 Slave 1_Defekt
package /ZeC/DTC/DTC/LIN_11_Slave_6_Defect
  diagnostic trouble code uds LIN_11_Slave_6_Defect: dtc-props=Dtc_Props_358996c7, uds-dtc-value=0x030b1b  # LIN 11 Slave 6_Defect
  diagnostic event EventLIN11Slave6Defect: aging-allowed=true, event-kind=SWC, prestorage-freeze-frame=false  # Event_LIN 11 Slave 6_Defect
  diagnostic event to trouble code uds mapping EventDtcMapLIN11Slave6Defect: diagnostic-event=EventLIN11Slave6Defect, trouble-code-uds=LIN_11_Slave_6_Defect  # Event_Dtc_Map_LIN 11 Slave 6_Defect
  diagnostic event to operation cycle mapping EventOperCycleMapLIN11Slave6Defect: diagnostic-event=EventLIN11Slave6Defect, operation-cycle=DefaultOperationCycle  # Event_Oper_Cycle_Map_LIN 11 Slave 6_Defect
  diagnostic event to debounce algorithm mapping EventDebounceMapLIN11Slave6Defect: debounce-algorithm=counter_based, diagnostic-event=EventLIN11Slave6Defect  # EventDebounceMap_LIN 11 Slave 6_Defect
package /ZeC/DTC/DTC/Power_Path_078_Short_to_BAT_Failure
  diagnostic trouble code uds Power_Path_078_Short_to_BAT_Failure: dtc-props=Dtc_Props_36d50462, uds-dtc-value=0x00514e
  diagnostic event EventPowerPath078ShortToBATFailure: aging-allowed=true, event-kind=SWC, prestorage-freeze-frame=false  # Event_Power_Path_078_Short_to_BAT_Failure
  diagnostic event to trouble code uds mapping EventDtcMapPowerPath078ShortToBATFailure: diagnostic-event=EventPowerPath078ShortToBATFailure, trouble-code-uds=Power_Path_078_Short_to_BAT_Failure  # Event_Dtc_Map_Power_Path_078_Short_to_BAT_Failure
  diagnostic event to operation cycle mapping EventOperCycleMapPowerPath078ShortToBATFailure: diagnostic-event=EventPowerPath078ShortToBATFailure, operation-cycle=DefaultOperationCycle  # Event_Oper_Cycle_Map_Power_Path_078_Short_to_BAT_Failure
  diagnostic event to debounce algorithm mapping EventDebounceMapPowerPath078ShortToBATFailure: debounce-algorithm=time_based, diagnostic-event=EventPowerPath078ShortToBATFailure  # EventDebounceMap_Power_Path_078_Short_to_BAT_Failure
package /ZeC/DTC/DTC/LIN_11_Slave_6_NoCommunication
  diagnostic trouble code uds LIN_11_Slave_6_NoCommunication: dtc-props=Dtc_Props_358996c7, uds-dtc-value=0x030b1c  # LIN 11 Slave 6_NoCommunication
  diagnostic event EventLIN11Slave6NoCommunication: aging-allowed=true, event-kind=SWC, prestorage-freeze-frame=false  # Event_LIN 11 Slave 6_NoCommunication
  diagnostic event to trouble code uds mapping EventDtcMapLIN11Slave6NoCommunication: diagnostic-event=EventLIN11Slave6NoCommunication, trouble-code-uds=LIN_11_Slave_6_NoCommunication  # Event_Dtc_Map_LIN 11 Slave 6_NoCommunication
  diagnostic event to operation cycle mapping EventOperCycleMapLIN11Slave6NoCommunication: diagnostic-event=EventLIN11Slave6NoCommunication, operation-cycle=DefaultOperationCycle  # Event_Oper_Cycle_Map_LIN 11 Slave 6_NoCommunication
  diagnostic event to debounce algorithm mapping EventDebounceMapLIN11Slave6NoCommunication: debounce-algorithm=counter_based, diagnostic-event=EventLIN11Slave6NoCommunication  # EventDebounceMap_LIN 11 Slave 6_NoCommunication
package /ZeC/DTC/DTC/Power_Path_077_Short_to_BAT_Failure
  diagnostic trouble code uds Power_Path_077_Short_to_BAT_Failure: dtc-props=Dtc_Props_70cc0e58, uds-dtc-value=0x00514d
  diagnostic event EventPowerPath077ShortToBATFailure: aging-allowed=true, event-kind=SWC, prestorage-freeze-frame=false  # Event_Power_Path_077_Short_to_BAT_Failure
  diagnostic event to trouble code uds mapping EventDtcMapPowerPath077ShortToBATFailure: diagnostic-event=EventPowerPath077ShortToBATFailure, trouble-code-uds=Power_Path_077_Short_to_BAT_Failure  # Event_Dtc_Map_Power_Path_077_Short_to_BAT_Failure
  diagnostic event to operation cycle mapping EventOperCycleMapPowerPath077ShortToBATFailure: diagnostic-event=EventPowerPath077ShortToBATFailure, operation-cycle=DefaultOperationCycle  # Event_Oper_Cycle_Map_Power_Path_077_Short_to_BAT_Failure
  diagnostic event to debounce algorithm mapping EventDebounceMapPowerPath077ShortToBATFailure: debounce-algorithm=time_based, diagnostic-event=EventPowerPath077ShortToBATFailure  # EventDebounceMap_Power_Path_077_Short_to_BAT_Failure
package /ZeC/DTC/DTC/LIN_1_Slave_10_Defekt
  diagnostic trouble code uds LIN_1_Slave_10_Defekt: dtc-props=Dtc_Props_358996c7, uds-dtc-value=0x030103  # LIN 1 Slave 10_Defekt
  diagnostic event EventLIN1Slave10Defekt: aging-allowed=true, event-kind=SWC, prestorage-freeze-frame=false  # Event_LIN 1 Slave 10_Defekt
  diagnostic event to trouble code uds mapping EventDtcMapLIN1Slave10Defekt: diagnostic-event=EventLIN1Slave10Defekt, trouble-code-uds=LIN_1_Slave_10_Defekt  # Event_Dtc_Map_LIN 1 Slave 10_Defekt
  diagnostic event to operation cycle mapping EventOperCycleMapLIN1Slave10Defekt: diagnostic-event=EventLIN1Slave10Defekt, operation-cycle=DefaultOperationCycle  # Event_Oper_Cycle_Map_LIN 1 Slave 10_Defekt
  diagnostic event to debounce algorithm mapping EventDebounceMapLIN1Slave10Defekt: debounce-algorithm=counter_based, diagnostic-event=EventLIN1Slave10Defekt  # EventDebounceMap_LIN 1 Slave 10_Defekt
package /ZeC/DTC/DTC/LIN_1_Slave_1_Communication
  diagnostic trouble code uds LIN_1_Slave_1_Communication: dtc-props=Dtc_Props_358996c7, uds-dtc-value=0x030102  # LIN 1 Slave 1_Communication
  diagnostic event EventLIN1Slave1Communication: aging-allowed=true, event-kind=SWC, prestorage-freeze-frame=false  # Event_LIN 1 Slave 1_Communication
  diagnostic event to trouble code uds mapping EventDtcMapLIN1Slave1Communication: diagnostic-event=EventLIN1Slave1Communication, trouble-code-uds=LIN_1_Slave_1_Communication  # Event_Dtc_Map_LIN 1 Slave 1_Communication
  diagnostic event to operation cycle mapping EventOperCycleMapLIN1Slave1Communication: diagnostic-event=EventLIN1Slave1Communication, operation-cycle=DefaultOperationCycle  # Event_Oper_Cycle_Map_LIN 1 Slave 1_Communication
  diagnostic event to debounce algorithm mapping EventDebounceMapLIN1Slave1Communication: debounce-algorithm=counter_based, diagnostic-event=EventLIN1Slave1Communication  # EventDebounceMap_LIN 1 Slave 1_Communication
package /ZeC/DTC/DTC/LIN_11_Slave_5_NoCommunication
  diagnostic trouble code uds LIN_11_Slave_5_NoCommunication: dtc-props=Dtc_Props_358996c7, uds-dtc-value=0x030b1a  # LIN 11 Slave 5_NoCommunication
  diagnostic event EventLIN11Slave5NoCommunication: aging-allowed=true, event-kind=SWC, prestorage-freeze-frame=false  # Event_LIN 11 Slave 5_NoCommunication
  diagnostic event to trouble code uds mapping EventDtcMapLIN11Slave5NoCommunication: diagnostic-event=EventLIN11Slave5NoCommunication, trouble-code-uds=LIN_11_Slave_5_NoCommunication  # Event_Dtc_Map_LIN 11 Slave 5_NoCommunication
  diagnostic event to operation cycle mapping EventOperCycleMapLIN11Slave5NoCommunication: diagnostic-event=EventLIN11Slave5NoCommunication, operation-cycle=DefaultOperationCycle  # Event_Oper_Cycle_Map_LIN 11 Slave 5_NoCommunication
  diagnostic event to debounce algorithm mapping EventDebounceMapLIN11Slave5NoCommunication: debounce-algorithm=counter_based, diagnostic-event=EventLIN11Slave5NoCommunication  # EventDebounceMap_LIN 11 Slave 5_NoCommunication
package /ZeC/DTC/DTC/Power_Path_079_Short_to_BAT_Failure
  diagnostic trouble code uds Power_Path_079_Short_to_BAT_Failure: dtc-props=Dtc_Props_fcfe1a2c, uds-dtc-value=0x00514f
  diagnostic event EventPowerPath079ShortToBATFailure: aging-allowed=true, event-kind=SWC, prestorage-freeze-frame=false  # Event_Power_Path_079_Short_to_BAT_Failure
  diagnostic event to trouble code uds mapping EventDtcMapPowerPath079ShortToBATFailure: diagnostic-event=EventPowerPath079ShortToBATFailure, trouble-code-uds=Power_Path_079_Short_to_BAT_Failure  # Event_Dtc_Map_Power_Path_079_Short_to_BAT_Failure
  diagnostic event to operation cycle mapping EventOperCycleMapPowerPath079ShortToBATFailure: diagnostic-event=EventPowerPath079ShortToBATFailure, operation-cycle=DefaultOperationCycle  # Event_Oper_Cycle_Map_Power_Path_079_Short_to_BAT_Failure
  diagnostic event to debounce algorithm mapping EventDebounceMapPowerPath079ShortToBATFailure: debounce-algorithm=time_based, diagnostic-event=EventPowerPath079ShortToBATFailure  # EventDebounceMap_Power_Path_079_Short_to_BAT_Failure
package /ZeC/DTC/DTC/Power_Path_074_Short_to_BAT_Failure
  diagnostic trouble code uds Power_Path_074_Short_to_BAT_Failure: dtc-props=Dtc_Props_f5c02acb, uds-dtc-value=0x00514a
  diagnostic event EventPowerPath074ShortToBATFailure: aging-allowed=true, event-kind=SWC, prestorage-freeze-frame=false  # Event_Power_Path_074_Short_to_BAT_Failure
  diagnostic event to trouble code uds mapping EventDtcMapPowerPath074ShortToBATFailure: diagnostic-event=EventPowerPath074ShortToBATFailure, trouble-code-uds=Power_Path_074_Short_to_BAT_Failure  # Event_Dtc_Map_Power_Path_074_Short_to_BAT_Failure
  diagnostic event to operation cycle mapping EventOperCycleMapPowerPath074ShortToBATFailure: diagnostic-event=EventPowerPath074ShortToBATFailure, operation-cycle=DefaultOperationCycle  # Event_Oper_Cycle_Map_Power_Path_074_Short_to_BAT_Failure
  diagnostic event to debounce algorithm mapping EventDebounceMapPowerPath074ShortToBATFailure: debounce-algorithm=time_based, diagnostic-event=EventPowerPath074ShortToBATFailure  # EventDebounceMap_Power_Path_074_Short_to_BAT_Failure
package /ZeC/DTC/DTC/Power_Path_076_Short_to_BAT_Failure
  diagnostic trouble code uds Power_Path_076_Short_to_BAT_Failure: dtc-props=Dtc_Props_79f23ebf, uds-dtc-value=0x00514c
  diagnostic event EventPowerPath076ShortToBATFailure: aging-allowed=true, event-kind=SWC, prestorage-freeze-frame=false  # Event_Power_Path_076_Short_to_BAT_Failure
  diagnostic event to trouble code uds mapping EventDtcMapPowerPath076ShortToBATFailure: diagnostic-event=EventPowerPath076ShortToBATFailure, trouble-code-uds=Power_Path_076_Short_to_BAT_Failure  # Event_Dtc_Map_Power_Path_076_Short_to_BAT_Failure
  diagnostic event to operation cycle mapping EventOperCycleMapPowerPath076ShortToBATFailure: diagnostic-event=EventPowerPath076ShortToBATFailure, operation-cycle=DefaultOperationCycle  # Event_Oper_Cycle_Map_Power_Path_076_Short_to_BAT_Failure
  diagnostic event to debounce algorithm mapping EventDebounceMapPowerPath076ShortToBATFailure: debounce-algorithm=time_based, diagnostic-event=EventPowerPath076ShortToBATFailure  # EventDebounceMap_Power_Path_076_Short_to_BAT_Failure
package /ZeC/DTC/DTC/Power_Path_075_Short_to_BAT_Failure
  diagnostic trouble code uds Power_Path_075_Short_to_BAT_Failure: dtc-props=Dtc_Props_3feb3485, uds-dtc-value=0x00514b
  diagnostic event EventPowerPath075ShortToBATFailure: aging-allowed=true, event-kind=SWC, prestorage-freeze-frame=false  # Event_Power_Path_075_Short_to_BAT_Failure
  diagnostic event to trouble code uds mapping EventDtcMapPowerPath075ShortToBATFailure: diagnostic-event=EventPowerPath075ShortToBATFailure, trouble-code-uds=Power_Path_075_Short_to_BAT_Failure  # Event_Dtc_Map_Power_Path_075_Short_to_BAT_Failure
  diagnostic event to operation cycle mapping EventOperCycleMapPowerPath075ShortToBATFailure: diagnostic-event=EventPowerPath075ShortToBATFailure, operation-cycle=DefaultOperationCycle  # Event_Oper_Cycle_Map_Power_Path_075_Short_to_BAT_Failure
  diagnostic event to debounce algorithm mapping EventDebounceMapPowerPath075ShortToBATFailure: debounce-algorithm=time_based, diagnostic-event=EventPowerPath075ShortToBATFailure  # EventDebounceMap_Power_Path_075_Short_to_BAT_Failure
package /ZeC/DTC/DTC/Power_Path_080_Short_to_BAT_Failure
  diagnostic trouble code uds Power_Path_080_Short_to_BAT_Failure: dtc-props=Dtc_Props_486c8434, uds-dtc-value=0x005150
  diagnostic event EventPowerPath080ShortToBATFailure: aging-allowed=true, event-kind=SWC, prestorage-freeze-frame=false  # Event_Power_Path_080_Short_to_BAT_Failure
  diagnostic event to trouble code uds mapping EventDtcMapPowerPath080ShortToBATFailure: diagnostic-event=EventPowerPath080ShortToBATFailure, trouble-code-uds=Power_Path_080_Short_to_BAT_Failure  # Event_Dtc_Map_Power_Path_080_Short_to_BAT_Failure
  diagnostic event to operation cycle mapping EventOperCycleMapPowerPath080ShortToBATFailure: diagnostic-event=EventPowerPath080ShortToBATFailure, operation-cycle=DefaultOperationCycle  # Event_Oper_Cycle_Map_Power_Path_080_Short_to_BAT_Failure
  diagnostic event to debounce algorithm mapping EventDebounceMapPowerPath080ShortToBATFailure: debounce-algorithm=time_based, diagnostic-event=EventPowerPath080ShortToBATFailure  # EventDebounceMap_Power_Path_080_Short_to_BAT_Failure
package /ZeC/DTC/DTC/LIN_1_Slave_15_NoCommunication
  diagnostic trouble code uds LIN_1_Slave_15_NoCommunication: dtc-props=Dtc_Props_358996c7, uds-dtc-value=0x03010e  # LIN 1 Slave 15_NoCommunication
  diagnostic event EventLIN1Slave15NoCommunication: aging-allowed=true, event-kind=SWC, prestorage-freeze-frame=false  # Event_LIN 1 Slave 15_NoCommunication
  diagnostic event to trouble code uds mapping EventDtcMapLIN1Slave15NoCommunication: diagnostic-event=EventLIN1Slave15NoCommunication, trouble-code-uds=LIN_1_Slave_15_NoCommunication  # Event_Dtc_Map_LIN 1 Slave 15_NoCommunication
  diagnostic event to operation cycle mapping EventOperCycleMapLIN1Slave15NoCommunication: diagnostic-event=EventLIN1Slave15NoCommunication, operation-cycle=DefaultOperationCycle  # Event_Oper_Cycle_Map_LIN 1 Slave 15_NoCommunication
  diagnostic event to debounce algorithm mapping EventDebounceMapLIN1Slave15NoCommunication: debounce-algorithm=counter_based, diagnostic-event=EventLIN1Slave15NoCommunication  # EventDebounceMap_LIN 1 Slave 15_NoCommunication
package /ZeC/DTC/DTC/LIN_1_Slave_15_Defekt
  diagnostic trouble code uds LIN_1_Slave_15_Defekt: dtc-props=Dtc_Props_358996c7, uds-dtc-value=0x03010d  # LIN 1 Slave 15_Defekt
  diagnostic event EventLIN1Slave15Defekt: aging-allowed=true, event-kind=SWC, prestorage-freeze-frame=false  # Event_LIN 1 Slave 15_Defekt
  diagnostic event to trouble code uds mapping EventDtcMapLIN1Slave15Defekt: diagnostic-event=EventLIN1Slave15Defekt, trouble-code-uds=LIN_1_Slave_15_Defekt  # Event_Dtc_Map_LIN 1 Slave 15_Defekt
  diagnostic event to operation cycle mapping EventOperCycleMapLIN1Slave15Defekt: diagnostic-event=EventLIN1Slave15Defekt, operation-cycle=DefaultOperationCycle  # Event_Oper_Cycle_Map_LIN 1 Slave 15_Defekt
  diagnostic event to debounce algorithm mapping EventDebounceMapLIN1Slave15Defekt: debounce-algorithm=counter_based, diagnostic-event=EventLIN1Slave15Defekt  # EventDebounceMap_LIN 1 Slave 15_Defekt
package /ZeC/DTC/DTC/LIN_1_Slave_2_Defekt
  diagnostic trouble code uds LIN_1_Slave_2_Defekt: dtc-props=Dtc_Props_358996c7, uds-dtc-value=0x03010f  # LIN 1 Slave 2_Defekt
  diagnostic event EventLIN1Slave2Defekt: aging-allowed=true, event-kind=SWC, prestorage-freeze-frame=false  # Event_LIN 1 Slave 2_Defekt
  diagnostic event to trouble code uds mapping EventDtcMapLIN1Slave2Defekt: diagnostic-event=EventLIN1Slave2Defekt, trouble-code-uds=LIN_1_Slave_2_Defekt  # Event_Dtc_Map_LIN 1 Slave 2_Defekt
  diagnostic event to operation cycle mapping EventOperCycleMapLIN1Slave2Defekt: diagnostic-event=EventLIN1Slave2Defekt, operation-cycle=DefaultOperationCycle  # Event_Oper_Cycle_Map_LIN 1 Slave 2_Defekt
  diagnostic event to debounce algorithm mapping EventDebounceMapLIN1Slave2Defekt: debounce-algorithm=counter_based, diagnostic-event=EventLIN1Slave2Defekt  # EventDebounceMap_LIN 1 Slave 2_Defekt
package /ZeC/DTC/DTC/LIN_1_Slave_13_NoCommunication
  diagnostic trouble code uds LIN_1_Slave_13_NoCommunication: dtc-props=Dtc_Props_358996c7, uds-dtc-value=0x03010a  # LIN 1 Slave 13_NoCommunication
  diagnostic event EventLIN1Slave13NoCommunication: aging-allowed=true, event-kind=SWC, prestorage-freeze-frame=false  # Event_LIN 1 Slave 13_NoCommunication
  diagnostic event to trouble code uds mapping EventDtcMapLIN1Slave13NoCommunication: diagnostic-event=EventLIN1Slave13NoCommunication, trouble-code-uds=LIN_1_Slave_13_NoCommunication  # Event_Dtc_Map_LIN 1 Slave 13_NoCommunication
  diagnostic event to operation cycle mapping EventOperCycleMapLIN1Slave13NoCommunication: diagnostic-event=EventLIN1Slave13NoCommunication, operation-cycle=DefaultOperationCycle  # Event_Oper_Cycle_Map_LIN 1 Slave 13_NoCommunication
  diagnostic event to debounce algorithm mapping EventDebounceMapLIN1Slave13NoCommunication: debounce-algorithm=counter_based, diagnostic-event=EventLIN1Slave13NoCommunication  # EventDebounceMap_LIN 1 Slave 13_NoCommunication
package /ZeC/DTC/DTC/Power_Path_086_Short_to_BAT_Failure
  diagnostic trouble code uds Power_Path_086_Short_to_BAT_Failure: dtc-props=Dtc_Props_74bbee9, uds-dtc-value=0x005156
  diagnostic event EventPowerPath086ShortToBATFailure: aging-allowed=true, event-kind=SWC, prestorage-freeze-frame=false  # Event_Power_Path_086_Short_to_BAT_Failure
  diagnostic event to trouble code uds mapping EventDtcMapPowerPath086ShortToBATFailure: diagnostic-event=EventPowerPath086ShortToBATFailure, trouble-code-uds=Power_Path_086_Short_to_BAT_Failure  # Event_Dtc_Map_Power_Path_086_Short_to_BAT_Failure
  diagnostic event to operation cycle mapping EventOperCycleMapPowerPath086ShortToBATFailure: diagnostic-event=EventPowerPath086ShortToBATFailure, operation-cycle=DefaultOperationCycle  # Event_Oper_Cycle_Map_Power_Path_086_Short_to_BAT_Failure
  diagnostic event to debounce algorithm mapping EventDebounceMapPowerPath086ShortToBATFailure: debounce-algorithm=time_based, diagnostic-event=EventPowerPath086ShortToBATFailure  # EventDebounceMap_Power_Path_086_Short_to_BAT_Failure
package /ZeC/DTC/DTC/Power_Path_085_Short_to_BAT_Failure
  diagnostic trouble code uds Power_Path_085_Short_to_BAT_Failure: dtc-props=Dtc_Props_cd60a0a7, uds-dtc-value=0x005155
  diagnostic event EventPowerPath085ShortToBATFailure: aging-allowed=true, event-kind=SWC, prestorage-freeze-frame=false  # Event_Power_Path_085_Short_to_BAT_Failure
  diagnostic event to trouble code uds mapping EventDtcMapPowerPath085ShortToBATFailure: diagnostic-event=EventPowerPath085ShortToBATFailure, trouble-code-uds=Power_Path_085_Short_to_BAT_Failure  # Event_Dtc_Map_Power_Path_085_Short_to_BAT_Failure
  diagnostic event to operation cycle mapping EventOperCycleMapPowerPath085ShortToBATFailure: diagnostic-event=EventPowerPath085ShortToBATFailure, operation-cycle=DefaultOperationCycle  # Event_Oper_Cycle_Map_Power_Path_085_Short_to_BAT_Failure
  diagnostic event to debounce algorithm mapping EventDebounceMapPowerPath085ShortToBATFailure: debounce-algorithm=time_based, diagnostic-event=EventPowerPath085ShortToBATFailure  # EventDebounceMap_Power_Path_085_Short_to_BAT_Failure
package /ZeC/DTC/DTC/LIN_1_Slave_14_NoCommunication
  diagnostic trouble code uds LIN_1_Slave_14_NoCommunication: dtc-props=Dtc_Props_358996c7, uds-dtc-value=0x03010c  # LIN 1 Slave 14_NoCommunication
  diagnostic event EventLIN1Slave14NoCommunication: aging-allowed=true, event-kind=SWC, prestorage-freeze-frame=false  # Event_LIN 1 Slave 14_NoCommunication
  diagnostic event to trouble code uds mapping EventDtcMapLIN1Slave14NoCommunication: diagnostic-event=EventLIN1Slave14NoCommunication, trouble-code-uds=LIN_1_Slave_14_NoCommunication  # Event_Dtc_Map_LIN 1 Slave 14_NoCommunication
  diagnostic event to operation cycle mapping EventOperCycleMapLIN1Slave14NoCommunication: diagnostic-event=EventLIN1Slave14NoCommunication, operation-cycle=DefaultOperationCycle  # Event_Oper_Cycle_Map_LIN 1 Slave 14_NoCommunication
  diagnostic event to debounce algorithm mapping EventDebounceMapLIN1Slave14NoCommunication: debounce-algorithm=counter_based, diagnostic-event=EventLIN1Slave14NoCommunication  # EventDebounceMap_LIN 1 Slave 14_NoCommunication
package /ZeC/DTC/DTC/LIN_11_Local_Databus_Electrical_Failure
  diagnostic trouble code uds LIN_11_Local_Databus_Electrical_Failure: dtc-props=Dtc_Props_358996c7, uds-dtc-value=0x030b21  # LIN 11 Local_Databus_Electrical_Failure
  diagnostic event EventLIN11LocalDatabusElectricalFailure: aging-allowed=true, event-kind=SWC, prestorage-freeze-frame=false  # Event_LIN 11 Local_Databus_Electrical_Failure
  diagnostic event to trouble code uds mapping EventDtcMapLIN11LocalDatabusElectricalFailure: diagnostic-event=EventLIN11LocalDatabusElectricalFailure, trouble-code-uds=LIN_11_Local_Databus_Electrical_Failure  # Event_Dtc_Map_LIN 11 Local_Databus_Electrical_Failure
  diagnostic event to operation cycle mapping EventOperCycleMapLIN11LocalDatabusElectricalFailure: diagnostic-event=EventLIN11LocalDatabusElectricalFailure, operation-cycle=DefaultOperationCycle  # Event_Oper_Cycle_Map_LIN 11 Local_Databus_Electrical_Failure
  diagnostic event to debounce algorithm mapping EventDebounceMapLIN11LocalDatabusElectricalFailure: debounce-algorithm=counter_based, diagnostic-event=EventLIN11LocalDatabusElectricalFailure  # EventDebounceMap_LIN 11 Local_Databus_Electrical_Failure
package /ZeC/DTC/DTC/Power_Path_088_Short_to_BAT_Failure
  diagnostic trouble code uds Power_Path_088_Short_to_BAT_Failure: dtc-props=Dtc_Props_1537df27, uds-dtc-value=0x005158
  diagnostic event EventPowerPath088ShortToBATFailure: aging-allowed=true, event-kind=SWC, prestorage-freeze-frame=false  # Event_Power_Path_088_Short_to_BAT_Failure
  diagnostic event to trouble code uds mapping EventDtcMapPowerPath088ShortToBATFailure: diagnostic-event=EventPowerPath088ShortToBATFailure, trouble-code-uds=Power_Path_088_Short_to_BAT_Failure  # Event_Dtc_Map_Power_Path_088_Short_to_BAT_Failure
  diagnostic event to operation cycle mapping EventOperCycleMapPowerPath088ShortToBATFailure: diagnostic-event=EventPowerPath088ShortToBATFailure, operation-cycle=DefaultOperationCycle  # Event_Oper_Cycle_Map_Power_Path_088_Short_to_BAT_Failure
  diagnostic event to debounce algorithm mapping EventDebounceMapPowerPath088ShortToBATFailure: debounce-algorithm=time_based, diagnostic-event=EventPowerPath088ShortToBATFailure  # EventDebounceMap_Power_Path_088_Short_to_BAT_Failure
package /ZeC/DTC/DTC/LIN_1_Slave_14_Defekt
  diagnostic trouble code uds LIN_1_Slave_14_Defekt: dtc-props=Dtc_Props_358996c7, uds-dtc-value=0x03010b  # LIN 1 Slave 14_Defekt
  diagnostic event EventLIN1Slave14Defekt: aging-allowed=true, event-kind=SWC, prestorage-freeze-frame=false  # Event_LIN 1 Slave 14_Defekt
  diagnostic event to trouble code uds mapping EventDtcMapLIN1Slave14Defekt: diagnostic-event=EventLIN1Slave14Defekt, trouble-code-uds=LIN_1_Slave_14_Defekt  # Event_Dtc_Map_LIN 1 Slave 14_Defekt
  diagnostic event to operation cycle mapping EventOperCycleMapLIN1Slave14Defekt: diagnostic-event=EventLIN1Slave14Defekt, operation-cycle=DefaultOperationCycle  # Event_Oper_Cycle_Map_LIN 1 Slave 14_Defekt
  diagnostic event to debounce algorithm mapping EventDebounceMapLIN1Slave14Defekt: debounce-algorithm=counter_based, diagnostic-event=EventLIN1Slave14Defekt  # EventDebounceMap_LIN 1 Slave 14_Defekt
package /ZeC/DTC/DTC/Power_Path_087_Short_to_BAT_Failure
  diagnostic trouble code uds Power_Path_087_Short_to_BAT_Failure: dtc-props=Dtc_Props_4152b4d3, uds-dtc-value=0x005157
  diagnostic event EventPowerPath087ShortToBATFailure: aging-allowed=true, event-kind=SWC, prestorage-freeze-frame=false  # Event_Power_Path_087_Short_to_BAT_Failure
  diagnostic event to trouble code uds mapping EventDtcMapPowerPath087ShortToBATFailure: diagnostic-event=EventPowerPath087ShortToBATFailure, trouble-code-uds=Power_Path_087_Short_to_BAT_Failure  # Event_Dtc_Map_Power_Path_087_Short_to_BAT_Failure
  diagnostic event to operation cycle mapping EventOperCycleMapPowerPath087ShortToBATFailure: diagnostic-event=EventPowerPath087ShortToBATFailure, operation-cycle=DefaultOperationCycle  # Event_Oper_Cycle_Map_Power_Path_087_Short_to_BAT_Failure
  diagnostic event to debounce algorithm mapping EventDebounceMapPowerPath087ShortToBATFailure: debounce-algorithm=time_based, diagnostic-event=EventPowerPath087ShortToBATFailure  # EventDebounceMap_Power_Path_087_Short_to_BAT_Failure
package /ZeC/DTC/DTC/Power_Path_082_Short_to_BAT_Failure
  diagnostic trouble code uds Power_Path_082_Short_to_BAT_Failure: dtc-props=Dtc_Props_c45e9040, uds-dtc-value=0x005152
  diagnostic event EventPowerPath082ShortToBATFailure: aging-allowed=true, event-kind=SWC, prestorage-freeze-frame=false  # Event_Power_Path_082_Short_to_BAT_Failure
  diagnostic event to trouble code uds mapping EventDtcMapPowerPath082ShortToBATFailure: diagnostic-event=EventPowerPath082ShortToBATFailure, trouble-code-uds=Power_Path_082_Short_to_BAT_Failure  # Event_Dtc_Map_Power_Path_082_Short_to_BAT_Failure
  diagnostic event to operation cycle mapping EventOperCycleMapPowerPath082ShortToBATFailure: diagnostic-event=EventPowerPath082ShortToBATFailure, operation-cycle=DefaultOperationCycle  # Event_Oper_Cycle_Map_Power_Path_082_Short_to_BAT_Failure
  diagnostic event to debounce algorithm mapping EventDebounceMapPowerPath082ShortToBATFailure: debounce-algorithm=time_based, diagnostic-event=EventPowerPath082ShortToBATFailure  # EventDebounceMap_Power_Path_082_Short_to_BAT_Failure
package /ZeC/DTC/DTC/LIN_11_Databus_No_Comm
  diagnostic trouble code uds LIN_11_Databus_No_Comm: dtc-props=Dtc_Props_358996c7, uds-dtc-value=0x030b20  # LIN 11 Databus_No_Comm
  diagnostic event EventLIN11DatabusNoComm: aging-allowed=true, event-kind=SWC, prestorage-freeze-frame=false  # Event_LIN 11 Databus_No_Comm
  diagnostic event to trouble code uds mapping EventDtcMapLIN11DatabusNoComm: diagnostic-event=EventLIN11DatabusNoComm, trouble-code-uds=LIN_11_Databus_No_Comm  # Event_Dtc_Map_LIN 11 Databus_No_Comm
  diagnostic event to operation cycle mapping EventOperCycleMapLIN11DatabusNoComm: diagnostic-event=EventLIN11DatabusNoComm, operation-cycle=DefaultOperationCycle  # Event_Oper_Cycle_Map_LIN 11 Databus_No_Comm
  diagnostic event to debounce algorithm mapping EventDebounceMapLIN11DatabusNoComm: debounce-algorithm=counter_based, diagnostic-event=EventLIN11DatabusNoComm  # EventDebounceMap_LIN 11 Databus_No_Comm
package /ZeC/DTC/DTC/Power_Path_081_Short_to_BAT_Failure
  diagnostic trouble code uds Power_Path_081_Short_to_BAT_Failure: dtc-props=Dtc_Props_e758e0e, uds-dtc-value=0x005151
  diagnostic event EventPowerPath081ShortToBATFailure: aging-allowed=true, event-kind=SWC, prestorage-freeze-frame=false  # Event_Power_Path_081_Short_to_BAT_Failure
  diagnostic event to trouble code uds mapping EventDtcMapPowerPath081ShortToBATFailure: diagnostic-event=EventPowerPath081ShortToBATFailure, trouble-code-uds=Power_Path_081_Short_to_BAT_Failure  # Event_Dtc_Map_Power_Path_081_Short_to_BAT_Failure
  diagnostic event to operation cycle mapping EventOperCycleMapPowerPath081ShortToBATFailure: diagnostic-event=EventPowerPath081ShortToBATFailure, operation-cycle=DefaultOperationCycle  # Event_Oper_Cycle_Map_Power_Path_081_Short_to_BAT_Failure
  diagnostic event to debounce algorithm mapping EventDebounceMapPowerPath081ShortToBATFailure: debounce-algorithm=time_based, diagnostic-event=EventPowerPath081ShortToBATFailure  # EventDebounceMap_Power_Path_081_Short_to_BAT_Failure
package /ZeC/DTC/DTC/Power_Path_084_Short_to_BAT_Failure
  diagnostic trouble code uds Power_Path_084_Short_to_BAT_Failure: dtc-props=Dtc_Props_8b79aa9d, uds-dtc-value=0x005154
  diagnostic event EventPowerPath084ShortToBATFailure: aging-allowed=true, event-kind=SWC, prestorage-freeze-frame=false  # Event_Power_Path_084_Short_to_BAT_Failure
  diagnostic event to trouble code uds mapping EventDtcMapPowerPath084ShortToBATFailure: diagnostic-event=EventPowerPath084ShortToBATFailure, trouble-code-uds=Power_Path_084_Short_to_BAT_Failure  # Event_Dtc_Map_Power_Path_084_Short_to_BAT_Failure
  diagnostic event to operation cycle mapping EventOperCycleMapPowerPath084ShortToBATFailure: diagnostic-event=EventPowerPath084ShortToBATFailure, operation-cycle=DefaultOperationCycle  # Event_Oper_Cycle_Map_Power_Path_084_Short_to_BAT_Failure
  diagnostic event to debounce algorithm mapping EventDebounceMapPowerPath084ShortToBATFailure: debounce-algorithm=time_based, diagnostic-event=EventPowerPath084ShortToBATFailure  # EventDebounceMap_Power_Path_084_Short_to_BAT_Failure
package /ZeC/DTC/DTC/Power_Path_083_Short_to_BAT_Failure
  diagnostic trouble code uds Power_Path_083_Short_to_BAT_Failure: dtc-props=Dtc_Props_82479a7a, uds-dtc-value=0x005153
  diagnostic event EventPowerPath083ShortToBATFailure: aging-allowed=true, event-kind=SWC, prestorage-freeze-frame=false  # Event_Power_Path_083_Short_to_BAT_Failure
  diagnostic event to trouble code uds mapping EventDtcMapPowerPath083ShortToBATFailure: diagnostic-event=EventPowerPath083ShortToBATFailure, trouble-code-uds=Power_Path_083_Short_to_BAT_Failure  # Event_Dtc_Map_Power_Path_083_Short_to_BAT_Failure
  diagnostic event to operation cycle mapping EventOperCycleMapPowerPath083ShortToBATFailure: diagnostic-event=EventPowerPath083ShortToBATFailure, operation-cycle=DefaultOperationCycle  # Event_Oper_Cycle_Map_Power_Path_083_Short_to_BAT_Failure
  diagnostic event to debounce algorithm mapping EventDebounceMapPowerPath083ShortToBATFailure: debounce-algorithm=time_based, diagnostic-event=EventPowerPath083ShortToBATFailure  # EventDebounceMap_Power_Path_083_Short_to_BAT_Failure
package /ZeC/DTC/DTC/LIN_1_Slave_7_Defekt
  diagnostic trouble code uds LIN_1_Slave_7_Defekt: dtc-props=Dtc_Props_358996c7, uds-dtc-value=0x030119  # LIN 1 Slave 7_Defekt
  diagnostic event EventLIN1Slave7Defekt: aging-allowed=true, event-kind=SWC, prestorage-freeze-frame=false  # Event_LIN 1 Slave 7_Defekt
  diagnostic event to trouble code uds mapping EventDtcMapLIN1Slave7Defekt: diagnostic-event=EventLIN1Slave7Defekt, trouble-code-uds=LIN_1_Slave_7_Defekt  # Event_Dtc_Map_LIN 1 Slave 7_Defekt
  diagnostic event to operation cycle mapping EventOperCycleMapLIN1Slave7Defekt: diagnostic-event=EventLIN1Slave7Defekt, operation-cycle=DefaultOperationCycle  # Event_Oper_Cycle_Map_LIN 1 Slave 7_Defekt
  diagnostic event to debounce algorithm mapping EventDebounceMapLIN1Slave7Defekt: debounce-algorithm=counter_based, diagnostic-event=EventLIN1Slave7Defekt  # EventDebounceMap_LIN 1 Slave 7_Defekt
package /ZeC/DTC/DTC/LIN_1_Slave_5_NoCommunication
  diagnostic trouble code uds LIN_1_Slave_5_NoCommunication: dtc-props=Dtc_Props_358996c7, uds-dtc-value=0x030116  # LIN 1 Slave 5_NoCommunication
  diagnostic event EventLIN1Slave5NoCommunication: aging-allowed=true, event-kind=SWC, prestorage-freeze-frame=false  # Event_LIN 1 Slave 5_NoCommunication
  diagnostic event to trouble code uds mapping EventDtcMapLIN1Slave5NoCommunication: diagnostic-event=EventLIN1Slave5NoCommunication, trouble-code-uds=LIN_1_Slave_5_NoCommunication  # Event_Dtc_Map_LIN 1 Slave 5_NoCommunication
  diagnostic event to operation cycle mapping EventOperCycleMapLIN1Slave5NoCommunication: diagnostic-event=EventLIN1Slave5NoCommunication, operation-cycle=DefaultOperationCycle  # Event_Oper_Cycle_Map_LIN 1 Slave 5_NoCommunication
  diagnostic event to debounce algorithm mapping EventDebounceMapLIN1Slave5NoCommunication: debounce-algorithm=counter_based, diagnostic-event=EventLIN1Slave5NoCommunication  # EventDebounceMap_LIN 1 Slave 5_NoCommunication
package /ZeC/DTC/DTC/Power_Path_056_Short_to_BAT_Failure
  diagnostic trouble code uds Power_Path_056_Short_to_BAT_Failure: dtc-props=Dtc_Props_ed1a5674, uds-dtc-value=0x005138
  diagnostic event EventPowerPath056ShortToBATFailure: aging-allowed=true, event-kind=SWC, prestorage-freeze-frame=false  # Event_Power_Path_056_Short_to_BAT_Failure
  diagnostic event to trouble code uds mapping EventDtcMapPowerPath056ShortToBATFailure: diagnostic-event=EventPowerPath056ShortToBATFailure, trouble-code-uds=Power_Path_056_Short_to_BAT_Failure  # Event_Dtc_Map_Power_Path_056_Short_to_BAT_Failure
  diagnostic event to operation cycle mapping EventOperCycleMapPowerPath056ShortToBATFailure: diagnostic-event=EventPowerPath056ShortToBATFailure, operation-cycle=DefaultOperationCycle  # Event_Oper_Cycle_Map_Power_Path_056_Short_to_BAT_Failure
  diagnostic event to debounce algorithm mapping EventDebounceMapPowerPath056ShortToBATFailure: debounce-algorithm=time_based, diagnostic-event=EventPowerPath056ShortToBATFailure  # EventDebounceMap_Power_Path_056_Short_to_BAT_Failure
package /ZeC/DTC/DTC/LIN_1_Slave_5_Defekt
  diagnostic trouble code uds LIN_1_Slave_5_Defekt: dtc-props=Dtc_Props_358996c7, uds-dtc-value=0x030115  # LIN 1 Slave 5_Defekt
  diagnostic event EventLIN1Slave5Defekt: aging-allowed=true, event-kind=SWC, prestorage-freeze-frame=false  # Event_LIN 1 Slave 5_Defekt
  diagnostic event to trouble code uds mapping EventDtcMapLIN1Slave5Defekt: diagnostic-event=EventLIN1Slave5Defekt, trouble-code-uds=LIN_1_Slave_5_Defekt  # Event_Dtc_Map_LIN 1 Slave 5_Defekt
  diagnostic event to operation cycle mapping EventOperCycleMapLIN1Slave5Defekt: diagnostic-event=EventLIN1Slave5Defekt, operation-cycle=DefaultOperationCycle  # Event_Oper_Cycle_Map_LIN 1 Slave 5_Defekt
  diagnostic event to debounce algorithm mapping EventDebounceMapLIN1Slave5Defekt: debounce-algorithm=counter_based, diagnostic-event=EventLIN1Slave5Defekt  # EventDebounceMap_LIN 1 Slave 5_Defekt
package /ZeC/DTC/DTC/Power_Path_055_Short_to_BAT_Failure
  diagnostic trouble code uds Power_Path_055_Short_to_BAT_Failure: dtc-props=Dtc_Props_b97f3d80, uds-dtc-value=0x005137
  diagnostic event EventPowerPath055ShortToBATFailure: aging-allowed=true, event-kind=SWC, prestorage-freeze-frame=false  # Event_Power_Path_055_Short_to_BAT_Failure
  diagnostic event to trouble code uds mapping EventDtcMapPowerPath055ShortToBATFailure: diagnostic-event=EventPowerPath055ShortToBATFailure, trouble-code-uds=Power_Path_055_Short_to_BAT_Failure  # Event_Dtc_Map_Power_Path_055_Short_to_BAT_Failure
  diagnostic event to operation cycle mapping EventOperCycleMapPowerPath055ShortToBATFailure: diagnostic-event=EventPowerPath055ShortToBATFailure, operation-cycle=DefaultOperationCycle  # Event_Oper_Cycle_Map_Power_Path_055_Short_to_BAT_Failure
  diagnostic event to debounce algorithm mapping EventDebounceMapPowerPath055ShortToBATFailure: debounce-algorithm=time_based, diagnostic-event=EventPowerPath055ShortToBATFailure  # EventDebounceMap_Power_Path_055_Short_to_BAT_Failure
package /ZeC/DTC/DTC/LIN_1_Slave_6_NoCommunication
  diagnostic trouble code uds LIN_1_Slave_6_NoCommunication: dtc-props=Dtc_Props_358996c7, uds-dtc-value=0x030118  # LIN 1 Slave 6_NoCommunication
  diagnostic event EventLIN1Slave6NoCommunication: aging-allowed=true, event-kind=SWC, prestorage-freeze-frame=false  # Event_LIN 1 Slave 6_NoCommunication
  diagnostic event to trouble code uds mapping EventDtcMapLIN1Slave6NoCommunication: diagnostic-event=EventLIN1Slave6NoCommunication, trouble-code-uds=LIN_1_Slave_6_NoCommunication  # Event_Dtc_Map_LIN 1 Slave 6_NoCommunication
  diagnostic event to operation cycle mapping EventOperCycleMapLIN1Slave6NoCommunication: diagnostic-event=EventLIN1Slave6NoCommunication, operation-cycle=DefaultOperationCycle  # Event_Oper_Cycle_Map_LIN 1 Slave 6_NoCommunication
  diagnostic event to debounce algorithm mapping EventDebounceMapLIN1Slave6NoCommunication: debounce-algorithm=counter_based, diagnostic-event=EventLIN1Slave6NoCommunication  # EventDebounceMap_LIN 1 Slave 6_NoCommunication
package /ZeC/DTC/DTC/LIN_1_Slave_6_Defekt
  diagnostic trouble code uds LIN_1_Slave_6_Defekt: dtc-props=Dtc_Props_358996c7, uds-dtc-value=0x030117  # LIN 1 Slave 6_Defekt
  diagnostic event EventLIN1Slave6Defekt: aging-allowed=true, event-kind=SWC, prestorage-freeze-frame=false  # Event_LIN 1 Slave 6_Defekt
  diagnostic event to trouble code uds mapping EventDtcMapLIN1Slave6Defekt: diagnostic-event=EventLIN1Slave6Defekt, trouble-code-uds=LIN_1_Slave_6_Defekt  # Event_Dtc_Map_LIN 1 Slave 6_Defekt
  diagnostic event to operation cycle mapping EventOperCycleMapLIN1Slave6Defekt: diagnostic-event=EventLIN1Slave6Defekt, operation-cycle=DefaultOperationCycle  # Event_Oper_Cycle_Map_LIN 1 Slave 6_Defekt
  diagnostic event to debounce algorithm mapping EventDebounceMapLIN1Slave6Defekt: debounce-algorithm=counter_based, diagnostic-event=EventLIN1Slave6Defekt  # EventDebounceMap_LIN 1 Slave 6_Defekt
package /ZeC/DTC/DTC/Power_Path_057_Short_to_BAT_Failure
  diagnostic trouble code uds Power_Path_057_Short_to_BAT_Failure: dtc-props=Dtc_Props_ab035c4e, uds-dtc-value=0x005139
  diagnostic event EventPowerPath057ShortToBATFailure: aging-allowed=true, event-kind=SWC, prestorage-freeze-frame=false  # Event_Power_Path_057_Short_to_BAT_Failure
  diagnostic event to trouble code uds mapping EventDtcMapPowerPath057ShortToBATFailure: diagnostic-event=EventPowerPath057ShortToBATFailure, trouble-code-uds=Power_Path_057_Short_to_BAT_Failure  # Event_Dtc_Map_Power_Path_057_Short_to_BAT_Failure
  diagnostic event to operation cycle mapping EventOperCycleMapPowerPath057ShortToBATFailure: diagnostic-event=EventPowerPath057ShortToBATFailure, operation-cycle=DefaultOperationCycle  # Event_Oper_Cycle_Map_Power_Path_057_Short_to_BAT_Failure
  diagnostic event to debounce algorithm mapping EventDebounceMapPowerPath057ShortToBATFailure: debounce-algorithm=time_based, diagnostic-event=EventPowerPath057ShortToBATFailure  # EventDebounceMap_Power_Path_057_Short_to_BAT_Failure
package /ZeC/DTC/DTC/LIN_1_Slave_3_NoCommunication
  diagnostic trouble code uds LIN_1_Slave_3_NoCommunication: dtc-props=Dtc_Props_358996c7, uds-dtc-value=0x030112  # LIN 1 Slave 3_NoCommunication
  diagnostic event EventLIN1Slave3NoCommunication: aging-allowed=true, event-kind=SWC, prestorage-freeze-frame=false  # Event_LIN 1 Slave 3_NoCommunication
  diagnostic event to trouble code uds mapping EventDtcMapLIN1Slave3NoCommunication: diagnostic-event=EventLIN1Slave3NoCommunication, trouble-code-uds=LIN_1_Slave_3_NoCommunication  # Event_Dtc_Map_LIN 1 Slave 3_NoCommunication
  diagnostic event to operation cycle mapping EventOperCycleMapLIN1Slave3NoCommunication: diagnostic-event=EventLIN1Slave3NoCommunication, operation-cycle=DefaultOperationCycle  # Event_Oper_Cycle_Map_LIN 1 Slave 3_NoCommunication
  diagnostic event to debounce algorithm mapping EventDebounceMapLIN1Slave3NoCommunication: debounce-algorithm=counter_based, diagnostic-event=EventLIN1Slave3NoCommunication  # EventDebounceMap_LIN 1 Slave 3_NoCommunication
package /ZeC/DTC/DTC/Power_Path_061_Short_to_BAT_Failure
  diagnostic trouble code uds Power_Path_061_Short_to_BAT_Failure: dtc-props=Dtc_Props_4eab47b3, uds-dtc-value=0x00513d
  diagnostic event EventPowerPath061ShortToBATFailure: aging-allowed=true, event-kind=SWC, prestorage-freeze-frame=false  # Event_Power_Path_061_Short_to_BAT_Failure
  diagnostic event to trouble code uds mapping EventDtcMapPowerPath061ShortToBATFailure: diagnostic-event=EventPowerPath061ShortToBATFailure, trouble-code-uds=Power_Path_061_Short_to_BAT_Failure  # Event_Dtc_Map_Power_Path_061_Short_to_BAT_Failure
  diagnostic event to operation cycle mapping EventOperCycleMapPowerPath061ShortToBATFailure: diagnostic-event=EventPowerPath061ShortToBATFailure, operation-cycle=DefaultOperationCycle  # Event_Oper_Cycle_Map_Power_Path_061_Short_to_BAT_Failure
  diagnostic event to debounce algorithm mapping EventDebounceMapPowerPath061ShortToBATFailure: debounce-algorithm=time_based, diagnostic-event=EventPowerPath061ShortToBATFailure  # EventDebounceMap_Power_Path_061_Short_to_BAT_Failure
package /ZeC/DTC/DTC/LIN_1_Slave_3_Defekt
  diagnostic trouble code uds LIN_1_Slave_3_Defekt: dtc-props=Dtc_Props_358996c7, uds-dtc-value=0x030111  # LIN 1 Slave 3_Defekt
  diagnostic event EventLIN1Slave3Defekt: aging-allowed=true, event-kind=SWC, prestorage-freeze-frame=false  # Event_LIN 1 Slave 3_Defekt
  diagnostic event to trouble code uds mapping EventDtcMapLIN1Slave3Defekt: diagnostic-event=EventLIN1Slave3Defekt, trouble-code-uds=LIN_1_Slave_3_Defekt  # Event_Dtc_Map_LIN 1 Slave 3_Defekt
  diagnostic event to operation cycle mapping EventOperCycleMapLIN1Slave3Defekt: diagnostic-event=EventLIN1Slave3Defekt, operation-cycle=DefaultOperationCycle  # Event_Oper_Cycle_Map_LIN 1 Slave 3_Defekt
  diagnostic event to debounce algorithm mapping EventDebounceMapLIN1Slave3Defekt: debounce-algorithm=counter_based, diagnostic-event=EventLIN1Slave3Defekt  # EventDebounceMap_LIN 1 Slave 3_Defekt
package /ZeC/DTC/DTC/Power_Path_060_Short_to_BAT_Failure
  diagnostic trouble code uds Power_Path_060_Short_to_BAT_Failure: dtc-props=Dtc_Props_47957754, uds-dtc-value=0x00513c
  diagnostic event EventPowerPath060ShortToBATFailure: aging-allowed=true, event-kind=SWC, prestorage-freeze-frame=false  # Event_Power_Path_060_Short_to_BAT_Failure
  diagnostic event to trouble code uds mapping EventDtcMapPowerPath060ShortToBATFailure: diagnostic-event=EventPowerPath060ShortToBATFailure, trouble-code-uds=Power_Path_060_Short_to_BAT_Failure  # Event_Dtc_Map_Power_Path_060_Short_to_BAT_Failure
  diagnostic event to operation cycle mapping EventOperCycleMapPowerPath060ShortToBATFailure: diagnostic-event=EventPowerPath060ShortToBATFailure, operation-cycle=DefaultOperationCycle  # Event_Oper_Cycle_Map_Power_Path_060_Short_to_BAT_Failure
  diagnostic event to debounce algorithm mapping EventDebounceMapPowerPath060ShortToBATFailure: debounce-algorithm=time_based, diagnostic-event=EventPowerPath060ShortToBATFailure  # EventDebounceMap_Power_Path_060_Short_to_BAT_Failure
package /ZeC/DTC/DTC/LIN_1_Slave_4_NoCommunication
  diagnostic trouble code uds LIN_1_Slave_4_NoCommunication: dtc-props=Dtc_Props_358996c7, uds-dtc-value=0x030114  # LIN 1 Slave 4_NoCommunication
  diagnostic event EventLIN1Slave4NoCommunication: aging-allowed=true, event-kind=SWC, prestorage-freeze-frame=false  # Event_LIN 1 Slave 4_NoCommunication
  diagnostic event to trouble code uds mapping EventDtcMapLIN1Slave4NoCommunication: diagnostic-event=EventLIN1Slave4NoCommunication, trouble-code-uds=LIN_1_Slave_4_NoCommunication  # Event_Dtc_Map_LIN 1 Slave 4_NoCommunication
  diagnostic event to operation cycle mapping EventOperCycleMapLIN1Slave4NoCommunication: diagnostic-event=EventLIN1Slave4NoCommunication, operation-cycle=DefaultOperationCycle  # Event_Oper_Cycle_Map_LIN 1 Slave 4_NoCommunication
  diagnostic event to debounce algorithm mapping EventDebounceMapLIN1Slave4NoCommunication: debounce-algorithm=counter_based, diagnostic-event=EventLIN1Slave4NoCommunication  # EventDebounceMap_LIN 1 Slave 4_NoCommunication
package /ZeC/DTC/DTC/Power_Path_063_Short_to_BAT_Failure
  diagnostic trouble code uds Power_Path_063_Short_to_BAT_Failure: dtc-props=Dtc_Props_c29953c7, uds-dtc-value=0x00513f
  diagnostic event EventPowerPath063ShortToBATFailure: aging-allowed=true, event-kind=SWC, prestorage-freeze-frame=false  # Event_Power_Path_063_Short_to_BAT_Failure
  diagnostic event to trouble code uds mapping EventDtcMapPowerPath063ShortToBATFailure: diagnostic-event=EventPowerPath063ShortToBATFailure, trouble-code-uds=Power_Path_063_Short_to_BAT_Failure  # Event_Dtc_Map_Power_Path_063_Short_to_BAT_Failure
  diagnostic event to operation cycle mapping EventOperCycleMapPowerPath063ShortToBATFailure: diagnostic-event=EventPowerPath063ShortToBATFailure, operation-cycle=DefaultOperationCycle  # Event_Oper_Cycle_Map_Power_Path_063_Short_to_BAT_Failure
  diagnostic event to debounce algorithm mapping EventDebounceMapPowerPath063ShortToBATFailure: debounce-algorithm=time_based, diagnostic-event=EventPowerPath063ShortToBATFailure  # EventDebounceMap_Power_Path_063_Short_to_BAT_Failure
package /ZeC/DTC/DTC/LIN_1_Slave_4_Defekt
  diagnostic trouble code uds LIN_1_Slave_4_Defekt: dtc-props=Dtc_Props_358996c7, uds-dtc-value=0x030113  # LIN 1 Slave 4_Defekt
  diagnostic event EventLIN1Slave4Defekt: aging-allowed=true, event-kind=SWC, prestorage-freeze-frame=false  # Event_LIN 1 Slave 4_Defekt
  diagnostic event to trouble code uds mapping EventDtcMapLIN1Slave4Defekt: diagnostic-event=EventLIN1Slave4Defekt, trouble-code-uds=LIN_1_Slave_4_Defekt  # Event_Dtc_Map_LIN 1 Slave 4_Defekt
  diagnostic event to operation cycle mapping EventOperCycleMapLIN1Slave4Defekt: diagnostic-event=EventLIN1Slave4Defekt, operation-cycle=DefaultOperationCycle  # Event_Oper_Cycle_Map_LIN 1 Slave 4_Defekt
  diagnostic event to debounce algorithm mapping EventDebounceMapLIN1Slave4Defekt: debounce-algorithm=counter_based, diagnostic-event=EventLIN1Slave4Defekt  # EventDebounceMap_LIN 1 Slave 4_Defekt
package /ZeC/DTC/DTC/Power_Path_062_Short_to_BAT_Failure
  diagnostic trouble code uds Power_Path_062_Short_to_BAT_Failure: dtc-props=Dtc_Props_8b24d89, uds-dtc-value=0x00513e
  diagnostic event EventPowerPath062ShortToBATFailure: aging-allowed=true, event-kind=SWC, prestorage-freeze-frame=false  # Event_Power_Path_062_Short_to_BAT_Failure
  diagnostic event to trouble code uds mapping EventDtcMapPowerPath062ShortToBATFailure: diagnostic-event=EventPowerPath062ShortToBATFailure, trouble-code-uds=Power_Path_062_Short_to_BAT_Failure  # Event_Dtc_Map_Power_Path_062_Short_to_BAT_Failure
  diagnostic event to operation cycle mapping EventOperCycleMapPowerPath062ShortToBATFailure: diagnostic-event=EventPowerPath062ShortToBATFailure, operation-cycle=DefaultOperationCycle  # Event_Oper_Cycle_Map_Power_Path_062_Short_to_BAT_Failure
  diagnostic event to debounce algorithm mapping EventDebounceMapPowerPath062ShortToBATFailure: debounce-algorithm=time_based, diagnostic-event=EventPowerPath062ShortToBATFailure  # EventDebounceMap_Power_Path_062_Short_to_BAT_Failure
package /ZeC/DTC/DTC/LIN_1_Slave_2_NoCommunication
  diagnostic trouble code uds LIN_1_Slave_2_NoCommunication: dtc-props=Dtc_Props_358996c7, uds-dtc-value=0x030110  # LIN 1 Slave 2_NoCommunication
  diagnostic event EventLIN1Slave2NoCommunication: aging-allowed=true, event-kind=SWC, prestorage-freeze-frame=false  # Event_LIN 1 Slave 2_NoCommunication
  diagnostic event to trouble code uds mapping EventDtcMapLIN1Slave2NoCommunication: diagnostic-event=EventLIN1Slave2NoCommunication, trouble-code-uds=LIN_1_Slave_2_NoCommunication  # Event_Dtc_Map_LIN 1 Slave 2_NoCommunication
  diagnostic event to operation cycle mapping EventOperCycleMapLIN1Slave2NoCommunication: diagnostic-event=EventLIN1Slave2NoCommunication, operation-cycle=DefaultOperationCycle  # Event_Oper_Cycle_Map_LIN 1 Slave 2_NoCommunication
  diagnostic event to debounce algorithm mapping EventDebounceMapLIN1Slave2NoCommunication: debounce-algorithm=counter_based, diagnostic-event=EventLIN1Slave2NoCommunication  # EventDebounceMap_LIN 1 Slave 2_NoCommunication
package /ZeC/DTC/DTC/Power_Path_059_Short_to_BAT_Failure
  diagnostic trouble code uds Power_Path_059_Short_to_BAT_Failure: dtc-props=Dtc_Props_18c7d6e, uds-dtc-value=0x00513b
  diagnostic event EventPowerPath059ShortToBATFailure: aging-allowed=true, event-kind=SWC, prestorage-freeze-frame=false  # Event_Power_Path_059_Short_to_BAT_Failure
  diagnostic event to trouble code uds mapping EventDtcMapPowerPath059ShortToBATFailure: diagnostic-event=EventPowerPath059ShortToBATFailure, trouble-code-uds=Power_Path_059_Short_to_BAT_Failure  # Event_Dtc_Map_Power_Path_059_Short_to_BAT_Failure
  diagnostic event to operation cycle mapping EventOperCycleMapPowerPath059ShortToBATFailure: diagnostic-event=EventPowerPath059ShortToBATFailure, operation-cycle=DefaultOperationCycle  # Event_Oper_Cycle_Map_Power_Path_059_Short_to_BAT_Failure
  diagnostic event to debounce algorithm mapping EventDebounceMapPowerPath059ShortToBATFailure: debounce-algorithm=time_based, diagnostic-event=EventPowerPath059ShortToBATFailure  # EventDebounceMap_Power_Path_059_Short_to_BAT_Failure
package /ZeC/DTC/DTC/Power_Path_058_Short_to_BAT_Failure
  diagnostic trouble code uds Power_Path_058_Short_to_BAT_Failure: dtc-props=Dtc_Props_cba76320, uds-dtc-value=0x00513a
  diagnostic event EventPowerPath058ShortToBATFailure: aging-allowed=true, event-kind=SWC, prestorage-freeze-frame=false  # Event_Power_Path_058_Short_to_BAT_Failure
  diagnostic event to trouble code uds mapping EventDtcMapPowerPath058ShortToBATFailure: diagnostic-event=EventPowerPath058ShortToBATFailure, trouble-code-uds=Power_Path_058_Short_to_BAT_Failure  # Event_Dtc_Map_Power_Path_058_Short_to_BAT_Failure
  diagnostic event to operation cycle mapping EventOperCycleMapPowerPath058ShortToBATFailure: diagnostic-event=EventPowerPath058ShortToBATFailure, operation-cycle=DefaultOperationCycle  # Event_Oper_Cycle_Map_Power_Path_058_Short_to_BAT_Failure
  diagnostic event to debounce algorithm mapping EventDebounceMapPowerPath058ShortToBATFailure: debounce-algorithm=time_based, diagnostic-event=EventPowerPath058ShortToBATFailure  # EventDebounceMap_Power_Path_058_Short_to_BAT_Failure
package /ZeC/DTC/DTC/LIN_1_Slave_9_NoCommunication
  diagnostic trouble code uds LIN_1_Slave_9_NoCommunication: dtc-props=Dtc_Props_358996c7, uds-dtc-value=0x03011e  # LIN 1 Slave 9_NoCommunication
  diagnostic event EventLIN1Slave9NoCommunication: aging-allowed=true, event-kind=SWC, prestorage-freeze-frame=false  # Event_LIN 1 Slave 9_NoCommunication
  diagnostic event to trouble code uds mapping EventDtcMapLIN1Slave9NoCommunication: diagnostic-event=EventLIN1Slave9NoCommunication, trouble-code-uds=LIN_1_Slave_9_NoCommunication  # Event_Dtc_Map_LIN 1 Slave 9_NoCommunication
  diagnostic event to operation cycle mapping EventOperCycleMapLIN1Slave9NoCommunication: diagnostic-event=EventLIN1Slave9NoCommunication, operation-cycle=DefaultOperationCycle  # Event_Oper_Cycle_Map_LIN 1 Slave 9_NoCommunication
  diagnostic event to debounce algorithm mapping EventDebounceMapLIN1Slave9NoCommunication: debounce-algorithm=counter_based, diagnostic-event=EventLIN1Slave9NoCommunication  # EventDebounceMap_LIN 1 Slave 9_NoCommunication
package /ZeC/DTC/DTC/LIN_1_Slave_8_Defekt
  diagnostic trouble code uds LIN_1_Slave_8_Defekt: dtc-props=Dtc_Props_358996c7, uds-dtc-value=0x03011b  # LIN 1 Slave 8_Defekt
  diagnostic event EventLIN1Slave8Defekt: aging-allowed=true, event-kind=SWC, prestorage-freeze-frame=false  # Event_LIN 1 Slave 8_Defekt
  diagnostic event to trouble code uds mapping EventDtcMapLIN1Slave8Defekt: diagnostic-event=EventLIN1Slave8Defekt, trouble-code-uds=LIN_1_Slave_8_Defekt  # Event_Dtc_Map_LIN 1 Slave 8_Defekt
  diagnostic event to operation cycle mapping EventOperCycleMapLIN1Slave8Defekt: diagnostic-event=EventLIN1Slave8Defekt, operation-cycle=DefaultOperationCycle  # Event_Oper_Cycle_Map_LIN 1 Slave 8_Defekt
  diagnostic event to debounce algorithm mapping EventDebounceMapLIN1Slave8Defekt: debounce-algorithm=counter_based, diagnostic-event=EventLIN1Slave8Defekt  # EventDebounceMap_LIN 1 Slave 8_Defekt
package /ZeC/DTC/DTC/Power_Path_069_Short_to_BAT_Failure
  diagnostic trouble code uds Power_Path_069_Short_to_BAT_Failure: dtc-props=Dtc_Props_b2a601f, uds-dtc-value=0x005145
  diagnostic event EventPowerPath069ShortToBATFailure: aging-allowed=true, event-kind=SWC, prestorage-freeze-frame=false  # Event_Power_Path_069_Short_to_BAT_Failure
  diagnostic event to trouble code uds mapping EventDtcMapPowerPath069ShortToBATFailure: diagnostic-event=EventPowerPath069ShortToBATFailure, trouble-code-uds=Power_Path_069_Short_to_BAT_Failure  # Event_Dtc_Map_Power_Path_069_Short_to_BAT_Failure
  diagnostic event to operation cycle mapping EventOperCycleMapPowerPath069ShortToBATFailure: diagnostic-event=EventPowerPath069ShortToBATFailure, operation-cycle=DefaultOperationCycle  # Event_Oper_Cycle_Map_Power_Path_069_Short_to_BAT_Failure
  diagnostic event to debounce algorithm mapping EventDebounceMapPowerPath069ShortToBATFailure: debounce-algorithm=time_based, diagnostic-event=EventPowerPath069ShortToBATFailure  # EventDebounceMap_Power_Path_069_Short_to_BAT_Failure
package /ZeC/DTC/DTC/LIN_1_Slave_7_NoCommunication
  diagnostic trouble code uds LIN_1_Slave_7_NoCommunication: dtc-props=Dtc_Props_358996c7, uds-dtc-value=0x03011a  # LIN 1 Slave 7_NoCommunication
  diagnostic event EventLIN1Slave7NoCommunication: aging-allowed=true, event-kind=SWC, prestorage-freeze-frame=false  # Event_LIN 1 Slave 7_NoCommunication
  diagnostic event to trouble code uds mapping EventDtcMapLIN1Slave7NoCommunication: diagnostic-event=EventLIN1Slave7NoCommunication, trouble-code-uds=LIN_1_Slave_7_NoCommunication  # Event_Dtc_Map_LIN 1 Slave 7_NoCommunication
  diagnostic event to operation cycle mapping EventOperCycleMapLIN1Slave7NoCommunication: diagnostic-event=EventLIN1Slave7NoCommunication, operation-cycle=DefaultOperationCycle  # Event_Oper_Cycle_Map_LIN 1 Slave 7_NoCommunication
  diagnostic event to debounce algorithm mapping EventDebounceMapLIN1Slave7NoCommunication: debounce-algorithm=counter_based, diagnostic-event=EventLIN1Slave7NoCommunication  # EventDebounceMap_LIN 1 Slave 7_NoCommunication
package /ZeC/DTC/DTC/Power_Path_068_Short_to_BAT_Failure
  diagnostic trouble code uds Power_Path_068_Short_to_BAT_Failure: dtc-props=Dtc_Props_4d336a25, uds-dtc-value=0x005144
  diagnostic event EventPowerPath068ShortToBATFailure: aging-allowed=true, event-kind=SWC, prestorage-freeze-frame=false  # Event_Power_Path_068_Short_to_BAT_Failure
  diagnostic event to trouble code uds mapping EventDtcMapPowerPath068ShortToBATFailure: diagnostic-event=EventPowerPath068ShortToBATFailure, trouble-code-uds=Power_Path_068_Short_to_BAT_Failure  # Event_Dtc_Map_Power_Path_068_Short_to_BAT_Failure
  diagnostic event to operation cycle mapping EventOperCycleMapPowerPath068ShortToBATFailure: diagnostic-event=EventPowerPath068ShortToBATFailure, operation-cycle=DefaultOperationCycle  # Event_Oper_Cycle_Map_Power_Path_068_Short_to_BAT_Failure
  diagnostic event to debounce algorithm mapping EventDebounceMapPowerPath068ShortToBATFailure: debounce-algorithm=time_based, diagnostic-event=EventPowerPath068ShortToBATFailure  # EventDebounceMap_Power_Path_068_Short_to_BAT_Failure
package /ZeC/DTC/DTC/LIN_1_Slave_9_Defekt
  diagnostic trouble code uds LIN_1_Slave_9_Defekt: dtc-props=Dtc_Props_358996c7, uds-dtc-value=0x03011d  # LIN 1 Slave 9_Defekt
  diagnostic event EventLIN1Slave9Defekt: aging-allowed=true, event-kind=SWC, prestorage-freeze-frame=false  # Event_LIN 1 Slave 9_Defekt
  diagnostic event to trouble code uds mapping EventDtcMapLIN1Slave9Defekt: diagnostic-event=EventLIN1Slave9Defekt, trouble-code-uds=LIN_1_Slave_9_Defekt  # Event_Dtc_Map_LIN 1 Slave 9_Defekt
  diagnostic event to operation cycle mapping EventOperCycleMapLIN1Slave9Defekt: diagnostic-event=EventLIN1Slave9Defekt, operation-cycle=DefaultOperationCycle  # Event_Oper_Cycle_Map_LIN 1 Slave 9_Defekt
  diagnostic event to debounce algorithm mapping EventDebounceMapLIN1Slave9Defekt: debounce-algorithm=counter_based, diagnostic-event=EventLIN1Slave9Defekt  # EventDebounceMap_LIN 1 Slave 9_Defekt
package /ZeC/DTC/DTC/Power_Path_071_Short_to_BAT_Failure
  diagnostic trouble code uds Power_Path_071_Short_to_BAT_Failure: dtc-props=Dtc_Props_8718746b, uds-dtc-value=0x005147
  diagnostic event EventPowerPath071ShortToBATFailure: aging-allowed=true, event-kind=SWC, prestorage-freeze-frame=false  # Event_Power_Path_071_Short_to_BAT_Failure
  diagnostic event to trouble code uds mapping EventDtcMapPowerPath071ShortToBATFailure: diagnostic-event=EventPowerPath071ShortToBATFailure, trouble-code-uds=Power_Path_071_Short_to_BAT_Failure  # Event_Dtc_Map_Power_Path_071_Short_to_BAT_Failure
  diagnostic event to operation cycle mapping EventOperCycleMapPowerPath071ShortToBATFailure: diagnostic-event=EventPowerPath071ShortToBATFailure, operation-cycle=DefaultOperationCycle  # Event_Oper_Cycle_Map_Power_Path_071_Short_to_BAT_Failure
  diagnostic event to debounce algorithm mapping EventDebounceMapPowerPath071ShortToBATFailure: debounce-algorithm=time_based, diagnostic-event=EventPowerPath071ShortToBATFailure  # EventDebounceMap_Power_Path_071_Short_to_BAT_Failure
package /ZeC/DTC/DTC/LIN_1_Slave_8_NoCommunication
  diagnostic trouble code uds LIN_1_Slave_8_NoCommunication: dtc-props=Dtc_Props_358996c7, uds-dtc-value=0x03011c  # LIN 1 Slave 8_NoCommunication
  diagnostic event EventLIN1Slave8NoCommunication: aging-allowed=true, event-kind=SWC, prestorage-freeze-frame=false  # Event_LIN 1 Slave 8_NoCommunication
  diagnostic event to trouble code uds mapping EventDtcMapLIN1Slave8NoCommunication: diagnostic-event=EventLIN1Slave8NoCommunication, trouble-code-uds=LIN_1_Slave_8_NoCommunication  # Event_Dtc_Map_LIN 1 Slave 8_NoCommunication
  diagnostic event to operation cycle mapping EventOperCycleMapLIN1Slave8NoCommunication: diagnostic-event=EventLIN1Slave8NoCommunication, operation-cycle=DefaultOperationCycle  # Event_Oper_Cycle_Map_LIN 1 Slave 8_NoCommunication
  diagnostic event to debounce algorithm mapping EventDebounceMapLIN1Slave8NoCommunication: debounce-algorithm=counter_based, diagnostic-event=EventLIN1Slave8NoCommunication  # EventDebounceMap_LIN 1 Slave 8_NoCommunication
package /ZeC/DTC/DTC/Power_Path_070_Short_to_BAT_Failure
  diagnostic trouble code uds Power_Path_070_Short_to_BAT_Failure: dtc-props=Dtc_Props_c1017e51, uds-dtc-value=0x005146
  diagnostic event EventPowerPath070ShortToBATFailure: aging-allowed=true, event-kind=SWC, prestorage-freeze-frame=false  # Event_Power_Path_070_Short_to_BAT_Failure
  diagnostic event to trouble code uds mapping EventDtcMapPowerPath070ShortToBATFailure: diagnostic-event=EventPowerPath070ShortToBATFailure, trouble-code-uds=Power_Path_070_Short_to_BAT_Failure  # Event_Dtc_Map_Power_Path_070_Short_to_BAT_Failure
  diagnostic event to operation cycle mapping EventOperCycleMapPowerPath070ShortToBATFailure: diagnostic-event=EventPowerPath070ShortToBATFailure, operation-cycle=DefaultOperationCycle  # Event_Oper_Cycle_Map_Power_Path_070_Short_to_BAT_Failure
  diagnostic event to debounce algorithm mapping EventDebounceMapPowerPath070ShortToBATFailure: debounce-algorithm=time_based, diagnostic-event=EventPowerPath070ShortToBATFailure  # EventDebounceMap_Power_Path_070_Short_to_BAT_Failure
package /ZeC/DTC/DTC/Power_Path_065_Short_to_BAT_Failure
  diagnostic trouble code uds Power_Path_065_Short_to_BAT_Failure: dtc-props=Dtc_Props_c83f4eb6, uds-dtc-value=0x005141
  diagnostic event EventPowerPath065ShortToBATFailure: aging-allowed=true, event-kind=SWC, prestorage-freeze-frame=false  # Event_Power_Path_065_Short_to_BAT_Failure
  diagnostic event to trouble code uds mapping EventDtcMapPowerPath065ShortToBATFailure: diagnostic-event=EventPowerPath065ShortToBATFailure, trouble-code-uds=Power_Path_065_Short_to_BAT_Failure  # Event_Dtc_Map_Power_Path_065_Short_to_BAT_Failure
  diagnostic event to operation cycle mapping EventOperCycleMapPowerPath065ShortToBATFailure: diagnostic-event=EventPowerPath065ShortToBATFailure, operation-cycle=DefaultOperationCycle  # Event_Oper_Cycle_Map_Power_Path_065_Short_to_BAT_Failure
  diagnostic event to debounce algorithm mapping EventDebounceMapPowerPath065ShortToBATFailure: debounce-algorithm=time_based, diagnostic-event=EventPowerPath065ShortToBATFailure  # EventDebounceMap_Power_Path_065_Short_to_BAT_Failure
package /ZeC/DTC/DTC/Power_Path_064_Short_to_BAT_Failure
  diagnostic trouble code uds Power_Path_064_Short_to_BAT_Failure: dtc-props=Dtc_Props_8e26448c, uds-dtc-value=0x005140
  diagnostic event EventPowerPath064ShortToBATFailure: aging-allowed=true, event-kind=SWC, prestorage-freeze-frame=false  # Event_Power_Path_064_Short_to_BAT_Failure
  diagnostic event to trouble code uds mapping EventDtcMapPowerPath064ShortToBATFailure: diagnostic-event=EventPowerPath064ShortToBATFailure, trouble-code-uds=Power_Path_064_Short_to_BAT_Failure  # Event_Dtc_Map_Power_Path_064_Short_to_BAT_Failure
  diagnostic event to operation cycle mapping EventOperCycleMapPowerPath064ShortToBATFailure: diagnostic-event=EventPowerPath064ShortToBATFailure, operation-cycle=DefaultOperationCycle  # Event_Oper_Cycle_Map_Power_Path_064_Short_to_BAT_Failure
  diagnostic event to debounce algorithm mapping EventDebounceMapPowerPath064ShortToBATFailure: debounce-algorithm=time_based, diagnostic-event=EventPowerPath064ShortToBATFailure  # EventDebounceMap_Power_Path_064_Short_to_BAT_Failure
package /ZeC/DTC/DTC/Power_Path_067_Short_to_BAT_Failure
  diagnostic trouble code uds Power_Path_067_Short_to_BAT_Failure: dtc-props=Dtc_Props_440d5ac2, uds-dtc-value=0x005143
  diagnostic event EventPowerPath067ShortToBATFailure: aging-allowed=true, event-kind=SWC, prestorage-freeze-frame=false  # Event_Power_Path_067_Short_to_BAT_Failure
  diagnostic event to trouble code uds mapping EventDtcMapPowerPath067ShortToBATFailure: diagnostic-event=EventPowerPath067ShortToBATFailure, trouble-code-uds=Power_Path_067_Short_to_BAT_Failure  # Event_Dtc_Map_Power_Path_067_Short_to_BAT_Failure
  diagnostic event to operation cycle mapping EventOperCycleMapPowerPath067ShortToBATFailure: diagnostic-event=EventPowerPath067ShortToBATFailure, operation-cycle=DefaultOperationCycle  # Event_Oper_Cycle_Map_Power_Path_067_Short_to_BAT_Failure
  diagnostic event to debounce algorithm mapping EventDebounceMapPowerPath067ShortToBATFailure: debounce-algorithm=time_based, diagnostic-event=EventPowerPath067ShortToBATFailure  # EventDebounceMap_Power_Path_067_Short_to_BAT_Failure
package /ZeC/DTC/DTC/Power_Path_066_Short_to_BAT_Failure
  diagnostic trouble code uds Power_Path_066_Short_to_BAT_Failure: dtc-props=Dtc_Props_21450f8, uds-dtc-value=0x005142
  diagnostic event EventPowerPath066ShortToBATFailure: aging-allowed=true, event-kind=SWC, prestorage-freeze-frame=false  # Event_Power_Path_066_Short_to_BAT_Failure
  diagnostic event to trouble code uds mapping EventDtcMapPowerPath066ShortToBATFailure: diagnostic-event=EventPowerPath066ShortToBATFailure, trouble-code-uds=Power_Path_066_Short_to_BAT_Failure  # Event_Dtc_Map_Power_Path_066_Short_to_BAT_Failure
  diagnostic event to operation cycle mapping EventOperCycleMapPowerPath066ShortToBATFailure: diagnostic-event=EventPowerPath066ShortToBATFailure, operation-cycle=DefaultOperationCycle  # Event_Oper_Cycle_Map_Power_Path_066_Short_to_BAT_Failure
  diagnostic event to debounce algorithm mapping EventDebounceMapPowerPath066ShortToBATFailure: debounce-algorithm=time_based, diagnostic-event=EventPowerPath066ShortToBATFailure  # EventDebounceMap_Power_Path_066_Short_to_BAT_Failure
package /ZeC/DTC/DTC/LIN_20_Slave_10_Defect
  diagnostic trouble code uds LIN_20_Slave_10_Defect: dtc-props=Dtc_Props_358996c7, uds-dtc-value=0x031419  # LIN 20 Slave 10_Defect
  diagnostic event EventLIN20Slave10Defect: aging-allowed=true, event-kind=SWC, prestorage-freeze-frame=false  # Event_LIN 20 Slave 10_Defect
  diagnostic event to trouble code uds mapping EventDtcMapLIN20Slave10Defect: diagnostic-event=EventLIN20Slave10Defect, trouble-code-uds=LIN_20_Slave_10_Defect  # Event_Dtc_Map_LIN 20 Slave 10_Defect
  diagnostic event to operation cycle mapping EventOperCycleMapLIN20Slave10Defect: diagnostic-event=EventLIN20Slave10Defect, operation-cycle=DefaultOperationCycle  # Event_Oper_Cycle_Map_LIN 20 Slave 10_Defect
  diagnostic event to debounce algorithm mapping EventDebounceMapLIN20Slave10Defect: debounce-algorithm=counter_based, diagnostic-event=EventLIN20Slave10Defect  # EventDebounceMap_LIN 20 Slave 10_Defect
package /ZeC/DTC/DTC/LIN_20_Slave_1_Defect
  diagnostic trouble code uds LIN_20_Slave_1_Defect: dtc-props=Dtc_Props_358996c7, uds-dtc-value=0x031417  # LIN 20 Slave 1_Defect
  diagnostic event EventLIN20Slave1Defect: aging-allowed=true, event-kind=SWC, prestorage-freeze-frame=false  # Event_LIN 20 Slave 1_Defect
  diagnostic event to trouble code uds mapping EventDtcMapLIN20Slave1Defect: diagnostic-event=EventLIN20Slave1Defect, trouble-code-uds=LIN_20_Slave_1_Defect  # Event_Dtc_Map_LIN 20 Slave 1_Defect
  diagnostic event to operation cycle mapping EventOperCycleMapLIN20Slave1Defect: diagnostic-event=EventLIN20Slave1Defect, operation-cycle=DefaultOperationCycle  # Event_Oper_Cycle_Map_LIN 20 Slave 1_Defect
  diagnostic event to debounce algorithm mapping EventDebounceMapLIN20Slave1Defect: debounce-algorithm=counter_based, diagnostic-event=EventLIN20Slave1Defect  # EventDebounceMap_LIN 20 Slave 1_Defect
package /ZeC/DTC/DTC/Power_Path_106_Short_to_BAT_Failure
  diagnostic trouble code uds Power_Path_106_Short_to_BAT_Failure: dtc-props=Dtc_Props_a224adfa, uds-dtc-value=0x00516a
  diagnostic event EventPowerPath106ShortToBATFailure: aging-allowed=true, event-kind=SWC, prestorage-freeze-frame=false  # Event_Power_Path_106_Short_to_BAT_Failure
  diagnostic event to trouble code uds mapping EventDtcMapPowerPath106ShortToBATFailure: diagnostic-event=EventPowerPath106ShortToBATFailure, trouble-code-uds=Power_Path_106_Short_to_BAT_Failure  # Event_Dtc_Map_Power_Path_106_Short_to_BAT_Failure
  diagnostic event to operation cycle mapping EventOperCycleMapPowerPath106ShortToBATFailure: diagnostic-event=EventPowerPath106ShortToBATFailure, operation-cycle=DefaultOperationCycle  # Event_Oper_Cycle_Map_Power_Path_106_Short_to_BAT_Failure
  diagnostic event to debounce algorithm mapping EventDebounceMapPowerPath106ShortToBATFailure: debounce-algorithm=time_based, diagnostic-event=EventPowerPath106ShortToBATFailure  # EventDebounceMap_Power_Path_106_Short_to_BAT_Failure
package /ZeC/DTC/DTC/LIN_20_Slave_1_NoCommunication
  diagnostic trouble code uds LIN_20_Slave_1_NoCommunication: dtc-props=Dtc_Props_358996c7, uds-dtc-value=0x031418  # LIN 20 Slave 1_NoCommunication
  diagnostic event EventLIN20Slave1NoCommunication: aging-allowed=true, event-kind=SWC, prestorage-freeze-frame=false  # Event_LIN 20 Slave 1_NoCommunication
  diagnostic event to trouble code uds mapping EventDtcMapLIN20Slave1NoCommunication: diagnostic-event=EventLIN20Slave1NoCommunication, trouble-code-uds=LIN_20_Slave_1_NoCommunication  # Event_Dtc_Map_LIN 20 Slave 1_NoCommunication
  diagnostic event to operation cycle mapping EventOperCycleMapLIN20Slave1NoCommunication: diagnostic-event=EventLIN20Slave1NoCommunication, operation-cycle=DefaultOperationCycle  # Event_Oper_Cycle_Map_LIN 20 Slave 1_NoCommunication
  diagnostic event to debounce algorithm mapping EventDebounceMapLIN20Slave1NoCommunication: debounce-algorithm=counter_based, diagnostic-event=EventLIN20Slave1NoCommunication  # EventDebounceMap_LIN 20 Slave 1_NoCommunication
package /ZeC/DTC/DTC/LIN_20_Slave_9_Defect
  diagnostic trouble code uds LIN_20_Slave_9_Defect: dtc-props=Dtc_Props_358996c7, uds-dtc-value=0x031415  # LIN 20 Slave 9_Defect
  diagnostic event EventLIN20Slave9Defect: aging-allowed=true, event-kind=SWC, prestorage-freeze-frame=false  # Event_LIN 20 Slave 9_Defect
  diagnostic event to trouble code uds mapping EventDtcMapLIN20Slave9Defect: diagnostic-event=EventLIN20Slave9Defect, trouble-code-uds=LIN_20_Slave_9_Defect  # Event_Dtc_Map_LIN 20 Slave 9_Defect
  diagnostic event to operation cycle mapping EventOperCycleMapLIN20Slave9Defect: diagnostic-event=EventLIN20Slave9Defect, operation-cycle=DefaultOperationCycle  # Event_Oper_Cycle_Map_LIN 20 Slave 9_Defect
  diagnostic event to debounce algorithm mapping EventDebounceMapLIN20Slave9Defect: debounce-algorithm=counter_based, diagnostic-event=EventLIN20Slave9Defect  # EventDebounceMap_LIN 20 Slave 9_Defect
package /ZeC/DTC/DTC/LIN_20_Slave_9_NoCommunication
  diagnostic trouble code uds LIN_20_Slave_9_NoCommunication: dtc-props=Dtc_Props_358996c7, uds-dtc-value=0x031416  # LIN 20 Slave 9_NoCommunication
  diagnostic event EventLIN20Slave9NoCommunication: aging-allowed=true, event-kind=SWC, prestorage-freeze-frame=false  # Event_LIN 20 Slave 9_NoCommunication
  diagnostic event to trouble code uds mapping EventDtcMapLIN20Slave9NoCommunication: diagnostic-event=EventLIN20Slave9NoCommunication, trouble-code-uds=LIN_20_Slave_9_NoCommunication  # Event_Dtc_Map_LIN 20 Slave 9_NoCommunication
  diagnostic event to operation cycle mapping EventOperCycleMapLIN20Slave9NoCommunication: diagnostic-event=EventLIN20Slave9NoCommunication, operation-cycle=DefaultOperationCycle  # Event_Oper_Cycle_Map_LIN 20 Slave 9_NoCommunication
  diagnostic event to debounce algorithm mapping EventDebounceMapLIN20Slave9NoCommunication: debounce-algorithm=counter_based, diagnostic-event=EventLIN20Slave9NoCommunication  # EventDebounceMap_LIN 20 Slave 9_NoCommunication
package /ZeC/DTC/DTC/LIN_20_Slave_8_Defect
  diagnostic trouble code uds LIN_20_Slave_8_Defect: dtc-props=Dtc_Props_358996c7, uds-dtc-value=0x031413  # LIN 20 Slave 8_Defect
  diagnostic event EventLIN20Slave8Defect: aging-allowed=true, event-kind=SWC, prestorage-freeze-frame=false  # Event_LIN 20 Slave 8_Defect
  diagnostic event to trouble code uds mapping EventDtcMapLIN20Slave8Defect: diagnostic-event=EventLIN20Slave8Defect, trouble-code-uds=LIN_20_Slave_8_Defect  # Event_Dtc_Map_LIN 20 Slave 8_Defect
  diagnostic event to operation cycle mapping EventOperCycleMapLIN20Slave8Defect: diagnostic-event=EventLIN20Slave8Defect, operation-cycle=DefaultOperationCycle  # Event_Oper_Cycle_Map_LIN 20 Slave 8_Defect
  diagnostic event to debounce algorithm mapping EventDebounceMapLIN20Slave8Defect: debounce-algorithm=counter_based, diagnostic-event=EventLIN20Slave8Defect  # EventDebounceMap_LIN 20 Slave 8_Defect
package /ZeC/DTC/DTC/LIN_20_Slave_8_NoCommunication
  diagnostic trouble code uds LIN_20_Slave_8_NoCommunication: dtc-props=Dtc_Props_358996c7, uds-dtc-value=0x031414  # LIN 20 Slave 8_NoCommunication
  diagnostic event EventLIN20Slave8NoCommunication: aging-allowed=true, event-kind=SWC, prestorage-freeze-frame=false  # Event_LIN 20 Slave 8_NoCommunication
  diagnostic event to trouble code uds mapping EventDtcMapLIN20Slave8NoCommunication: diagnostic-event=EventLIN20Slave8NoCommunication, trouble-code-uds=LIN_20_Slave_8_NoCommunication  # Event_Dtc_Map_LIN 20 Slave 8_NoCommunication
  diagnostic event to operation cycle mapping EventOperCycleMapLIN20Slave8NoCommunication: diagnostic-event=EventLIN20Slave8NoCommunication, operation-cycle=DefaultOperationCycle  # Event_Oper_Cycle_Map_LIN 20 Slave 8_NoCommunication
  diagnostic event to debounce algorithm mapping EventDebounceMapLIN20Slave8NoCommunication: debounce-algorithm=counter_based, diagnostic-event=EventLIN20Slave8NoCommunication  # EventDebounceMap_LIN 20 Slave 8_NoCommunication
package /ZeC/DTC/DTC/LIN_20_Slave_7_Defect
  diagnostic trouble code uds LIN_20_Slave_7_Defect: dtc-props=Dtc_Props_358996c7, uds-dtc-value=0x031411  # LIN 20 Slave 7_Defect
  diagnostic event EventLIN20Slave7Defect: aging-allowed=true, event-kind=SWC, prestorage-freeze-frame=false  # Event_LIN 20 Slave 7_Defect
  diagnostic event to trouble code uds mapping EventDtcMapLIN20Slave7Defect: diagnostic-event=EventLIN20Slave7Defect, trouble-code-uds=LIN_20_Slave_7_Defect  # Event_Dtc_Map_LIN 20 Slave 7_Defect
  diagnostic event to operation cycle mapping EventOperCycleMapLIN20Slave7Defect: diagnostic-event=EventLIN20Slave7Defect, operation-cycle=DefaultOperationCycle  # Event_Oper_Cycle_Map_LIN 20 Slave 7_Defect
  diagnostic event to debounce algorithm mapping EventDebounceMapLIN20Slave7Defect: debounce-algorithm=counter_based, diagnostic-event=EventLIN20Slave7Defect  # EventDebounceMap_LIN 20 Slave 7_Defect
package /ZeC/DTC/DTC/LIN_20_Slave_7_NoCommunication
  diagnostic trouble code uds LIN_20_Slave_7_NoCommunication: dtc-props=Dtc_Props_358996c7, uds-dtc-value=0x031412  # LIN 20 Slave 7_NoCommunication
  diagnostic event EventLIN20Slave7NoCommunication: aging-allowed=true, event-kind=SWC, prestorage-freeze-frame=false  # Event_LIN 20 Slave 7_NoCommunication
  diagnostic event to trouble code uds mapping EventDtcMapLIN20Slave7NoCommunication: diagnostic-event=EventLIN20Slave7NoCommunication, trouble-code-uds=LIN_20_Slave_7_NoCommunication  # Event_Dtc_Map_LIN 20 Slave 7_NoCommunication
  diagnostic event to operation cycle mapping EventOperCycleMapLIN20Slave7NoCommunication: diagnostic-event=EventLIN20Slave7NoCommunication, operation-cycle=DefaultOperationCycle  # Event_Oper_Cycle_Map_LIN 20 Slave 7_NoCommunication
  diagnostic event to debounce algorithm mapping EventDebounceMapLIN20Slave7NoCommunication: debounce-algorithm=counter_based, diagnostic-event=EventLIN20Slave7NoCommunication  # EventDebounceMap_LIN 20 Slave 7_NoCommunication
