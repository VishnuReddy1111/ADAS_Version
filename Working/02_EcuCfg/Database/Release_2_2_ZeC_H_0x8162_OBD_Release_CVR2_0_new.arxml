[part 8 of 19: packages /ZeC/DTC/DTC/Power_Path_090_Load_Failure to /ZeC/DTC/DTC/Power_Path_056_Load_Failure]
AUTOSAR XML (schema 00047)
package /ZeC/DTC/DTC/Power_Path_090_Load_Failure
  diagnostic trouble code uds Power_Path_090_Load_Failure: dtc-props=Dtc_Props_338aea73, uds-dtc-value=0x00545a
  diagnostic event EventPowerPath090LoadFailure: aging-allowed=true, event-kind=SWC, prestorage-freeze-frame=false  # Event_Power_Path_090_Load_Failure
  diagnostic event to trouble code uds mapping EventDtcMapPowerPath090LoadFailure: diagnostic-event=EventPowerPath090LoadFailure, trouble-code-uds=Power_Path_090_Load_Failure  # Event_Dtc_Map_Power_Path_090_Load_Failure
  diagnostic event to operation cycle mapping EventOperCycleMapPowerPath090LoadFailure: diagnostic-event=EventPowerPath090LoadFailure, operation-cycle=DefaultOperationCycle  # Event_Oper_Cycle_Map_Power_Path_090_Load_Failure
  diagnostic event to debounce algorithm mapping EventDebounceMapPowerPath090LoadFailure: debounce-algorithm=time_based, diagnostic-event=EventPowerPath090LoadFailure  # EventDebounceMap_Power_Path_090_Load_Failure
package /ZeC/DTC/DTC/Power_Path_095_Load_Failure
  diagnostic trouble code uds Power_Path_095_Load_Failure: dtc-props=Dtc_Props_3ab4da94, uds-dtc-value=0x00545f
  diagnostic event EventPowerPath095LoadFailure: aging-allowed=true, event-kind=SWC, prestorage-freeze-frame=false  # Event_Power_Path_095_Load_Failure
  diagnostic event to trouble code uds mapping EventDtcMapPowerPath095LoadFailure: diagnostic-event=EventPowerPath095LoadFailure, trouble-code-uds=Power_Path_095_Load_Failure  # Event_Dtc_Map_Power_Path_095_Load_Failure
  diagnostic event to operation cycle mapping EventOperCycleMapPowerPath095LoadFailure: diagnostic-event=EventPowerPath095LoadFailure, operation-cycle=DefaultOperationCycle  # Event_Oper_Cycle_Map_Power_Path_095_Load_Failure
  diagnostic event to debounce algorithm mapping EventDebounceMapPowerPath095LoadFailure: debounce-algorithm=time_based, diagnostic-event=EventPowerPath095LoadFailure  # EventDebounceMap_Power_Path_095_Load_Failure
package /ZeC/DTC/DTC/Power_Path_100_Load_Failure
  diagnostic trouble code uds Power_Path_100_Load_Failure: dtc-props=Dtc_Props_1ad7ed14, uds-dtc-value=0x005464
  diagnostic event EventPowerPath100LoadFailure: aging-allowed=true, event-kind=SWC, prestorage-freeze-frame=false  # Event_Power_Path_100_Load_Failure
  diagnostic event to trouble code uds mapping EventDtcMapPowerPath100LoadFailure: diagnostic-event=EventPowerPath100LoadFailure, trouble-code-uds=Power_Path_100_Load_Failure  # Event_Dtc_Map_Power_Path_100_Load_Failure
  diagnostic event to operation cycle mapping EventOperCycleMapPowerPath100LoadFailure: diagnostic-event=EventPowerPath100LoadFailure, operation-cycle=DefaultOperationCycle  # Event_Oper_Cycle_Map_Power_Path_100_Load_Failure
  diagnostic event to debounce algorithm mapping EventDebounceMapPowerPath100LoadFailure: debounce-algorithm=time_based, diagnostic-event=EventPowerPath100LoadFailure  # EventDebounceMap_Power_Path_100_Load_Failure
package /ZeC/DTC/DTC/Power_Path_099_Load_Failure
  diagnostic trouble code uds Power_Path_099_Load_Failure: dtc-props=Dtc_Props_13e9ddf3, uds-dtc-value=0x005463
  diagnostic event EventPowerPath099LoadFailure: aging-allowed=true, event-kind=SWC, prestorage-freeze-frame=false  # Event_Power_Path_099_Load_Failure
  diagnostic event to trouble code uds mapping EventDtcMapPowerPath099LoadFailure: diagnostic-event=EventPowerPath099LoadFailure, trouble-code-uds=Power_Path_099_Load_Failure  # Event_Dtc_Map_Power_Path_099_Load_Failure
  diagnostic event to operation cycle mapping EventOperCycleMapPowerPath099LoadFailure: diagnostic-event=EventPowerPath099LoadFailure, operation-cycle=DefaultOperationCycle  # Event_Oper_Cycle_Map_Power_Path_099_Load_Failure
  diagnostic event to debounce algorithm mapping EventDebounceMapPowerPath099LoadFailure: debounce-algorithm=time_based, diagnostic-event=EventPowerPath099LoadFailure  # EventDebounceMap_Power_Path_099_Load_Failure
package /ZeC/DTC/DTC/Power_Path_102_Load_Failure
  diagnostic trouble code uds Power_Path_102_Load_Failure: dtc-props=Dtc_Props_96e5f960, uds-dtc-value=0x005466
  diagnostic event EventPowerPath102LoadFailure: aging-allowed=true, event-kind=SWC, prestorage-freeze-frame=false  # Event_Power_Path_102_Load_Failure
  diagnostic event to trouble code uds mapping EventDtcMapPowerPath102LoadFailure: diagnostic-event=EventPowerPath102LoadFailure, trouble-code-uds=Power_Path_102_Load_Failure  # Event_Dtc_Map_Power_Path_102_Load_Failure
  diagnostic event to operation cycle mapping EventOperCycleMapPowerPath102LoadFailure: diagnostic-event=EventPowerPath102LoadFailure, operation-cycle=DefaultOperationCycle  # Event_Oper_Cycle_Map_Power_Path_102_Load_Failure
  diagnostic event to debounce algorithm mapping EventDebounceMapPowerPath102LoadFailure: debounce-algorithm=time_based, diagnostic-event=EventPowerPath102LoadFailure  # EventDebounceMap_Power_Path_102_Load_Failure
package /ZeC/DTC/DTC/Power_Path_101_Load_Failure
  diagnostic trouble code uds Power_Path_101_Load_Failure: dtc-props=Dtc_Props_5ccee72e, uds-dtc-value=0x005465
  diagnostic event EventPowerPath101LoadFailure: aging-allowed=true, event-kind=SWC, prestorage-freeze-frame=false  # Event_Power_Path_101_Load_Failure
  diagnostic event to trouble code uds mapping EventDtcMapPowerPath101LoadFailure: diagnostic-event=EventPowerPath101LoadFailure, trouble-code-uds=Power_Path_101_Load_Failure  # Event_Dtc_Map_Power_Path_101_Load_Failure
  diagnostic event to operation cycle mapping EventOperCycleMapPowerPath101LoadFailure: diagnostic-event=EventPowerPath101LoadFailure, operation-cycle=DefaultOperationCycle  # Event_Oper_Cycle_Map_Power_Path_101_Load_Failure
  diagnostic event to debounce algorithm mapping EventDebounceMapPowerPath101LoadFailure: debounce-algorithm=time_based, diagnostic-event=EventPowerPath101LoadFailure  # EventDebounceMap_Power_Path_101_Load_Failure
package /ZeC/DTC/DTC/Power_Path_096_Load_Failure
  diagnostic trouble code uds Power_Path_096_Load_Failure: dtc-props=Dtc_Props_d9c2c3bd, uds-dtc-value=0x005460
  diagnostic event EventPowerPath096LoadFailure: aging-allowed=true, event-kind=SWC, prestorage-freeze-frame=false  # Event_Power_Path_096_Load_Failure
  diagnostic event to trouble code uds mapping EventDtcMapPowerPath096LoadFailure: diagnostic-event=EventPowerPath096LoadFailure, trouble-code-uds=Power_Path_096_Load_Failure  # Event_Dtc_Map_Power_Path_096_Load_Failure
  diagnostic event to operation cycle mapping EventOperCycleMapPowerPath096LoadFailure: diagnostic-event=EventPowerPath096LoadFailure, operation-cycle=DefaultOperationCycle  # Event_Oper_Cycle_Map_Power_Path_096_Load_Failure
  diagnostic event to debounce algorithm mapping EventDebounceMapPowerPath096LoadFailure: debounce-algorithm=time_based, diagnostic-event=EventPowerPath096LoadFailure  # EventDebounceMap_Power_Path_096_Load_Failure
package /ZeC/DTC/DTC/Power_Path_098_Load_Failure
  diagnostic trouble code uds Power_Path_098_Load_Failure: dtc-props=Dtc_Props_55f0d7c9, uds-dtc-value=0x005462
  diagnostic event EventPowerPath098LoadFailure: aging-allowed=true, event-kind=SWC, prestorage-freeze-frame=false  # Event_Power_Path_098_Load_Failure
  diagnostic event to trouble code uds mapping EventDtcMapPowerPath098LoadFailure: diagnostic-event=EventPowerPath098LoadFailure, trouble-code-uds=Power_Path_098_Load_Failure  # Event_Dtc_Map_Power_Path_098_Load_Failure
  diagnostic event to operation cycle mapping EventOperCycleMapPowerPath098LoadFailure: diagnostic-event=EventPowerPath098LoadFailure, operation-cycle=DefaultOperationCycle  # Event_Oper_Cycle_Map_Power_Path_098_Load_Failure
  diagnostic event to debounce algorithm mapping EventDebounceMapPowerPath098LoadFailure: debounce-algorithm=time_based, diagnostic-event=EventPowerPath098LoadFailure  # EventDebounceMap_Power_Path_098_Load_Failure
package /ZeC/DTC/DTC/Power_Path_097_Load_Failure
  diagnostic trouble code uds Power_Path_097_Load_Failure: dtc-props=Dtc_Props_9fdbc987, uds-dtc-value=0x005461
  diagnostic event EventPowerPath097LoadFailure: aging-allowed=true, event-kind=SWC, prestorage-freeze-frame=false  # Event_Power_Path_097_Load_Failure
  diagnostic event to trouble code uds mapping EventDtcMapPowerPath097LoadFailure: diagnostic-event=EventPowerPath097LoadFailure, trouble-code-uds=Power_Path_097_Load_Failure  # Event_Dtc_Map_Power_Path_097_Load_Failure
  diagnostic event to operation cycle mapping EventOperCycleMapPowerPath097LoadFailure: diagnostic-event=EventPowerPath097LoadFailure, operation-cycle=DefaultOperationCycle  # Event_Oper_Cycle_Map_Power_Path_097_Load_Failure
  diagnostic event to debounce algorithm mapping EventDebounceMapPowerPath097LoadFailure: debounce-algorithm=time_based, diagnostic-event=EventPowerPath097LoadFailure  # EventDebounceMap_Power_Path_097_Load_Failure
package /ZeC/DTC/DTC/LIN_4_Slave_5_Defect
  diagnostic trouble code uds LIN_4_Slave_5_Defect: dtc-props=Dtc_Props_358996c7, uds-dtc-value=0x030406  # LIN 4 Slave 5_Defect
  diagnostic event EventLIN4Slave5Defect: aging-allowed=true, event-kind=SWC, prestorage-freeze-frame=false  # Event_LIN 4 Slave 5_Defect
  diagnostic event to trouble code uds mapping EventDtcMapLIN4Slave5Defect: diagnostic-event=EventLIN4Slave5Defect, trouble-code-uds=LIN_4_Slave_5_Defect  # Event_Dtc_Map_LIN 4 Slave 5_Defect
  diagnostic event to operation cycle mapping EventOperCycleMapLIN4Slave5Defect: diagnostic-event=EventLIN4Slave5Defect, operation-cycle=DefaultOperationCycle  # Event_Oper_Cycle_Map_LIN 4 Slave 5_Defect
  diagnostic event to debounce algorithm mapping EventDebounceMapLIN4Slave5Defect: debounce-algorithm=counter_based, diagnostic-event=EventLIN4Slave5Defect  # EventDebounceMap_LIN 4 Slave 5_Defect
package /ZeC/DTC/DTC/LIN_4_Slave_4_NoCommunication
  diagnostic trouble code uds LIN_4_Slave_4_NoCommunication: dtc-props=Dtc_Props_358996c7, uds-dtc-value=0x030405  # LIN 4 Slave 4_NoCommunication
  diagnostic event EventLIN4Slave4NoCommunication: aging-allowed=true, event-kind=SWC, prestorage-freeze-frame=false  # Event_LIN 4 Slave 4_NoCommunication
  diagnostic event to trouble code uds mapping EventDtcMapLIN4Slave4NoCommunication: diagnostic-event=EventLIN4Slave4NoCommunication, trouble-code-uds=LIN_4_Slave_4_NoCommunication  # Event_Dtc_Map_LIN 4 Slave 4_NoCommunication
  diagnostic event to operation cycle mapping EventOperCycleMapLIN4Slave4NoCommunication: diagnostic-event=EventLIN4Slave4NoCommunication, operation-cycle=DefaultOperationCycle  # Event_Oper_Cycle_Map_LIN 4 Slave 4_NoCommunication
  diagnostic event to debounce algorithm mapping EventDebounceMapLIN4Slave4NoCommunication: debounce-algorithm=counter_based, diagnostic-event=EventLIN4Slave4NoCommunication  # EventDebounceMap_LIN 4 Slave 4_NoCommunication
package /ZeC/DTC/DTC/LIN_4_Slave_6_Defect
  diagnostic trouble code uds LIN_4_Slave_6_Defect: dtc-props=Dtc_Props_358996c7, uds-dtc-value=0x030408  # LIN 4 Slave 6_Defect
  diagnostic event EventLIN4Slave6Defect: aging-allowed=true, event-kind=SWC, prestorage-freeze-frame=false  # Event_LIN 4 Slave 6_Defect
  diagnostic event to trouble code uds mapping EventDtcMapLIN4Slave6Defect: diagnostic-event=EventLIN4Slave6Defect, trouble-code-uds=LIN_4_Slave_6_Defect  # Event_Dtc_Map_LIN 4 Slave 6_Defect
  diagnostic event to operation cycle mapping EventOperCycleMapLIN4Slave6Defect: diagnostic-event=EventLIN4Slave6Defect, operation-cycle=DefaultOperationCycle  # Event_Oper_Cycle_Map_LIN 4 Slave 6_Defect
  diagnostic event to debounce algorithm mapping EventDebounceMapLIN4Slave6Defect: debounce-algorithm=counter_based, diagnostic-event=EventLIN4Slave6Defect  # EventDebounceMap_LIN 4 Slave 6_Defect
package /ZeC/DTC/DTC/LIN_14_Slave_4_NoCommunication
  diagnostic trouble code uds LIN_14_Slave_4_NoCommunication: dtc-props=Dtc_Props_358996c7, uds-dtc-value=0x030e1e  # LIN 14 Slave 4_NoCommunication
  diagnostic event EventLIN14Slave4NoCommunication: aging-allowed=true, event-kind=SWC, prestorage-freeze-frame=false  # Event_LIN 14 Slave 4_NoCommunication
  diagnostic event to trouble code uds mapping EventDtcMapLIN14Slave4NoCommunication: diagnostic-event=EventLIN14Slave4NoCommunication, trouble-code-uds=LIN_14_Slave_4_NoCommunication  # Event_Dtc_Map_LIN 14 Slave 4_NoCommunication
  diagnostic event to operation cycle mapping EventOperCycleMapLIN14Slave4NoCommunication: diagnostic-event=EventLIN14Slave4NoCommunication, operation-cycle=DefaultOperationCycle  # Event_Oper_Cycle_Map_LIN 14 Slave 4_NoCommunication
  diagnostic event to debounce algorithm mapping EventDebounceMapLIN14Slave4NoCommunication: debounce-algorithm=counter_based, diagnostic-event=EventLIN14Slave4NoCommunication  # EventDebounceMap_LIN 14 Slave 4_NoCommunication
package /ZeC/DTC/DTC/LIN_4_Slave_5_NoCommunication
  diagnostic trouble code uds LIN_4_Slave_5_NoCommunication: dtc-props=Dtc_Props_358996c7, uds-dtc-value=0x030407  # LIN 4 Slave 5_NoCommunication
  diagnostic event EventLIN4Slave5NoCommunication: aging-allowed=true, event-kind=SWC, prestorage-freeze-frame=false  # Event_LIN 4 Slave 5_NoCommunication
  diagnostic event to trouble code uds mapping EventDtcMapLIN4Slave5NoCommunication: diagnostic-event=EventLIN4Slave5NoCommunication, trouble-code-uds=LIN_4_Slave_5_NoCommunication  # Event_Dtc_Map_LIN 4 Slave 5_NoCommunication
  diagnostic event to operation cycle mapping EventOperCycleMapLIN4Slave5NoCommunication: diagnostic-event=EventLIN4Slave5NoCommunication, operation-cycle=DefaultOperationCycle  # Event_Oper_Cycle_Map_LIN 4 Slave 5_NoCommunication
  diagnostic event to debounce algorithm mapping EventDebounceMapLIN4Slave5NoCommunication: debounce-algorithm=counter_based, diagnostic-event=EventLIN4Slave5NoCommunication  # EventDebounceMap_LIN 4 Slave 5_NoCommunication
package /ZeC/DTC/DTC/LIN_4_Slave_3_Defect
  diagnostic trouble code uds LIN_4_Slave_3_Defect: dtc-props=Dtc_Props_358996c7, uds-dtc-value=0x030402  # LIN 4 Slave 3_Defect
  diagnostic event EventLIN4Slave3Defect: aging-allowed=true, event-kind=SWC, prestorage-freeze-frame=false  # Event_LIN 4 Slave 3_Defect
  diagnostic event to trouble code uds mapping EventDtcMapLIN4Slave3Defect: diagnostic-event=EventLIN4Slave3Defect, trouble-code-uds=LIN_4_Slave_3_Defect  # Event_Dtc_Map_LIN 4 Slave 3_Defect
  diagnostic event to operation cycle mapping EventOperCycleMapLIN4Slave3Defect: diagnostic-event=EventLIN4Slave3Defect, operation-cycle=DefaultOperationCycle  # Event_Oper_Cycle_Map_LIN 4 Slave 3_Defect
  diagnostic event to debounce algorithm mapping EventDebounceMapLIN4Slave3Defect: debounce-algorithm=counter_based, diagnostic-event=EventLIN4Slave3Defect  # EventDebounceMap_LIN 4 Slave 3_Defect
package /ZeC/DTC/DTC/LIN_14_Slave_3_NoCommunication
  diagnostic trouble code uds LIN_14_Slave_3_NoCommunication: dtc-props=Dtc_Props_358996c7, uds-dtc-value=0x030e1c  # LIN 14 Slave 3_NoCommunication
  diagnostic event EventLIN14Slave3NoCommunication: aging-allowed=true, event-kind=SWC, prestorage-freeze-frame=false  # Event_LIN 14 Slave 3_NoCommunication
  diagnostic event to trouble code uds mapping EventDtcMapLIN14Slave3NoCommunication: diagnostic-event=EventLIN14Slave3NoCommunication, trouble-code-uds=LIN_14_Slave_3_NoCommunication  # Event_Dtc_Map_LIN 14 Slave 3_NoCommunication
  diagnostic event to operation cycle mapping EventOperCycleMapLIN14Slave3NoCommunication: diagnostic-event=EventLIN14Slave3NoCommunication, operation-cycle=DefaultOperationCycle  # Event_Oper_Cycle_Map_LIN 14 Slave 3_NoCommunication
  diagnostic event to debounce algorithm mapping EventDebounceMapLIN14Slave3NoCommunication: debounce-algorithm=counter_based, diagnostic-event=EventLIN14Slave3NoCommunication  # EventDebounceMap_LIN 14 Slave 3_NoCommunication
package /ZeC/DTC/DTC/LIN_4_Slave_2_NoCommunication
  diagnostic trouble code uds LIN_4_Slave_2_NoCommunication: dtc-props=Dtc_Props_358996c7, uds-dtc-value=0x030401  # LIN 4 Slave 2_NoCommunication
  diagnostic event EventLIN4Slave2NoCommunication: aging-allowed=true, event-kind=SWC, prestorage-freeze-frame=false  # Event_LIN 4 Slave 2_NoCommunication
  diagnostic event to trouble code uds mapping EventDtcMapLIN4Slave2NoCommunication: diagnostic-event=EventLIN4Slave2NoCommunication, trouble-code-uds=LIN_4_Slave_2_NoCommunication  # Event_Dtc_Map_LIN 4 Slave 2_NoCommunication
  diagnostic event to operation cycle mapping EventOperCycleMapLIN4Slave2NoCommunication: diagnostic-event=EventLIN4Slave2NoCommunication, operation-cycle=DefaultOperationCycle  # Event_Oper_Cycle_Map_LIN 4 Slave 2_NoCommunication
  diagnostic event to debounce algorithm mapping EventDebounceMapLIN4Slave2NoCommunication: debounce-algorithm=counter_based, diagnostic-event=EventLIN4Slave2NoCommunication  # EventDebounceMap_LIN 4 Slave 2_NoCommunication
package /ZeC/DTC/DTC/LIN_14_Slave_4_Defect
  diagnostic trouble code uds LIN_14_Slave_4_Defect: dtc-props=Dtc_Props_358996c7, uds-dtc-value=0x030e1d  # LIN 14 Slave 4_Defect
  diagnostic event EventLIN14Slave4Defect: aging-allowed=true, event-kind=SWC, prestorage-freeze-frame=false  # Event_LIN 14 Slave 4_Defect
  diagnostic event to trouble code uds mapping EventDtcMapLIN14Slave4Defect: diagnostic-event=EventLIN14Slave4Defect, trouble-code-uds=LIN_14_Slave_4_Defect  # Event_Dtc_Map_LIN 14 Slave 4_Defect
  diagnostic event to operation cycle mapping EventOperCycleMapLIN14Slave4Defect: diagnostic-event=EventLIN14Slave4Defect, operation-cycle=DefaultOperationCycle  # Event_Oper_Cycle_Map_LIN 14 Slave 4_Defect
  diagnostic event to debounce algorithm mapping EventDebounceMapLIN14Slave4Defect: debounce-algorithm=counter_based, diagnostic-event=EventLIN14Slave4Defect  # EventDebounceMap_LIN 14 Slave 4_Defect
package /ZeC/DTC/DTC/Power_Path_137_Load_Failure
  diagnostic trouble code uds Power_Path_137_Load_Failure: dtc-props=Dtc_Props_be4e0142, uds-dtc-value=0x005489
  diagnostic event EventPowerPath137LoadFailure: aging-allowed=true, event-kind=SWC, prestorage-freeze-frame=false  # Event_Power_Path_137_Load_Failure
  diagnostic event to trouble code uds mapping EventDtcMapPowerPath137LoadFailure: diagnostic-event=EventPowerPath137LoadFailure, trouble-code-uds=Power_Path_137_Load_Failure  # Event_Dtc_Map_Power_Path_137_Load_Failure
  diagnostic event to operation cycle mapping EventOperCycleMapPowerPath137LoadFailure: diagnostic-event=EventPowerPath137LoadFailure, operation-cycle=DefaultOperationCycle  # Event_Oper_Cycle_Map_Power_Path_137_Load_Failure
  diagnostic event to debounce algorithm mapping EventDebounceMapPowerPath137LoadFailure: debounce-algorithm=time_based, diagnostic-event=EventPowerPath137LoadFailure  # EventDebounceMap_Power_Path_137_Load_Failure
package /ZeC/DTC/DTC/LIN_4_Slave_4_Defect
  diagnostic trouble code uds LIN_4_Slave_4_Defect: dtc-props=Dtc_Props_358996c7, uds-dtc-value=0x030404  # LIN 4 Slave 4_Defect
  diagnostic event EventLIN4Slave4Defect: aging-allowed=true, event-kind=SWC, prestorage-freeze-frame=false  # Event_LIN 4 Slave 4_Defect
  diagnostic event to trouble code uds mapping EventDtcMapLIN4Slave4Defect: diagnostic-event=EventLIN4Slave4Defect, trouble-code-uds=LIN_4_Slave_4_Defect  # Event_Dtc_Map_LIN 4 Slave 4_Defect
  diagnostic event to operation cycle mapping EventOperCycleMapLIN4Slave4Defect: diagnostic-event=EventLIN4Slave4Defect, operation-cycle=DefaultOperationCycle  # Event_Oper_Cycle_Map_LIN 4 Slave 4_Defect
  diagnostic event to debounce algorithm mapping EventDebounceMapLIN4Slave4Defect: debounce-algorithm=counter_based, diagnostic-event=EventLIN4Slave4Defect  # EventDebounceMap_LIN 4 Slave 4_Defect
package /ZeC/DTC/DTC/LIN_14_Slave_2_NoCommunication
  diagnostic trouble code uds LIN_14_Slave_2_NoCommunication: dtc-props=Dtc_Props_358996c7, uds-dtc-value=0x030e1a  # LIN 14 Slave 2_NoCommunication
  diagnostic event EventLIN14Slave2NoCommunication: aging-allowed=true, event-kind=SWC, prestorage-freeze-frame=false  # Event_LIN 14 Slave 2_NoCommunication
  diagnostic event to trouble code uds mapping EventDtcMapLIN14Slave2NoCommunication: diagnostic-event=EventLIN14Slave2NoCommunication, trouble-code-uds=LIN_14_Slave_2_NoCommunication  # Event_Dtc_Map_LIN 14 Slave 2_NoCommunication
  diagnostic event to operation cycle mapping EventOperCycleMapLIN14Slave2NoCommunication: diagnostic-event=EventLIN14Slave2NoCommunication, operation-cycle=DefaultOperationCycle  # Event_Oper_Cycle_Map_LIN 14 Slave 2_NoCommunication
  diagnostic event to debounce algorithm mapping EventDebounceMapLIN14Slave2NoCommunication: debounce-algorithm=counter_based, diagnostic-event=EventLIN14Slave2NoCommunication  # EventDebounceMap_LIN 14 Slave 2_NoCommunication
package /ZeC/DTC/DTC/LIN_4_Slave_3_NoCommunication
  diagnostic trouble code uds LIN_4_Slave_3_NoCommunication: dtc-props=Dtc_Props_358996c7, uds-dtc-value=0x030403  # LIN 4 Slave 3_NoCommunication
  diagnostic event EventLIN4Slave3NoCommunication: aging-allowed=true, event-kind=SWC, prestorage-freeze-frame=false  # Event_LIN 4 Slave 3_NoCommunication
  diagnostic event to trouble code uds mapping EventDtcMapLIN4Slave3NoCommunication: diagnostic-event=EventLIN4Slave3NoCommunication, trouble-code-uds=LIN_4_Slave_3_NoCommunication  # Event_Dtc_Map_LIN 4 Slave 3_NoCommunication
  diagnostic event to operation cycle mapping EventOperCycleMapLIN4Slave3NoCommunication: diagnostic-event=EventLIN4Slave3NoCommunication, operation-cycle=DefaultOperationCycle  # Event_Oper_Cycle_Map_LIN 4 Slave 3_NoCommunication
  diagnostic event to debounce algorithm mapping EventDebounceMapLIN4Slave3NoCommunication: debounce-algorithm=counter_based, diagnostic-event=EventLIN4Slave3NoCommunication  # EventDebounceMap_LIN 4 Slave 3_NoCommunication
package /ZeC/DTC/DTC/LIN_14_Slave_3_Defect
  diagnostic trouble code uds LIN_14_Slave_3_Defect: dtc-props=Dtc_Props_358996c7, uds-dtc-value=0x030e1b  # LIN 14 Slave 3_Defect
  diagnostic event EventLIN14Slave3Defect: aging-allowed=true, event-kind=SWC, prestorage-freeze-frame=false  # Event_LIN 14 Slave 3_Defect
  diagnostic event to trouble code uds mapping EventDtcMapLIN14Slave3Defect: diagnostic-event=EventLIN14Slave3Defect, trouble-code-uds=LIN_14_Slave_3_Defect  # Event_Dtc_Map_LIN 14 Slave 3_Defect
  diagnostic event to operation cycle mapping EventOperCycleMapLIN14Slave3Defect: diagnostic-event=EventLIN14Slave3Defect, operation-cycle=DefaultOperationCycle  # Event_Oper_Cycle_Map_LIN 14 Slave 3_Defect
  diagnostic event to debounce algorithm mapping EventDebounceMapLIN14Slave3Defect: debounce-algorithm=counter_based, diagnostic-event=EventLIN14Slave3Defect  # EventDebounceMap_LIN 14 Slave 3_Defect
package /ZeC/DTC/DTC/Power_Path_143_Load_Failure
  diagnostic trouble code uds Power_Path_143_Load_Failure: dtc-props=Dtc_Props_d7d40ecb, uds-dtc-value=0x00548f
  diagnostic event EventPowerPath143LoadFailure: aging-allowed=true, event-kind=SWC, prestorage-freeze-frame=false  # Event_Power_Path_143_Load_Failure
  diagnostic event to trouble code uds mapping EventDtcMapPowerPath143LoadFailure: diagnostic-event=EventPowerPath143LoadFailure, trouble-code-uds=Power_Path_143_Load_Failure  # Event_Dtc_Map_Power_Path_143_Load_Failure
  diagnostic event to operation cycle mapping EventOperCycleMapPowerPath143LoadFailure: diagnostic-event=EventPowerPath143LoadFailure, operation-cycle=DefaultOperationCycle  # Event_Oper_Cycle_Map_Power_Path_143_Load_Failure
  diagnostic event to debounce algorithm mapping EventDebounceMapPowerPath143LoadFailure: debounce-algorithm=time_based, diagnostic-event=EventPowerPath143LoadFailure  # EventDebounceMap_Power_Path_143_Load_Failure
package /ZeC/DTC/DTC/Power_Path_142_Load_Failure
  diagnostic trouble code uds Power_Path_142_Load_Failure: dtc-props=Dtc_Props_1dff1085, uds-dtc-value=0x00548e
  diagnostic event EventPowerPath142LoadFailure: aging-allowed=true, event-kind=SWC, prestorage-freeze-frame=false  # Event_Power_Path_142_Load_Failure
  diagnostic event to trouble code uds mapping EventDtcMapPowerPath142LoadFailure: diagnostic-event=EventPowerPath142LoadFailure, trouble-code-uds=Power_Path_142_Load_Failure  # Event_Dtc_Map_Power_Path_142_Load_Failure
  diagnostic event to operation cycle mapping EventOperCycleMapPowerPath142LoadFailure: diagnostic-event=EventPowerPath142LoadFailure, operation-cycle=DefaultOperationCycle  # Event_Oper_Cycle_Map_Power_Path_142_Load_Failure
  diagnostic event to debounce algorithm mapping EventDebounceMapPowerPath142LoadFailure: debounce-algorithm=time_based, diagnostic-event=EventPowerPath142LoadFailure  # EventDebounceMap_Power_Path_142_Load_Failure
package /ZeC/DTC/DTC/Power_Path_139_Load_Failure
  diagnostic trouble code uds Power_Path_139_Load_Failure: dtc-props=Dtc_Props_14c12062, uds-dtc-value=0x00548b
  diagnostic event EventPowerPath139LoadFailure: aging-allowed=true, event-kind=SWC, prestorage-freeze-frame=false  # Event_Power_Path_139_Load_Failure
  diagnostic event to trouble code uds mapping EventDtcMapPowerPath139LoadFailure: diagnostic-event=EventPowerPath139LoadFailure, trouble-code-uds=Power_Path_139_Load_Failure  # Event_Dtc_Map_Power_Path_139_Load_Failure
  diagnostic event to operation cycle mapping EventOperCycleMapPowerPath139LoadFailure: diagnostic-event=EventPowerPath139LoadFailure, operation-cycle=DefaultOperationCycle  # Event_Oper_Cycle_Map_Power_Path_139_Load_Failure
  diagnostic event to debounce algorithm mapping EventDebounceMapPowerPath139LoadFailure: debounce-algorithm=time_based, diagnostic-event=EventPowerPath139LoadFailure  # EventDebounceMap_Power_Path_139_Load_Failure
package /ZeC/DTC/DTC/Power_Path_138_Load_Failure
  diagnostic trouble code uds Power_Path_138_Load_Failure: dtc-props=Dtc_Props_deea3e2c, uds-dtc-value=0x00548a
  diagnostic event EventPowerPath138LoadFailure: aging-allowed=true, event-kind=SWC, prestorage-freeze-frame=false  # Event_Power_Path_138_Load_Failure
  diagnostic event to trouble code uds mapping EventDtcMapPowerPath138LoadFailure: diagnostic-event=EventPowerPath138LoadFailure, trouble-code-uds=Power_Path_138_Load_Failure  # Event_Dtc_Map_Power_Path_138_Load_Failure
  diagnostic event to operation cycle mapping EventOperCycleMapPowerPath138LoadFailure: diagnostic-event=EventPowerPath138LoadFailure, operation-cycle=DefaultOperationCycle  # Event_Oper_Cycle_Map_Power_Path_138_Load_Failure
  diagnostic event to debounce algorithm mapping EventDebounceMapPowerPath138LoadFailure: debounce-algorithm=time_based, diagnostic-event=EventPowerPath138LoadFailure  # EventDebounceMap_Power_Path_138_Load_Failure
package /ZeC/DTC/DTC/LIN_14_Slave_2_Defect
  diagnostic trouble code uds LIN_14_Slave_2_Defect: dtc-props=Dtc_Props_358996c7, uds-dtc-value=0x030e19  # LIN 14 Slave 2_Defect
  diagnostic event EventLIN14Slave2Defect: aging-allowed=true, event-kind=SWC, prestorage-freeze-frame=false  # Event_LIN 14 Slave 2_Defect
  diagnostic event to trouble code uds mapping EventDtcMapLIN14Slave2Defect: diagnostic-event=EventLIN14Slave2Defect, trouble-code-uds=LIN_14_Slave_2_Defect  # Event_Dtc_Map_LIN 14 Slave 2_Defect
  diagnostic event to operation cycle mapping EventOperCycleMapLIN14Slave2Defect: diagnostic-event=EventLIN14Slave2Defect, operation-cycle=DefaultOperationCycle  # Event_Oper_Cycle_Map_LIN 14 Slave 2_Defect
  diagnostic event to debounce algorithm mapping EventDebounceMapLIN14Slave2Defect: debounce-algorithm=counter_based, diagnostic-event=EventLIN14Slave2Defect  # EventDebounceMap_LIN 14 Slave 2_Defect
package /ZeC/DTC/DTC/Power_Path_141_Load_Failure
  diagnostic trouble code uds Power_Path_141_Load_Failure: dtc-props=Dtc_Props_5be61abf, uds-dtc-value=0x00548d
  diagnostic event EventPowerPath141LoadFailure: aging-allowed=true, event-kind=SWC, prestorage-freeze-frame=false  # Event_Power_Path_141_Load_Failure
  diagnostic event to trouble code uds mapping EventDtcMapPowerPath141LoadFailure: diagnostic-event=EventPowerPath141LoadFailure, trouble-code-uds=Power_Path_141_Load_Failure  # Event_Dtc_Map_Power_Path_141_Load_Failure
  diagnostic event to operation cycle mapping EventOperCycleMapPowerPath141LoadFailure: diagnostic-event=EventPowerPath141LoadFailure, operation-cycle=DefaultOperationCycle  # Event_Oper_Cycle_Map_Power_Path_141_Load_Failure
  diagnostic event to debounce algorithm mapping EventDebounceMapPowerPath141LoadFailure: debounce-algorithm=time_based, diagnostic-event=EventPowerPath141LoadFailure  # EventDebounceMap_Power_Path_141_Load_Failure
package /ZeC/DTC/DTC/Power_Path_140_Load_Failure
  diagnostic trouble code uds Power_Path_140_Load_Failure: dtc-props=Dtc_Props_52d82a58, uds-dtc-value=0x00548c
  diagnostic event EventPowerPath140LoadFailure: aging-allowed=true, event-kind=SWC, prestorage-freeze-frame=false  # Event_Power_Path_140_Load_Failure
  diagnostic event to trouble code uds mapping EventDtcMapPowerPath140LoadFailure: diagnostic-event=EventPowerPath140LoadFailure, trouble-code-uds=Power_Path_140_Load_Failure  # Event_Dtc_Map_Power_Path_140_Load_Failure
  diagnostic event to operation cycle mapping EventOperCycleMapPowerPath140LoadFailure: diagnostic-event=EventPowerPath140LoadFailure, operation-cycle=DefaultOperationCycle  # Event_Oper_Cycle_Map_Power_Path_140_Load_Failure
  diagnostic event to debounce algorithm mapping EventDebounceMapPowerPath140LoadFailure: debounce-algorithm=time_based, diagnostic-event=EventPowerPath140LoadFailure  # EventDebounceMap_Power_Path_140_Load_Failure
package /ZeC/DTC/DTC/LIN_4_Slave_9_NoCommunication
  diagnostic trouble code uds LIN_4_Slave_9_NoCommunication: dtc-props=Dtc_Props_358996c7, uds-dtc-value=0x03040f  # LIN 4 Slave 9_NoCommunication
  diagnostic event EventLIN4Slave9NoCommunication: aging-allowed=true, event-kind=SWC, prestorage-freeze-frame=false  # Event_LIN 4 Slave 9_NoCommunication
  diagnostic event to trouble code uds mapping EventDtcMapLIN4Slave9NoCommunication: diagnostic-event=EventLIN4Slave9NoCommunication, trouble-code-uds=LIN_4_Slave_9_NoCommunication  # Event_Dtc_Map_LIN 4 Slave 9_NoCommunication
  diagnostic event to operation cycle mapping EventOperCycleMapLIN4Slave9NoCommunication: diagnostic-event=EventLIN4Slave9NoCommunication, operation-cycle=DefaultOperationCycle  # Event_Oper_Cycle_Map_LIN 4 Slave 9_NoCommunication
  diagnostic event to debounce algorithm mapping EventDebounceMapLIN4Slave9NoCommunication: debounce-algorithm=counter_based, diagnostic-event=EventLIN4Slave9NoCommunication  # EventDebounceMap_LIN 4 Slave 9_NoCommunication
package /ZeC/DTC/DTC/LIN_4_Slave_9_Defect
  diagnostic trouble code uds LIN_4_Slave_9_Defect: dtc-props=Dtc_Props_358996c7, uds-dtc-value=0x03040e  # LIN 4 Slave 9_Defect
  diagnostic event EventLIN4Slave9Defect: aging-allowed=true, event-kind=SWC, prestorage-freeze-frame=false  # Event_LIN 4 Slave 9_Defect
  diagnostic event to trouble code uds mapping EventDtcMapLIN4Slave9Defect: diagnostic-event=EventLIN4Slave9Defect, trouble-code-uds=LIN_4_Slave_9_Defect  # Event_Dtc_Map_LIN 4 Slave 9_Defect
  diagnostic event to operation cycle mapping EventOperCycleMapLIN4Slave9Defect: diagnostic-event=EventLIN4Slave9Defect, operation-cycle=DefaultOperationCycle  # Event_Oper_Cycle_Map_LIN 4 Slave 9_Defect
  diagnostic event to debounce algorithm mapping EventDebounceMapLIN4Slave9Defect: debounce-algorithm=counter_based, diagnostic-event=EventLIN4Slave9Defect  # EventDebounceMap_LIN 4 Slave 9_Defect
package /ZeC/DTC/DTC/Power_Path_145_Load_Failure
  diagnostic trouble code uds Power_Path_145_Load_Failure: dtc-props=Dtc_Props_255f9ae9, uds-dtc-value=0x005491
  diagnostic event EventPowerPath145LoadFailure: aging-allowed=true, event-kind=SWC, prestorage-freeze-frame=false  # Event_Power_Path_145_Load_Failure
  diagnostic event to trouble code uds mapping EventDtcMapPowerPath145LoadFailure: diagnostic-event=EventPowerPath145LoadFailure, trouble-code-uds=Power_Path_145_Load_Failure  # Event_Dtc_Map_Power_Path_145_Load_Failure
  diagnostic event to operation cycle mapping EventOperCycleMapPowerPath145LoadFailure: diagnostic-event=EventPowerPath145LoadFailure, operation-cycle=DefaultOperationCycle  # Event_Oper_Cycle_Map_Power_Path_145_Load_Failure
  diagnostic event to debounce algorithm mapping EventDebounceMapPowerPath145LoadFailure: debounce-algorithm=time_based, diagnostic-event=EventPowerPath145LoadFailure  # EventDebounceMap_Power_Path_145_Load_Failure
package /ZeC/DTC/DTC/Power_Path_144_Load_Failure
  diagnostic trouble code uds Power_Path_144_Load_Failure: dtc-props=Dtc_Props_634690d3, uds-dtc-value=0x005490
  diagnostic event EventPowerPath144LoadFailure: aging-allowed=true, event-kind=SWC, prestorage-freeze-frame=false  # Event_Power_Path_144_Load_Failure
  diagnostic event to trouble code uds mapping EventDtcMapPowerPath144LoadFailure: diagnostic-event=EventPowerPath144LoadFailure, trouble-code-uds=Power_Path_144_Load_Failure  # Event_Dtc_Map_Power_Path_144_Load_Failure
  diagnostic event to operation cycle mapping EventOperCycleMapPowerPath144LoadFailure: diagnostic-event=EventPowerPath144LoadFailure, operation-cycle=DefaultOperationCycle  # Event_Oper_Cycle_Map_Power_Path_144_Load_Failure
  diagnostic event to debounce algorithm mapping EventDebounceMapPowerPath144LoadFailure: debounce-algorithm=time_based, diagnostic-event=EventPowerPath144LoadFailure  # EventDebounceMap_Power_Path_144_Load_Failure
package /ZeC/DTC/DTC/LIN_4_Slave_7_NoCommunication
  diagnostic trouble code uds LIN_4_Slave_7_NoCommunication: dtc-props=Dtc_Props_358996c7, uds-dtc-value=0x03040b  # LIN 4 Slave 7_NoCommunication
  diagnostic event EventLIN4Slave7NoCommunication: aging-allowed=true, event-kind=SWC, prestorage-freeze-frame=false  # Event_LIN 4 Slave 7_NoCommunication
  diagnostic event to trouble code uds mapping EventDtcMapLIN4Slave7NoCommunication: diagnostic-event=EventLIN4Slave7NoCommunication, trouble-code-uds=LIN_4_Slave_7_NoCommunication  # Event_Dtc_Map_LIN 4 Slave 7_NoCommunication
  diagnostic event to operation cycle mapping EventOperCycleMapLIN4Slave7NoCommunication: diagnostic-event=EventLIN4Slave7NoCommunication, operation-cycle=DefaultOperationCycle  # Event_Oper_Cycle_Map_LIN 4 Slave 7_NoCommunication
  diagnostic event to debounce algorithm mapping EventDebounceMapLIN4Slave7NoCommunication: debounce-algorithm=counter_based, diagnostic-event=EventLIN4Slave7NoCommunication  # EventDebounceMap_LIN 4 Slave 7_NoCommunication
package /ZeC/DTC/DTC/LIN_4_Slave_7_Defect
  diagnostic trouble code uds LIN_4_Slave_7_Defect: dtc-props=Dtc_Props_358996c7, uds-dtc-value=0x03040a  # LIN 4 Slave 7_Defect
  diagnostic event EventLIN4Slave7Defect: aging-allowed=true, event-kind=SWC, prestorage-freeze-frame=false  # Event_LIN 4 Slave 7_Defect
  diagnostic event to trouble code uds mapping EventDtcMapLIN4Slave7Defect: diagnostic-event=EventLIN4Slave7Defect, trouble-code-uds=LIN_4_Slave_7_Defect  # Event_Dtc_Map_LIN 4 Slave 7_Defect
  diagnostic event to operation cycle mapping EventOperCycleMapLIN4Slave7Defect: diagnostic-event=EventLIN4Slave7Defect, operation-cycle=DefaultOperationCycle  # Event_Oper_Cycle_Map_LIN 4 Slave 7_Defect
  diagnostic event to debounce algorithm mapping EventDebounceMapLIN4Slave7Defect: debounce-algorithm=counter_based, diagnostic-event=EventLIN4Slave7Defect  # EventDebounceMap_LIN 4 Slave 7_Defect
package /ZeC/DTC/DTC/LIN_4_Slave_8_NoCommunication
  diagnostic trouble code uds LIN_4_Slave_8_NoCommunication: dtc-props=Dtc_Props_358996c7, uds-dtc-value=0x03040d  # LIN 4 Slave 8_NoCommunication
  diagnostic event EventLIN4Slave8NoCommunication: aging-allowed=true, event-kind=SWC, prestorage-freeze-frame=false  # Event_LIN 4 Slave 8_NoCommunication
  diagnostic event to trouble code uds mapping EventDtcMapLIN4Slave8NoCommunication: diagnostic-event=EventLIN4Slave8NoCommunication, trouble-code-uds=LIN_4_Slave_8_NoCommunication  # Event_Dtc_Map_LIN 4 Slave 8_NoCommunication
  diagnostic event to operation cycle mapping EventOperCycleMapLIN4Slave8NoCommunication: diagnostic-event=EventLIN4Slave8NoCommunication, operation-cycle=DefaultOperationCycle  # Event_Oper_Cycle_Map_LIN 4 Slave 8_NoCommunication
  diagnostic event to debounce algorithm mapping EventDebounceMapLIN4Slave8NoCommunication: debounce-algorithm=counter_based, diagnostic-event=EventLIN4Slave8NoCommunication  # EventDebounceMap_LIN 4 Slave 8_NoCommunication
package /ZeC/DTC/DTC/LIN_4_Slave_8_Defect
  diagnostic trouble code uds LIN_4_Slave_8_Defect: dtc-props=Dtc_Props_358996c7, uds-dtc-value=0x03040c  # LIN 4 Slave 8_Defect
  diagnostic event EventLIN4Slave8Defect: aging-allowed=true, event-kind=SWC, prestorage-freeze-frame=false  # Event_LIN 4 Slave 8_Defect
  diagnostic event to trouble code uds mapping EventDtcMapLIN4Slave8Defect: diagnostic-event=EventLIN4Slave8Defect, trouble-code-uds=LIN_4_Slave_8_Defect  # Event_Dtc_Map_LIN 4 Slave 8_Defect
  diagnostic event to operation cycle mapping EventOperCycleMapLIN4Slave8Defect: diagnostic-event=EventLIN4Slave8Defect, operation-cycle=DefaultOperationCycle  # Event_Oper_Cycle_Map_LIN 4 Slave 8_Defect
  diagnostic event to debounce algorithm mapping EventDebounceMapLIN4Slave8Defect: debounce-algorithm=counter_based, diagnostic-event=EventLIN4Slave8Defect  # EventDebounceMap_LIN 4 Slave 8_Defect
package /ZeC/DTC/DTC/Power_Path_160_Cable_Protection_Failure
  diagnostic trouble code uds Power_Path_160_Cable_Protection_Failure: dtc-props=Dtc_Props_c92c78b3, uds-dtc-value=0x0058a0
  diagnostic event EventPowerPath160CableProtectionFailure: aging-allowed=true, event-kind=SWC, prestorage-freeze-frame=false  # Event_Power_Path_160_Cable_Protection_Failure
  diagnostic event to trouble code uds mapping EventDtcMapPowerPath160CableProtectionFailure: diagnostic-event=EventPowerPath160CableProtectionFailure, trouble-code-uds=Power_Path_160_Cable_Protection_Failure  # Event_Dtc_Map_Power_Path_160_Cable_Protection_Failure
  diagnostic event to operation cycle mapping EventOperCycleMapPowerPath160CableProtectionFailure: diagnostic-event=EventPowerPath160CableProtectionFailure, operation-cycle=DefaultOperationCycle  # Event_Oper_Cycle_Map_Power_Path_160_Cable_Protection_Failure
  diagnostic event to debounce algorithm mapping EventDebounceMapPowerPath160CableProtectionFailure: debounce-algorithm=time_based, diagnostic-event=EventPowerPath160CableProtectionFailure  # EventDebounceMap_Power_Path_160_Cable_Protection_Failure
package /ZeC/DTC/DTC/LIN_14_Databus_No_Comm
  diagnostic trouble code uds LIN_14_Databus_No_Comm: dtc-props=Dtc_Props_358996c7, uds-dtc-value=0x030e20  # LIN 14 Databus_No_Comm
  diagnostic event EventLIN14DatabusNoComm: aging-allowed=true, event-kind=SWC, prestorage-freeze-frame=false  # Event_LIN 14 Databus_No_Comm
  diagnostic event to trouble code uds mapping EventDtcMapLIN14DatabusNoComm: diagnostic-event=EventLIN14DatabusNoComm, trouble-code-uds=LIN_14_Databus_No_Comm  # Event_Dtc_Map_LIN 14 Databus_No_Comm
  diagnostic event to operation cycle mapping EventOperCycleMapLIN14DatabusNoComm: diagnostic-event=EventLIN14DatabusNoComm, operation-cycle=DefaultOperationCycle  # Event_Oper_Cycle_Map_LIN 14 Databus_No_Comm
  diagnostic event to debounce algorithm mapping EventDebounceMapLIN14DatabusNoComm: debounce-algorithm=counter_based, diagnostic-event=EventLIN14DatabusNoComm  # EventDebounceMap_LIN 14 Databus_No_Comm
package /ZeC/DTC/DTC/Power_Path_151_Load_Failure
  diagnostic trouble code uds Power_Path_151_Load_Failure: dtc-props=Dtc_Props_6a78a034, uds-dtc-value=0x005497
  diagnostic event EventPowerPath151LoadFailure: aging-allowed=true, event-kind=SWC, prestorage-freeze-frame=false  # Event_Power_Path_151_Load_Failure
  diagnostic event to trouble code uds mapping EventDtcMapPowerPath151LoadFailure: diagnostic-event=EventPowerPath151LoadFailure, trouble-code-uds=Power_Path_151_Load_Failure  # Event_Dtc_Map_Power_Path_151_Load_Failure
  diagnostic event to operation cycle mapping EventOperCycleMapPowerPath151LoadFailure: diagnostic-event=EventPowerPath151LoadFailure, operation-cycle=DefaultOperationCycle  # Event_Oper_Cycle_Map_Power_Path_151_Load_Failure
  diagnostic event to debounce algorithm mapping EventDebounceMapPowerPath151LoadFailure: debounce-algorithm=time_based, diagnostic-event=EventPowerPath151LoadFailure  # EventDebounceMap_Power_Path_151_Load_Failure
package /ZeC/DTC/DTC/LIN_14_Local_Databus_Electrical_Failure
  diagnostic trouble code uds LIN_14_Local_Databus_Electrical_Failure: dtc-props=Dtc_Props_358996c7, uds-dtc-value=0x030e21  # LIN 14 Local_Databus_Electrical_Failure
  diagnostic event EventLIN14LocalDatabusElectricalFailure: aging-allowed=true, event-kind=SWC, prestorage-freeze-frame=false  # Event_LIN 14 Local_Databus_Electrical_Failure
  diagnostic event to trouble code uds mapping EventDtcMapLIN14LocalDatabusElectricalFailure: diagnostic-event=EventLIN14LocalDatabusElectricalFailure, trouble-code-uds=LIN_14_Local_Databus_Electrical_Failure  # Event_Dtc_Map_LIN 14 Local_Databus_Electrical_Failure
  diagnostic event to operation cycle mapping EventOperCycleMapLIN14LocalDatabusElectricalFailure: diagnostic-event=EventLIN14LocalDatabusElectricalFailure, operation-cycle=DefaultOperationCycle  # Event_Oper_Cycle_Map_LIN 14 Local_Databus_Electrical_Failure
  diagnostic event to debounce algorithm mapping EventDebounceMapLIN14LocalDatabusElectricalFailure: debounce-algorithm=counter_based, diagnostic-event=EventLIN14LocalDatabusElectricalFailure  # EventDebounceMap_LIN 14 Local_Databus_Electrical_Failure
package /ZeC/DTC/DTC/Power_Path_150_Load_Failure
  diagnostic trouble code uds Power_Path_150_Load_Failure: dtc-props=Dtc_Props_2c61aa0e, uds-dtc-value=0x005496
  diagnostic event EventPowerPath150LoadFailure: aging-allowed=true, event-kind=SWC, prestorage-freeze-frame=false  # Event_Power_Path_150_Load_Failure
  diagnostic event to trouble code uds mapping EventDtcMapPowerPath150LoadFailure: diagnostic-event=EventPowerPath150LoadFailure, trouble-code-uds=Power_Path_150_Load_Failure  # Event_Dtc_Map_Power_Path_150_Load_Failure
  diagnostic event to operation cycle mapping EventOperCycleMapPowerPath150LoadFailure: diagnostic-event=EventPowerPath150LoadFailure, operation-cycle=DefaultOperationCycle  # Event_Oper_Cycle_Map_Power_Path_150_Load_Failure
  diagnostic event to debounce algorithm mapping EventDebounceMapPowerPath150LoadFailure: debounce-algorithm=time_based, diagnostic-event=EventPowerPath150LoadFailure  # EventDebounceMap_Power_Path_150_Load_Failure
package /ZeC/DTC/DTC/Power_Path_153_Load_Failure
  diagnostic trouble code uds Power_Path_153_Load_Failure: dtc-props=Dtc_Props_7804c1fa, uds-dtc-value=0x005499
  diagnostic event EventPowerPath153LoadFailure: aging-allowed=true, event-kind=SWC, prestorage-freeze-frame=false  # Event_Power_Path_153_Load_Failure
  diagnostic event to trouble code uds mapping EventDtcMapPowerPath153LoadFailure: diagnostic-event=EventPowerPath153LoadFailure, trouble-code-uds=Power_Path_153_Load_Failure  # Event_Dtc_Map_Power_Path_153_Load_Failure
  diagnostic event to operation cycle mapping EventOperCycleMapPowerPath153LoadFailure: diagnostic-event=EventPowerPath153LoadFailure, operation-cycle=DefaultOperationCycle  # Event_Oper_Cycle_Map_Power_Path_153_Load_Failure
  diagnostic event to debounce algorithm mapping EventDebounceMapPowerPath153LoadFailure: debounce-algorithm=time_based, diagnostic-event=EventPowerPath153LoadFailure  # EventDebounceMap_Power_Path_153_Load_Failure
package /ZeC/DTC/DTC/Power_Path_152_Load_Failure
  diagnostic trouble code uds Power_Path_152_Load_Failure: dtc-props=Dtc_Props_3e1dcbc0, uds-dtc-value=0x005498
  diagnostic event EventPowerPath152LoadFailure: aging-allowed=true, event-kind=SWC, prestorage-freeze-frame=false  # Event_Power_Path_152_Load_Failure
  diagnostic event to trouble code uds mapping EventDtcMapPowerPath152LoadFailure: diagnostic-event=EventPowerPath152LoadFailure, trouble-code-uds=Power_Path_152_Load_Failure  # Event_Dtc_Map_Power_Path_152_Load_Failure
  diagnostic event to operation cycle mapping EventOperCycleMapPowerPath152LoadFailure: diagnostic-event=EventPowerPath152LoadFailure, operation-cycle=DefaultOperationCycle  # Event_Oper_Cycle_Map_Power_Path_152_Load_Failure
  diagnostic event to debounce algorithm mapping EventDebounceMapPowerPath152LoadFailure: debounce-algorithm=time_based, diagnostic-event=EventPowerPath152LoadFailure  # EventDebounceMap_Power_Path_152_Load_Failure
package /ZeC/DTC/DTC/Power_Path_147_Load_Failure
  diagnostic trouble code uds Power_Path_147_Load_Failure: dtc-props=Dtc_Props_a96d8e9d, uds-dtc-value=0x005493
  diagnostic event EventPowerPath147LoadFailure: aging-allowed=true, event-kind=SWC, prestorage-freeze-frame=false  # Event_Power_Path_147_Load_Failure
  diagnostic event to trouble code uds mapping EventDtcMapPowerPath147LoadFailure: diagnostic-event=EventPowerPath147LoadFailure, trouble-code-uds=Power_Path_147_Load_Failure  # Event_Dtc_Map_Power_Path_147_Load_Failure
  diagnostic event to operation cycle mapping EventOperCycleMapPowerPath147LoadFailure: diagnostic-event=EventPowerPath147LoadFailure, operation-cycle=DefaultOperationCycle  # Event_Oper_Cycle_Map_Power_Path_147_Load_Failure
  diagnostic event to debounce algorithm mapping EventDebounceMapPowerPath147LoadFailure: debounce-algorithm=time_based, diagnostic-event=EventPowerPath147LoadFailure  # EventDebounceMap_Power_Path_147_Load_Failure
package /ZeC/DTC/DTC/LIN_4_Slave_6_NoCommunication
  diagnostic trouble code uds LIN_4_Slave_6_NoCommunication: dtc-props=Dtc_Props_358996c7, uds-dtc-value=0x030409  # LIN 4 Slave 6_NoCommunication
  diagnostic event EventLIN4Slave6NoCommunication: aging-allowed=true, event-kind=SWC, prestorage-freeze-frame=false  # Event_LIN 4 Slave 6_NoCommunication
  diagnostic event to trouble code uds mapping EventDtcMapLIN4Slave6NoCommunication: diagnostic-event=EventLIN4Slave6NoCommunication, trouble-code-uds=LIN_4_Slave_6_NoCommunication  # Event_Dtc_Map_LIN 4 Slave 6_NoCommunication
  diagnostic event to operation cycle mapping EventOperCycleMapLIN4Slave6NoCommunication: diagnostic-event=EventLIN4Slave6NoCommunication, operation-cycle=DefaultOperationCycle  # Event_Oper_Cycle_Map_LIN 4 Slave 6_NoCommunication
  diagnostic event to debounce algorithm mapping EventDebounceMapLIN4Slave6NoCommunication: debounce-algorithm=counter_based, diagnostic-event=EventLIN4Slave6NoCommunication  # EventDebounceMap_LIN 4 Slave 6_NoCommunication
package /ZeC/DTC/DTC/Power_Path_146_Load_Failure
  diagnostic trouble code uds Power_Path_146_Load_Failure: dtc-props=Dtc_Props_ef7484a7, uds-dtc-value=0x005492
  diagnostic event EventPowerPath146LoadFailure: aging-allowed=true, event-kind=SWC, prestorage-freeze-frame=false  # Event_Power_Path_146_Load_Failure
  diagnostic event to trouble code uds mapping EventDtcMapPowerPath146LoadFailure: diagnostic-event=EventPowerPath146LoadFailure, trouble-code-uds=Power_Path_146_Load_Failure  # Event_Dtc_Map_Power_Path_146_Load_Failure
  diagnostic event to operation cycle mapping EventOperCycleMapPowerPath146LoadFailure: diagnostic-event=EventPowerPath146LoadFailure, operation-cycle=DefaultOperationCycle  # Event_Oper_Cycle_Map_Power_Path_146_Load_Failure
  diagnostic event to debounce algorithm mapping EventDebounceMapPowerPath146LoadFailure: debounce-algorithm=time_based, diagnostic-event=EventPowerPath146LoadFailure  # EventDebounceMap_Power_Path_146_Load_Failure
package /ZeC/DTC/DTC/Power_Path_149_Load_Failure
  diagnostic trouble code uds Power_Path_149_Load_Failure: dtc-props=Dtc_Props_e64ab440, uds-dtc-value=0x005495
  diagnostic event EventPowerPath149LoadFailure: aging-allowed=true, event-kind=SWC, prestorage-freeze-frame=false  # Event_Power_Path_149_Load_Failure
  diagnostic event to trouble code uds mapping EventDtcMapPowerPath149LoadFailure: diagnostic-event=EventPowerPath149LoadFailure, trouble-code-uds=Power_Path_149_Load_Failure  # Event_Dtc_Map_Power_Path_149_Load_Failure
  diagnostic event to operation cycle mapping EventOperCycleMapPowerPath149LoadFailure: diagnostic-event=EventPowerPath149LoadFailure, operation-cycle=DefaultOperationCycle  # Event_Oper_Cycle_Map_Power_Path_149_Load_Failure
  diagnostic event to debounce algorithm mapping EventDebounceMapPowerPath149LoadFailure: debounce-algorithm=time_based, diagnostic-event=EventPowerPath149LoadFailure  # EventDebounceMap_Power_Path_149_Load_Failure
package /ZeC/DTC/DTC/Power_Path_148_Load_Failure
  diagnostic trouble code uds Power_Path_148_Load_Failure: dtc-props=Dtc_Props_a053be7a, uds-dtc-value=0x005494
  diagnostic event EventPowerPath148LoadFailure: aging-allowed=true, event-kind=SWC, prestorage-freeze-frame=false  # Event_Power_Path_148_Load_Failure
  diagnostic event to trouble code uds mapping EventDtcMapPowerPath148LoadFailure: diagnostic-event=EventPowerPath148LoadFailure, trouble-code-uds=Power_Path_148_Load_Failure  # Event_Dtc_Map_Power_Path_148_Load_Failure
  diagnostic event to operation cycle mapping EventOperCycleMapPowerPath148LoadFailure: diagnostic-event=EventPowerPath148LoadFailure, operation-cycle=DefaultOperationCycle  # Event_Oper_Cycle_Map_Power_Path_148_Load_Failure
  diagnostic event to debounce algorithm mapping EventDebounceMapPowerPath148LoadFailure: debounce-algorithm=time_based, diagnostic-event=EventPowerPath148LoadFailure  # EventDebounceMap_Power_Path_148_Load_Failure
package /ZeC/DTC/DTC/LIN_4_Slave_12_NoCommunication
  diagnostic trouble code uds LIN_4_Slave_12_NoCommunication: dtc-props=Dtc_Props_358996c7, uds-dtc-value=0x030417  # LIN 4 Slave 12_NoCommunication
  diagnostic event EventLIN4Slave12NoCommunication: aging-allowed=true, event-kind=SWC, prestorage-freeze-frame=false  # Event_LIN 4 Slave 12_NoCommunication
  diagnostic event to trouble code uds mapping EventDtcMapLIN4Slave12NoCommunication: diagnostic-event=EventLIN4Slave12NoCommunication, trouble-code-uds=LIN_4_Slave_12_NoCommunication  # Event_Dtc_Map_LIN 4 Slave 12_NoCommunication
  diagnostic event to operation cycle mapping EventOperCycleMapLIN4Slave12NoCommunication: diagnostic-event=EventLIN4Slave12NoCommunication, operation-cycle=DefaultOperationCycle  # Event_Oper_Cycle_Map_LIN 4 Slave 12_NoCommunication
  diagnostic event to debounce algorithm mapping EventDebounceMapLIN4Slave12NoCommunication: debounce-algorithm=counter_based, diagnostic-event=EventLIN4Slave12NoCommunication  # EventDebounceMap_LIN 4 Slave 12_NoCommunication
package /ZeC/DTC/DTC/LIN_4_Slave_12_Defect
  diagnostic trouble code uds LIN_4_Slave_12_Defect: dtc-props=Dtc_Props_358996c7, uds-dtc-value=0x030416  # LIN 4 Slave 12_Defect
  diagnostic event EventLIN4Slave12Defect: aging-allowed=true, event-kind=SWC, prestorage-freeze-frame=false  # Event_LIN 4 Slave 12_Defect
  diagnostic event to trouble code uds mapping EventDtcMapLIN4Slave12Defect: diagnostic-event=EventLIN4Slave12Defect, trouble-code-uds=LIN_4_Slave_12_Defect  # Event_Dtc_Map_LIN 4 Slave 12_Defect
  diagnostic event to operation cycle mapping EventOperCycleMapLIN4Slave12Defect: diagnostic-event=EventLIN4Slave12Defect, operation-cycle=DefaultOperationCycle  # Event_Oper_Cycle_Map_LIN 4 Slave 12_Defect
  diagnostic event to debounce algorithm mapping EventDebounceMapLIN4Slave12Defect: debounce-algorithm=counter_based, diagnostic-event=EventLIN4Slave12Defect  # EventDebounceMap_LIN 4 Slave 12_Defect
package /ZeC/DTC/DTC/LIN_4_Slave_13_NoCommunication
  diagnostic trouble code uds LIN_4_Slave_13_NoCommunication: dtc-props=Dtc_Props_358996c7, uds-dtc-value=0x030419  # LIN 4 Slave 13_NoCommunication
  diagnostic event EventLIN4Slave13NoCommunication: aging-allowed=true, event-kind=SWC, prestorage-freeze-frame=false  # Event_LIN 4 Slave 13_NoCommunication
  diagnostic event to trouble code uds mapping EventDtcMapLIN4Slave13NoCommunication: diagnostic-event=EventLIN4Slave13NoCommunication, trouble-code-uds=LIN_4_Slave_13_NoCommunication  # Event_Dtc_Map_LIN 4 Slave 13_NoCommunication
  diagnostic event to operation cycle mapping EventOperCycleMapLIN4Slave13NoCommunication: diagnostic-event=EventLIN4Slave13NoCommunication, operation-cycle=DefaultOperationCycle  # Event_Oper_Cycle_Map_LIN 4 Slave 13_NoCommunication
  diagnostic event to debounce algorithm mapping EventDebounceMapLIN4Slave13NoCommunication: debounce-algorithm=counter_based, diagnostic-event=EventLIN4Slave13NoCommunication  # EventDebounceMap_LIN 4 Slave 13_NoCommunication
package /ZeC/DTC/DTC/LIN_4_Slave_13_Defect
  diagnostic trouble code uds LIN_4_Slave_13_Defect: dtc-props=Dtc_Props_358996c7, uds-dtc-value=0x030418  # LIN 4 Slave 13_Defect
  diagnostic event EventLIN4Slave13Defect: aging-allowed=true, event-kind=SWC, prestorage-freeze-frame=false  # Event_LIN 4 Slave 13_Defect
  diagnostic event to trouble code uds mapping EventDtcMapLIN4Slave13Defect: diagnostic-event=EventLIN4Slave13Defect, trouble-code-uds=LIN_4_Slave_13_Defect  # Event_Dtc_Map_LIN 4 Slave 13_Defect
  diagnostic event to operation cycle mapping EventOperCycleMapLIN4Slave13Defect: diagnostic-event=EventLIN4Slave13Defect, operation-cycle=DefaultOperationCycle  # Event_Oper_Cycle_Map_LIN 4 Slave 13_Defect
  diagnostic event to debounce algorithm mapping EventDebounceMapLIN4Slave13Defect: debounce-algorithm=counter_based, diagnostic-event=EventLIN4Slave13Defect  # EventDebounceMap_LIN 4 Slave 13_Defect
package /ZeC/DTC/DTC/LIN_4_Slave_10_NoCommunication
  diagnostic trouble code uds LIN_4_Slave_10_NoCommunication: dtc-props=Dtc_Props_358996c7, uds-dtc-value=0x030413  # LIN 4 Slave 10_NoCommunication
  diagnostic event EventLIN4Slave10NoCommunication: aging-allowed=true, event-kind=SWC, prestorage-freeze-frame=false  # Event_LIN 4 Slave 10_NoCommunication
  diagnostic event to trouble code uds mapping EventDtcMapLIN4Slave10NoCommunication: diagnostic-event=EventLIN4Slave10NoCommunication, trouble-code-uds=LIN_4_Slave_10_NoCommunication  # Event_Dtc_Map_LIN 4 Slave 10_NoCommunication
  diagnostic event to operation cycle mapping EventOperCycleMapLIN4Slave10NoCommunication: diagnostic-event=EventLIN4Slave10NoCommunication, operation-cycle=DefaultOperationCycle  # Event_Oper_Cycle_Map_LIN 4 Slave 10_NoCommunication
  diagnostic event to debounce algorithm mapping EventDebounceMapLIN4Slave10NoCommunication: debounce-algorithm=counter_based, diagnostic-event=EventLIN4Slave10NoCommunication  # EventDebounceMap_LIN 4 Slave 10_NoCommunication
package /ZeC/DTC/DTC/Power_Path_121_Load_Failure
  diagnostic trouble code uds Power_Path_121_Load_Failure: dtc-props=Dtc_Props_4ca522c, uds-dtc-value=0x005479
  diagnostic event EventPowerPath121LoadFailure: aging-allowed=true, event-kind=SWC, prestorage-freeze-frame=false  # Event_Power_Path_121_Load_Failure
  diagnostic event to trouble code uds mapping EventDtcMapPowerPath121LoadFailure: diagnostic-event=EventPowerPath121LoadFailure, trouble-code-uds=Power_Path_121_Load_Failure  # Event_Dtc_Map_Power_Path_121_Load_Failure
  diagnostic event to operation cycle mapping EventOperCycleMapPowerPath121LoadFailure: diagnostic-event=EventPowerPath121LoadFailure, operation-cycle=DefaultOperationCycle  # Event_Oper_Cycle_Map_Power_Path_121_Load_Failure
  diagnostic event to debounce algorithm mapping EventDebounceMapPowerPath121LoadFailure: debounce-algorithm=time_based, diagnostic-event=EventPowerPath121LoadFailure  # EventDebounceMap_Power_Path_121_Load_Failure
package /ZeC/DTC/DTC/LIN_4_Slave_10_Defect
  diagnostic trouble code uds LIN_4_Slave_10_Defect: dtc-props=Dtc_Props_358996c7, uds-dtc-value=0x030412  # LIN 4 Slave 10_Defect
  diagnostic event EventLIN4Slave10Defect: aging-allowed=true, event-kind=SWC, prestorage-freeze-frame=false  # Event_LIN 4 Slave 10_Defect
  diagnostic event to trouble code uds mapping EventDtcMapLIN4Slave10Defect: diagnostic-event=EventLIN4Slave10Defect, trouble-code-uds=LIN_4_Slave_10_Defect  # Event_Dtc_Map_LIN 4 Slave 10_Defect
  diagnostic event to operation cycle mapping EventOperCycleMapLIN4Slave10Defect: diagnostic-event=EventLIN4Slave10Defect, operation-cycle=DefaultOperationCycle  # Event_Oper_Cycle_Map_LIN 4 Slave 10_Defect
  diagnostic event to debounce algorithm mapping EventDebounceMapLIN4Slave10Defect: debounce-algorithm=counter_based, diagnostic-event=EventLIN4Slave10Defect  # EventDebounceMap_LIN 4 Slave 10_Defect
package /ZeC/DTC/DTC/Power_Path_120_Load_Failure
  diagnostic trouble code uds Power_Path_120_Load_Failure: dtc-props=Dtc_Props_42d35816, uds-dtc-value=0x005478
  diagnostic event EventPowerPath120LoadFailure: aging-allowed=true, event-kind=SWC, prestorage-freeze-frame=false  # Event_Power_Path_120_Load_Failure
  diagnostic event to trouble code uds mapping EventDtcMapPowerPath120LoadFailure: diagnostic-event=EventPowerPath120LoadFailure, trouble-code-uds=Power_Path_120_Load_Failure  # Event_Dtc_Map_Power_Path_120_Load_Failure
  diagnostic event to operation cycle mapping EventOperCycleMapPowerPath120LoadFailure: diagnostic-event=EventPowerPath120LoadFailure, operation-cycle=DefaultOperationCycle  # Event_Oper_Cycle_Map_Power_Path_120_Load_Failure
  diagnostic event to debounce algorithm mapping EventDebounceMapPowerPath120LoadFailure: debounce-algorithm=time_based, diagnostic-event=EventPowerPath120LoadFailure  # EventDebounceMap_Power_Path_120_Load_Failure
package /ZeC/DTC/DTC/LIN_4_Slave_11_NoCommunication
  diagnostic trouble code uds LIN_4_Slave_11_NoCommunication: dtc-props=Dtc_Props_358996c7, uds-dtc-value=0x030415  # LIN 4 Slave 11_NoCommunication
  diagnostic event EventLIN4Slave11NoCommunication: aging-allowed=true, event-kind=SWC, prestorage-freeze-frame=false  # Event_LIN 4 Slave 11_NoCommunication
  diagnostic event to trouble code uds mapping EventDtcMapLIN4Slave11NoCommunication: diagnostic-event=EventLIN4Slave11NoCommunication, trouble-code-uds=LIN_4_Slave_11_NoCommunication  # Event_Dtc_Map_LIN 4 Slave 11_NoCommunication
  diagnostic event to operation cycle mapping EventOperCycleMapLIN4Slave11NoCommunication: diagnostic-event=EventLIN4Slave11NoCommunication, operation-cycle=DefaultOperationCycle  # Event_Oper_Cycle_Map_LIN 4 Slave 11_NoCommunication
  diagnostic event to debounce algorithm mapping EventDebounceMapLIN4Slave11NoCommunication: debounce-algorithm=counter_based, diagnostic-event=EventLIN4Slave11NoCommunication  # EventDebounceMap_LIN 4 Slave 11_NoCommunication
package /ZeC/DTC/DTC/LIN_4_Slave_11_Defect
  diagnostic trouble code uds LIN_4_Slave_11_Defect: dtc-props=Dtc_Props_358996c7, uds-dtc-value=0x030414  # LIN 4 Slave 11_Defect
  diagnostic event EventLIN4Slave11Defect: aging-allowed=true, event-kind=SWC, prestorage-freeze-frame=false  # Event_LIN 4 Slave 11_Defect
  diagnostic event to trouble code uds mapping EventDtcMapLIN4Slave11Defect: diagnostic-event=EventLIN4Slave11Defect, trouble-code-uds=LIN_4_Slave_11_Defect  # Event_Dtc_Map_LIN 4 Slave 11_Defect
  diagnostic event to operation cycle mapping EventOperCycleMapLIN4Slave11Defect: diagnostic-event=EventLIN4Slave11Defect, operation-cycle=DefaultOperationCycle  # Event_Oper_Cycle_Map_LIN 4 Slave 11_Defect
  diagnostic event to debounce algorithm mapping EventDebounceMapLIN4Slave11Defect: debounce-algorithm=counter_based, diagnostic-event=EventLIN4Slave11Defect  # EventDebounceMap_LIN 4 Slave 11_Defect
package /ZeC/DTC/DTC/Power_Path_126_Load_Failure
  diagnostic trouble code uds Power_Path_126_Load_Failure: dtc-props=Dtc_Props_a77b43eb, uds-dtc-value=0x00547e
  diagnostic event EventPowerPath126LoadFailure: aging-allowed=true, event-kind=SWC, prestorage-freeze-frame=false  # Event_Power_Path_126_Load_Failure
  diagnostic event to trouble code uds mapping EventDtcMapPowerPath126LoadFailure: diagnostic-event=EventPowerPath126LoadFailure, trouble-code-uds=Power_Path_126_Load_Failure  # Event_Dtc_Map_Power_Path_126_Load_Failure
  diagnostic event to operation cycle mapping EventOperCycleMapPowerPath126LoadFailure: diagnostic-event=EventPowerPath126LoadFailure, operation-cycle=DefaultOperationCycle  # Event_Oper_Cycle_Map_Power_Path_126_Load_Failure
  diagnostic event to debounce algorithm mapping EventDebounceMapPowerPath126LoadFailure: debounce-algorithm=time_based, diagnostic-event=EventPowerPath126LoadFailure  # EventDebounceMap_Power_Path_126_Load_Failure
package /ZeC/DTC/DTC/Power_Path_125_Load_Failure
  diagnostic trouble code uds Power_Path_125_Load_Failure: dtc-props=Dtc_Props_e16249d1, uds-dtc-value=0x00547d
  diagnostic event EventPowerPath125LoadFailure: aging-allowed=true, event-kind=SWC, prestorage-freeze-frame=false  # Event_Power_Path_125_Load_Failure
  diagnostic event to trouble code uds mapping EventDtcMapPowerPath125LoadFailure: diagnostic-event=EventPowerPath125LoadFailure, trouble-code-uds=Power_Path_125_Load_Failure  # Event_Dtc_Map_Power_Path_125_Load_Failure
  diagnostic event to operation cycle mapping EventOperCycleMapPowerPath125LoadFailure: diagnostic-event=EventPowerPath125LoadFailure, operation-cycle=DefaultOperationCycle  # Event_Oper_Cycle_Map_Power_Path_125_Load_Failure
  diagnostic event to debounce algorithm mapping EventDebounceMapPowerPath125LoadFailure: debounce-algorithm=time_based, diagnostic-event=EventPowerPath125LoadFailure  # EventDebounceMap_Power_Path_125_Load_Failure
package /ZeC/DTC/DTC/LIN_4_Slave_1_NoCommunication
  diagnostic trouble code uds LIN_4_Slave_1_NoCommunication: dtc-props=Dtc_Props_358996c7, uds-dtc-value=0x030411  # LIN 4 Slave 1_NoCommunication
  diagnostic event EventLIN4Slave1NoCommunication: aging-allowed=true, event-kind=SWC, prestorage-freeze-frame=false  # Event_LIN 4 Slave 1_NoCommunication
  diagnostic event to trouble code uds mapping EventDtcMapLIN4Slave1NoCommunication: diagnostic-event=EventLIN4Slave1NoCommunication, trouble-code-uds=LIN_4_Slave_1_NoCommunication  # Event_Dtc_Map_LIN 4 Slave 1_NoCommunication
  diagnostic event to operation cycle mapping EventOperCycleMapLIN4Slave1NoCommunication: diagnostic-event=EventLIN4Slave1NoCommunication, operation-cycle=DefaultOperationCycle  # Event_Oper_Cycle_Map_LIN 4 Slave 1_NoCommunication
  diagnostic event to debounce algorithm mapping EventDebounceMapLIN4Slave1NoCommunication: debounce-algorithm=counter_based, diagnostic-event=EventLIN4Slave1NoCommunication  # EventDebounceMap_LIN 4 Slave 1_NoCommunication
package /ZeC/DTC/DTC/LIN_4_Slave_1_Defect
  diagnostic trouble code uds LIN_4_Slave_1_Defect: dtc-props=Dtc_Props_358996c7, uds-dtc-value=0x030410  # LIN 4 Slave 1_Defect
  diagnostic event EventLIN4Slave1Defect: aging-allowed=true, event-kind=SWC, prestorage-freeze-frame=false  # Event_LIN 4 Slave 1_Defect
  diagnostic event to trouble code uds mapping EventDtcMapLIN4Slave1Defect: diagnostic-event=EventLIN4Slave1Defect, trouble-code-uds=LIN_4_Slave_1_Defect  # Event_Dtc_Map_LIN 4 Slave 1_Defect
  diagnostic event to operation cycle mapping EventOperCycleMapLIN4Slave1Defect: diagnostic-event=EventLIN4Slave1Defect, operation-cycle=DefaultOperationCycle  # Event_Oper_Cycle_Map_LIN 4 Slave 1_Defect
  diagnostic event to debounce algorithm mapping EventDebounceMapLIN4Slave1Defect: debounce-algorithm=counter_based, diagnostic-event=EventLIN4Slave1Defect  # EventDebounceMap_LIN 4 Slave 1_Defect
package /ZeC/DTC/DTC/Power_Path_127_Load_Failure
  diagnostic trouble code uds Power_Path_127_Load_Failure: dtc-props=Dtc_Props_6d505da5, uds-dtc-value=0x00547f
  diagnostic event EventPowerPath127LoadFailure: aging-allowed=true, event-kind=SWC, prestorage-freeze-frame=false  # Event_Power_Path_127_Load_Failure
  diagnostic event to trouble code uds mapping EventDtcMapPowerPath127LoadFailure: diagnostic-event=EventPowerPath127LoadFailure, trouble-code-uds=Power_Path_127_Load_Failure  # Event_Dtc_Map_Power_Path_127_Load_Failure
  diagnostic event to operation cycle mapping EventOperCycleMapPowerPath127LoadFailure: diagnostic-event=EventPowerPath127LoadFailure, operation-cycle=DefaultOperationCycle  # Event_Oper_Cycle_Map_Power_Path_127_Load_Failure
  diagnostic event to debounce algorithm mapping EventDebounceMapPowerPath127LoadFailure: debounce-algorithm=time_based, diagnostic-event=EventPowerPath127LoadFailure  # EventDebounceMap_Power_Path_127_Load_Failure
package /ZeC/DTC/DTC/Power_Path_122_Load_Failure
  diagnostic trouble code uds Power_Path_122_Load_Failure: dtc-props=Dtc_Props_646e6d42, uds-dtc-value=0x00547a
  diagnostic event EventPowerPath122LoadFailure: aging-allowed=true, event-kind=SWC, prestorage-freeze-frame=false  # Event_Power_Path_122_Load_Failure
  diagnostic event to trouble code uds mapping EventDtcMapPowerPath122LoadFailure: diagnostic-event=EventPowerPath122LoadFailure, trouble-code-uds=Power_Path_122_Load_Failure  # Event_Dtc_Map_Power_Path_122_Load_Failure
  diagnostic event to operation cycle mapping EventOperCycleMapPowerPath122LoadFailure: diagnostic-event=EventPowerPath122LoadFailure, operation-cycle=DefaultOperationCycle  # Event_Oper_Cycle_Map_Power_Path_122_Load_Failure
  diagnostic event to debounce algorithm mapping EventDebounceMapPowerPath122LoadFailure: debounce-algorithm=time_based, diagnostic-event=EventPowerPath122LoadFailure  # EventDebounceMap_Power_Path_122_Load_Failure
package /ZeC/DTC/DTC/Power_Path_124_Load_Failure
  diagnostic trouble code uds Power_Path_124_Load_Failure: dtc-props=Dtc_Props_e85c7936, uds-dtc-value=0x00547c
  diagnostic event EventPowerPath124LoadFailure: aging-allowed=true, event-kind=SWC, prestorage-freeze-frame=false  # Event_Power_Path_124_Load_Failure
  diagnostic event to trouble code uds mapping EventDtcMapPowerPath124LoadFailure: diagnostic-event=EventPowerPath124LoadFailure, trouble-code-uds=Power_Path_124_Load_Failure  # Event_Dtc_Map_Power_Path_124_Load_Failure
  diagnostic event to operation cycle mapping EventOperCycleMapPowerPath124LoadFailure: diagnostic-event=EventPowerPath124LoadFailure, operation-cycle=DefaultOperationCycle  # Event_Oper_Cycle_Map_Power_Path_124_Load_Failure
  diagnostic event to debounce algorithm mapping EventDebounceMapPowerPath124LoadFailure: debounce-algorithm=time_based, diagnostic-event=EventPowerPath124LoadFailure  # EventDebounceMap_Power_Path_124_Load_Failure
package /ZeC/DTC/DTC/Power_Path_123_Load_Failure
  diagnostic trouble code uds Power_Path_123_Load_Failure: dtc-props=Dtc_Props_ae45730c, uds-dtc-value=0x00547b
  diagnostic event EventPowerPath123LoadFailure: aging-allowed=true, event-kind=SWC, prestorage-freeze-frame=false  # Event_Power_Path_123_Load_Failure
  diagnostic event to trouble code uds mapping EventDtcMapPowerPath123LoadFailure: diagnostic-event=EventPowerPath123LoadFailure, trouble-code-uds=Power_Path_123_Load_Failure  # Event_Dtc_Map_Power_Path_123_Load_Failure
  diagnostic event to operation cycle mapping EventOperCycleMapPowerPath123LoadFailure: diagnostic-event=EventPowerPath123LoadFailure, operation-cycle=DefaultOperationCycle  # Event_Oper_Cycle_Map_Power_Path_123_Load_Failure
  diagnostic event to debounce algorithm mapping EventDebounceMapPowerPath123LoadFailure: debounce-algorithm=time_based, diagnostic-event=EventPowerPath123LoadFailure  # EventDebounceMap_Power_Path_123_Load_Failure
package /ZeC/DTC/DTC/Power_Path_128_Load_Failure
  diagnostic trouble code uds Power_Path_128_Load_Failure: dtc-props=Dtc_Props_a50c506b, uds-dtc-value=0x005480
  diagnostic event EventPowerPath128LoadFailure: aging-allowed=true, event-kind=SWC, prestorage-freeze-frame=false  # Event_Power_Path_128_Load_Failure
  diagnostic event to trouble code uds mapping EventDtcMapPowerPath128LoadFailure: diagnostic-event=EventPowerPath128LoadFailure, trouble-code-uds=Power_Path_128_Load_Failure  # Event_Dtc_Map_Power_Path_128_Load_Failure
  diagnostic event to operation cycle mapping EventOperCycleMapPowerPath128LoadFailure: diagnostic-event=EventPowerPath128LoadFailure, operation-cycle=DefaultOperationCycle  # Event_Oper_Cycle_Map_Power_Path_128_Load_Failure
  diagnostic event to debounce algorithm mapping EventDebounceMapPowerPath128LoadFailure: debounce-algorithm=time_based, diagnostic-event=EventPowerPath128LoadFailure  # EventDebounceMap_Power_Path_128_Load_Failure
package /ZeC/DTC/DTC/LIN_4_Slave_15_Defect
  diagnostic trouble code uds LIN_4_Slave_15_Defect: dtc-props=Dtc_Props_358996c7, uds-dtc-value=0x03041c  # LIN 4 Slave 15_Defect
  diagnostic event EventLIN4Slave15Defect: aging-allowed=true, event-kind=SWC, prestorage-freeze-frame=false  # Event_LIN 4 Slave 15_Defect
  diagnostic event to trouble code uds mapping EventDtcMapLIN4Slave15Defect: diagnostic-event=EventLIN4Slave15Defect, trouble-code-uds=LIN_4_Slave_15_Defect  # Event_Dtc_Map_LIN 4 Slave 15_Defect
  diagnostic event to operation cycle mapping EventOperCycleMapLIN4Slave15Defect: diagnostic-event=EventLIN4Slave15Defect, operation-cycle=DefaultOperationCycle  # Event_Oper_Cycle_Map_LIN 4 Slave 15_Defect
  diagnostic event to debounce algorithm mapping EventDebounceMapLIN4Slave15Defect: debounce-algorithm=counter_based, diagnostic-event=EventLIN4Slave15Defect  # EventDebounceMap_LIN 4 Slave 15_Defect
package /ZeC/DTC/DTC/LIN_4_Slave_14_NoCommunication
  diagnostic trouble code uds LIN_4_Slave_14_NoCommunication: dtc-props=Dtc_Props_358996c7, uds-dtc-value=0x03041b  # LIN 4 Slave 14_NoCommunication
  diagnostic event EventLIN4Slave14NoCommunication: aging-allowed=true, event-kind=SWC, prestorage-freeze-frame=false  # Event_LIN 4 Slave 14_NoCommunication
  diagnostic event to trouble code uds mapping EventDtcMapLIN4Slave14NoCommunication: diagnostic-event=EventLIN4Slave14NoCommunication, trouble-code-uds=LIN_4_Slave_14_NoCommunication  # Event_Dtc_Map_LIN 4 Slave 14_NoCommunication
  diagnostic event to operation cycle mapping EventOperCycleMapLIN4Slave14NoCommunication: diagnostic-event=EventLIN4Slave14NoCommunication, operation-cycle=DefaultOperationCycle  # Event_Oper_Cycle_Map_LIN 4 Slave 14_NoCommunication
  diagnostic event to debounce algorithm mapping EventDebounceMapLIN4Slave14NoCommunication: debounce-algorithm=counter_based, diagnostic-event=EventLIN4Slave14NoCommunication  # EventDebounceMap_LIN 4 Slave 14_NoCommunication
package /ZeC/DTC/DTC/LIN_4_Slave_2_Defect
  diagnostic trouble code uds LIN_4_Slave_2_Defect: dtc-props=Dtc_Props_358996c7, uds-dtc-value=0x03041e  # LIN 4 Slave 2_Defect
  diagnostic event EventLIN4Slave2Defect: aging-allowed=true, event-kind=SWC, prestorage-freeze-frame=false  # Event_LIN 4 Slave 2_Defect
  diagnostic event to trouble code uds mapping EventDtcMapLIN4Slave2Defect: diagnostic-event=EventLIN4Slave2Defect, trouble-code-uds=LIN_4_Slave_2_Defect  # Event_Dtc_Map_LIN 4 Slave 2_Defect
  diagnostic event to operation cycle mapping EventOperCycleMapLIN4Slave2Defect: diagnostic-event=EventLIN4Slave2Defect, operation-cycle=DefaultOperationCycle  # Event_Oper_Cycle_Map_LIN 4 Slave 2_Defect
  diagnostic event to debounce algorithm mapping EventDebounceMapLIN4Slave2Defect: debounce-algorithm=counter_based, diagnostic-event=EventLIN4Slave2Defect  # EventDebounceMap_LIN 4 Slave 2_Defect
package /ZeC/DTC/DTC/LIN_4_Slave_15_NoCommunication
  diagnostic trouble code uds LIN_4_Slave_15_NoCommunication: dtc-props=Dtc_Props_358996c7, uds-dtc-value=0x03041d  # LIN 4 Slave 15_NoCommunication
  diagnostic event EventLIN4Slave15NoCommunication: aging-allowed=true, event-kind=SWC, prestorage-freeze-frame=false  # Event_LIN 4 Slave 15_NoCommunication
  diagnostic event to trouble code uds mapping EventDtcMapLIN4Slave15NoCommunication: diagnostic-event=EventLIN4Slave15NoCommunication, trouble-code-uds=LIN_4_Slave_15_NoCommunication  # Event_Dtc_Map_LIN 4 Slave 15_NoCommunication
  diagnostic event to operation cycle mapping EventOperCycleMapLIN4Slave15NoCommunication: diagnostic-event=EventLIN4Slave15NoCommunication, operation-cycle=DefaultOperationCycle  # Event_Oper_Cycle_Map_LIN 4 Slave 15_NoCommunication
  diagnostic event to debounce algorithm mapping EventDebounceMapLIN4Slave15NoCommunication: debounce-algorithm=counter_based, diagnostic-event=EventLIN4Slave15NoCommunication  # EventDebounceMap_LIN 4 Slave 15_NoCommunication
package /ZeC/DTC/DTC/Power_Path_134_Load_Failure
  diagnostic trouble code uds Power_Path_134_Load_Failure: dtc-props=Dtc_Props_ea2b6ab6, uds-dtc-value=0x005486
  diagnostic event EventPowerPath134LoadFailure: aging-allowed=true, event-kind=SWC, prestorage-freeze-frame=false  # Event_Power_Path_134_Load_Failure
  diagnostic event to trouble code uds mapping EventDtcMapPowerPath134LoadFailure: diagnostic-event=EventPowerPath134LoadFailure, trouble-code-uds=Power_Path_134_Load_Failure  # Event_Dtc_Map_Power_Path_134_Load_Failure
  diagnostic event to operation cycle mapping EventOperCycleMapPowerPath134LoadFailure: diagnostic-event=EventPowerPath134LoadFailure, operation-cycle=DefaultOperationCycle  # Event_Oper_Cycle_Map_Power_Path_134_Load_Failure
  diagnostic event to debounce algorithm mapping EventDebounceMapPowerPath134LoadFailure: debounce-algorithm=time_based, diagnostic-event=EventPowerPath134LoadFailure  # EventDebounceMap_Power_Path_134_Load_Failure
package /ZeC/DTC/DTC/Power_Path_133_Load_Failure
  diagnostic trouble code uds Power_Path_133_Load_Failure: dtc-props=Dtc_Props_200074f8, uds-dtc-value=0x005485
  diagnostic event EventPowerPath133LoadFailure: aging-allowed=true, event-kind=SWC, prestorage-freeze-frame=false  # Event_Power_Path_133_Load_Failure
  diagnostic event to trouble code uds mapping EventDtcMapPowerPath133LoadFailure: diagnostic-event=EventPowerPath133LoadFailure, trouble-code-uds=Power_Path_133_Load_Failure  # Event_Dtc_Map_Power_Path_133_Load_Failure
  diagnostic event to operation cycle mapping EventOperCycleMapPowerPath133LoadFailure: diagnostic-event=EventPowerPath133LoadFailure, operation-cycle=DefaultOperationCycle  # Event_Oper_Cycle_Map_Power_Path_133_Load_Failure
  diagnostic event to debounce algorithm mapping EventDebounceMapPowerPath133LoadFailure: debounce-algorithm=time_based, diagnostic-event=EventPowerPath133LoadFailure  # EventDebounceMap_Power_Path_133_Load_Failure
package /ZeC/DTC/DTC/LIN_4_Slave_14_Defect
  diagnostic trouble code uds LIN_4_Slave_14_Defect: dtc-props=Dtc_Props_358996c7, uds-dtc-value=0x03041a  # LIN 4 Slave 14_Defect
  diagnostic event EventLIN4Slave14Defect: aging-allowed=true, event-kind=SWC, prestorage-freeze-frame=false  # Event_LIN 4 Slave 14_Defect
  diagnostic event to trouble code uds mapping EventDtcMapLIN4Slave14Defect: diagnostic-event=EventLIN4Slave14Defect, trouble-code-uds=LIN_4_Slave_14_Defect  # Event_Dtc_Map_LIN 4 Slave 14_Defect
  diagnostic event to operation cycle mapping EventOperCycleMapLIN4Slave14Defect: diagnostic-event=EventLIN4Slave14Defect, operation-cycle=DefaultOperationCycle  # Event_Oper_Cycle_Map_LIN 4 Slave 14_Defect
  diagnostic event to debounce algorithm mapping EventDebounceMapLIN4Slave14Defect: debounce-algorithm=counter_based, diagnostic-event=EventLIN4Slave14Defect  # EventDebounceMap_LIN 4 Slave 14_Defect
package /ZeC/DTC/DTC/Power_Path_136_Load_Failure
  diagnostic trouble code uds Power_Path_136_Load_Failure: dtc-props=Dtc_Props_f8570b78, uds-dtc-value=0x005488
  diagnostic event EventPowerPath136LoadFailure: aging-allowed=true, event-kind=SWC, prestorage-freeze-frame=false  # Event_Power_Path_136_Load_Failure
  diagnostic event to trouble code uds mapping EventDtcMapPowerPath136LoadFailure: diagnostic-event=EventPowerPath136LoadFailure, trouble-code-uds=Power_Path_136_Load_Failure  # Event_Dtc_Map_Power_Path_136_Load_Failure
  diagnostic event to operation cycle mapping EventOperCycleMapPowerPath136LoadFailure: diagnostic-event=EventPowerPath136LoadFailure, operation-cycle=DefaultOperationCycle  # Event_Oper_Cycle_Map_Power_Path_136_Load_Failure
  diagnostic event to debounce algorithm mapping EventDebounceMapPowerPath136LoadFailure: debounce-algorithm=time_based, diagnostic-event=EventPowerPath136LoadFailure  # EventDebounceMap_Power_Path_136_Load_Failure
package /ZeC/DTC/DTC/Power_Path_135_Load_Failure
  diagnostic trouble code uds Power_Path_135_Load_Failure: dtc-props=Dtc_Props_ac32608c, uds-dtc-value=0x005487
  diagnostic event EventPowerPath135LoadFailure: aging-allowed=true, event-kind=SWC, prestorage-freeze-frame=false  # Event_Power_Path_135_Load_Failure
  diagnostic event to trouble code uds mapping EventDtcMapPowerPath135LoadFailure: diagnostic-event=EventPowerPath135LoadFailure, trouble-code-uds=Power_Path_135_Load_Failure  # Event_Dtc_Map_Power_Path_135_Load_Failure
  diagnostic event to operation cycle mapping EventOperCycleMapPowerPath135LoadFailure: diagnostic-event=EventPowerPath135LoadFailure, operation-cycle=DefaultOperationCycle  # Event_Oper_Cycle_Map_Power_Path_135_Load_Failure
  diagnostic event to debounce algorithm mapping EventDebounceMapPowerPath135LoadFailure: debounce-algorithm=time_based, diagnostic-event=EventPowerPath135LoadFailure  # EventDebounceMap_Power_Path_135_Load_Failure
package /ZeC/DTC/DTC/Power_Path_130_Load_Failure
  diagnostic trouble code uds Power_Path_130_Load_Failure: dtc-props=Dtc_Props_293e441f, uds-dtc-value=0x005482
  diagnostic event EventPowerPath130LoadFailure: aging-allowed=true, event-kind=SWC, prestorage-freeze-frame=false  # Event_Power_Path_130_Load_Failure
  diagnostic event to trouble code uds mapping EventDtcMapPowerPath130LoadFailure: diagnostic-event=EventPowerPath130LoadFailure, trouble-code-uds=Power_Path_130_Load_Failure  # Event_Dtc_Map_Power_Path_130_Load_Failure
  diagnostic event to operation cycle mapping EventOperCycleMapPowerPath130LoadFailure: diagnostic-event=EventPowerPath130LoadFailure, operation-cycle=DefaultOperationCycle  # Event_Oper_Cycle_Map_Power_Path_130_Load_Failure
  diagnostic event to debounce algorithm mapping EventDebounceMapPowerPath130LoadFailure: debounce-algorithm=time_based, diagnostic-event=EventPowerPath130LoadFailure  # EventDebounceMap_Power_Path_130_Load_Failure
package /ZeC/DTC/DTC/Power_Path_129_Load_Failure
  diagnostic trouble code uds Power_Path_129_Load_Failure: dtc-props=Dtc_Props_e3155a51, uds-dtc-value=0x005481
  diagnostic event EventPowerPath129LoadFailure: aging-allowed=true, event-kind=SWC, prestorage-freeze-frame=false  # Event_Power_Path_129_Load_Failure
  diagnostic event to trouble code uds mapping EventDtcMapPowerPath129LoadFailure: diagnostic-event=EventPowerPath129LoadFailure, trouble-code-uds=Power_Path_129_Load_Failure  # Event_Dtc_Map_Power_Path_129_Load_Failure
  diagnostic event to operation cycle mapping EventOperCycleMapPowerPath129LoadFailure: diagnostic-event=EventPowerPath129LoadFailure, operation-cycle=DefaultOperationCycle  # Event_Oper_Cycle_Map_Power_Path_129_Load_Failure
  diagnostic event to debounce algorithm mapping EventDebounceMapPowerPath129LoadFailure: debounce-algorithm=time_based, diagnostic-event=EventPowerPath129LoadFailure  # EventDebounceMap_Power_Path_129_Load_Failure
package /ZeC/DTC/DTC/Power_Path_132_Load_Failure
  diagnostic trouble code uds Power_Path_132_Load_Failure: dtc-props=Dtc_Props_66197ec2, uds-dtc-value=0x005484
  diagnostic event EventPowerPath132LoadFailure: aging-allowed=true, event-kind=SWC, prestorage-freeze-frame=false  # Event_Power_Path_132_Load_Failure
  diagnostic event to trouble code uds mapping EventDtcMapPowerPath132LoadFailure: diagnostic-event=EventPowerPath132LoadFailure, trouble-code-uds=Power_Path_132_Load_Failure  # Event_Dtc_Map_Power_Path_132_Load_Failure
  diagnostic event to operation cycle mapping EventOperCycleMapPowerPath132LoadFailure: diagnostic-event=EventPowerPath132LoadFailure, operation-cycle=DefaultOperationCycle  # Event_Oper_Cycle_Map_Power_Path_132_Load_Failure
  diagnostic event to debounce algorithm mapping EventDebounceMapPowerPath132LoadFailure: debounce-algorithm=time_based, diagnostic-event=EventPowerPath132LoadFailure  # EventDebounceMap_Power_Path_132_Load_Failure
package /ZeC/DTC/DTC/Power_Path_131_Load_Failure
  diagnostic trouble code uds Power_Path_131_Load_Failure: dtc-props=Dtc_Props_6f274e25, uds-dtc-value=0x005483
  diagnostic event EventPowerPath131LoadFailure: aging-allowed=true, event-kind=SWC, prestorage-freeze-frame=false  # Event_Power_Path_131_Load_Failure
  diagnostic event to trouble code uds mapping EventDtcMapPowerPath131LoadFailure: diagnostic-event=EventPowerPath131LoadFailure, trouble-code-uds=Power_Path_131_Load_Failure  # Event_Dtc_Map_Power_Path_131_Load_Failure
  diagnostic event to operation cycle mapping EventOperCycleMapPowerPath131LoadFailure: diagnostic-event=EventPowerPath131LoadFailure, operation-cycle=DefaultOperationCycle  # Event_Oper_Cycle_Map_Power_Path_131_Load_Failure
  diagnostic event to debounce algorithm mapping EventDebounceMapPowerPath131LoadFailure: debounce-algorithm=time_based, diagnostic-event=EventPowerPath131LoadFailure  # EventDebounceMap_Power_Path_131_Load_Failure
package /ZeC/DTC/DTC/LIN_22_Slave_7_NoCommunication
  diagnostic trouble code uds LIN_22_Slave_7_NoCommunication: dtc-props=Dtc_Props_358996c7, uds-dtc-value=0x031716  # LIN 22 Slave 7_NoCommunication
  diagnostic event EventLIN22Slave7NoCommunication: aging-allowed=true, event-kind=SWC, prestorage-freeze-frame=false  # Event_LIN 22 Slave 7_NoCommunication
  diagnostic event to trouble code uds mapping EventDtcMapLIN22Slave7NoCommunication: diagnostic-event=EventLIN22Slave7NoCommunication, trouble-code-uds=LIN_22_Slave_7_NoCommunication  # Event_Dtc_Map_LIN 22 Slave 7_NoCommunication
  diagnostic event to operation cycle mapping EventOperCycleMapLIN22Slave7NoCommunication: diagnostic-event=EventLIN22Slave7NoCommunication, operation-cycle=DefaultOperationCycle  # Event_Oper_Cycle_Map_LIN 22 Slave 7_NoCommunication
  diagnostic event to debounce algorithm mapping EventDebounceMapLIN22Slave7NoCommunication: debounce-algorithm=counter_based, diagnostic-event=EventLIN22Slave7NoCommunication  # EventDebounceMap_LIN 22 Slave 7_NoCommunication
package /ZeC/DTC/DTC/Power_Path_040_Load_Failure
  diagnostic trouble code uds Power_Path_040_Load_Failure: dtc-props=Dtc_Props_2b5096cc, uds-dtc-value=0x005428
  diagnostic event EventPowerPath040LoadFailure: aging-allowed=true, event-kind=SWC, prestorage-freeze-frame=false  # Event_Power_Path_040_Load_Failure
  diagnostic event to trouble code uds mapping EventDtcMapPowerPath040LoadFailure: diagnostic-event=EventPowerPath040LoadFailure, trouble-code-uds=Power_Path_040_Load_Failure  # Event_Dtc_Map_Power_Path_040_Load_Failure
  diagnostic event to operation cycle mapping EventOperCycleMapPowerPath040LoadFailure: diagnostic-event=EventPowerPath040LoadFailure, operation-cycle=DefaultOperationCycle  # Event_Oper_Cycle_Map_Power_Path_040_Load_Failure
  diagnostic event to debounce algorithm mapping EventDebounceMapPowerPath040LoadFailure: debounce-algorithm=time_based, diagnostic-event=EventPowerPath040LoadFailure  # EventDebounceMap_Power_Path_040_Load_Failure
package /ZeC/DTC/DTC/LIN_22_Slave_8_Defect
  diagnostic trouble code uds LIN_22_Slave_8_Defect: dtc-props=Dtc_Props_358996c7, uds-dtc-value=0x031717  # LIN 22 Slave 8_Defect
  diagnostic event EventLIN22Slave8Defect: aging-allowed=true, event-kind=SWC, prestorage-freeze-frame=false  # Event_LIN 22 Slave 8_Defect
  diagnostic event to trouble code uds mapping EventDtcMapLIN22Slave8Defect: diagnostic-event=EventLIN22Slave8Defect, trouble-code-uds=LIN_22_Slave_8_Defect  # Event_Dtc_Map_LIN 22 Slave 8_Defect
  diagnostic event to operation cycle mapping EventOperCycleMapLIN22Slave8Defect: diagnostic-event=EventLIN22Slave8Defect, operation-cycle=DefaultOperationCycle  # Event_Oper_Cycle_Map_LIN 22 Slave 8_Defect
  diagnostic event to debounce algorithm mapping EventDebounceMapLIN22Slave8Defect: debounce-algorithm=counter_based, diagnostic-event=EventLIN22Slave8Defect  # EventDebounceMap_LIN 22 Slave 8_Defect
package /ZeC/DTC/DTC/Power_Path_039_Load_Failure
  diagnostic trouble code uds Power_Path_039_Load_Failure: dtc-props=Dtc_Props_7f35fd38, uds-dtc-value=0x005427
  diagnostic event EventPowerPath039LoadFailure: aging-allowed=true, event-kind=SWC, prestorage-freeze-frame=false  # Event_Power_Path_039_Load_Failure
  diagnostic event to trouble code uds mapping EventDtcMapPowerPath039LoadFailure: diagnostic-event=EventPowerPath039LoadFailure, trouble-code-uds=Power_Path_039_Load_Failure  # Event_Dtc_Map_Power_Path_039_Load_Failure
  diagnostic event to operation cycle mapping EventOperCycleMapPowerPath039LoadFailure: diagnostic-event=EventPowerPath039LoadFailure, operation-cycle=DefaultOperationCycle  # Event_Oper_Cycle_Map_Power_Path_039_Load_Failure
  diagnostic event to debounce algorithm mapping EventDebounceMapPowerPath039LoadFailure: debounce-algorithm=time_based, diagnostic-event=EventPowerPath039LoadFailure  # EventDebounceMap_Power_Path_039_Load_Failure
package /ZeC/DTC/DTC/LIN_22_Slave_6_NoCommunication
  diagnostic trouble code uds LIN_22_Slave_6_NoCommunication: dtc-props=Dtc_Props_358996c7, uds-dtc-value=0x031714  # LIN 22 Slave 6_NoCommunication
  diagnostic event EventLIN22Slave6NoCommunication: aging-allowed=true, event-kind=SWC, prestorage-freeze-frame=false  # Event_LIN 22 Slave 6_NoCommunication
  diagnostic event to trouble code uds mapping EventDtcMapLIN22Slave6NoCommunication: diagnostic-event=EventLIN22Slave6NoCommunication, trouble-code-uds=LIN_22_Slave_6_NoCommunication  # Event_Dtc_Map_LIN 22 Slave 6_NoCommunication
  diagnostic event to operation cycle mapping EventOperCycleMapLIN22Slave6NoCommunication: diagnostic-event=EventLIN22Slave6NoCommunication, operation-cycle=DefaultOperationCycle  # Event_Oper_Cycle_Map_LIN 22 Slave 6_NoCommunication
  diagnostic event to debounce algorithm mapping EventDebounceMapLIN22Slave6NoCommunication: debounce-algorithm=counter_based, diagnostic-event=EventLIN22Slave6NoCommunication  # EventDebounceMap_LIN 22 Slave 6_NoCommunication
package /ZeC/DTC/DTC/LIN_22_Slave_7_Defect
  diagnostic trouble code uds LIN_22_Slave_7_Defect: dtc-props=Dtc_Props_358996c7, uds-dtc-value=0x031715  # LIN 22 Slave 7_Defect
  diagnostic event EventLIN22Slave7Defect: aging-allowed=true, event-kind=SWC, prestorage-freeze-frame=false  # Event_LIN 22 Slave 7_Defect
  diagnostic event to trouble code uds mapping EventDtcMapLIN22Slave7Defect: diagnostic-event=EventLIN22Slave7Defect, trouble-code-uds=LIN_22_Slave_7_Defect  # Event_Dtc_Map_LIN 22 Slave 7_Defect
  diagnostic event to operation cycle mapping EventOperCycleMapLIN22Slave7Defect: diagnostic-event=EventLIN22Slave7Defect, operation-cycle=DefaultOperationCycle  # Event_Oper_Cycle_Map_LIN 22 Slave 7_Defect
  diagnostic event to debounce algorithm mapping EventDebounceMapLIN22Slave7Defect: debounce-algorithm=counter_based, diagnostic-event=EventLIN22Slave7Defect  # EventDebounceMap_LIN 22 Slave 7_Defect
package /ZeC/DTC/DTC/Power_Path_041_Load_Failure
  diagnostic trouble code uds Power_Path_041_Load_Failure: dtc-props=Dtc_Props_6d499cf6, uds-dtc-value=0x005429
  diagnostic event EventPowerPath041LoadFailure: aging-allowed=true, event-kind=SWC, prestorage-freeze-frame=false  # Event_Power_Path_041_Load_Failure
  diagnostic event to trouble code uds mapping EventDtcMapPowerPath041LoadFailure: diagnostic-event=EventPowerPath041LoadFailure, trouble-code-uds=Power_Path_041_Load_Failure  # Event_Dtc_Map_Power_Path_041_Load_Failure
  diagnostic event to operation cycle mapping EventOperCycleMapPowerPath041LoadFailure: diagnostic-event=EventPowerPath041LoadFailure, operation-cycle=DefaultOperationCycle  # Event_Oper_Cycle_Map_Power_Path_041_Load_Failure
  diagnostic event to debounce algorithm mapping EventDebounceMapPowerPath041LoadFailure: debounce-algorithm=time_based, diagnostic-event=EventPowerPath041LoadFailure  # EventDebounceMap_Power_Path_041_Load_Failure
package /ZeC/DTC/DTC/LIN_22_Slave_5_NoCommunication
  diagnostic trouble code uds LIN_22_Slave_5_NoCommunication: dtc-props=Dtc_Props_358996c7, uds-dtc-value=0x031712  # LIN 22 Slave 5_NoCommunication
  diagnostic event EventLIN22Slave5NoCommunication: aging-allowed=true, event-kind=SWC, prestorage-freeze-frame=false  # Event_LIN 22 Slave 5_NoCommunication
  diagnostic event to trouble code uds mapping EventDtcMapLIN22Slave5NoCommunication: diagnostic-event=EventLIN22Slave5NoCommunication, trouble-code-uds=LIN_22_Slave_5_NoCommunication  # Event_Dtc_Map_LIN 22 Slave 5_NoCommunication
  diagnostic event to operation cycle mapping EventOperCycleMapLIN22Slave5NoCommunication: diagnostic-event=EventLIN22Slave5NoCommunication, operation-cycle=DefaultOperationCycle  # Event_Oper_Cycle_Map_LIN 22 Slave 5_NoCommunication
  diagnostic event to debounce algorithm mapping EventDebounceMapLIN22Slave5NoCommunication: debounce-algorithm=counter_based, diagnostic-event=EventLIN22Slave5NoCommunication  # EventDebounceMap_LIN 22 Slave 5_NoCommunication
package /ZeC/DTC/DTC/Power_Path_036_Load_Failure
  diagnostic trouble code uds Power_Path_036_Load_Failure: dtc-props=Dtc_Props_b51ee376, uds-dtc-value=0x005424
  diagnostic event EventPowerPath036LoadFailure: aging-allowed=true, event-kind=SWC, prestorage-freeze-frame=false  # Event_Power_Path_036_Load_Failure
  diagnostic event to trouble code uds mapping EventDtcMapPowerPath036LoadFailure: diagnostic-event=EventPowerPath036LoadFailure, trouble-code-uds=Power_Path_036_Load_Failure  # Event_Dtc_Map_Power_Path_036_Load_Failure
  diagnostic event to operation cycle mapping EventOperCycleMapPowerPath036LoadFailure: diagnostic-event=EventPowerPath036LoadFailure, operation-cycle=DefaultOperationCycle  # Event_Oper_Cycle_Map_Power_Path_036_Load_Failure
  diagnostic event to debounce algorithm mapping EventDebounceMapPowerPath036LoadFailure: debounce-algorithm=time_based, diagnostic-event=EventPowerPath036LoadFailure  # EventDebounceMap_Power_Path_036_Load_Failure
package /ZeC/DTC/DTC/LIN_22_Slave_6_Defect
  diagnostic trouble code uds LIN_22_Slave_6_Defect: dtc-props=Dtc_Props_358996c7, uds-dtc-value=0x031713  # LIN 22 Slave 6_Defect
  diagnostic event EventLIN22Slave6Defect: aging-allowed=true, event-kind=SWC, prestorage-freeze-frame=false  # Event_LIN 22 Slave 6_Defect
  diagnostic event to trouble code uds mapping EventDtcMapLIN22Slave6Defect: diagnostic-event=EventLIN22Slave6Defect, trouble-code-uds=LIN_22_Slave_6_Defect  # Event_Dtc_Map_LIN 22 Slave 6_Defect
  diagnostic event to operation cycle mapping EventOperCycleMapLIN22Slave6Defect: diagnostic-event=EventLIN22Slave6Defect, operation-cycle=DefaultOperationCycle  # Event_Oper_Cycle_Map_LIN 22 Slave 6_Defect
  diagnostic event to debounce algorithm mapping EventDebounceMapLIN22Slave6Defect: debounce-algorithm=counter_based, diagnostic-event=EventLIN22Slave6Defect  # EventDebounceMap_LIN 22 Slave 6_Defect
package /ZeC/DTC/DTC/Power_Path_035_Load_Failure
  diagnostic trouble code uds Power_Path_035_Load_Failure: dtc-props=Dtc_Props_bc20d391, uds-dtc-value=0x005423
  diagnostic event EventPowerPath035LoadFailure: aging-allowed=true, event-kind=SWC, prestorage-freeze-frame=false  # Event_Power_Path_035_Load_Failure
  diagnostic event to trouble code uds mapping EventDtcMapPowerPath035LoadFailure: diagnostic-event=EventPowerPath035LoadFailure, trouble-code-uds=Power_Path_035_Load_Failure  # Event_Dtc_Map_Power_Path_035_Load_Failure
  diagnostic event to operation cycle mapping EventOperCycleMapPowerPath035LoadFailure: diagnostic-event=EventPowerPath035LoadFailure, operation-cycle=DefaultOperationCycle  # Event_Oper_Cycle_Map_Power_Path_035_Load_Failure
  diagnostic event to debounce algorithm mapping EventDebounceMapPowerPath035LoadFailure: debounce-algorithm=time_based, diagnostic-event=EventPowerPath035LoadFailure  # EventDebounceMap_Power_Path_035_Load_Failure
package /ZeC/DTC/DTC/LIN_22_Slave_4_NoCommunication
  diagnostic trouble code uds LIN_22_Slave_4_NoCommunication: dtc-props=Dtc_Props_358996c7, uds-dtc-value=0x031710  # LIN 22 Slave 4_NoCommunication
  diagnostic event EventLIN22Slave4NoCommunication: aging-allowed=true, event-kind=SWC, prestorage-freeze-frame=false  # Event_LIN 22 Slave 4_NoCommunication
  diagnostic event to trouble code uds mapping EventDtcMapLIN22Slave4NoCommunication: diagnostic-event=EventLIN22Slave4NoCommunication, trouble-code-uds=LIN_22_Slave_4_NoCommunication  # Event_Dtc_Map_LIN 22 Slave 4_NoCommunication
  diagnostic event to operation cycle mapping EventOperCycleMapLIN22Slave4NoCommunication: diagnostic-event=EventLIN22Slave4NoCommunication, operation-cycle=DefaultOperationCycle  # Event_Oper_Cycle_Map_LIN 22 Slave 4_NoCommunication
  diagnostic event to debounce algorithm mapping EventDebounceMapLIN22Slave4NoCommunication: debounce-algorithm=counter_based, diagnostic-event=EventLIN22Slave4NoCommunication  # EventDebounceMap_LIN 22 Slave 4_NoCommunication
package /ZeC/DTC/DTC/Power_Path_038_Load_Failure
  diagnostic trouble code uds Power_Path_038_Load_Failure: dtc-props=Dtc_Props_392cf702, uds-dtc-value=0x005426
  diagnostic event EventPowerPath038LoadFailure: aging-allowed=true, event-kind=SWC, prestorage-freeze-frame=false  # Event_Power_Path_038_Load_Failure
  diagnostic event to trouble code uds mapping EventDtcMapPowerPath038LoadFailure: diagnostic-event=EventPowerPath038LoadFailure, trouble-code-uds=Power_Path_038_Load_Failure  # Event_Dtc_Map_Power_Path_038_Load_Failure
  diagnostic event to operation cycle mapping EventOperCycleMapPowerPath038LoadFailure: diagnostic-event=EventPowerPath038LoadFailure, operation-cycle=DefaultOperationCycle  # Event_Oper_Cycle_Map_Power_Path_038_Load_Failure
  diagnostic event to debounce algorithm mapping EventDebounceMapPowerPath038LoadFailure: debounce-algorithm=time_based, diagnostic-event=EventPowerPath038LoadFailure  # EventDebounceMap_Power_Path_038_Load_Failure
package /ZeC/DTC/DTC/LIN_22_Slave_5_Defect
  diagnostic trouble code uds LIN_22_Slave_5_Defect: dtc-props=Dtc_Props_358996c7, uds-dtc-value=0x031711  # LIN 22 Slave 5_Defect
  diagnostic event EventLIN22Slave5Defect: aging-allowed=true, event-kind=SWC, prestorage-freeze-frame=false  # Event_LIN 22 Slave 5_Defect
  diagnostic event to trouble code uds mapping EventDtcMapLIN22Slave5Defect: diagnostic-event=EventLIN22Slave5Defect, trouble-code-uds=LIN_22_Slave_5_Defect  # Event_Dtc_Map_LIN 22 Slave 5_Defect
  diagnostic event to operation cycle mapping EventOperCycleMapLIN22Slave5Defect: diagnostic-event=EventLIN22Slave5Defect, operation-cycle=DefaultOperationCycle  # Event_Oper_Cycle_Map_LIN 22 Slave 5_Defect
  diagnostic event to debounce algorithm mapping EventDebounceMapLIN22Slave5Defect: debounce-algorithm=counter_based, diagnostic-event=EventLIN22Slave5Defect  # EventDebounceMap_LIN 22 Slave 5_Defect
package /ZeC/DTC/DTC/Power_Path_037_Load_Failure
  diagnostic trouble code uds Power_Path_037_Load_Failure: dtc-props=Dtc_Props_f307e94c, uds-dtc-value=0x005425
  diagnostic event EventPowerPath037LoadFailure: aging-allowed=true, event-kind=SWC, prestorage-freeze-frame=false  # Event_Power_Path_037_Load_Failure
  diagnostic event to trouble code uds mapping EventDtcMapPowerPath037LoadFailure: diagnostic-event=EventPowerPath037LoadFailure, trouble-code-uds=Power_Path_037_Load_Failure  # Event_Dtc_Map_Power_Path_037_Load_Failure
  diagnostic event to operation cycle mapping EventOperCycleMapPowerPath037LoadFailure: diagnostic-event=EventPowerPath037LoadFailure, operation-cycle=DefaultOperationCycle  # Event_Oper_Cycle_Map_Power_Path_037_Load_Failure
  diagnostic event to debounce algorithm mapping EventDebounceMapPowerPath037LoadFailure: debounce-algorithm=time_based, diagnostic-event=EventPowerPath037LoadFailure  # EventDebounceMap_Power_Path_037_Load_Failure
package /ZeC/DTC/DTC/Power_Path_043_Load_Failure
  diagnostic trouble code uds Power_Path_043_Load_Failure: dtc-props=Dtc_Props_c7c6bdd6, uds-dtc-value=0x00542b
  diagnostic event EventPowerPath043LoadFailure: aging-allowed=true, event-kind=SWC, prestorage-freeze-frame=false  # Event_Power_Path_043_Load_Failure
  diagnostic event to trouble code uds mapping EventDtcMapPowerPath043LoadFailure: diagnostic-event=EventPowerPath043LoadFailure, trouble-code-uds=Power_Path_043_Load_Failure  # Event_Dtc_Map_Power_Path_043_Load_Failure
  diagnostic event to operation cycle mapping EventOperCycleMapPowerPath043LoadFailure: diagnostic-event=EventPowerPath043LoadFailure, operation-cycle=DefaultOperationCycle  # Event_Oper_Cycle_Map_Power_Path_043_Load_Failure
  diagnostic event to debounce algorithm mapping EventDebounceMapPowerPath043LoadFailure: debounce-algorithm=time_based, diagnostic-event=EventPowerPath043LoadFailure  # EventDebounceMap_Power_Path_043_Load_Failure
package /ZeC/DTC/DTC/Power_Path_042_Load_Failure
  diagnostic trouble code uds Power_Path_042_Load_Failure: dtc-props=Dtc_Props_deda398, uds-dtc-value=0x00542a
  diagnostic event EventPowerPath042LoadFailure: aging-allowed=true, event-kind=SWC, prestorage-freeze-frame=false  # Event_Power_Path_042_Load_Failure
  diagnostic event to trouble code uds mapping EventDtcMapPowerPath042LoadFailure: diagnostic-event=EventPowerPath042LoadFailure, trouble-code-uds=Power_Path_042_Load_Failure  # Event_Dtc_Map_Power_Path_042_Load_Failure
  diagnostic event to operation cycle mapping EventOperCycleMapPowerPath042LoadFailure: diagnostic-event=EventPowerPath042LoadFailure, operation-cycle=DefaultOperationCycle  # Event_Oper_Cycle_Map_Power_Path_042_Load_Failure
  diagnostic event to debounce algorithm mapping EventDebounceMapPowerPath042LoadFailure: debounce-algorithm=time_based, diagnostic-event=EventPowerPath042LoadFailure  # EventDebounceMap_Power_Path_042_Load_Failure
package /ZeC/DTC/DTC/LIN_14_Slave_7_NoCommunication
  diagnostic trouble code uds LIN_14_Slave_7_NoCommunication: dtc-props=Dtc_Props_358996c7, uds-dtc-value=0x030e06  # LIN 14 Slave 7_NoCommunication
  diagnostic event EventLIN14Slave7NoCommunication: aging-allowed=true, event-kind=SWC, prestorage-freeze-frame=false  # Event_LIN 14 Slave 7_NoCommunication
  diagnostic event to trouble code uds mapping EventDtcMapLIN14Slave7NoCommunication: diagnostic-event=EventLIN14Slave7NoCommunication, trouble-code-uds=LIN_14_Slave_7_NoCommunication  # Event_Dtc_Map_LIN 14 Slave 7_NoCommunication
  diagnostic event to operation cycle mapping EventOperCycleMapLIN14Slave7NoCommunication: diagnostic-event=EventLIN14Slave7NoCommunication, operation-cycle=DefaultOperationCycle  # Event_Oper_Cycle_Map_LIN 14 Slave 7_NoCommunication
  diagnostic event to debounce algorithm mapping EventDebounceMapLIN14Slave7NoCommunication: debounce-algorithm=counter_based, diagnostic-event=EventLIN14Slave7NoCommunication  # EventDebounceMap_LIN 14 Slave 7_NoCommunication
package /ZeC/DTC/DTC/LIN_14_Slave_8_Defect
  diagnostic trouble code uds LIN_14_Slave_8_Defect: dtc-props=Dtc_Props_358996c7, uds-dtc-value=0x030e07  # LIN 14 Slave 8_Defect
  diagnostic event EventLIN14Slave8Defect: aging-allowed=true, event-kind=SWC, prestorage-freeze-frame=false  # Event_LIN 14 Slave 8_Defect
  diagnostic event to trouble code uds mapping EventDtcMapLIN14Slave8Defect: diagnostic-event=EventLIN14Slave8Defect, trouble-code-uds=LIN_14_Slave_8_Defect  # Event_Dtc_Map_LIN 14 Slave 8_Defect
  diagnostic event to operation cycle mapping EventOperCycleMapLIN14Slave8Defect: diagnostic-event=EventLIN14Slave8Defect, operation-cycle=DefaultOperationCycle  # Event_Oper_Cycle_Map_LIN 14 Slave 8_Defect
  diagnostic event to debounce algorithm mapping EventDebounceMapLIN14Slave8Defect: debounce-algorithm=counter_based, diagnostic-event=EventLIN14Slave8Defect  # EventDebounceMap_LIN 14 Slave 8_Defect
package /ZeC/DTC/DTC/LIN_14_Slave_6_NoCommunication
  diagnostic trouble code uds LIN_14_Slave_6_NoCommunication: dtc-props=Dtc_Props_358996c7, uds-dtc-value=0x030e04  # LIN 14 Slave 6_NoCommunication
  diagnostic event EventLIN14Slave6NoCommunication: aging-allowed=true, event-kind=SWC, prestorage-freeze-frame=false  # Event_LIN 14 Slave 6_NoCommunication
  diagnostic event to trouble code uds mapping EventDtcMapLIN14Slave6NoCommunication: diagnostic-event=EventLIN14Slave6NoCommunication, trouble-code-uds=LIN_14_Slave_6_NoCommunication  # Event_Dtc_Map_LIN 14 Slave 6_NoCommunication
  diagnostic event to operation cycle mapping EventOperCycleMapLIN14Slave6NoCommunication: diagnostic-event=EventLIN14Slave6NoCommunication, operation-cycle=DefaultOperationCycle  # Event_Oper_Cycle_Map_LIN 14 Slave 6_NoCommunication
  diagnostic event to debounce algorithm mapping EventDebounceMapLIN14Slave6NoCommunication: debounce-algorithm=counter_based, diagnostic-event=EventLIN14Slave6NoCommunication  # EventDebounceMap_LIN 14 Slave 6_NoCommunication
package /ZeC/DTC/DTC/LIN_22_Slave_10_Defect
  diagnostic trouble code uds LIN_22_Slave_10_Defect: dtc-props=Dtc_Props_358996c7, uds-dtc-value=0x03171d  # LIN 22 Slave 10_Defect
  diagnostic event EventLIN22Slave10Defect: aging-allowed=true, event-kind=SWC, prestorage-freeze-frame=false  # Event_LIN 22 Slave 10_Defect
  diagnostic event to trouble code uds mapping EventDtcMapLIN22Slave10Defect: diagnostic-event=EventLIN22Slave10Defect, trouble-code-uds=LIN_22_Slave_10_Defect  # Event_Dtc_Map_LIN 22 Slave 10_Defect
  diagnostic event to operation cycle mapping EventOperCycleMapLIN22Slave10Defect: diagnostic-event=EventLIN22Slave10Defect, operation-cycle=DefaultOperationCycle  # Event_Oper_Cycle_Map_LIN 22 Slave 10_Defect
  diagnostic event to debounce algorithm mapping EventDebounceMapLIN22Slave10Defect: debounce-algorithm=counter_based, diagnostic-event=EventLIN22Slave10Defect  # EventDebounceMap_LIN 22 Slave 10_Defect
package /ZeC/DTC/DTC/LIN_14_Slave_7_Defect
  diagnostic trouble code uds LIN_14_Slave_7_Defect: dtc-props=Dtc_Props_358996c7, uds-dtc-value=0x030e05  # LIN 14 Slave 7_Defect
  diagnostic event EventLIN14Slave7Defect: aging-allowed=true, event-kind=SWC, prestorage-freeze-frame=false  # Event_LIN 14 Slave 7_Defect
  diagnostic event to trouble code uds mapping EventDtcMapLIN14Slave7Defect: diagnostic-event=EventLIN14Slave7Defect, trouble-code-uds=LIN_14_Slave_7_Defect  # Event_Dtc_Map_LIN 14 Slave 7_Defect
  diagnostic event to operation cycle mapping EventOperCycleMapLIN14Slave7Defect: diagnostic-event=EventLIN14Slave7Defect, operation-cycle=DefaultOperationCycle  # Event_Oper_Cycle_Map_LIN 14 Slave 7_Defect
  diagnostic event to debounce algorithm mapping EventDebounceMapLIN14Slave7Defect: debounce-algorithm=counter_based, diagnostic-event=EventLIN14Slave7Defect  # EventDebounceMap_LIN 14 Slave 7_Defect
package /ZeC/DTC/DTC/LIN_22_Slave_10_NoCommunication
  diagnostic trouble code uds LIN_22_Slave_10_NoCommunication: dtc-props=Dtc_Props_358996c7, uds-dtc-value=0x03171e  # LIN 22 Slave 10_NoCommunication
  diagnostic event EventLIN22Slave10NoCommunication: aging-allowed=true, event-kind=SWC, prestorage-freeze-frame=false  # Event_LIN 22 Slave 10_NoCommunication
  diagnostic event to trouble code uds mapping EventDtcMapLIN22Slave10NoCommunication: diagnostic-event=EventLIN22Slave10NoCommunication, trouble-code-uds=LIN_22_Slave_10_NoCommunication  # Event_Dtc_Map_LIN 22 Slave 10_NoCommunication
  diagnostic event to operation cycle mapping EventOperCycleMapLIN22Slave10NoCommunication: diagnostic-event=EventLIN22Slave10NoCommunication, operation-cycle=DefaultOperationCycle  # Event_Oper_Cycle_Map_LIN 22 Slave 10_NoCommunication
  diagnostic event to debounce algorithm mapping EventDebounceMapLIN22Slave10NoCommunication: debounce-algorithm=counter_based, diagnostic-event=EventLIN22Slave10NoCommunication  # EventDebounceMap_LIN 22 Slave 10_NoCommunication
package /ZeC/DTC/DTC/LIN_14_Slave_5_NoCommunication
  diagnostic trouble code uds LIN_14_Slave_5_NoCommunication: dtc-props=Dtc_Props_358996c7, uds-dtc-value=0x030e02  # LIN 14 Slave 5_NoCommunication
  diagnostic event EventLIN14Slave5NoCommunication: aging-allowed=true, event-kind=SWC, prestorage-freeze-frame=false  # Event_LIN 14 Slave 5_NoCommunication
  diagnostic event to trouble code uds mapping EventDtcMapLIN14Slave5NoCommunication: diagnostic-event=EventLIN14Slave5NoCommunication, trouble-code-uds=LIN_14_Slave_5_NoCommunication  # Event_Dtc_Map_LIN 14 Slave 5_NoCommunication
  diagnostic event to operation cycle mapping EventOperCycleMapLIN14Slave5NoCommunication: diagnostic-event=EventLIN14Slave5NoCommunication, operation-cycle=DefaultOperationCycle  # Event_Oper_Cycle_Map_LIN 14 Slave 5_NoCommunication
  diagnostic event to debounce algorithm mapping EventDebounceMapLIN14Slave5NoCommunication: debounce-algorithm=counter_based, diagnostic-event=EventLIN14Slave5NoCommunication  # EventDebounceMap_LIN 14 Slave 5_NoCommunication
package /ZeC/DTC/DTC/LIN_22_Slave_1_Defect
  diagnostic trouble code uds LIN_22_Slave_1_Defect: dtc-props=Dtc_Props_358996c7, uds-dtc-value=0x03171b  # LIN 22 Slave 1_Defect
  diagnostic event EventLIN22Slave1Defect: aging-allowed=true, event-kind=SWC, prestorage-freeze-frame=false  # Event_LIN 22 Slave 1_Defect
  diagnostic event to trouble code uds mapping EventDtcMapLIN22Slave1Defect: diagnostic-event=EventLIN22Slave1Defect, trouble-code-uds=LIN_22_Slave_1_Defect  # Event_Dtc_Map_LIN 22 Slave 1_Defect
  diagnostic event to operation cycle mapping EventOperCycleMapLIN22Slave1Defect: diagnostic-event=EventLIN22Slave1Defect, operation-cycle=DefaultOperationCycle  # Event_Oper_Cycle_Map_LIN 22 Slave 1_Defect
  diagnostic event to debounce algorithm mapping EventDebounceMapLIN22Slave1Defect: debounce-algorithm=counter_based, diagnostic-event=EventLIN22Slave1Defect  # EventDebounceMap_LIN 22 Slave 1_Defect
package /ZeC/DTC/DTC/Power_Path_045_Load_Failure
  diagnostic trouble code uds Power_Path_045_Load_Failure: dtc-props=Dtc_Props_88e1870b, uds-dtc-value=0x00542d
  diagnostic event EventPowerPath045LoadFailure: aging-allowed=true, event-kind=SWC, prestorage-freeze-frame=false  # Event_Power_Path_045_Load_Failure
  diagnostic event to trouble code uds mapping EventDtcMapPowerPath045LoadFailure: diagnostic-event=EventPowerPath045LoadFailure, trouble-code-uds=Power_Path_045_Load_Failure  # Event_Dtc_Map_Power_Path_045_Load_Failure
  diagnostic event to operation cycle mapping EventOperCycleMapPowerPath045LoadFailure: diagnostic-event=EventPowerPath045LoadFailure, operation-cycle=DefaultOperationCycle  # Event_Oper_Cycle_Map_Power_Path_045_Load_Failure
  diagnostic event to debounce algorithm mapping EventDebounceMapPowerPath045LoadFailure: debounce-algorithm=time_based, diagnostic-event=EventPowerPath045LoadFailure  # EventDebounceMap_Power_Path_045_Load_Failure
package /ZeC/DTC/DTC/LIN_14_Slave_6_Defect
  diagnostic trouble code uds LIN_14_Slave_6_Defect: dtc-props=Dtc_Props_358996c7, uds-dtc-value=0x030e03  # LIN 14 Slave 6_Defect
  diagnostic event EventLIN14Slave6Defect: aging-allowed=true, event-kind=SWC, prestorage-freeze-frame=false  # Event_LIN 14 Slave 6_Defect
  diagnostic event to trouble code uds mapping EventDtcMapLIN14Slave6Defect: diagnostic-event=EventLIN14Slave6Defect, trouble-code-uds=LIN_14_Slave_6_Defect  # Event_Dtc_Map_LIN 14 Slave 6_Defect
  diagnostic event to operation cycle mapping EventOperCycleMapLIN14Slave6Defect: diagnostic-event=EventLIN14Slave6Defect, operation-cycle=DefaultOperationCycle  # Event_Oper_Cycle_Map_LIN 14 Slave 6_Defect
  diagnostic event to debounce algorithm mapping EventDebounceMapLIN14Slave6Defect: debounce-algorithm=counter_based, diagnostic-event=EventLIN14Slave6Defect  # EventDebounceMap_LIN 14 Slave 6_Defect
package /ZeC/DTC/DTC/LIN_22_Slave_1_NoCommunication
  diagnostic trouble code uds LIN_22_Slave_1_NoCommunication: dtc-props=Dtc_Props_358996c7, uds-dtc-value=0x03171c  # LIN 22 Slave 1_NoCommunication
  diagnostic event EventLIN22Slave1NoCommunication: aging-allowed=true, event-kind=SWC, prestorage-freeze-frame=false  # Event_LIN 22 Slave 1_NoCommunication
  diagnostic event to trouble code uds mapping EventDtcMapLIN22Slave1NoCommunication: diagnostic-event=EventLIN22Slave1NoCommunication, trouble-code-uds=LIN_22_Slave_1_NoCommunication  # Event_Dtc_Map_LIN 22 Slave 1_NoCommunication
  diagnostic event to operation cycle mapping EventOperCycleMapLIN22Slave1NoCommunication: diagnostic-event=EventLIN22Slave1NoCommunication, operation-cycle=DefaultOperationCycle  # Event_Oper_Cycle_Map_LIN 22 Slave 1_NoCommunication
  diagnostic event to debounce algorithm mapping EventDebounceMapLIN22Slave1NoCommunication: debounce-algorithm=counter_based, diagnostic-event=EventLIN22Slave1NoCommunication  # EventDebounceMap_LIN 22 Slave 1_NoCommunication
package /ZeC/DTC/DTC/Power_Path_044_Load_Failure
  diagnostic trouble code uds Power_Path_044_Load_Failure: dtc-props=Dtc_Props_81dfb7ec, uds-dtc-value=0x00542c
  diagnostic event EventPowerPath044LoadFailure: aging-allowed=true, event-kind=SWC, prestorage-freeze-frame=false  # Event_Power_Path_044_Load_Failure
  diagnostic event to trouble code uds mapping EventDtcMapPowerPath044LoadFailure: diagnostic-event=EventPowerPath044LoadFailure, trouble-code-uds=Power_Path_044_Load_Failure  # Event_Dtc_Map_Power_Path_044_Load_Failure
  diagnostic event to operation cycle mapping EventOperCycleMapPowerPath044LoadFailure: diagnostic-event=EventPowerPath044LoadFailure, operation-cycle=DefaultOperationCycle  # Event_Oper_Cycle_Map_Power_Path_044_Load_Failure
  diagnostic event to debounce algorithm mapping EventDebounceMapPowerPath044LoadFailure: debounce-algorithm=time_based, diagnostic-event=EventPowerPath044LoadFailure  # EventDebounceMap_Power_Path_044_Load_Failure
package /ZeC/DTC/DTC/Power_Path_047_Load_Failure
  diagnostic trouble code uds Power_Path_047_Load_Failure: dtc-props=Dtc_Props_4d3937f, uds-dtc-value=0x00542f
  diagnostic event EventPowerPath047LoadFailure: aging-allowed=true, event-kind=SWC, prestorage-freeze-frame=false  # Event_Power_Path_047_Load_Failure
  diagnostic event to trouble code uds mapping EventDtcMapPowerPath047LoadFailure: diagnostic-event=EventPowerPath047LoadFailure, trouble-code-uds=Power_Path_047_Load_Failure  # Event_Dtc_Map_Power_Path_047_Load_Failure
  diagnostic event to operation cycle mapping EventOperCycleMapPowerPath047LoadFailure: diagnostic-event=EventPowerPath047LoadFailure, operation-cycle=DefaultOperationCycle  # Event_Oper_Cycle_Map_Power_Path_047_Load_Failure
  diagnostic event to debounce algorithm mapping EventDebounceMapPowerPath047LoadFailure: debounce-algorithm=time_based, diagnostic-event=EventPowerPath047LoadFailure  # EventDebounceMap_Power_Path_047_Load_Failure
package /ZeC/DTC/DTC/LIN_14_Slave_5_Defect
  diagnostic trouble code uds LIN_14_Slave_5_Defect: dtc-props=Dtc_Props_358996c7, uds-dtc-value=0x030e01  # LIN 14 Slave 5_Defect
  diagnostic event EventLIN14Slave5Defect: aging-allowed=true, event-kind=SWC, prestorage-freeze-frame=false  # Event_LIN 14 Slave 5_Defect
  diagnostic event to trouble code uds mapping EventDtcMapLIN14Slave5Defect: diagnostic-event=EventLIN14Slave5Defect, trouble-code-uds=LIN_14_Slave_5_Defect  # Event_Dtc_Map_LIN 14 Slave 5_Defect
  diagnostic event to operation cycle mapping EventOperCycleMapLIN14Slave5Defect: diagnostic-event=EventLIN14Slave5Defect, operation-cycle=DefaultOperationCycle  # Event_Oper_Cycle_Map_LIN 14 Slave 5_Defect
  diagnostic event to debounce algorithm mapping EventDebounceMapLIN14Slave5Defect: debounce-algorithm=counter_based, diagnostic-event=EventLIN14Slave5Defect  # EventDebounceMap_LIN 14 Slave 5_Defect
package /ZeC/DTC/DTC/LIN_22_Slave_9_NoCommunication
  diagnostic trouble code uds LIN_22_Slave_9_NoCommunication: dtc-props=Dtc_Props_358996c7, uds-dtc-value=0x03171a  # LIN 22 Slave 9_NoCommunication
  diagnostic event EventLIN22Slave9NoCommunication: aging-allowed=true, event-kind=SWC, prestorage-freeze-frame=false  # Event_LIN 22 Slave 9_NoCommunication
  diagnostic event to trouble code uds mapping EventDtcMapLIN22Slave9NoCommunication: diagnostic-event=EventLIN22Slave9NoCommunication, trouble-code-uds=LIN_22_Slave_9_NoCommunication  # Event_Dtc_Map_LIN 22 Slave 9_NoCommunication
  diagnostic event to operation cycle mapping EventOperCycleMapLIN22Slave9NoCommunication: diagnostic-event=EventLIN22Slave9NoCommunication, operation-cycle=DefaultOperationCycle  # Event_Oper_Cycle_Map_LIN 22 Slave 9_NoCommunication
  diagnostic event to debounce algorithm mapping EventDebounceMapLIN22Slave9NoCommunication: debounce-algorithm=counter_based, diagnostic-event=EventLIN22Slave9NoCommunication  # EventDebounceMap_LIN 22 Slave 9_NoCommunication
package /ZeC/DTC/DTC/Power_Path_046_Load_Failure
  diagnostic trouble code uds Power_Path_046_Load_Failure: dtc-props=Dtc_Props_cef88d31, uds-dtc-value=0x00542e
  diagnostic event EventPowerPath046LoadFailure: aging-allowed=true, event-kind=SWC, prestorage-freeze-frame=false  # Event_Power_Path_046_Load_Failure
  diagnostic event to trouble code uds mapping EventDtcMapPowerPath046LoadFailure: diagnostic-event=EventPowerPath046LoadFailure, trouble-code-uds=Power_Path_046_Load_Failure  # Event_Dtc_Map_Power_Path_046_Load_Failure
  diagnostic event to operation cycle mapping EventOperCycleMapPowerPath046LoadFailure: diagnostic-event=EventPowerPath046LoadFailure, operation-cycle=DefaultOperationCycle  # Event_Oper_Cycle_Map_Power_Path_046_Load_Failure
  diagnostic event to debounce algorithm mapping EventDebounceMapPowerPath046LoadFailure: debounce-algorithm=time_based, diagnostic-event=EventPowerPath046LoadFailure  # EventDebounceMap_Power_Path_046_Load_Failure
package /ZeC/DTC/DTC/Power_Path_049_Load_Failure
  diagnostic trouble code uds Power_Path_049_Load_Failure: dtc-props=Dtc_Props_f658075d, uds-dtc-value=0x005431
  diagnostic event EventPowerPath049LoadFailure: aging-allowed=true, event-kind=SWC, prestorage-freeze-frame=false  # Event_Power_Path_049_Load_Failure
  diagnostic event to trouble code uds mapping EventDtcMapPowerPath049LoadFailure: diagnostic-event=EventPowerPath049LoadFailure, trouble-code-uds=Power_Path_049_Load_Failure  # Event_Dtc_Map_Power_Path_049_Load_Failure
  diagnostic event to operation cycle mapping EventOperCycleMapPowerPath049LoadFailure: diagnostic-event=EventPowerPath049LoadFailure, operation-cycle=DefaultOperationCycle  # Event_Oper_Cycle_Map_Power_Path_049_Load_Failure
  diagnostic event to debounce algorithm mapping EventDebounceMapPowerPath049LoadFailure: debounce-algorithm=time_based, diagnostic-event=EventPowerPath049LoadFailure  # EventDebounceMap_Power_Path_049_Load_Failure
package /ZeC/DTC/DTC/Power_Path_048_Load_Failure
  diagnostic trouble code uds Power_Path_048_Load_Failure: dtc-props=Dtc_Props_b0410d67, uds-dtc-value=0x005430
  diagnostic event EventPowerPath048LoadFailure: aging-allowed=true, event-kind=SWC, prestorage-freeze-frame=false  # Event_Power_Path_048_Load_Failure
  diagnostic event to trouble code uds mapping EventDtcMapPowerPath048LoadFailure: diagnostic-event=EventPowerPath048LoadFailure, trouble-code-uds=Power_Path_048_Load_Failure  # Event_Dtc_Map_Power_Path_048_Load_Failure
  diagnostic event to operation cycle mapping EventOperCycleMapPowerPath048LoadFailure: diagnostic-event=EventPowerPath048LoadFailure, operation-cycle=DefaultOperationCycle  # Event_Oper_Cycle_Map_Power_Path_048_Load_Failure
  diagnostic event to debounce algorithm mapping EventDebounceMapPowerPath048LoadFailure: debounce-algorithm=time_based, diagnostic-event=EventPowerPath048LoadFailure  # EventDebounceMap_Power_Path_048_Load_Failure
package /ZeC/DTC/DTC/Power_Path_051_Load_Failure
  diagnostic trouble code uds Power_Path_051_Load_Failure: dtc-props=Dtc_Props_7a6a1329, uds-dtc-value=0x005433
  diagnostic event EventPowerPath051LoadFailure: aging-allowed=true, event-kind=SWC, prestorage-freeze-frame=false  # Event_Power_Path_051_Load_Failure
  diagnostic event to trouble code uds mapping EventDtcMapPowerPath051LoadFailure: diagnostic-event=EventPowerPath051LoadFailure, trouble-code-uds=Power_Path_051_Load_Failure  # Event_Dtc_Map_Power_Path_051_Load_Failure
  diagnostic event to operation cycle mapping EventOperCycleMapPowerPath051LoadFailure: diagnostic-event=EventPowerPath051LoadFailure, operation-cycle=DefaultOperationCycle  # Event_Oper_Cycle_Map_Power_Path_051_Load_Failure
  diagnostic event to debounce algorithm mapping EventDebounceMapPowerPath051LoadFailure: debounce-algorithm=time_based, diagnostic-event=EventPowerPath051LoadFailure  # EventDebounceMap_Power_Path_051_Load_Failure
package /ZeC/DTC/DTC/Power_Path_050_Load_Failure
  diagnostic trouble code uds Power_Path_050_Load_Failure: dtc-props=Dtc_Props_3c731913, uds-dtc-value=0x005432
  diagnostic event EventPowerPath050LoadFailure: aging-allowed=true, event-kind=SWC, prestorage-freeze-frame=false  # Event_Power_Path_050_Load_Failure
  diagnostic event to trouble code uds mapping EventDtcMapPowerPath050LoadFailure: diagnostic-event=EventPowerPath050LoadFailure, trouble-code-uds=Power_Path_050_Load_Failure  # Event_Dtc_Map_Power_Path_050_Load_Failure
  diagnostic event to operation cycle mapping EventOperCycleMapPowerPath050LoadFailure: diagnostic-event=EventPowerPath050LoadFailure, operation-cycle=DefaultOperationCycle  # Event_Oper_Cycle_Map_Power_Path_050_Load_Failure
  diagnostic event to debounce algorithm mapping EventDebounceMapPowerPath050LoadFailure: debounce-algorithm=time_based, diagnostic-event=EventPowerPath050LoadFailure  # EventDebounceMap_Power_Path_050_Load_Failure
package /ZeC/DTC/DTC/SOK_function_deactivated
  diagnostic trouble code uds SOK_function_deactivated: dtc-props=Dtc_Props_b618fb9, uds-dtc-value=0x001070
  diagnostic event EventSOKFunctionDeactivated: aging-allowed=true, event-kind=SWC, prestorage-freeze-frame=false  # Event_SOK_function_deactivated
  diagnostic event to trouble code uds mapping EventDtcMapSOKFunctionDeactivated: diagnostic-event=EventSOKFunctionDeactivated, trouble-code-uds=SOK_function_deactivated  # Event_Dtc_Map_SOK_function_deactivated
  diagnostic event to operation cycle mapping EventOperCycleMapSOKFunctionDeactivated: diagnostic-event=EventSOKFunctionDeactivated, operation-cycle=DefaultOperationCycle  # Event_Oper_Cycle_Map_SOK_function_deactivated
  diagnostic event to debounce algorithm mapping EventDebounceMapSOKFunctionDeactivated: debounce-algorithm=time_based, diagnostic-event=EventSOKFunctionDeactivated  # EventDebounceMap_SOK_function_deactivated
package /ZeC/DTC/DTC/SOK_key_not_available
  diagnostic trouble code uds SOK_key_not_available: dtc-props=Dtc_Props_d78b13b8, uds-dtc-value=0x001071
  diagnostic event EventSOKKeyNotAvailable: aging-allowed=true, event-kind=SWC, prestorage-freeze-frame=false  # Event_SOK_key_not_available
  diagnostic event to trouble code uds mapping EventDtcMapSOKKeyNotAvailable: diagnostic-event=EventSOKKeyNotAvailable, trouble-code-uds=SOK_key_not_available  # Event_Dtc_Map_SOK_key_not_available
  diagnostic event to operation cycle mapping EventOperCycleMapSOKKeyNotAvailable: diagnostic-event=EventSOKKeyNotAvailable, operation-cycle=DefaultOperationCycle  # Event_Oper_Cycle_Map_SOK_key_not_available
  diagnostic event to debounce algorithm mapping EventDebounceMapSOKKeyNotAvailable: debounce-algorithm=time_based, diagnostic-event=EventSOKKeyNotAvailable  # EventDebounceMap_SOK_key_not_available
package /ZeC/DTC/DTC/SOK_signature_verification_failed
  diagnostic trouble code uds SOK_signature_verification_failed: dtc-props=Dtc_Props_c8ff1f07, uds-dtc-value=0x001072
  diagnostic event EventSOKSignatureVerificationFailed: aging-allowed=true, event-kind=SWC, prestorage-freeze-frame=false  # Event_SOK_signature_verification_failed
  diagnostic event to trouble code uds mapping EventDtcMapSOKSignatureVerificationFailed: diagnostic-event=EventSOKSignatureVerificationFailed, trouble-code-uds=SOK_signature_verification_failed  # Event_Dtc_Map_SOK_signature_verification_failed
  diagnostic event to operation cycle mapping EventOperCycleMapSOKSignatureVerificationFailed: diagnostic-event=EventSOKSignatureVerificationFailed, operation-cycle=DefaultOperationCycle  # Event_Oper_Cycle_Map_SOK_signature_verification_failed
  diagnostic event to debounce algorithm mapping EventDebounceMapSOKSignatureVerificationFailed: debounce-algorithm=time_based, diagnostic-event=EventSOKSignatureVerificationFailed  # EventDebounceMap_SOK_signature_verification_failed
package /ZeC/DTC/DTC/LIN_22_Slave_8_NoCommunication
  diagnostic trouble code uds LIN_22_Slave_8_NoCommunication: dtc-props=Dtc_Props_358996c7, uds-dtc-value=0x031718  # LIN 22 Slave 8_NoCommunication
  diagnostic event EventLIN22Slave8NoCommunication: aging-allowed=true, event-kind=SWC, prestorage-freeze-frame=false  # Event_LIN 22 Slave 8_NoCommunication
  diagnostic event to trouble code uds mapping EventDtcMapLIN22Slave8NoCommunication: diagnostic-event=EventLIN22Slave8NoCommunication, trouble-code-uds=LIN_22_Slave_8_NoCommunication  # Event_Dtc_Map_LIN 22 Slave 8_NoCommunication
  diagnostic event to operation cycle mapping EventOperCycleMapLIN22Slave8NoCommunication: diagnostic-event=EventLIN22Slave8NoCommunication, operation-cycle=DefaultOperationCycle  # Event_Oper_Cycle_Map_LIN 22 Slave 8_NoCommunication
  diagnostic event to debounce algorithm mapping EventDebounceMapLIN22Slave8NoCommunication: debounce-algorithm=counter_based, diagnostic-event=EventLIN22Slave8NoCommunication  # EventDebounceMap_LIN 22 Slave 8_NoCommunication
package /ZeC/DTC/DTC/SOK_timeserver_not_available
  diagnostic trouble code uds SOK_timeserver_not_available: dtc-props=Dtc_Props_d78b13b8, uds-dtc-value=0x001073
  diagnostic event EventSOKTimeserverNotAvailable: aging-allowed=true, event-kind=SWC, prestorage-freeze-frame=false  # Event_SOK_timeserver_not_available
  diagnostic event to trouble code uds mapping EventDtcMapSOKTimeserverNotAvailable: diagnostic-event=EventSOKTimeserverNotAvailable, trouble-code-uds=SOK_timeserver_not_available  # Event_Dtc_Map_SOK_timeserver_not_available
  diagnostic event to operation cycle mapping EventOperCycleMapSOKTimeserverNotAvailable: diagnostic-event=EventSOKTimeserverNotAvailable, operation-cycle=DefaultOperationCycle  # Event_Oper_Cycle_Map_SOK_timeserver_not_available
  diagnostic event to debounce algorithm mapping EventDebounceMapSOKTimeserverNotAvailable: debounce-algorithm=counter_based, diagnostic-event=EventSOKTimeserverNotAvailable  # EventDebounceMap_SOK_timeserver_not_available
package /ZeC/DTC/DTC/LIN_22_Slave_9_Defect
  diagnostic trouble code uds LIN_22_Slave_9_Defect: dtc-props=Dtc_Props_358996c7, uds-dtc-value=0x031719  # LIN 22 Slave 9_Defect
  diagnostic event EventLIN22Slave9Defect: aging-allowed=true, event-kind=SWC, prestorage-freeze-frame=false  # Event_LIN 22 Slave 9_Defect
  diagnostic event to trouble code uds mapping EventDtcMapLIN22Slave9Defect: diagnostic-event=EventLIN22Slave9Defect, trouble-code-uds=LIN_22_Slave_9_Defect  # Event_Dtc_Map_LIN 22 Slave 9_Defect
  diagnostic event to operation cycle mapping EventOperCycleMapLIN22Slave9Defect: diagnostic-event=EventLIN22Slave9Defect, operation-cycle=DefaultOperationCycle  # Event_Oper_Cycle_Map_LIN 22 Slave 9_Defect
  diagnostic event to debounce algorithm mapping EventDebounceMapLIN22Slave9Defect: debounce-algorithm=counter_based, diagnostic-event=EventLIN22Slave9Defect  # EventDebounceMap_LIN 22 Slave 9_Defect
package /ZeC/DTC/DTC/LIN_14_Slave_11_Defect
  diagnostic trouble code uds LIN_14_Slave_11_Defect: dtc-props=Dtc_Props_358996c7, uds-dtc-value=0x030e0f  # LIN 14 Slave 11_Defect
  diagnostic event EventLIN14Slave11Defect: aging-allowed=true, event-kind=SWC, prestorage-freeze-frame=false  # Event_LIN 14 Slave 11_Defect
  diagnostic event to trouble code uds mapping EventDtcMapLIN14Slave11Defect: diagnostic-event=EventLIN14Slave11Defect, trouble-code-uds=LIN_14_Slave_11_Defect  # Event_Dtc_Map_LIN 14 Slave 11_Defect
  diagnostic event to operation cycle mapping EventOperCycleMapLIN14Slave11Defect: diagnostic-event=EventLIN14Slave11Defect, operation-cycle=DefaultOperationCycle  # Event_Oper_Cycle_Map_LIN 14 Slave 11_Defect
  diagnostic event to debounce algorithm mapping EventDebounceMapLIN14Slave11Defect: debounce-algorithm=counter_based, diagnostic-event=EventLIN14Slave11Defect  # EventDebounceMap_LIN 14 Slave 11_Defect
package /ZeC/DTC/DTC/Power_Path_023_Load_Failure
  diagnostic trouble code uds Power_Path_023_Load_Failure: dtc-props=Dtc_Props_ee9bbab1, uds-dtc-value=0x005417
  diagnostic event EventPowerPath023LoadFailure: aging-allowed=true, event-kind=SWC, prestorage-freeze-frame=false  # Event_Power_Path_023_Load_Failure
  diagnostic event to trouble code uds mapping EventDtcMapPowerPath023LoadFailure: diagnostic-event=EventPowerPath023LoadFailure, trouble-code-uds=Power_Path_023_Load_Failure  # Event_Dtc_Map_Power_Path_023_Load_Failure
  diagnostic event to operation cycle mapping EventOperCycleMapPowerPath023LoadFailure: diagnostic-event=EventPowerPath023LoadFailure, operation-cycle=DefaultOperationCycle  # Event_Oper_Cycle_Map_Power_Path_023_Load_Failure
  diagnostic event to debounce algorithm mapping EventDebounceMapPowerPath023LoadFailure: debounce-algorithm=time_based, diagnostic-event=EventPowerPath023LoadFailure  # EventDebounceMap_Power_Path_023_Load_Failure
package /ZeC/DTC/DTC/Power_Path_022_Load_Failure
  diagnostic trouble code uds Power_Path_022_Load_Failure: dtc-props=Dtc_Props_a882b08b, uds-dtc-value=0x005416
  diagnostic event EventPowerPath022LoadFailure: aging-allowed=true, event-kind=SWC, prestorage-freeze-frame=false  # Event_Power_Path_022_Load_Failure
  diagnostic event to trouble code uds mapping EventDtcMapPowerPath022LoadFailure: diagnostic-event=EventPowerPath022LoadFailure, trouble-code-uds=Power_Path_022_Load_Failure  # Event_Dtc_Map_Power_Path_022_Load_Failure
  diagnostic event to operation cycle mapping EventOperCycleMapPowerPath022LoadFailure: diagnostic-event=EventPowerPath022LoadFailure, operation-cycle=DefaultOperationCycle  # Event_Oper_Cycle_Map_Power_Path_022_Load_Failure
  diagnostic event to debounce algorithm mapping EventDebounceMapPowerPath022LoadFailure: debounce-algorithm=time_based, diagnostic-event=EventPowerPath022LoadFailure  # EventDebounceMap_Power_Path_022_Load_Failure
package /ZeC/DTC/DTC/LIN_14_Slave_10_Defect
  diagnostic trouble code uds LIN_14_Slave_10_Defect: dtc-props=Dtc_Props_358996c7, uds-dtc-value=0x030e0d  # LIN 14 Slave 10_Defect
  diagnostic event EventLIN14Slave10Defect: aging-allowed=true, event-kind=SWC, prestorage-freeze-frame=false  # Event_LIN 14 Slave 10_Defect
  diagnostic event to trouble code uds mapping EventDtcMapLIN14Slave10Defect: diagnostic-event=EventLIN14Slave10Defect, trouble-code-uds=LIN_14_Slave_10_Defect  # Event_Dtc_Map_LIN 14 Slave 10_Defect
  diagnostic event to operation cycle mapping EventOperCycleMapLIN14Slave10Defect: diagnostic-event=EventLIN14Slave10Defect, operation-cycle=DefaultOperationCycle  # Event_Oper_Cycle_Map_LIN 14 Slave 10_Defect
  diagnostic event to debounce algorithm mapping EventDebounceMapLIN14Slave10Defect: debounce-algorithm=counter_based, diagnostic-event=EventLIN14Slave10Defect  # EventDebounceMap_LIN 14 Slave 10_Defect
package /ZeC/DTC/DTC/Power_Path_025_Load_Failure
  diagnostic trouble code uds Power_Path_025_Load_Failure: dtc-props=Dtc_Props_fce7db7f, uds-dtc-value=0x005419
  diagnostic event EventPowerPath025LoadFailure: aging-allowed=true, event-kind=SWC, prestorage-freeze-frame=false  # Event_Power_Path_025_Load_Failure
  diagnostic event to trouble code uds mapping EventDtcMapPowerPath025LoadFailure: diagnostic-event=EventPowerPath025LoadFailure, trouble-code-uds=Power_Path_025_Load_Failure  # Event_Dtc_Map_Power_Path_025_Load_Failure
  diagnostic event to operation cycle mapping EventOperCycleMapPowerPath025LoadFailure: diagnostic-event=EventPowerPath025LoadFailure, operation-cycle=DefaultOperationCycle  # Event_Oper_Cycle_Map_Power_Path_025_Load_Failure
  diagnostic event to debounce algorithm mapping EventDebounceMapPowerPath025LoadFailure: debounce-algorithm=time_based, diagnostic-event=EventPowerPath025LoadFailure  # EventDebounceMap_Power_Path_025_Load_Failure
package /ZeC/DTC/DTC/LIN_14_Slave_10_NoCommunication
  diagnostic trouble code uds LIN_14_Slave_10_NoCommunication: dtc-props=Dtc_Props_358996c7, uds-dtc-value=0x030e0e  # LIN 14 Slave 10_NoCommunication
  diagnostic event EventLIN14Slave10NoCommunication: aging-allowed=true, event-kind=SWC, prestorage-freeze-frame=false  # Event_LIN 14 Slave 10_NoCommunication
  diagnostic event to trouble code uds mapping EventDtcMapLIN14Slave10NoCommunication: diagnostic-event=EventLIN14Slave10NoCommunication, trouble-code-uds=LIN_14_Slave_10_NoCommunication  # Event_Dtc_Map_LIN 14 Slave 10_NoCommunication
  diagnostic event to operation cycle mapping EventOperCycleMapLIN14Slave10NoCommunication: diagnostic-event=EventLIN14Slave10NoCommunication, operation-cycle=DefaultOperationCycle  # Event_Oper_Cycle_Map_LIN 14 Slave 10_NoCommunication
  diagnostic event to debounce algorithm mapping EventDebounceMapLIN14Slave10NoCommunication: debounce-algorithm=counter_based, diagnostic-event=EventLIN14Slave10NoCommunication  # EventDebounceMap_LIN 14 Slave 10_NoCommunication
package /ZeC/DTC/DTC/Power_Path_024_Load_Failure
  diagnostic trouble code uds Power_Path_024_Load_Failure: dtc-props=Dtc_Props_bafed145, uds-dtc-value=0x005418
  diagnostic event EventPowerPath024LoadFailure: aging-allowed=true, event-kind=SWC, prestorage-freeze-frame=false  # Event_Power_Path_024_Load_Failure
  diagnostic event to trouble code uds mapping EventDtcMapPowerPath024LoadFailure: diagnostic-event=EventPowerPath024LoadFailure, trouble-code-uds=Power_Path_024_Load_Failure  # Event_Dtc_Map_Power_Path_024_Load_Failure
  diagnostic event to operation cycle mapping EventOperCycleMapPowerPath024LoadFailure: diagnostic-event=EventPowerPath024LoadFailure, operation-cycle=DefaultOperationCycle  # Event_Oper_Cycle_Map_Power_Path_024_Load_Failure
  diagnostic event to debounce algorithm mapping EventDebounceMapPowerPath024LoadFailure: debounce-algorithm=time_based, diagnostic-event=EventPowerPath024LoadFailure  # EventDebounceMap_Power_Path_024_Load_Failure
package /ZeC/DTC/DTC/LIN_14_Slave_1_Defect
  diagnostic trouble code uds LIN_14_Slave_1_Defect: dtc-props=Dtc_Props_358996c7, uds-dtc-value=0x030e0b  # LIN 14 Slave 1_Defect
  diagnostic event EventLIN14Slave1Defect: aging-allowed=true, event-kind=SWC, prestorage-freeze-frame=false  # Event_LIN 14 Slave 1_Defect
  diagnostic event to trouble code uds mapping EventDtcMapLIN14Slave1Defect: diagnostic-event=EventLIN14Slave1Defect, trouble-code-uds=LIN_14_Slave_1_Defect  # Event_Dtc_Map_LIN 14 Slave 1_Defect
  diagnostic event to operation cycle mapping EventOperCycleMapLIN14Slave1Defect: diagnostic-event=EventLIN14Slave1Defect, operation-cycle=DefaultOperationCycle  # Event_Oper_Cycle_Map_LIN 14 Slave 1_Defect
  diagnostic event to debounce algorithm mapping EventDebounceMapLIN14Slave1Defect: debounce-algorithm=counter_based, diagnostic-event=EventLIN14Slave1Defect  # EventDebounceMap_LIN 14 Slave 1_Defect
package /ZeC/DTC/DTC/Power_Path_019_Load_Failure
  diagnostic trouble code uds Power_Path_019_Load_Failure: dtc-props=Dtc_Props_2d8e9418, uds-dtc-value=0x005413
  diagnostic event EventPowerPath019LoadFailure: aging-allowed=true, event-kind=SWC, prestorage-freeze-frame=false  # Event_Power_Path_019_Load_Failure
  diagnostic event to trouble code uds mapping EventDtcMapPowerPath019LoadFailure: diagnostic-event=EventPowerPath019LoadFailure, trouble-code-uds=Power_Path_019_Load_Failure  # Event_Dtc_Map_Power_Path_019_Load_Failure
  diagnostic event to operation cycle mapping EventOperCycleMapPowerPath019LoadFailure: diagnostic-event=EventPowerPath019LoadFailure, operation-cycle=DefaultOperationCycle  # Event_Oper_Cycle_Map_Power_Path_019_Load_Failure
  diagnostic event to debounce algorithm mapping EventDebounceMapPowerPath019LoadFailure: debounce-algorithm=time_based, diagnostic-event=EventPowerPath019LoadFailure  # EventDebounceMap_Power_Path_019_Load_Failure
package /ZeC/DTC/DTC/Power_Path_151_Cable_Protection_Failure
  diagnostic trouble code uds Power_Path_151_Cable_Protection_Failure: dtc-props=Dtc_Props_6a78a034, uds-dtc-value=0x005897
  diagnostic event EventPowerPath151CableProtectionFailure: aging-allowed=true, event-kind=SWC, prestorage-freeze-frame=false  # Event_Power_Path_151_Cable_Protection_Failure
  diagnostic event to trouble code uds mapping EventDtcMapPowerPath151CableProtectionFailure: diagnostic-event=EventPowerPath151CableProtectionFailure, trouble-code-uds=Power_Path_151_Cable_Protection_Failure  # Event_Dtc_Map_Power_Path_151_Cable_Protection_Failure
  diagnostic event to operation cycle mapping EventOperCycleMapPowerPath151CableProtectionFailure: diagnostic-event=EventPowerPath151CableProtectionFailure, operation-cycle=DefaultOperationCycle  # Event_Oper_Cycle_Map_Power_Path_151_Cable_Protection_Failure
  diagnostic event to debounce algorithm mapping EventDebounceMapPowerPath151CableProtectionFailure: debounce-algorithm=time_based, diagnostic-event=EventPowerPath151CableProtectionFailure  # EventDebounceMap_Power_Path_151_Cable_Protection_Failure
package /ZeC/DTC/DTC/LIN_14_Slave_1_NoCommunication
  diagnostic trouble code uds LIN_14_Slave_1_NoCommunication: dtc-props=Dtc_Props_358996c7, uds-dtc-value=0x030e0c  # LIN 14 Slave 1_NoCommunication
  diagnostic event EventLIN14Slave1NoCommunication: aging-allowed=true, event-kind=SWC, prestorage-freeze-frame=false  # Event_LIN 14 Slave 1_NoCommunication
  diagnostic event to trouble code uds mapping EventDtcMapLIN14Slave1NoCommunication: diagnostic-event=EventLIN14Slave1NoCommunication, trouble-code-uds=LIN_14_Slave_1_NoCommunication  # Event_Dtc_Map_LIN 14 Slave 1_NoCommunication
  diagnostic event to operation cycle mapping EventOperCycleMapLIN14Slave1NoCommunication: diagnostic-event=EventLIN14Slave1NoCommunication, operation-cycle=DefaultOperationCycle  # Event_Oper_Cycle_Map_LIN 14 Slave 1_NoCommunication
  diagnostic event to debounce algorithm mapping EventDebounceMapLIN14Slave1NoCommunication: debounce-algorithm=counter_based, diagnostic-event=EventLIN14Slave1NoCommunication  # EventDebounceMap_LIN 14 Slave 1_NoCommunication
package /ZeC/DTC/DTC/Power_Path_150_Cable_Protection_Failure
  diagnostic trouble code uds Power_Path_150_Cable_Protection_Failure: dtc-props=Dtc_Props_2c61aa0e, uds-dtc-value=0x005896
  diagnostic event EventPowerPath150CableProtectionFailure: aging-allowed=true, event-kind=SWC, prestorage-freeze-frame=false  # Event_Power_Path_150_Cable_Protection_Failure
  diagnostic event to trouble code uds mapping EventDtcMapPowerPath150CableProtectionFailure: diagnostic-event=EventPowerPath150CableProtectionFailure, trouble-code-uds=Power_Path_150_Cable_Protection_Failure  # Event_Dtc_Map_Power_Path_150_Cable_Protection_Failure
  diagnostic event to operation cycle mapping EventOperCycleMapPowerPath150CableProtectionFailure: diagnostic-event=EventPowerPath150CableProtectionFailure, operation-cycle=DefaultOperationCycle  # Event_Oper_Cycle_Map_Power_Path_150_Cable_Protection_Failure
  diagnostic event to debounce algorithm mapping EventDebounceMapPowerPath150CableProtectionFailure: debounce-algorithm=time_based, diagnostic-event=EventPowerPath150CableProtectionFailure  # EventDebounceMap_Power_Path_150_Cable_Protection_Failure
package /ZeC/DTC/DTC/Power_Path_018_Load_Failure
  diagnostic trouble code uds Power_Path_018_Load_Failure: dtc-props=Dtc_Props_6b979e22, uds-dtc-value=0x005412
  diagnostic event EventPowerPath018LoadFailure: aging-allowed=true, event-kind=SWC, prestorage-freeze-frame=false  # Event_Power_Path_018_Load_Failure
  diagnostic event to trouble code uds mapping EventDtcMapPowerPath018LoadFailure: diagnostic-event=EventPowerPath018LoadFailure, trouble-code-uds=Power_Path_018_Load_Failure  # Event_Dtc_Map_Power_Path_018_Load_Failure
  diagnostic event to operation cycle mapping EventOperCycleMapPowerPath018LoadFailure: diagnostic-event=EventPowerPath018LoadFailure, operation-cycle=DefaultOperationCycle  # Event_Oper_Cycle_Map_Power_Path_018_Load_Failure
  diagnostic event to debounce algorithm mapping EventDebounceMapPowerPath018LoadFailure: debounce-algorithm=time_based, diagnostic-event=EventPowerPath018LoadFailure  # EventDebounceMap_Power_Path_018_Load_Failure
package /ZeC/DTC/DTC/LIN_22_Local_Databus_Electrical_Failure
  diagnostic trouble code uds LIN_22_Local_Databus_Electrical_Failure: dtc-props=Dtc_Props_358996c7, uds-dtc-value=0x031721  # LIN 22 Local_Databus_Electrical_Failure
  diagnostic event EventLIN22LocalDatabusElectricalFailure: aging-allowed=true, event-kind=SWC, prestorage-freeze-frame=false  # Event_LIN 22 Local_Databus_Electrical_Failure
  diagnostic event to trouble code uds mapping EventDtcMapLIN22LocalDatabusElectricalFailure: diagnostic-event=EventLIN22LocalDatabusElectricalFailure, trouble-code-uds=LIN_22_Local_Databus_Electrical_Failure  # Event_Dtc_Map_LIN 22 Local_Databus_Electrical_Failure
  diagnostic event to operation cycle mapping EventOperCycleMapLIN22LocalDatabusElectricalFailure: diagnostic-event=EventLIN22LocalDatabusElectricalFailure, operation-cycle=DefaultOperationCycle  # Event_Oper_Cycle_Map_LIN 22 Local_Databus_Electrical_Failure
  diagnostic event to debounce algorithm mapping EventDebounceMapLIN22LocalDatabusElectricalFailure: debounce-algorithm=counter_based, diagnostic-event=EventLIN22LocalDatabusElectricalFailure  # EventDebounceMap_LIN 22 Local_Databus_Electrical_Failure
package /ZeC/DTC/DTC/Power_Path_021_Load_Failure
  diagnostic trouble code uds Power_Path_021_Load_Failure: dtc-props=Dtc_Props_62a9aec5, uds-dtc-value=0x005415
  diagnostic event EventPowerPath021LoadFailure: aging-allowed=true, event-kind=SWC, prestorage-freeze-frame=false  # Event_Power_Path_021_Load_Failure
  diagnostic event to trouble code uds mapping EventDtcMapPowerPath021LoadFailure: diagnostic-event=EventPowerPath021LoadFailure, trouble-code-uds=Power_Path_021_Load_Failure  # Event_Dtc_Map_Power_Path_021_Load_Failure
  diagnostic event to operation cycle mapping EventOperCycleMapPowerPath021LoadFailure: diagnostic-event=EventPowerPath021LoadFailure, operation-cycle=DefaultOperationCycle  # Event_Oper_Cycle_Map_Power_Path_021_Load_Failure
  diagnostic event to debounce algorithm mapping EventDebounceMapPowerPath021LoadFailure: debounce-algorithm=time_based, diagnostic-event=EventPowerPath021LoadFailure  # EventDebounceMap_Power_Path_021_Load_Failure
package /ZeC/DTC/DTC/Power_Path_153_Cable_Protection_Failure
  diagnostic trouble code uds Power_Path_153_Cable_Protection_Failure: dtc-props=Dtc_Props_7804c1fa, uds-dtc-value=0x005899
  diagnostic event EventPowerPath153CableProtectionFailure: aging-allowed=true, event-kind=SWC, prestorage-freeze-frame=false  # Event_Power_Path_153_Cable_Protection_Failure
  diagnostic event to trouble code uds mapping EventDtcMapPowerPath153CableProtectionFailure: diagnostic-event=EventPowerPath153CableProtectionFailure, trouble-code-uds=Power_Path_153_Cable_Protection_Failure  # Event_Dtc_Map_Power_Path_153_Cable_Protection_Failure
  diagnostic event to operation cycle mapping EventOperCycleMapPowerPath153CableProtectionFailure: diagnostic-event=EventPowerPath153CableProtectionFailure, operation-cycle=DefaultOperationCycle  # Event_Oper_Cycle_Map_Power_Path_153_Cable_Protection_Failure
  diagnostic event to debounce algorithm mapping EventDebounceMapPowerPath153CableProtectionFailure: debounce-algorithm=time_based, diagnostic-event=EventPowerPath153CableProtectionFailure  # EventDebounceMap_Power_Path_153_Cable_Protection_Failure
package /ZeC/DTC/DTC/LIN_14_Slave_9_NoCommunication
  diagnostic trouble code uds LIN_14_Slave_9_NoCommunication: dtc-props=Dtc_Props_358996c7, uds-dtc-value=0x030e0a  # LIN 14 Slave 9_NoCommunication
  diagnostic event EventLIN14Slave9NoCommunication: aging-allowed=true, event-kind=SWC, prestorage-freeze-frame=false  # Event_LIN 14 Slave 9_NoCommunication
  diagnostic event to trouble code uds mapping EventDtcMapLIN14Slave9NoCommunication: diagnostic-event=EventLIN14Slave9NoCommunication, trouble-code-uds=LIN_14_Slave_9_NoCommunication  # Event_Dtc_Map_LIN 14 Slave 9_NoCommunication
  diagnostic event to operation cycle mapping EventOperCycleMapLIN14Slave9NoCommunication: diagnostic-event=EventLIN14Slave9NoCommunication, operation-cycle=DefaultOperationCycle  # Event_Oper_Cycle_Map_LIN 14 Slave 9_NoCommunication
  diagnostic event to debounce algorithm mapping EventDebounceMapLIN14Slave9NoCommunication: debounce-algorithm=counter_based, diagnostic-event=EventLIN14Slave9NoCommunication  # EventDebounceMap_LIN 14 Slave 9_NoCommunication
package /ZeC/DTC/DTC/Power_Path_020_Load_Failure
  diagnostic trouble code uds Power_Path_020_Load_Failure: dtc-props=Dtc_Props_24b0a4ff, uds-dtc-value=0x005414
  diagnostic event EventPowerPath020LoadFailure: aging-allowed=true, event-kind=SWC, prestorage-freeze-frame=false  # Event_Power_Path_020_Load_Failure
  diagnostic event to trouble code uds mapping EventDtcMapPowerPath020LoadFailure: diagnostic-event=EventPowerPath020LoadFailure, trouble-code-uds=Power_Path_020_Load_Failure  # Event_Dtc_Map_Power_Path_020_Load_Failure
  diagnostic event to operation cycle mapping EventOperCycleMapPowerPath020LoadFailure: diagnostic-event=EventPowerPath020LoadFailure, operation-cycle=DefaultOperationCycle  # Event_Oper_Cycle_Map_Power_Path_020_Load_Failure
  diagnostic event to debounce algorithm mapping EventDebounceMapPowerPath020LoadFailure: debounce-algorithm=time_based, diagnostic-event=EventPowerPath020LoadFailure  # EventDebounceMap_Power_Path_020_Load_Failure
package /ZeC/DTC/DTC/Power_Path_152_Cable_Protection_Failure
  diagnostic trouble code uds Power_Path_152_Cable_Protection_Failure: dtc-props=Dtc_Props_3e1dcbc0, uds-dtc-value=0x005898
  diagnostic event EventPowerPath152CableProtectionFailure: aging-allowed=true, event-kind=SWC, prestorage-freeze-frame=false  # Event_Power_Path_152_Cable_Protection_Failure
  diagnostic event to trouble code uds mapping EventDtcMapPowerPath152CableProtectionFailure: diagnostic-event=EventPowerPath152CableProtectionFailure, trouble-code-uds=Power_Path_152_Cable_Protection_Failure  # Event_Dtc_Map_Power_Path_152_Cable_Protection_Failure
  diagnostic event to operation cycle mapping EventOperCycleMapPowerPath152CableProtectionFailure: diagnostic-event=EventPowerPath152CableProtectionFailure, operation-cycle=DefaultOperationCycle  # Event_Oper_Cycle_Map_Power_Path_152_Cable_Protection_Failure
  diagnostic event to debounce algorithm mapping EventDebounceMapPowerPath152CableProtectionFailure: debounce-algorithm=time_based, diagnostic-event=EventPowerPath152CableProtectionFailure  # EventDebounceMap_Power_Path_152_Cable_Protection_Failure
package /ZeC/DTC/DTC/Power_Path_156_Cable_Protection_Failure
  diagnostic trouble code uds Power_Path_156_Cable_Protection_Failure: dtc-props=Dtc_Props_9492eae0, uds-dtc-value=0x00589c
  diagnostic event EventPowerPath156CableProtectionFailure: aging-allowed=true, event-kind=SWC, prestorage-freeze-frame=false  # Event_Power_Path_156_Cable_Protection_Failure
  diagnostic event to trouble code uds mapping EventDtcMapPowerPath156CableProtectionFailure: diagnostic-event=EventPowerPath156CableProtectionFailure, trouble-code-uds=Power_Path_156_Cable_Protection_Failure  # Event_Dtc_Map_Power_Path_156_Cable_Protection_Failure
  diagnostic event to operation cycle mapping EventOperCycleMapPowerPath156CableProtectionFailure: diagnostic-event=EventPowerPath156CableProtectionFailure, operation-cycle=DefaultOperationCycle  # Event_Oper_Cycle_Map_Power_Path_156_Cable_Protection_Failure
  diagnostic event to debounce algorithm mapping EventDebounceMapPowerPath156CableProtectionFailure: debounce-algorithm=time_based, diagnostic-event=EventPowerPath156CableProtectionFailure  # EventDebounceMap_Power_Path_156_Cable_Protection_Failure
package /ZeC/DTC/DTC/LIN_22_Databus_No_Comm
  diagnostic trouble code uds LIN_22_Databus_No_Comm: dtc-props=Dtc_Props_358996c7, uds-dtc-value=0x031720  # LIN 22 Databus_No_Comm
  diagnostic event EventLIN22DatabusNoComm: aging-allowed=true, event-kind=SWC, prestorage-freeze-frame=false  # Event_LIN 22 Databus_No_Comm
  diagnostic event to trouble code uds mapping EventDtcMapLIN22DatabusNoComm: diagnostic-event=EventLIN22DatabusNoComm, trouble-code-uds=LIN_22_Databus_No_Comm  # Event_Dtc_Map_LIN 22 Databus_No_Comm
  diagnostic event to operation cycle mapping EventOperCycleMapLIN22DatabusNoComm: diagnostic-event=EventLIN22DatabusNoComm, operation-cycle=DefaultOperationCycle  # Event_Oper_Cycle_Map_LIN 22 Databus_No_Comm
  diagnostic event to debounce algorithm mapping EventDebounceMapLIN22DatabusNoComm: debounce-algorithm=counter_based, diagnostic-event=EventLIN22DatabusNoComm  # EventDebounceMap_LIN 22 Databus_No_Comm
package /ZeC/DTC/DTC/Power_Path_155_Cable_Protection_Failure
  diagnostic trouble code uds Power_Path_155_Cable_Protection_Failure: dtc-props=Dtc_Props_d28be0da, uds-dtc-value=0x00589b
  diagnostic event EventPowerPath155CableProtectionFailure: aging-allowed=true, event-kind=SWC, prestorage-freeze-frame=false  # Event_Power_Path_155_Cable_Protection_Failure
  diagnostic event to trouble code uds mapping EventDtcMapPowerPath155CableProtectionFailure: diagnostic-event=EventPowerPath155CableProtectionFailure, trouble-code-uds=Power_Path_155_Cable_Protection_Failure  # Event_Dtc_Map_Power_Path_155_Cable_Protection_Failure
  diagnostic event to operation cycle mapping EventOperCycleMapPowerPath155CableProtectionFailure: diagnostic-event=EventPowerPath155CableProtectionFailure, operation-cycle=DefaultOperationCycle  # Event_Oper_Cycle_Map_Power_Path_155_Cable_Protection_Failure
  diagnostic event to debounce algorithm mapping EventDebounceMapPowerPath155CableProtectionFailure: debounce-algorithm=time_based, diagnostic-event=EventPowerPath155CableProtectionFailure  # EventDebounceMap_Power_Path_155_Cable_Protection_Failure
package /ZeC/DTC/DTC/Power_Path_026_Load_Failure
  diagnostic trouble code uds Power_Path_026_Load_Failure: dtc-props=Dtc_Props_9c43e411, uds-dtc-value=0x00541a
  diagnostic event EventPowerPath026LoadFailure: aging-allowed=true, event-kind=SWC, prestorage-freeze-frame=false  # Event_Power_Path_026_Load_Failure
  diagnostic event to trouble code uds mapping EventDtcMapPowerPath026LoadFailure: diagnostic-event=EventPowerPath026LoadFailure, trouble-code-uds=Power_Path_026_Load_Failure  # Event_Dtc_Map_Power_Path_026_Load_Failure
  diagnostic event to operation cycle mapping EventOperCycleMapPowerPath026LoadFailure: diagnostic-event=EventPowerPath026LoadFailure, operation-cycle=DefaultOperationCycle  # Event_Oper_Cycle_Map_Power_Path_026_Load_Failure
  diagnostic event to debounce algorithm mapping EventDebounceMapPowerPath026LoadFailure: debounce-algorithm=time_based, diagnostic-event=EventPowerPath026LoadFailure  # EventDebounceMap_Power_Path_026_Load_Failure
package /ZeC/DTC/DTC/Power_Path_158_Cable_Protection_Failure
  diagnostic trouble code uds Power_Path_158_Cable_Protection_Failure: dtc-props=Dtc_Props_dbb5d03d, uds-dtc-value=0x00589e
  diagnostic event EventPowerPath158CableProtectionFailure: aging-allowed=true, event-kind=SWC, prestorage-freeze-frame=false  # Event_Power_Path_158_Cable_Protection_Failure
  diagnostic event to trouble code uds mapping EventDtcMapPowerPath158CableProtectionFailure: diagnostic-event=EventPowerPath158CableProtectionFailure, trouble-code-uds=Power_Path_158_Cable_Protection_Failure  # Event_Dtc_Map_Power_Path_158_Cable_Protection_Failure
  diagnostic event to operation cycle mapping EventOperCycleMapPowerPath158CableProtectionFailure: diagnostic-event=EventPowerPath158CableProtectionFailure, operation-cycle=DefaultOperationCycle  # Event_Oper_Cycle_Map_Power_Path_158_Cable_Protection_Failure
  diagnostic event to debounce algorithm mapping EventDebounceMapPowerPath158CableProtectionFailure: debounce-algorithm=time_based, diagnostic-event=EventPowerPath158CableProtectionFailure  # EventDebounceMap_Power_Path_158_Cable_Protection_Failure
package /ZeC/DTC/DTC/Power_Path_157_Cable_Protection_Failure
  diagnostic trouble code uds Power_Path_157_Cable_Protection_Failure: dtc-props=Dtc_Props_9dacda07, uds-dtc-value=0x00589d
  diagnostic event EventPowerPath157CableProtectionFailure: aging-allowed=true, event-kind=SWC, prestorage-freeze-frame=false  # Event_Power_Path_157_Cable_Protection_Failure
  diagnostic event to trouble code uds mapping EventDtcMapPowerPath157CableProtectionFailure: diagnostic-event=EventPowerPath157CableProtectionFailure, trouble-code-uds=Power_Path_157_Cable_Protection_Failure  # Event_Dtc_Map_Power_Path_157_Cable_Protection_Failure
  diagnostic event to operation cycle mapping EventOperCycleMapPowerPath157CableProtectionFailure: diagnostic-event=EventPowerPath157CableProtectionFailure, operation-cycle=DefaultOperationCycle  # Event_Oper_Cycle_Map_Power_Path_157_Cable_Protection_Failure
  diagnostic event to debounce algorithm mapping EventDebounceMapPowerPath157CableProtectionFailure: debounce-algorithm=time_based, diagnostic-event=EventPowerPath157CableProtectionFailure  # EventDebounceMap_Power_Path_157_Cable_Protection_Failure
package /ZeC/DTC/DTC/LIN_14_Slave_8_NoCommunication
  diagnostic trouble code uds LIN_14_Slave_8_NoCommunication: dtc-props=Dtc_Props_358996c7, uds-dtc-value=0x030e08  # LIN 14 Slave 8_NoCommunication
  diagnostic event EventLIN14Slave8NoCommunication: aging-allowed=true, event-kind=SWC, prestorage-freeze-frame=false  # Event_LIN 14 Slave 8_NoCommunication
  diagnostic event to trouble code uds mapping EventDtcMapLIN14Slave8NoCommunication: diagnostic-event=EventLIN14Slave8NoCommunication, trouble-code-uds=LIN_14_Slave_8_NoCommunication  # Event_Dtc_Map_LIN 14 Slave 8_NoCommunication
  diagnostic event to operation cycle mapping EventOperCycleMapLIN14Slave8NoCommunication: diagnostic-event=EventLIN14Slave8NoCommunication, operation-cycle=DefaultOperationCycle  # Event_Oper_Cycle_Map_LIN 14 Slave 8_NoCommunication
  diagnostic event to debounce algorithm mapping EventDebounceMapLIN14Slave8NoCommunication: debounce-algorithm=counter_based, diagnostic-event=EventLIN14Slave8NoCommunication  # EventDebounceMap_LIN 14 Slave 8_NoCommunication
package /ZeC/DTC/DTC/Power_Path_154_Cable_Protection_Failure
  diagnostic trouble code uds Power_Path_154_Cable_Protection_Failure: dtc-props=Dtc_Props_18a0fe94, uds-dtc-value=0x00589a
  diagnostic event EventPowerPath154CableProtectionFailure: aging-allowed=true, event-kind=SWC, prestorage-freeze-frame=false  # Event_Power_Path_154_Cable_Protection_Failure
  diagnostic event to trouble code uds mapping EventDtcMapPowerPath154CableProtectionFailure: diagnostic-event=EventPowerPath154CableProtectionFailure, trouble-code-uds=Power_Path_154_Cable_Protection_Failure  # Event_Dtc_Map_Power_Path_154_Cable_Protection_Failure
  diagnostic event to operation cycle mapping EventOperCycleMapPowerPath154CableProtectionFailure: diagnostic-event=EventPowerPath154CableProtectionFailure, operation-cycle=DefaultOperationCycle  # Event_Oper_Cycle_Map_Power_Path_154_Cable_Protection_Failure
  diagnostic event to debounce algorithm mapping EventDebounceMapPowerPath154CableProtectionFailure: debounce-algorithm=time_based, diagnostic-event=EventPowerPath154CableProtectionFailure  # EventDebounceMap_Power_Path_154_Cable_Protection_Failure
package /ZeC/DTC/DTC/LIN_14_Slave_9_Defect
  diagnostic trouble code uds LIN_14_Slave_9_Defect: dtc-props=Dtc_Props_358996c7, uds-dtc-value=0x030e09  # LIN 14 Slave 9_Defect
  diagnostic event EventLIN14Slave9Defect: aging-allowed=true, event-kind=SWC, prestorage-freeze-frame=false  # Event_LIN 14 Slave 9_Defect
  diagnostic event to trouble code uds mapping EventDtcMapLIN14Slave9Defect: diagnostic-event=EventLIN14Slave9Defect, trouble-code-uds=LIN_14_Slave_9_Defect  # Event_Dtc_Map_LIN 14 Slave 9_Defect
  diagnostic event to operation cycle mapping EventOperCycleMapLIN14Slave9Defect: diagnostic-event=EventLIN14Slave9Defect, operation-cycle=DefaultOperationCycle  # Event_Oper_Cycle_Map_LIN 14 Slave 9_Defect
  diagnostic event to debounce algorithm mapping EventDebounceMapLIN14Slave9Defect: debounce-algorithm=counter_based, diagnostic-event=EventLIN14Slave9Defect  # EventDebounceMap_LIN 14 Slave 9_Defect
package /ZeC/DTC/DTC/LIN_14_Slave_15_Defect
  diagnostic trouble code uds LIN_14_Slave_15_Defect: dtc-props=Dtc_Props_358996c7, uds-dtc-value=0x030e17  # LIN 14 Slave 15_Defect
  diagnostic event EventLIN14Slave15Defect: aging-allowed=true, event-kind=SWC, prestorage-freeze-frame=false  # Event_LIN 14 Slave 15_Defect
  diagnostic event to trouble code uds mapping EventDtcMapLIN14Slave15Defect: diagnostic-event=EventLIN14Slave15Defect, trouble-code-uds=LIN_14_Slave_15_Defect  # Event_Dtc_Map_LIN 14 Slave 15_Defect
  diagnostic event to operation cycle mapping EventOperCycleMapLIN14Slave15Defect: diagnostic-event=EventLIN14Slave15Defect, operation-cycle=DefaultOperationCycle  # Event_Oper_Cycle_Map_LIN 14 Slave 15_Defect
  diagnostic event to debounce algorithm mapping EventDebounceMapLIN14Slave15Defect: debounce-algorithm=counter_based, diagnostic-event=EventLIN14Slave15Defect  # EventDebounceMap_LIN 14 Slave 15_Defect
package /ZeC/DTC/DTC/LIN_14_Slave_15_NoCommunication
  diagnostic trouble code uds LIN_14_Slave_15_NoCommunication: dtc-props=Dtc_Props_358996c7, uds-dtc-value=0x030e18  # LIN 14 Slave 15_NoCommunication
  diagnostic event EventLIN14Slave15NoCommunication: aging-allowed=true, event-kind=SWC, prestorage-freeze-frame=false  # Event_LIN 14 Slave 15_NoCommunication
  diagnostic event to trouble code uds mapping EventDtcMapLIN14Slave15NoCommunication: diagnostic-event=EventLIN14Slave15NoCommunication, trouble-code-uds=LIN_14_Slave_15_NoCommunication  # Event_Dtc_Map_LIN 14 Slave 15_NoCommunication
  diagnostic event to operation cycle mapping EventOperCycleMapLIN14Slave15NoCommunication: diagnostic-event=EventLIN14Slave15NoCommunication, operation-cycle=DefaultOperationCycle  # Event_Oper_Cycle_Map_LIN 14 Slave 15_NoCommunication
  diagnostic event to debounce algorithm mapping EventDebounceMapLIN14Slave15NoCommunication: debounce-algorithm=counter_based, diagnostic-event=EventLIN14Slave15NoCommunication  # EventDebounceMap_LIN 14 Slave 15_NoCommunication
package /ZeC/DTC/DTC/Power_Path_031_Load_Failure
  diagnostic trouble code uds Power_Path_031_Load_Failure: dtc-props=Dtc_Props_957dd4f6, uds-dtc-value=0x00541f
  diagnostic event EventPowerPath031LoadFailure: aging-allowed=true, event-kind=SWC, prestorage-freeze-frame=false  # Event_Power_Path_031_Load_Failure
  diagnostic event to trouble code uds mapping EventDtcMapPowerPath031LoadFailure: diagnostic-event=EventPowerPath031LoadFailure, trouble-code-uds=Power_Path_031_Load_Failure  # Event_Dtc_Map_Power_Path_031_Load_Failure
  diagnostic event to operation cycle mapping EventOperCycleMapPowerPath031LoadFailure: diagnostic-event=EventPowerPath031LoadFailure, operation-cycle=DefaultOperationCycle  # Event_Oper_Cycle_Map_Power_Path_031_Load_Failure
  diagnostic event to debounce algorithm mapping EventDebounceMapPowerPath031LoadFailure: debounce-algorithm=time_based, diagnostic-event=EventPowerPath031LoadFailure  # EventDebounceMap_Power_Path_031_Load_Failure
package /ZeC/DTC/DTC/LIN_14_Slave_14_Defect
  diagnostic trouble code uds LIN_14_Slave_14_Defect: dtc-props=Dtc_Props_358996c7, uds-dtc-value=0x030e15  # LIN 14 Slave 14_Defect
  diagnostic event EventLIN14Slave14Defect: aging-allowed=true, event-kind=SWC, prestorage-freeze-frame=false  # Event_LIN 14 Slave 14_Defect
  diagnostic event to trouble code uds mapping EventDtcMapLIN14Slave14Defect: diagnostic-event=EventLIN14Slave14Defect, trouble-code-uds=LIN_14_Slave_14_Defect  # Event_Dtc_Map_LIN 14 Slave 14_Defect
  diagnostic event to operation cycle mapping EventOperCycleMapLIN14Slave14Defect: diagnostic-event=EventLIN14Slave14Defect, operation-cycle=DefaultOperationCycle  # Event_Oper_Cycle_Map_LIN 14 Slave 14_Defect
  diagnostic event to debounce algorithm mapping EventDebounceMapLIN14Slave14Defect: debounce-algorithm=counter_based, diagnostic-event=EventLIN14Slave14Defect  # EventDebounceMap_LIN 14 Slave 14_Defect
package /ZeC/DTC/DTC/LIN_14_Slave_14_NoCommunication
  diagnostic trouble code uds LIN_14_Slave_14_NoCommunication: dtc-props=Dtc_Props_358996c7, uds-dtc-value=0x030e16  # LIN 14 Slave 14_NoCommunication
  diagnostic event EventLIN14Slave14NoCommunication: aging-allowed=true, event-kind=SWC, prestorage-freeze-frame=false  # Event_LIN 14 Slave 14_NoCommunication
  diagnostic event to trouble code uds mapping EventDtcMapLIN14Slave14NoCommunication: diagnostic-event=EventLIN14Slave14NoCommunication, trouble-code-uds=LIN_14_Slave_14_NoCommunication  # Event_Dtc_Map_LIN 14 Slave 14_NoCommunication
  diagnostic event to operation cycle mapping EventOperCycleMapLIN14Slave14NoCommunication: diagnostic-event=EventLIN14Slave14NoCommunication, operation-cycle=DefaultOperationCycle  # Event_Oper_Cycle_Map_LIN 14 Slave 14_NoCommunication
  diagnostic event to debounce algorithm mapping EventDebounceMapLIN14Slave14NoCommunication: debounce-algorithm=counter_based, diagnostic-event=EventLIN14Slave14NoCommunication  # EventDebounceMap_LIN 14 Slave 14_NoCommunication
package /ZeC/DTC/DTC/LIN_14_Slave_13_Defect
  diagnostic trouble code uds LIN_14_Slave_13_Defect: dtc-props=Dtc_Props_358996c7, uds-dtc-value=0x030e13  # LIN 14 Slave 13_Defect
  diagnostic event EventLIN14Slave13Defect: aging-allowed=true, event-kind=SWC, prestorage-freeze-frame=false  # Event_LIN 14 Slave 13_Defect
  diagnostic event to trouble code uds mapping EventDtcMapLIN14Slave13Defect: diagnostic-event=EventLIN14Slave13Defect, trouble-code-uds=LIN_14_Slave_13_Defect  # Event_Dtc_Map_LIN 14 Slave 13_Defect
  diagnostic event to operation cycle mapping EventOperCycleMapLIN14Slave13Defect: diagnostic-event=EventLIN14Slave13Defect, operation-cycle=DefaultOperationCycle  # Event_Oper_Cycle_Map_LIN 14 Slave 13_Defect
  diagnostic event to debounce algorithm mapping EventDebounceMapLIN14Slave13Defect: debounce-algorithm=counter_based, diagnostic-event=EventLIN14Slave13Defect  # EventDebounceMap_LIN 14 Slave 13_Defect
package /ZeC/DTC/DTC/Power_Path_028_Load_Failure
  diagnostic trouble code uds Power_Path_028_Load_Failure: dtc-props=Dtc_Props_1071f065, uds-dtc-value=0x00541c
  diagnostic event EventPowerPath028LoadFailure: aging-allowed=true, event-kind=SWC, prestorage-freeze-frame=false  # Event_Power_Path_028_Load_Failure
  diagnostic event to trouble code uds mapping EventDtcMapPowerPath028LoadFailure: diagnostic-event=EventPowerPath028LoadFailure, trouble-code-uds=Power_Path_028_Load_Failure  # Event_Dtc_Map_Power_Path_028_Load_Failure
  diagnostic event to operation cycle mapping EventOperCycleMapPowerPath028LoadFailure: diagnostic-event=EventPowerPath028LoadFailure, operation-cycle=DefaultOperationCycle  # Event_Oper_Cycle_Map_Power_Path_028_Load_Failure
  diagnostic event to debounce algorithm mapping EventDebounceMapPowerPath028LoadFailure: debounce-algorithm=time_based, diagnostic-event=EventPowerPath028LoadFailure  # EventDebounceMap_Power_Path_028_Load_Failure
package /ZeC/DTC/DTC/LIN_14_Slave_13_NoCommunication
  diagnostic trouble code uds LIN_14_Slave_13_NoCommunication: dtc-props=Dtc_Props_358996c7, uds-dtc-value=0x030e14  # LIN 14 Slave 13_NoCommunication
  diagnostic event EventLIN14Slave13NoCommunication: aging-allowed=true, event-kind=SWC, prestorage-freeze-frame=false  # Event_LIN 14 Slave 13_NoCommunication
  diagnostic event to trouble code uds mapping EventDtcMapLIN14Slave13NoCommunication: diagnostic-event=EventLIN14Slave13NoCommunication, trouble-code-uds=LIN_14_Slave_13_NoCommunication  # Event_Dtc_Map_LIN 14 Slave 13_NoCommunication
  diagnostic event to operation cycle mapping EventOperCycleMapLIN14Slave13NoCommunication: diagnostic-event=EventLIN14Slave13NoCommunication, operation-cycle=DefaultOperationCycle  # Event_Oper_Cycle_Map_LIN 14 Slave 13_NoCommunication
  diagnostic event to debounce algorithm mapping EventDebounceMapLIN14Slave13NoCommunication: debounce-algorithm=counter_based, diagnostic-event=EventLIN14Slave13NoCommunication  # EventDebounceMap_LIN 14 Slave 13_NoCommunication
package /ZeC/DTC/DTC/Power_Path_027_Load_Failure
  diagnostic trouble code uds Power_Path_027_Load_Failure: dtc-props=Dtc_Props_5668fa5f, uds-dtc-value=0x00541b
  diagnostic event EventPowerPath027LoadFailure: aging-allowed=true, event-kind=SWC, prestorage-freeze-frame=false  # Event_Power_Path_027_Load_Failure
  diagnostic event to trouble code uds mapping EventDtcMapPowerPath027LoadFailure: diagnostic-event=EventPowerPath027LoadFailure, trouble-code-uds=Power_Path_027_Load_Failure  # Event_Dtc_Map_Power_Path_027_Load_Failure
  diagnostic event to operation cycle mapping EventOperCycleMapPowerPath027LoadFailure: diagnostic-event=EventPowerPath027LoadFailure, operation-cycle=DefaultOperationCycle  # Event_Oper_Cycle_Map_Power_Path_027_Load_Failure
  diagnostic event to debounce algorithm mapping EventDebounceMapPowerPath027LoadFailure: debounce-algorithm=time_based, diagnostic-event=EventPowerPath027LoadFailure  # EventDebounceMap_Power_Path_027_Load_Failure
package /ZeC/DTC/DTC/Power_Path_159_Cable_Protection_Failure
  diagnostic trouble code uds Power_Path_159_Cable_Protection_Failure: dtc-props=Dtc_Props_119ece73, uds-dtc-value=0x00589f
  diagnostic event EventPowerPath159CableProtectionFailure: aging-allowed=true, event-kind=SWC, prestorage-freeze-frame=false  # Event_Power_Path_159_Cable_Protection_Failure
  diagnostic event to trouble code uds mapping EventDtcMapPowerPath159CableProtectionFailure: diagnostic-event=EventPowerPath159CableProtectionFailure, trouble-code-uds=Power_Path_159_Cable_Protection_Failure  # Event_Dtc_Map_Power_Path_159_Cable_Protection_Failure
  diagnostic event to operation cycle mapping EventOperCycleMapPowerPath159CableProtectionFailure: diagnostic-event=EventPowerPath159CableProtectionFailure, operation-cycle=DefaultOperationCycle  # Event_Oper_Cycle_Map_Power_Path_159_Cable_Protection_Failure
  diagnostic event to debounce algorithm mapping EventDebounceMapPowerPath159CableProtectionFailure: debounce-algorithm=time_based, diagnostic-event=EventPowerPath159CableProtectionFailure  # EventDebounceMap_Power_Path_159_Cable_Protection_Failure
package /ZeC/DTC/DTC/LIN_14_Slave_12_Defect
  diagnostic trouble code uds LIN_14_Slave_12_Defect: dtc-props=Dtc_Props_358996c7, uds-dtc-value=0x030e11  # LIN 14 Slave 12_Defect
  diagnostic event EventLIN14Slave12Defect: aging-allowed=true, event-kind=SWC, prestorage-freeze-frame=false  # Event_LIN 14 Slave 12_Defect
  diagnostic event to trouble code uds mapping EventDtcMapLIN14Slave12Defect: diagnostic-event=EventLIN14Slave12Defect, trouble-code-uds=LIN_14_Slave_12_Defect  # Event_Dtc_Map_LIN 14 Slave 12_Defect
  diagnostic event to operation cycle mapping EventOperCycleMapLIN14Slave12Defect: diagnostic-event=EventLIN14Slave12Defect, operation-cycle=DefaultOperationCycle  # Event_Oper_Cycle_Map_LIN 14 Slave 12_Defect
  diagnostic event to debounce algorithm mapping EventDebounceMapLIN14Slave12Defect: debounce-algorithm=counter_based, diagnostic-event=EventLIN14Slave12Defect  # EventDebounceMap_LIN 14 Slave 12_Defect
package /ZeC/DTC/DTC/Power_Path_030_Load_Failure
  diagnostic trouble code uds Power_Path_030_Load_Failure: dtc-props=Dtc_Props_5f56cab8, uds-dtc-value=0x00541e
  diagnostic event EventPowerPath030LoadFailure: aging-allowed=true, event-kind=SWC, prestorage-freeze-frame=false  # Event_Power_Path_030_Load_Failure
  diagnostic event to trouble code uds mapping EventDtcMapPowerPath030LoadFailure: diagnostic-event=EventPowerPath030LoadFailure, trouble-code-uds=Power_Path_030_Load_Failure  # Event_Dtc_Map_Power_Path_030_Load_Failure
  diagnostic event to operation cycle mapping EventOperCycleMapPowerPath030LoadFailure: diagnostic-event=EventPowerPath030LoadFailure, operation-cycle=DefaultOperationCycle  # Event_Oper_Cycle_Map_Power_Path_030_Load_Failure
  diagnostic event to debounce algorithm mapping EventDebounceMapPowerPath030LoadFailure: debounce-algorithm=time_based, diagnostic-event=EventPowerPath030LoadFailure  # EventDebounceMap_Power_Path_030_Load_Failure
package /ZeC/DTC/DTC/LIN_14_Slave_12_NoCommunication
  diagnostic trouble code uds LIN_14_Slave_12_NoCommunication: dtc-props=Dtc_Props_358996c7, uds-dtc-value=0x030e12  # LIN 14 Slave 12_NoCommunication
  diagnostic event EventLIN14Slave12NoCommunication: aging-allowed=true, event-kind=SWC, prestorage-freeze-frame=false  # Event_LIN 14 Slave 12_NoCommunication
  diagnostic event to trouble code uds mapping EventDtcMapLIN14Slave12NoCommunication: diagnostic-event=EventLIN14Slave12NoCommunication, trouble-code-uds=LIN_14_Slave_12_NoCommunication  # Event_Dtc_Map_LIN 14 Slave 12_NoCommunication
  diagnostic event to operation cycle mapping EventOperCycleMapLIN14Slave12NoCommunication: diagnostic-event=EventLIN14Slave12NoCommunication, operation-cycle=DefaultOperationCycle  # Event_Oper_Cycle_Map_LIN 14 Slave 12_NoCommunication
  diagnostic event to debounce algorithm mapping EventDebounceMapLIN14Slave12NoCommunication: debounce-algorithm=counter_based, diagnostic-event=EventLIN14Slave12NoCommunication  # EventDebounceMap_LIN 14 Slave 12_NoCommunication
package /ZeC/DTC/DTC/Power_Path_029_Load_Failure
  diagnostic trouble code uds Power_Path_029_Load_Failure: dtc-props=Dtc_Props_194fc082, uds-dtc-value=0x00541d
  diagnostic event EventPowerPath029LoadFailure: aging-allowed=true, event-kind=SWC, prestorage-freeze-frame=false  # Event_Power_Path_029_Load_Failure
  diagnostic event to trouble code uds mapping EventDtcMapPowerPath029LoadFailure: diagnostic-event=EventPowerPath029LoadFailure, trouble-code-uds=Power_Path_029_Load_Failure  # Event_Dtc_Map_Power_Path_029_Load_Failure
  diagnostic event to operation cycle mapping EventOperCycleMapPowerPath029LoadFailure: diagnostic-event=EventPowerPath029LoadFailure, operation-cycle=DefaultOperationCycle  # Event_Oper_Cycle_Map_Power_Path_029_Load_Failure
  diagnostic event to debounce algorithm mapping EventDebounceMapPowerPath029LoadFailure: debounce-algorithm=time_based, diagnostic-event=EventPowerPath029LoadFailure  # EventDebounceMap_Power_Path_029_Load_Failure
package /ZeC/DTC/DTC/Power_Path_032_Load_Failure
  diagnostic trouble code uds Power_Path_032_Load_Failure: dtc-props=Dtc_Props_760bcddf, uds-dtc-value=0x005420
  diagnostic event EventPowerPath032LoadFailure: aging-allowed=true, event-kind=SWC, prestorage-freeze-frame=false  # Event_Power_Path_032_Load_Failure
  diagnostic event to trouble code uds mapping EventDtcMapPowerPath032LoadFailure: diagnostic-event=EventPowerPath032LoadFailure, trouble-code-uds=Power_Path_032_Load_Failure  # Event_Dtc_Map_Power_Path_032_Load_Failure
  diagnostic event to operation cycle mapping EventOperCycleMapPowerPath032LoadFailure: diagnostic-event=EventPowerPath032LoadFailure, operation-cycle=DefaultOperationCycle  # Event_Oper_Cycle_Map_Power_Path_032_Load_Failure
  diagnostic event to debounce algorithm mapping EventDebounceMapPowerPath032LoadFailure: debounce-algorithm=time_based, diagnostic-event=EventPowerPath032LoadFailure  # EventDebounceMap_Power_Path_032_Load_Failure
package /ZeC/DTC/DTC/LIN_14_Slave_11_NoCommunication
  diagnostic trouble code uds LIN_14_Slave_11_NoCommunication: dtc-props=Dtc_Props_358996c7, uds-dtc-value=0x030e10  # LIN 14 Slave 11_NoCommunication
  diagnostic event EventLIN14Slave11NoCommunication: aging-allowed=true, event-kind=SWC, prestorage-freeze-frame=false  # Event_LIN 14 Slave 11_NoCommunication
  diagnostic event to trouble code uds mapping EventDtcMapLIN14Slave11NoCommunication: diagnostic-event=EventLIN14Slave11NoCommunication, trouble-code-uds=LIN_14_Slave_11_NoCommunication  # Event_Dtc_Map_LIN 14 Slave 11_NoCommunication
  diagnostic event to operation cycle mapping EventOperCycleMapLIN14Slave11NoCommunication: diagnostic-event=EventLIN14Slave11NoCommunication, operation-cycle=DefaultOperationCycle  # Event_Oper_Cycle_Map_LIN 14 Slave 11_NoCommunication
  diagnostic event to debounce algorithm mapping EventDebounceMapLIN14Slave11NoCommunication: debounce-algorithm=counter_based, diagnostic-event=EventLIN14Slave11NoCommunication  # EventDebounceMap_LIN 14 Slave 11_NoCommunication
package /ZeC/DTC/DTC/Power_Path_034_Load_Failure
  diagnostic trouble code uds Power_Path_034_Load_Failure: dtc-props=Dtc_Props_fa39d9ab, uds-dtc-value=0x005422
  diagnostic event EventPowerPath034LoadFailure: aging-allowed=true, event-kind=SWC, prestorage-freeze-frame=false  # Event_Power_Path_034_Load_Failure
  diagnostic event to trouble code uds mapping EventDtcMapPowerPath034LoadFailure: diagnostic-event=EventPowerPath034LoadFailure, trouble-code-uds=Power_Path_034_Load_Failure  # Event_Dtc_Map_Power_Path_034_Load_Failure
  diagnostic event to operation cycle mapping EventOperCycleMapPowerPath034LoadFailure: diagnostic-event=EventPowerPath034LoadFailure, operation-cycle=DefaultOperationCycle  # Event_Oper_Cycle_Map_Power_Path_034_Load_Failure
  diagnostic event to debounce algorithm mapping EventDebounceMapPowerPath034LoadFailure: debounce-algorithm=time_based, diagnostic-event=EventPowerPath034LoadFailure  # EventDebounceMap_Power_Path_034_Load_Failure
package /ZeC/DTC/DTC/Power_Path_033_Load_Failure
  diagnostic trouble code uds Power_Path_033_Load_Failure: dtc-props=Dtc_Props_3012c7e5, uds-dtc-value=0x005421
  diagnostic event EventPowerPath033LoadFailure: aging-allowed=true, event-kind=SWC, prestorage-freeze-frame=false  # Event_Power_Path_033_Load_Failure
  diagnostic event to trouble code uds mapping EventDtcMapPowerPath033LoadFailure: diagnostic-event=EventPowerPath033LoadFailure, trouble-code-uds=Power_Path_033_Load_Failure  # Event_Dtc_Map_Power_Path_033_Load_Failure
  diagnostic event to operation cycle mapping EventOperCycleMapPowerPath033LoadFailure: diagnostic-event=EventPowerPath033LoadFailure, operation-cycle=DefaultOperationCycle  # Event_Oper_Cycle_Map_Power_Path_033_Load_Failure
  diagnostic event to debounce algorithm mapping EventDebounceMapPowerPath033LoadFailure: debounce-algorithm=time_based, diagnostic-event=EventPowerPath033LoadFailure  # EventDebounceMap_Power_Path_033_Load_Failure
package /ZeC/DTC/DTC/ECU_unlocked
  diagnostic trouble code uds ECU_unlocked: dtc-props=Dtc_Props_d78b13b8, uds-dtc-value=0x001060  # ECU unlocked
  diagnostic event EventECUUnlocked: aging-allowed=true, event-kind=SWC, prestorage-freeze-frame=false  # Event_ECU unlocked
  diagnostic event to trouble code uds mapping EventDtcMapECUUnlocked: diagnostic-event=EventECUUnlocked, trouble-code-uds=ECU_unlocked  # Event_Dtc_Map_ECU unlocked
  diagnostic event to operation cycle mapping EventOperCycleMapECUUnlocked: diagnostic-event=EventECUUnlocked, operation-cycle=DefaultOperationCycle  # Event_Oper_Cycle_Map_ECU unlocked
  diagnostic event to debounce algorithm mapping EventDebounceMapECUUnlocked: debounce-algorithm=time_based, diagnostic-event=EventECUUnlocked  # EventDebounceMap_ECU unlocked
package /ZeC/DTC/DTC/SFD_developer_mode_active
  diagnostic trouble code uds SFD_developer_mode_active: dtc-props=Dtc_Props_d78b13b8, uds-dtc-value=0x001061  # SFD developer mode active
  diagnostic event EventSFDDeveloperModeActive: aging-allowed=true, event-kind=SWC, prestorage-freeze-frame=false  # Event_SFD developer mode active
  diagnostic event to trouble code uds mapping EventDtcMapSFDDeveloperModeActive: diagnostic-event=EventSFDDeveloperModeActive, trouble-code-uds=SFD_developer_mode_active  # Event_Dtc_Map_SFD developer mode active
  diagnostic event to operation cycle mapping EventOperCycleMapSFDDeveloperModeActive: diagnostic-event=EventSFDDeveloperModeActive, operation-cycle=DefaultOperationCycle  # Event_Oper_Cycle_Map_SFD developer mode active
  diagnostic event to debounce algorithm mapping EventDebounceMapSFDDeveloperModeActive: debounce-algorithm=time_based, diagnostic-event=EventSFDDeveloperModeActive  # EventDebounceMap_SFD developer mode active
package /ZeC/DTC/DTC/Power_Path_073_Load_Failure
  diagnostic trouble code uds Power_Path_073_Load_Failure: dtc-props=Dtc_Props_956415a5, uds-dtc-value=0x005449
  diagnostic event EventPowerPath073LoadFailure: aging-allowed=true, event-kind=SWC, prestorage-freeze-frame=false  # Event_Power_Path_073_Load_Failure
  diagnostic event to trouble code uds mapping EventDtcMapPowerPath073LoadFailure: diagnostic-event=EventPowerPath073LoadFailure, trouble-code-uds=Power_Path_073_Load_Failure  # Event_Dtc_Map_Power_Path_073_Load_Failure
  diagnostic event to operation cycle mapping EventOperCycleMapPowerPath073LoadFailure: diagnostic-event=EventPowerPath073LoadFailure, operation-cycle=DefaultOperationCycle  # Event_Oper_Cycle_Map_Power_Path_073_Load_Failure
  diagnostic event to debounce algorithm mapping EventDebounceMapPowerPath073LoadFailure: debounce-algorithm=time_based, diagnostic-event=EventPowerPath073LoadFailure  # EventDebounceMap_Power_Path_073_Load_Failure
package /ZeC/DTC/DTC/Power_Path_070_Load_Failure
  diagnostic trouble code uds Power_Path_070_Load_Failure: dtc-props=Dtc_Props_c1017e51, uds-dtc-value=0x005446
  diagnostic event EventPowerPath070LoadFailure: aging-allowed=true, event-kind=SWC, prestorage-freeze-frame=false  # Event_Power_Path_070_Load_Failure
  diagnostic event to trouble code uds mapping EventDtcMapPowerPath070LoadFailure: diagnostic-event=EventPowerPath070LoadFailure, trouble-code-uds=Power_Path_070_Load_Failure  # Event_Dtc_Map_Power_Path_070_Load_Failure
  diagnostic event to operation cycle mapping EventOperCycleMapPowerPath070LoadFailure: diagnostic-event=EventPowerPath070LoadFailure, operation-cycle=DefaultOperationCycle  # Event_Oper_Cycle_Map_Power_Path_070_Load_Failure
  diagnostic event to debounce algorithm mapping EventDebounceMapPowerPath070LoadFailure: debounce-algorithm=time_based, diagnostic-event=EventPowerPath070LoadFailure  # EventDebounceMap_Power_Path_070_Load_Failure
package /ZeC/DTC/DTC/Power_Path_069_Load_Failure
  diagnostic trouble code uds Power_Path_069_Load_Failure: dtc-props=Dtc_Props_b2a601f, uds-dtc-value=0x005445
  diagnostic event EventPowerPath069LoadFailure: aging-allowed=true, event-kind=SWC, prestorage-freeze-frame=false  # Event_Power_Path_069_Load_Failure
  diagnostic event to trouble code uds mapping EventDtcMapPowerPath069LoadFailure: diagnostic-event=EventPowerPath069LoadFailure, trouble-code-uds=Power_Path_069_Load_Failure  # Event_Dtc_Map_Power_Path_069_Load_Failure
  diagnostic event to operation cycle mapping EventOperCycleMapPowerPath069LoadFailure: diagnostic-event=EventPowerPath069LoadFailure, operation-cycle=DefaultOperationCycle  # Event_Oper_Cycle_Map_Power_Path_069_Load_Failure
  diagnostic event to debounce algorithm mapping EventDebounceMapPowerPath069LoadFailure: debounce-algorithm=time_based, diagnostic-event=EventPowerPath069LoadFailure  # EventDebounceMap_Power_Path_069_Load_Failure
package /ZeC/DTC/DTC/Power_Path_072_Load_Failure
  diagnostic trouble code uds Power_Path_072_Load_Failure: dtc-props=Dtc_Props_d37d1f9f, uds-dtc-value=0x005448
  diagnostic event EventPowerPath072LoadFailure: aging-allowed=true, event-kind=SWC, prestorage-freeze-frame=false  # Event_Power_Path_072_Load_Failure
  diagnostic event to trouble code uds mapping EventDtcMapPowerPath072LoadFailure: diagnostic-event=EventPowerPath072LoadFailure, trouble-code-uds=Power_Path_072_Load_Failure  # Event_Dtc_Map_Power_Path_072_Load_Failure
  diagnostic event to operation cycle mapping EventOperCycleMapPowerPath072LoadFailure: diagnostic-event=EventPowerPath072LoadFailure, operation-cycle=DefaultOperationCycle  # Event_Oper_Cycle_Map_Power_Path_072_Load_Failure
  diagnostic event to debounce algorithm mapping EventDebounceMapPowerPath072LoadFailure: debounce-algorithm=time_based, diagnostic-event=EventPowerPath072LoadFailure  # EventDebounceMap_Power_Path_072_Load_Failure
package /ZeC/DTC/DTC/Power_Path_071_Load_Failure
  diagnostic trouble code uds Power_Path_071_Load_Failure: dtc-props=Dtc_Props_8718746b, uds-dtc-value=0x005447
  diagnostic event EventPowerPath071LoadFailure: aging-allowed=true, event-kind=SWC, prestorage-freeze-frame=false  # Event_Power_Path_071_Load_Failure
  diagnostic event to trouble code uds mapping EventDtcMapPowerPath071LoadFailure: diagnostic-event=EventPowerPath071LoadFailure, trouble-code-uds=Power_Path_071_Load_Failure  # Event_Dtc_Map_Power_Path_071_Load_Failure
  diagnostic event to operation cycle mapping EventOperCycleMapPowerPath071LoadFailure: diagnostic-event=EventPowerPath071LoadFailure, operation-cycle=DefaultOperationCycle  # Event_Oper_Cycle_Map_Power_Path_071_Load_Failure
  diagnostic event to debounce algorithm mapping EventDebounceMapPowerPath071LoadFailure: debounce-algorithm=time_based, diagnostic-event=EventPowerPath071LoadFailure  # EventDebounceMap_Power_Path_071_Load_Failure
package /ZeC/DTC/DTC/Power_Path_075_Load_Failure
  diagnostic trouble code uds Power_Path_075_Load_Failure: dtc-props=Dtc_Props_3feb3485, uds-dtc-value=0x00544b
  diagnostic event EventPowerPath075LoadFailure: aging-allowed=true, event-kind=SWC, prestorage-freeze-frame=false  # Event_Power_Path_075_Load_Failure
  diagnostic event to trouble code uds mapping EventDtcMapPowerPath075LoadFailure: diagnostic-event=EventPowerPath075LoadFailure, trouble-code-uds=Power_Path_075_Load_Failure  # Event_Dtc_Map_Power_Path_075_Load_Failure
  diagnostic event to operation cycle mapping EventOperCycleMapPowerPath075LoadFailure: diagnostic-event=EventPowerPath075LoadFailure, operation-cycle=DefaultOperationCycle  # Event_Oper_Cycle_Map_Power_Path_075_Load_Failure
  diagnostic event to debounce algorithm mapping EventDebounceMapPowerPath075LoadFailure: debounce-algorithm=time_based, diagnostic-event=EventPowerPath075LoadFailure  # EventDebounceMap_Power_Path_075_Load_Failure
package /ZeC/DTC/DTC/Power_Path_074_Load_Failure
  diagnostic trouble code uds Power_Path_074_Load_Failure: dtc-props=Dtc_Props_f5c02acb, uds-dtc-value=0x00544a
  diagnostic event EventPowerPath074LoadFailure: aging-allowed=true, event-kind=SWC, prestorage-freeze-frame=false  # Event_Power_Path_074_Load_Failure
  diagnostic event to trouble code uds mapping EventDtcMapPowerPath074LoadFailure: diagnostic-event=EventPowerPath074LoadFailure, trouble-code-uds=Power_Path_074_Load_Failure  # Event_Dtc_Map_Power_Path_074_Load_Failure
  diagnostic event to operation cycle mapping EventOperCycleMapPowerPath074LoadFailure: diagnostic-event=EventPowerPath074LoadFailure, operation-cycle=DefaultOperationCycle  # Event_Oper_Cycle_Map_Power_Path_074_Load_Failure
  diagnostic event to debounce algorithm mapping EventDebounceMapPowerPath074LoadFailure: debounce-algorithm=time_based, diagnostic-event=EventPowerPath074LoadFailure  # EventDebounceMap_Power_Path_074_Load_Failure
package /ZeC/DTC/DTC/Power_Path_077_Load_Failure
  diagnostic trouble code uds Power_Path_077_Load_Failure: dtc-props=Dtc_Props_70cc0e58, uds-dtc-value=0x00544d
  diagnostic event EventPowerPath077LoadFailure: aging-allowed=true, event-kind=SWC, prestorage-freeze-frame=false  # Event_Power_Path_077_Load_Failure
  diagnostic event to trouble code uds mapping EventDtcMapPowerPath077LoadFailure: diagnostic-event=EventPowerPath077LoadFailure, trouble-code-uds=Power_Path_077_Load_Failure  # Event_Dtc_Map_Power_Path_077_Load_Failure
  diagnostic event to operation cycle mapping EventOperCycleMapPowerPath077LoadFailure: diagnostic-event=EventPowerPath077LoadFailure, operation-cycle=DefaultOperationCycle  # Event_Oper_Cycle_Map_Power_Path_077_Load_Failure
  diagnostic event to debounce algorithm mapping EventDebounceMapPowerPath077LoadFailure: debounce-algorithm=time_based, diagnostic-event=EventPowerPath077LoadFailure  # EventDebounceMap_Power_Path_077_Load_Failure
package /ZeC/DTC/DTC/Power_Path_076_Load_Failure
  diagnostic trouble code uds Power_Path_076_Load_Failure: dtc-props=Dtc_Props_79f23ebf, uds-dtc-value=0x00544c
  diagnostic event EventPowerPath076LoadFailure: aging-allowed=true, event-kind=SWC, prestorage-freeze-frame=false  # Event_Power_Path_076_Load_Failure
  diagnostic event to trouble code uds mapping EventDtcMapPowerPath076LoadFailure: diagnostic-event=EventPowerPath076LoadFailure, trouble-code-uds=Power_Path_076_Load_Failure  # Event_Dtc_Map_Power_Path_076_Load_Failure
  diagnostic event to operation cycle mapping EventOperCycleMapPowerPath076LoadFailure: diagnostic-event=EventPowerPath076LoadFailure, operation-cycle=DefaultOperationCycle  # Event_Oper_Cycle_Map_Power_Path_076_Load_Failure
  diagnostic event to debounce algorithm mapping EventDebounceMapPowerPath076LoadFailure: debounce-algorithm=time_based, diagnostic-event=EventPowerPath076LoadFailure  # EventDebounceMap_Power_Path_076_Load_Failure
package /ZeC/DTC/DTC/VKMS_application_requested_missing_key
  diagnostic trouble code uds VKMS_application_requested_missing_key: dtc-props=Dtc_Props_906b1391, uds-dtc-value=0x001090
  diagnostic event EventVKMSApplicationRequestedMissingKey: aging-allowed=true, event-kind=SWC, prestorage-freeze-frame=false  # Event_VKMS_application_requested_missing_key
  diagnostic event to trouble code uds mapping EventDtcMapVKMSApplicationRequestedMissingKey: diagnostic-event=EventVKMSApplicationRequestedMissingKey, trouble-code-uds=VKMS_application_requested_missing_key  # Event_Dtc_Map_VKMS_application_requested_missing_key
  diagnostic event to operation cycle mapping EventOperCycleMapVKMSApplicationRequestedMissingKey: diagnostic-event=EventVKMSApplicationRequestedMissingKey, operation-cycle=DefaultOperationCycle  # Event_Oper_Cycle_Map_VKMS_application_requested_missing_key
  diagnostic event to debounce algorithm mapping EventDebounceMapVKMSApplicationRequestedMissingKey: debounce-algorithm=time_based, diagnostic-event=EventVKMSApplicationRequestedMissingKey  # EventDebounceMap_VKMS_application_requested_missing_key
package /ZeC/DTC/DTC/VKMS_first_download_container_required
  diagnostic trouble code uds VKMS_first_download_container_required: dtc-props=Dtc_Props_d78b13b8, uds-dtc-value=0x001091
  diagnostic event EventVKMSFirstDownloadContainerRequired: aging-allowed=true, event-kind=SWC, prestorage-freeze-frame=false  # Event_VKMS_first_download_container_required
  diagnostic event to trouble code uds mapping EventDtcMapVKMSFirstDownloadContainerRequired: diagnostic-event=EventVKMSFirstDownloadContainerRequired, trouble-code-uds=VKMS_first_download_container_required  # Event_Dtc_Map_VKMS_first_download_container_required
  diagnostic event to operation cycle mapping EventOperCycleMapVKMSFirstDownloadContainerRequired: diagnostic-event=EventVKMSFirstDownloadContainerRequired, operation-cycle=DefaultOperationCycle  # Event_Oper_Cycle_Map_VKMS_first_download_container_required
  diagnostic event to debounce algorithm mapping EventDebounceMapVKMSFirstDownloadContainerRequired: debounce-algorithm=time_based, diagnostic-event=EventVKMSFirstDownloadContainerRequired  # EventDebounceMap_VKMS_first_download_container_required
package /ZeC/DTC/DTC/Power_Path_079_Load_Failure
  diagnostic trouble code uds Power_Path_079_Load_Failure: dtc-props=Dtc_Props_fcfe1a2c, uds-dtc-value=0x00544f
  diagnostic event EventPowerPath079LoadFailure: aging-allowed=true, event-kind=SWC, prestorage-freeze-frame=false  # Event_Power_Path_079_Load_Failure
  diagnostic event to trouble code uds mapping EventDtcMapPowerPath079LoadFailure: diagnostic-event=EventPowerPath079LoadFailure, trouble-code-uds=Power_Path_079_Load_Failure  # Event_Dtc_Map_Power_Path_079_Load_Failure
  diagnostic event to operation cycle mapping EventOperCycleMapPowerPath079LoadFailure: diagnostic-event=EventPowerPath079LoadFailure, operation-cycle=DefaultOperationCycle  # Event_Oper_Cycle_Map_Power_Path_079_Load_Failure
  diagnostic event to debounce algorithm mapping EventDebounceMapPowerPath079LoadFailure: debounce-algorithm=time_based, diagnostic-event=EventPowerPath079LoadFailure  # EventDebounceMap_Power_Path_079_Load_Failure
package /ZeC/DTC/DTC/Power_Path_078_Load_Failure
  diagnostic trouble code uds Power_Path_078_Load_Failure: dtc-props=Dtc_Props_36d50462, uds-dtc-value=0x00544e
  diagnostic event EventPowerPath078LoadFailure: aging-allowed=true, event-kind=SWC, prestorage-freeze-frame=false  # Event_Power_Path_078_Load_Failure
  diagnostic event to trouble code uds mapping EventDtcMapPowerPath078LoadFailure: diagnostic-event=EventPowerPath078LoadFailure, trouble-code-uds=Power_Path_078_Load_Failure  # Event_Dtc_Map_Power_Path_078_Load_Failure
  diagnostic event to operation cycle mapping EventOperCycleMapPowerPath078LoadFailure: diagnostic-event=EventPowerPath078LoadFailure, operation-cycle=DefaultOperationCycle  # Event_Oper_Cycle_Map_Power_Path_078_Load_Failure
  diagnostic event to debounce algorithm mapping EventDebounceMapPowerPath078LoadFailure: debounce-algorithm=time_based, diagnostic-event=EventPowerPath078LoadFailure  # EventDebounceMap_Power_Path_078_Load_Failure
package /ZeC/DTC/DTC/Power_Path_083_Load_Failure
  diagnostic trouble code uds Power_Path_083_Load_Failure: dtc-props=Dtc_Props_82479a7a, uds-dtc-value=0x005453
  diagnostic event EventPowerPath083LoadFailure: aging-allowed=true, event-kind=SWC, prestorage-freeze-frame=false  # Event_Power_Path_083_Load_Failure
  diagnostic event to trouble code uds mapping EventDtcMapPowerPath083LoadFailure: diagnostic-event=EventPowerPath083LoadFailure, trouble-code-uds=Power_Path_083_Load_Failure  # Event_Dtc_Map_Power_Path_083_Load_Failure
  diagnostic event to operation cycle mapping EventOperCycleMapPowerPath083LoadFailure: diagnostic-event=EventPowerPath083LoadFailure, operation-cycle=DefaultOperationCycle  # Event_Oper_Cycle_Map_Power_Path_083_Load_Failure
  diagnostic event to debounce algorithm mapping EventDebounceMapPowerPath083LoadFailure: debounce-algorithm=time_based, diagnostic-event=EventPowerPath083LoadFailure  # EventDebounceMap_Power_Path_083_Load_Failure
package /ZeC/DTC/DTC/Power_Path_082_Load_Failure
  diagnostic trouble code uds Power_Path_082_Load_Failure: dtc-props=Dtc_Props_c45e9040, uds-dtc-value=0x005452
  diagnostic event EventPowerPath082LoadFailure: aging-allowed=true, event-kind=SWC, prestorage-freeze-frame=false  # Event_Power_Path_082_Load_Failure
  diagnostic event to trouble code uds mapping EventDtcMapPowerPath082LoadFailure: diagnostic-event=EventPowerPath082LoadFailure, trouble-code-uds=Power_Path_082_Load_Failure  # Event_Dtc_Map_Power_Path_082_Load_Failure
  diagnostic event to operation cycle mapping EventOperCycleMapPowerPath082LoadFailure: diagnostic-event=EventPowerPath082LoadFailure, operation-cycle=DefaultOperationCycle  # Event_Oper_Cycle_Map_Power_Path_082_Load_Failure
  diagnostic event to debounce algorithm mapping EventDebounceMapPowerPath082LoadFailure: debounce-algorithm=time_based, diagnostic-event=EventPowerPath082LoadFailure  # EventDebounceMap_Power_Path_082_Load_Failure
package /ZeC/DTC/DTC/Power_Path_085_Load_Failure
  diagnostic trouble code uds Power_Path_085_Load_Failure: dtc-props=Dtc_Props_cd60a0a7, uds-dtc-value=0x005455
  diagnostic event EventPowerPath085LoadFailure: aging-allowed=true, event-kind=SWC, prestorage-freeze-frame=false  # Event_Power_Path_085_Load_Failure
  diagnostic event to trouble code uds mapping EventDtcMapPowerPath085LoadFailure: diagnostic-event=EventPowerPath085LoadFailure, trouble-code-uds=Power_Path_085_Load_Failure  # Event_Dtc_Map_Power_Path_085_Load_Failure
  diagnostic event to operation cycle mapping EventOperCycleMapPowerPath085LoadFailure: diagnostic-event=EventPowerPath085LoadFailure, operation-cycle=DefaultOperationCycle  # Event_Oper_Cycle_Map_Power_Path_085_Load_Failure
  diagnostic event to debounce algorithm mapping EventDebounceMapPowerPath085LoadFailure: debounce-algorithm=time_based, diagnostic-event=EventPowerPath085LoadFailure  # EventDebounceMap_Power_Path_085_Load_Failure
package /ZeC/DTC/DTC/Power_Path_084_Load_Failure
  diagnostic trouble code uds Power_Path_084_Load_Failure: dtc-props=Dtc_Props_8b79aa9d, uds-dtc-value=0x005454
  diagnostic event EventPowerPath084LoadFailure: aging-allowed=true, event-kind=SWC, prestorage-freeze-frame=false  # Event_Power_Path_084_Load_Failure
  diagnostic event to trouble code uds mapping EventDtcMapPowerPath084LoadFailure: diagnostic-event=EventPowerPath084LoadFailure, trouble-code-uds=Power_Path_084_Load_Failure  # Event_Dtc_Map_Power_Path_084_Load_Failure
  diagnostic event to operation cycle mapping EventOperCycleMapPowerPath084LoadFailure: diagnostic-event=EventPowerPath084LoadFailure, operation-cycle=DefaultOperationCycle  # Event_Oper_Cycle_Map_Power_Path_084_Load_Failure
  diagnostic event to debounce algorithm mapping EventDebounceMapPowerPath084LoadFailure: debounce-algorithm=time_based, diagnostic-event=EventPowerPath084LoadFailure  # EventDebounceMap_Power_Path_084_Load_Failure
package /ZeC/DTC/DTC/VKMS_new_download_container_required_due_to_data_corruption
  diagnostic trouble code uds VKMS_new_download_container_required_due_to_data_corruption: dtc-props=Dtc_Props_d78b13b8, uds-dtc-value=0x001092
  diagnostic event EventVKMSNewDownloadContainerRequiredDueToDataCorruption: aging-allowed=true, event-kind=SWC, prestorage-freeze-frame=false  # Event_VKMS_new_download_container_required_due_to_data_corruption
  diagnostic event to trouble code uds mapping EventDtcMapVKMSNewDownloadContainerRequiredDueToDataCorruption: diagnostic-event=EventVKMSNewDownloadContainerRequiredDueToDataCorruption, trouble-code-uds=VKMS_new_download_container_required_due_to_data_corruption  # Event_Dtc_Map_VKMS_new_download_container_required_due_to_data_corruption
  diagnostic event to operation cycle mapping EventOperCycleMapVKMSNewDownloadContainerRequiredDueToDataCorruption: diagnostic-event=EventVKMSNewDownloadContainerRequiredDueToDataCorruption, operation-cycle=DefaultOperationCycle  # Event_Oper_Cycle_Map_VKMS_new_download_container_required_due_to_data_corruption
  diagnostic event to debounce algorithm mapping EventDebounceMapVKMSNewDownloadContainerRequiredDueToDataCorruption: debounce-algorithm=time_based, diagnostic-event=EventVKMSNewDownloadContainerRequiredDueToDataCorruption  # EventDebounceMap_VKMS_new_download_container_required_due_to_data_corruption
package /ZeC/DTC/DTC/VKMS_new_download_container_required_due_to_vehicle_change
  diagnostic trouble code uds VKMS_new_download_container_required_due_to_vehicle_change: dtc-props=Dtc_Props_d78b13b8, uds-dtc-value=0x001093
  diagnostic event EventVKMSNewDownloadContainerRequiredDueToVehicleChange: aging-allowed=true, event-kind=SWC, prestorage-freeze-frame=false  # Event_VKMS_new_download_container_required_due_to_vehicle_change
  diagnostic event to trouble code uds mapping EventDtcMapVKMSNewDownloadContainerRequiredDueToVehicleChange: diagnostic-event=EventVKMSNewDownloadContainerRequiredDueToVehicleChange, trouble-code-uds=VKMS_new_download_container_required_due_to_vehicle_change  # Event_Dtc_Map_VKMS_new_download_container_required_due_to_vehicle_change
  diagnostic event to operation cycle mapping EventOperCycleMapVKMSNewDownloadContainerRequiredDueToVehicleChange: diagnostic-event=EventVKMSNewDownloadContainerRequiredDueToVehicleChange, operation-cycle=DefaultOperationCycle  # Event_Oper_Cycle_Map_VKMS_new_download_container_required_due_to_vehicle_change
  diagnostic event to debounce algorithm mapping EventDebounceMapVKMSNewDownloadContainerRequiredDueToVehicleChange: debounce-algorithm=time_based, diagnostic-event=EventVKMSNewDownloadContainerRequiredDueToVehicleChange  # EventDebounceMap_VKMS_new_download_container_required_due_to_vehicle_change
package /ZeC/DTC/DTC/Power_Path_081_Load_Failure
  diagnostic trouble code uds Power_Path_081_Load_Failure: dtc-props=Dtc_Props_e758e0e, uds-dtc-value=0x005451
  diagnostic event EventPowerPath081LoadFailure: aging-allowed=true, event-kind=SWC, prestorage-freeze-frame=false  # Event_Power_Path_081_Load_Failure
  diagnostic event to trouble code uds mapping EventDtcMapPowerPath081LoadFailure: diagnostic-event=EventPowerPath081LoadFailure, trouble-code-uds=Power_Path_081_Load_Failure  # Event_Dtc_Map_Power_Path_081_Load_Failure
  diagnostic event to operation cycle mapping EventOperCycleMapPowerPath081LoadFailure: diagnostic-event=EventPowerPath081LoadFailure, operation-cycle=DefaultOperationCycle  # Event_Oper_Cycle_Map_Power_Path_081_Load_Failure
  diagnostic event to debounce algorithm mapping EventDebounceMapPowerPath081LoadFailure: debounce-algorithm=time_based, diagnostic-event=EventPowerPath081LoadFailure  # EventDebounceMap_Power_Path_081_Load_Failure
package /ZeC/DTC/DTC/Power_Path_080_Load_Failure
  diagnostic trouble code uds Power_Path_080_Load_Failure: dtc-props=Dtc_Props_486c8434, uds-dtc-value=0x005450
  diagnostic event EventPowerPath080LoadFailure: aging-allowed=true, event-kind=SWC, prestorage-freeze-frame=false  # Event_Power_Path_080_Load_Failure
  diagnostic event to trouble code uds mapping EventDtcMapPowerPath080LoadFailure: diagnostic-event=EventPowerPath080LoadFailure, trouble-code-uds=Power_Path_080_Load_Failure  # Event_Dtc_Map_Power_Path_080_Load_Failure
  diagnostic event to operation cycle mapping EventOperCycleMapPowerPath080LoadFailure: diagnostic-event=EventPowerPath080LoadFailure, operation-cycle=DefaultOperationCycle  # Event_Oper_Cycle_Map_Power_Path_080_Load_Failure
  diagnostic event to debounce algorithm mapping EventDebounceMapPowerPath080LoadFailure: debounce-algorithm=time_based, diagnostic-event=EventPowerPath080LoadFailure  # EventDebounceMap_Power_Path_080_Load_Failure
package /ZeC/DTC/DTC/LIN_22_Slave_13_Defect
  diagnostic trouble code uds LIN_22_Slave_13_Defect: dtc-props=Dtc_Props_358996c7, uds-dtc-value=0x031705  # LIN 22 Slave 13_Defect
  diagnostic event EventLIN22Slave13Defect: aging-allowed=true, event-kind=SWC, prestorage-freeze-frame=false  # Event_LIN 22 Slave 13_Defect
  diagnostic event to trouble code uds mapping EventDtcMapLIN22Slave13Defect: diagnostic-event=EventLIN22Slave13Defect, trouble-code-uds=LIN_22_Slave_13_Defect  # Event_Dtc_Map_LIN 22 Slave 13_Defect
  diagnostic event to operation cycle mapping EventOperCycleMapLIN22Slave13Defect: diagnostic-event=EventLIN22Slave13Defect, operation-cycle=DefaultOperationCycle  # Event_Oper_Cycle_Map_LIN 22 Slave 13_Defect
  diagnostic event to debounce algorithm mapping EventDebounceMapLIN22Slave13Defect: debounce-algorithm=counter_based, diagnostic-event=EventLIN22Slave13Defect  # EventDebounceMap_LIN 22 Slave 13_Defect
package /ZeC/DTC/DTC/Power_Path_057_Load_Failure
  diagnostic trouble code uds Power_Path_057_Load_Failure: dtc-props=Dtc_Props_ab035c4e, uds-dtc-value=0x005439
  diagnostic event EventPowerPath057LoadFailure: aging-allowed=true, event-kind=SWC, prestorage-freeze-frame=false  # Event_Power_Path_057_Load_Failure
  diagnostic event to trouble code uds mapping EventDtcMapPowerPath057LoadFailure: diagnostic-event=EventPowerPath057LoadFailure, trouble-code-uds=Power_Path_057_Load_Failure  # Event_Dtc_Map_Power_Path_057_Load_Failure
  diagnostic event to operation cycle mapping EventOperCycleMapPowerPath057LoadFailure: diagnostic-event=EventPowerPath057LoadFailure, operation-cycle=DefaultOperationCycle  # Event_Oper_Cycle_Map_Power_Path_057_Load_Failure
  diagnostic event to debounce algorithm mapping EventDebounceMapPowerPath057LoadFailure: debounce-algorithm=time_based, diagnostic-event=EventPowerPath057LoadFailure  # EventDebounceMap_Power_Path_057_Load_Failure
package /ZeC/DTC/DTC/LIN_22_Slave_13_NoCommunication
  diagnostic trouble code uds LIN_22_Slave_13_NoCommunication: dtc-props=Dtc_Props_358996c7, uds-dtc-value=0x031706  # LIN 22 Slave 13_NoCommunication
  diagnostic event EventLIN22Slave13NoCommunication: aging-allowed=true, event-kind=SWC, prestorage-freeze-frame=false  # Event_LIN 22 Slave 13_NoCommunication
  diagnostic event to trouble code uds mapping EventDtcMapLIN22Slave13NoCommunication: diagnostic-event=EventLIN22Slave13NoCommunication, trouble-code-uds=LIN_22_Slave_13_NoCommunication  # Event_Dtc_Map_LIN 22 Slave 13_NoCommunication
  diagnostic event to operation cycle mapping EventOperCycleMapLIN22Slave13NoCommunication: diagnostic-event=EventLIN22Slave13NoCommunication, operation-cycle=DefaultOperationCycle  # Event_Oper_Cycle_Map_LIN 22 Slave 13_NoCommunication
  diagnostic event to debounce algorithm mapping EventDebounceMapLIN22Slave13NoCommunication: debounce-algorithm=counter_based, diagnostic-event=EventLIN22Slave13NoCommunication  # EventDebounceMap_LIN 22 Slave 13_NoCommunication
package /ZeC/DTC/DTC/Power_Path_056_Load_Failure
  diagnostic trouble code uds Power_Path_056_Load_Failure: dtc-props=Dtc_Props_ed1a5674, uds-dtc-value=0x005438
  diagnostic event EventPowerPath056LoadFailure: aging-allowed=true, event-kind=SWC, prestorage-freeze-frame=false  # Event_Power_Path_056_Load_Failure
  diagnostic event to trouble code uds mapping EventDtcMapPowerPath056LoadFailure: diagnostic-event=EventPowerPath056LoadFailure, trouble-code-uds=Power_Path_056_Load_Failure  # Event_Dtc_Map_Power_Path_056_Load_Failure
  diagnostic event to operation cycle mapping EventOperCycleMapPowerPath056LoadFailure: diagnostic-event=EventPowerPath056LoadFailure, operation-cycle=DefaultOperationCycle  # Event_Oper_Cycle_Map_Power_Path_056_Load_Failure
  diagnostic event to debounce algorithm mapping EventDebounceMapPowerPath056LoadFailure: debounce-algorithm=time_based, diagnostic-event=EventPowerPath056LoadFailure  # EventDebounceMap_Power_Path_056_Load_Failure
