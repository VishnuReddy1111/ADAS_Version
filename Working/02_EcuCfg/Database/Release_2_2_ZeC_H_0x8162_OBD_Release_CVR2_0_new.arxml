[part 15 of 19: packages /ZeC/DTC/DTC/Power_Path_120_Not_Found_Failure to /ZeC/DTC/DTC/Power_Path_011_Over_Load_Failure]
AUTOSAR XML (schema 00047)
package /ZeC/DTC/DTC/Power_Path_120_Not_Found_Failure
  diagnostic trouble code uds Power_Path_120_Not_Found_Failure: dtc-props=Dtc_Props_42d35816, uds-dtc-value=0x005678
  diagnostic event EventPowerPath120NotFoundFailure: aging-allowed=true, event-kind=SWC, prestorage-freeze-frame=false  # Event_Power_Path_120_Not_Found_Failure
  diagnostic event to trouble code uds mapping EventDtcMapPowerPath120NotFoundFailure: diagnostic-event=EventPowerPath120NotFoundFailure, trouble-code-uds=Power_Path_120_Not_Found_Failure  # Event_Dtc_Map_Power_Path_120_Not_Found_Failure
  diagnostic event to operation cycle mapping EventOperCycleMapPowerPath120NotFoundFailure: diagnostic-event=EventPowerPath120NotFoundFailure, operation-cycle=DefaultOperationCycle  # Event_Oper_Cycle_Map_Power_Path_120_Not_Found_Failure
  diagnostic event to debounce algorithm mapping EventDebounceMapPowerPath120NotFoundFailure: debounce-algorithm=time_based, diagnostic-event=EventPowerPath120NotFoundFailure  # EventDebounceMap_Power_Path_120_Not_Found_Failure
package /ZeC/DTC/DTC/Power_Path_124_Not_Found_Failure
  diagnostic trouble code uds Power_Path_124_Not_Found_Failure: dtc-props=Dtc_Props_e85c7936, uds-dtc-value=0x00567c
  diagnostic event EventPowerPath124NotFoundFailure: aging-allowed=true, event-kind=SWC, prestorage-freeze-frame=false  # Event_Power_Path_124_Not_Found_Failure
  diagnostic event to trouble code uds mapping EventDtcMapPowerPath124NotFoundFailure: diagnostic-event=EventPowerPath124NotFoundFailure, trouble-code-uds=Power_Path_124_Not_Found_Failure  # Event_Dtc_Map_Power_Path_124_Not_Found_Failure
  diagnostic event to operation cycle mapping EventOperCycleMapPowerPath124NotFoundFailure: diagnostic-event=EventPowerPath124NotFoundFailure, operation-cycle=DefaultOperationCycle  # Event_Oper_Cycle_Map_Power_Path_124_Not_Found_Failure
  diagnostic event to debounce algorithm mapping EventDebounceMapPowerPath124NotFoundFailure: debounce-algorithm=time_based, diagnostic-event=EventPowerPath124NotFoundFailure  # EventDebounceMap_Power_Path_124_Not_Found_Failure
package /ZeC/DTC/DTC/Power_Path_123_Not_Found_Failure
  diagnostic trouble code uds Power_Path_123_Not_Found_Failure: dtc-props=Dtc_Props_ae45730c, uds-dtc-value=0x00567b
  diagnostic event EventPowerPath123NotFoundFailure: aging-allowed=true, event-kind=SWC, prestorage-freeze-frame=false  # Event_Power_Path_123_Not_Found_Failure
  diagnostic event to trouble code uds mapping EventDtcMapPowerPath123NotFoundFailure: diagnostic-event=EventPowerPath123NotFoundFailure, trouble-code-uds=Power_Path_123_Not_Found_Failure  # Event_Dtc_Map_Power_Path_123_Not_Found_Failure
  diagnostic event to operation cycle mapping EventOperCycleMapPowerPath123NotFoundFailure: diagnostic-event=EventPowerPath123NotFoundFailure, operation-cycle=DefaultOperationCycle  # Event_Oper_Cycle_Map_Power_Path_123_Not_Found_Failure
  diagnostic event to debounce algorithm mapping EventDebounceMapPowerPath123NotFoundFailure: debounce-algorithm=time_based, diagnostic-event=EventPowerPath123NotFoundFailure  # EventDebounceMap_Power_Path_123_Not_Found_Failure
package /ZeC/DTC/DTC/Power_Path_126_Not_Found_Failure
  diagnostic trouble code uds Power_Path_126_Not_Found_Failure: dtc-props=Dtc_Props_a77b43eb, uds-dtc-value=0x00567e
  diagnostic event EventPowerPath126NotFoundFailure: aging-allowed=true, event-kind=SWC, prestorage-freeze-frame=false  # Event_Power_Path_126_Not_Found_Failure
  diagnostic event to trouble code uds mapping EventDtcMapPowerPath126NotFoundFailure: diagnostic-event=EventPowerPath126NotFoundFailure, trouble-code-uds=Power_Path_126_Not_Found_Failure  # Event_Dtc_Map_Power_Path_126_Not_Found_Failure
  diagnostic event to operation cycle mapping EventOperCycleMapPowerPath126NotFoundFailure: diagnostic-event=EventPowerPath126NotFoundFailure, operation-cycle=DefaultOperationCycle  # Event_Oper_Cycle_Map_Power_Path_126_Not_Found_Failure
  diagnostic event to debounce algorithm mapping EventDebounceMapPowerPath126NotFoundFailure: debounce-algorithm=time_based, diagnostic-event=EventPowerPath126NotFoundFailure  # EventDebounceMap_Power_Path_126_Not_Found_Failure
package /ZeC/DTC/DTC/Power_Path_125_Not_Found_Failure
  diagnostic trouble code uds Power_Path_125_Not_Found_Failure: dtc-props=Dtc_Props_e16249d1, uds-dtc-value=0x00567d
  diagnostic event EventPowerPath125NotFoundFailure: aging-allowed=true, event-kind=SWC, prestorage-freeze-frame=false  # Event_Power_Path_125_Not_Found_Failure
  diagnostic event to trouble code uds mapping EventDtcMapPowerPath125NotFoundFailure: diagnostic-event=EventPowerPath125NotFoundFailure, trouble-code-uds=Power_Path_125_Not_Found_Failure  # Event_Dtc_Map_Power_Path_125_Not_Found_Failure
  diagnostic event to operation cycle mapping EventOperCycleMapPowerPath125NotFoundFailure: diagnostic-event=EventPowerPath125NotFoundFailure, operation-cycle=DefaultOperationCycle  # Event_Oper_Cycle_Map_Power_Path_125_Not_Found_Failure
  diagnostic event to debounce algorithm mapping EventDebounceMapPowerPath125NotFoundFailure: debounce-algorithm=time_based, diagnostic-event=EventPowerPath125NotFoundFailure  # EventDebounceMap_Power_Path_125_Not_Found_Failure
package /ZeC/DTC/DTC/Power_Path_122_Not_Found_Failure
  diagnostic trouble code uds Power_Path_122_Not_Found_Failure: dtc-props=Dtc_Props_646e6d42, uds-dtc-value=0x00567a
  diagnostic event EventPowerPath122NotFoundFailure: aging-allowed=true, event-kind=SWC, prestorage-freeze-frame=false  # Event_Power_Path_122_Not_Found_Failure
  diagnostic event to trouble code uds mapping EventDtcMapPowerPath122NotFoundFailure: diagnostic-event=EventPowerPath122NotFoundFailure, trouble-code-uds=Power_Path_122_Not_Found_Failure  # Event_Dtc_Map_Power_Path_122_Not_Found_Failure
  diagnostic event to operation cycle mapping EventOperCycleMapPowerPath122NotFoundFailure: diagnostic-event=EventPowerPath122NotFoundFailure, operation-cycle=DefaultOperationCycle  # Event_Oper_Cycle_Map_Power_Path_122_Not_Found_Failure
  diagnostic event to debounce algorithm mapping EventDebounceMapPowerPath122NotFoundFailure: debounce-algorithm=time_based, diagnostic-event=EventPowerPath122NotFoundFailure  # EventDebounceMap_Power_Path_122_Not_Found_Failure
package /ZeC/DTC/DTC/LIN_6_Slave_2_Defect
  diagnostic trouble code uds LIN_6_Slave_2_Defect: dtc-props=Dtc_Props_358996c7, uds-dtc-value=0x03061e  # LIN 6 Slave 2_Defect
  diagnostic event EventLIN6Slave2Defect: aging-allowed=true, event-kind=SWC, prestorage-freeze-frame=false  # Event_LIN 6 Slave 2_Defect
  diagnostic event to trouble code uds mapping EventDtcMapLIN6Slave2Defect: diagnostic-event=EventLIN6Slave2Defect, trouble-code-uds=LIN_6_Slave_2_Defect  # Event_Dtc_Map_LIN 6 Slave 2_Defect
  diagnostic event to operation cycle mapping EventOperCycleMapLIN6Slave2Defect: diagnostic-event=EventLIN6Slave2Defect, operation-cycle=DefaultOperationCycle  # Event_Oper_Cycle_Map_LIN 6 Slave 2_Defect
  diagnostic event to debounce algorithm mapping EventDebounceMapLIN6Slave2Defect: debounce-algorithm=counter_based, diagnostic-event=EventLIN6Slave2Defect  # EventDebounceMap_LIN 6 Slave 2_Defect
package /ZeC/DTC/DTC/LIN_6_Slave_15_NoCommunication
  diagnostic trouble code uds LIN_6_Slave_15_NoCommunication: dtc-props=Dtc_Props_358996c7, uds-dtc-value=0x03061d  # LIN 6 Slave 15_NoCommunication
  diagnostic event EventLIN6Slave15NoCommunication: aging-allowed=true, event-kind=SWC, prestorage-freeze-frame=false  # Event_LIN 6 Slave 15_NoCommunication
  diagnostic event to trouble code uds mapping EventDtcMapLIN6Slave15NoCommunication: diagnostic-event=EventLIN6Slave15NoCommunication, trouble-code-uds=LIN_6_Slave_15_NoCommunication  # Event_Dtc_Map_LIN 6 Slave 15_NoCommunication
  diagnostic event to operation cycle mapping EventOperCycleMapLIN6Slave15NoCommunication: diagnostic-event=EventLIN6Slave15NoCommunication, operation-cycle=DefaultOperationCycle  # Event_Oper_Cycle_Map_LIN 6 Slave 15_NoCommunication
  diagnostic event to debounce algorithm mapping EventDebounceMapLIN6Slave15NoCommunication: debounce-algorithm=counter_based, diagnostic-event=EventLIN6Slave15NoCommunication  # EventDebounceMap_LIN 6 Slave 15_NoCommunication
package /ZeC/DTC/DTC/LIN_6_Slave_14_Defect
  diagnostic trouble code uds LIN_6_Slave_14_Defect: dtc-props=Dtc_Props_358996c7, uds-dtc-value=0x03061a  # LIN 6 Slave 14_Defect
  diagnostic event EventLIN6Slave14Defect: aging-allowed=true, event-kind=SWC, prestorage-freeze-frame=false  # Event_LIN 6 Slave 14_Defect
  diagnostic event to trouble code uds mapping EventDtcMapLIN6Slave14Defect: diagnostic-event=EventLIN6Slave14Defect, trouble-code-uds=LIN_6_Slave_14_Defect  # Event_Dtc_Map_LIN 6 Slave 14_Defect
  diagnostic event to operation cycle mapping EventOperCycleMapLIN6Slave14Defect: diagnostic-event=EventLIN6Slave14Defect, operation-cycle=DefaultOperationCycle  # Event_Oper_Cycle_Map_LIN 6 Slave 14_Defect
  diagnostic event to debounce algorithm mapping EventDebounceMapLIN6Slave14Defect: debounce-algorithm=counter_based, diagnostic-event=EventLIN6Slave14Defect  # EventDebounceMap_LIN 6 Slave 14_Defect
package /ZeC/DTC/DTC/Power_Path_127_Not_Found_Failure
  diagnostic trouble code uds Power_Path_127_Not_Found_Failure: dtc-props=Dtc_Props_6d505da5, uds-dtc-value=0x00567f
  diagnostic event EventPowerPath127NotFoundFailure: aging-allowed=true, event-kind=SWC, prestorage-freeze-frame=false  # Event_Power_Path_127_Not_Found_Failure
  diagnostic event to trouble code uds mapping EventDtcMapPowerPath127NotFoundFailure: diagnostic-event=EventPowerPath127NotFoundFailure, trouble-code-uds=Power_Path_127_Not_Found_Failure  # Event_Dtc_Map_Power_Path_127_Not_Found_Failure
  diagnostic event to operation cycle mapping EventOperCycleMapPowerPath127NotFoundFailure: diagnostic-event=EventPowerPath127NotFoundFailure, operation-cycle=DefaultOperationCycle  # Event_Oper_Cycle_Map_Power_Path_127_Not_Found_Failure
  diagnostic event to debounce algorithm mapping EventDebounceMapPowerPath127NotFoundFailure: debounce-algorithm=time_based, diagnostic-event=EventPowerPath127NotFoundFailure  # EventDebounceMap_Power_Path_127_Not_Found_Failure
package /ZeC/DTC/DTC/LIN_6_Slave_15_Defect
  diagnostic trouble code uds LIN_6_Slave_15_Defect: dtc-props=Dtc_Props_358996c7, uds-dtc-value=0x03061c  # LIN 6 Slave 15_Defect
  diagnostic event EventLIN6Slave15Defect: aging-allowed=true, event-kind=SWC, prestorage-freeze-frame=false  # Event_LIN 6 Slave 15_Defect
  diagnostic event to trouble code uds mapping EventDtcMapLIN6Slave15Defect: diagnostic-event=EventLIN6Slave15Defect, trouble-code-uds=LIN_6_Slave_15_Defect  # Event_Dtc_Map_LIN 6 Slave 15_Defect
  diagnostic event to operation cycle mapping EventOperCycleMapLIN6Slave15Defect: diagnostic-event=EventLIN6Slave15Defect, operation-cycle=DefaultOperationCycle  # Event_Oper_Cycle_Map_LIN 6 Slave 15_Defect
  diagnostic event to debounce algorithm mapping EventDebounceMapLIN6Slave15Defect: debounce-algorithm=counter_based, diagnostic-event=EventLIN6Slave15Defect  # EventDebounceMap_LIN 6 Slave 15_Defect
package /ZeC/DTC/DTC/LIN_6_Slave_14_NoCommunication
  diagnostic trouble code uds LIN_6_Slave_14_NoCommunication: dtc-props=Dtc_Props_358996c7, uds-dtc-value=0x03061b  # LIN 6 Slave 14_NoCommunication
  diagnostic event EventLIN6Slave14NoCommunication: aging-allowed=true, event-kind=SWC, prestorage-freeze-frame=false  # Event_LIN 6 Slave 14_NoCommunication
  diagnostic event to trouble code uds mapping EventDtcMapLIN6Slave14NoCommunication: diagnostic-event=EventLIN6Slave14NoCommunication, trouble-code-uds=LIN_6_Slave_14_NoCommunication  # Event_Dtc_Map_LIN 6 Slave 14_NoCommunication
  diagnostic event to operation cycle mapping EventOperCycleMapLIN6Slave14NoCommunication: diagnostic-event=EventLIN6Slave14NoCommunication, operation-cycle=DefaultOperationCycle  # Event_Oper_Cycle_Map_LIN 6 Slave 14_NoCommunication
  diagnostic event to debounce algorithm mapping EventDebounceMapLIN6Slave14NoCommunication: debounce-algorithm=counter_based, diagnostic-event=EventLIN6Slave14NoCommunication  # EventDebounceMap_LIN 6 Slave 14_NoCommunication
package /ZeC/DTC/DTC/Power_Path_132_Not_Found_Failure
  diagnostic trouble code uds Power_Path_132_Not_Found_Failure: dtc-props=Dtc_Props_66197ec2, uds-dtc-value=0x005684
  diagnostic event EventPowerPath132NotFoundFailure: aging-allowed=true, event-kind=SWC, prestorage-freeze-frame=false  # Event_Power_Path_132_Not_Found_Failure
  diagnostic event to trouble code uds mapping EventDtcMapPowerPath132NotFoundFailure: diagnostic-event=EventPowerPath132NotFoundFailure, trouble-code-uds=Power_Path_132_Not_Found_Failure  # Event_Dtc_Map_Power_Path_132_Not_Found_Failure
  diagnostic event to operation cycle mapping EventOperCycleMapPowerPath132NotFoundFailure: diagnostic-event=EventPowerPath132NotFoundFailure, operation-cycle=DefaultOperationCycle  # Event_Oper_Cycle_Map_Power_Path_132_Not_Found_Failure
  diagnostic event to debounce algorithm mapping EventDebounceMapPowerPath132NotFoundFailure: debounce-algorithm=time_based, diagnostic-event=EventPowerPath132NotFoundFailure  # EventDebounceMap_Power_Path_132_Not_Found_Failure
package /ZeC/DTC/DTC/Power_Path_131_Not_Found_Failure
  diagnostic trouble code uds Power_Path_131_Not_Found_Failure: dtc-props=Dtc_Props_6f274e25, uds-dtc-value=0x005683
  diagnostic event EventPowerPath131NotFoundFailure: aging-allowed=true, event-kind=SWC, prestorage-freeze-frame=false  # Event_Power_Path_131_Not_Found_Failure
  diagnostic event to trouble code uds mapping EventDtcMapPowerPath131NotFoundFailure: diagnostic-event=EventPowerPath131NotFoundFailure, trouble-code-uds=Power_Path_131_Not_Found_Failure  # Event_Dtc_Map_Power_Path_131_Not_Found_Failure
  diagnostic event to operation cycle mapping EventOperCycleMapPowerPath131NotFoundFailure: diagnostic-event=EventPowerPath131NotFoundFailure, operation-cycle=DefaultOperationCycle  # Event_Oper_Cycle_Map_Power_Path_131_Not_Found_Failure
  diagnostic event to debounce algorithm mapping EventDebounceMapPowerPath131NotFoundFailure: debounce-algorithm=time_based, diagnostic-event=EventPowerPath131NotFoundFailure  # EventDebounceMap_Power_Path_131_Not_Found_Failure
package /ZeC/DTC/DTC/Power_Path_002_Short_to_GND_Failure
  diagnostic trouble code uds Power_Path_002_Short_to_GND_Failure: dtc-props=Dtc_Props_addd5e9a, uds-dtc-value=0x005202
  diagnostic event EventPowerPath002ShortToGNDFailure: aging-allowed=true, event-kind=SWC, prestorage-freeze-frame=false  # Event_Power_Path_002_Short_to_GND_Failure
  diagnostic event to trouble code uds mapping EventDtcMapPowerPath002ShortToGNDFailure: diagnostic-event=EventPowerPath002ShortToGNDFailure, trouble-code-uds=Power_Path_002_Short_to_GND_Failure  # Event_Dtc_Map_Power_Path_002_Short_to_GND_Failure
  diagnostic event to operation cycle mapping EventOperCycleMapPowerPath002ShortToGNDFailure: diagnostic-event=EventPowerPath002ShortToGNDFailure, operation-cycle=DefaultOperationCycle  # Event_Oper_Cycle_Map_Power_Path_002_Short_to_GND_Failure
  diagnostic event to debounce algorithm mapping EventDebounceMapPowerPath002ShortToGNDFailure: debounce-algorithm=time_based, diagnostic-event=EventPowerPath002ShortToGNDFailure  # EventDebounceMap_Power_Path_002_Short_to_GND_Failure
package /ZeC/DTC/DTC/Power_Path_134_Not_Found_Failure
  diagnostic trouble code uds Power_Path_134_Not_Found_Failure: dtc-props=Dtc_Props_ea2b6ab6, uds-dtc-value=0x005686
  diagnostic event EventPowerPath134NotFoundFailure: aging-allowed=true, event-kind=SWC, prestorage-freeze-frame=false  # Event_Power_Path_134_Not_Found_Failure
  diagnostic event to trouble code uds mapping EventDtcMapPowerPath134NotFoundFailure: diagnostic-event=EventPowerPath134NotFoundFailure, trouble-code-uds=Power_Path_134_Not_Found_Failure  # Event_Dtc_Map_Power_Path_134_Not_Found_Failure
  diagnostic event to operation cycle mapping EventOperCycleMapPowerPath134NotFoundFailure: diagnostic-event=EventPowerPath134NotFoundFailure, operation-cycle=DefaultOperationCycle  # Event_Oper_Cycle_Map_Power_Path_134_Not_Found_Failure
  diagnostic event to debounce algorithm mapping EventDebounceMapPowerPath134NotFoundFailure: debounce-algorithm=time_based, diagnostic-event=EventPowerPath134NotFoundFailure  # EventDebounceMap_Power_Path_134_Not_Found_Failure
package /ZeC/DTC/DTC/Power_Path_001_Short_to_GND_Failure
  diagnostic trouble code uds Power_Path_001_Short_to_GND_Failure: dtc-props=Dtc_Props_67f640d4, uds-dtc-value=0x005201
  diagnostic event EventPowerPath001ShortToGNDFailure: aging-allowed=true, event-kind=SWC, prestorage-freeze-frame=false  # Event_Power_Path_001_Short_to_GND_Failure
  diagnostic event to trouble code uds mapping EventDtcMapPowerPath001ShortToGNDFailure: diagnostic-event=EventPowerPath001ShortToGNDFailure, trouble-code-uds=Power_Path_001_Short_to_GND_Failure  # Event_Dtc_Map_Power_Path_001_Short_to_GND_Failure
  diagnostic event to operation cycle mapping EventOperCycleMapPowerPath001ShortToGNDFailure: diagnostic-event=EventPowerPath001ShortToGNDFailure, operation-cycle=DefaultOperationCycle  # Event_Oper_Cycle_Map_Power_Path_001_Short_to_GND_Failure
  diagnostic event to debounce algorithm mapping EventDebounceMapPowerPath001ShortToGNDFailure: debounce-algorithm=time_based, diagnostic-event=EventPowerPath001ShortToGNDFailure  # EventDebounceMap_Power_Path_001_Short_to_GND_Failure
package /ZeC/DTC/DTC/Power_Path_133_Not_Found_Failure
  diagnostic trouble code uds Power_Path_133_Not_Found_Failure: dtc-props=Dtc_Props_200074f8, uds-dtc-value=0x005685
  diagnostic event EventPowerPath133NotFoundFailure: aging-allowed=true, event-kind=SWC, prestorage-freeze-frame=false  # Event_Power_Path_133_Not_Found_Failure
  diagnostic event to trouble code uds mapping EventDtcMapPowerPath133NotFoundFailure: diagnostic-event=EventPowerPath133NotFoundFailure, trouble-code-uds=Power_Path_133_Not_Found_Failure  # Event_Dtc_Map_Power_Path_133_Not_Found_Failure
  diagnostic event to operation cycle mapping EventOperCycleMapPowerPath133NotFoundFailure: diagnostic-event=EventPowerPath133NotFoundFailure, operation-cycle=DefaultOperationCycle  # Event_Oper_Cycle_Map_Power_Path_133_Not_Found_Failure
  diagnostic event to debounce algorithm mapping EventDebounceMapPowerPath133NotFoundFailure: debounce-algorithm=time_based, diagnostic-event=EventPowerPath133NotFoundFailure  # EventDebounceMap_Power_Path_133_Not_Found_Failure
package /ZeC/DTC/DTC/LIN_6_Slave_13_NoCommunication
  diagnostic trouble code uds LIN_6_Slave_13_NoCommunication: dtc-props=Dtc_Props_358996c7, uds-dtc-value=0x030619  # LIN 6 Slave 13_NoCommunication
  diagnostic event EventLIN6Slave13NoCommunication: aging-allowed=true, event-kind=SWC, prestorage-freeze-frame=false  # Event_LIN 6 Slave 13_NoCommunication
  diagnostic event to trouble code uds mapping EventDtcMapLIN6Slave13NoCommunication: diagnostic-event=EventLIN6Slave13NoCommunication, trouble-code-uds=LIN_6_Slave_13_NoCommunication  # Event_Dtc_Map_LIN 6 Slave 13_NoCommunication
  diagnostic event to operation cycle mapping EventOperCycleMapLIN6Slave13NoCommunication: diagnostic-event=EventLIN6Slave13NoCommunication, operation-cycle=DefaultOperationCycle  # Event_Oper_Cycle_Map_LIN 6 Slave 13_NoCommunication
  diagnostic event to debounce algorithm mapping EventDebounceMapLIN6Slave13NoCommunication: debounce-algorithm=counter_based, diagnostic-event=EventLIN6Slave13NoCommunication  # EventDebounceMap_LIN 6 Slave 13_NoCommunication
package /ZeC/DTC/DTC/Power_Path_128_Not_Found_Failure
  diagnostic trouble code uds Power_Path_128_Not_Found_Failure: dtc-props=Dtc_Props_a50c506b, uds-dtc-value=0x005680
  diagnostic event EventPowerPath128NotFoundFailure: aging-allowed=true, event-kind=SWC, prestorage-freeze-frame=false  # Event_Power_Path_128_Not_Found_Failure
  diagnostic event to trouble code uds mapping EventDtcMapPowerPath128NotFoundFailure: diagnostic-event=EventPowerPath128NotFoundFailure, trouble-code-uds=Power_Path_128_Not_Found_Failure  # Event_Dtc_Map_Power_Path_128_Not_Found_Failure
  diagnostic event to operation cycle mapping EventOperCycleMapPowerPath128NotFoundFailure: diagnostic-event=EventPowerPath128NotFoundFailure, operation-cycle=DefaultOperationCycle  # Event_Oper_Cycle_Map_Power_Path_128_Not_Found_Failure
  diagnostic event to debounce algorithm mapping EventDebounceMapPowerPath128NotFoundFailure: debounce-algorithm=time_based, diagnostic-event=EventPowerPath128NotFoundFailure  # EventDebounceMap_Power_Path_128_Not_Found_Failure
package /ZeC/DTC/DTC/LIN_6_Slave_13_Defect
  diagnostic trouble code uds LIN_6_Slave_13_Defect: dtc-props=Dtc_Props_358996c7, uds-dtc-value=0x030618  # LIN 6 Slave 13_Defect
  diagnostic event EventLIN6Slave13Defect: aging-allowed=true, event-kind=SWC, prestorage-freeze-frame=false  # Event_LIN 6 Slave 13_Defect
  diagnostic event to trouble code uds mapping EventDtcMapLIN6Slave13Defect: diagnostic-event=EventLIN6Slave13Defect, trouble-code-uds=LIN_6_Slave_13_Defect  # Event_Dtc_Map_LIN 6 Slave 13_Defect
  diagnostic event to operation cycle mapping EventOperCycleMapLIN6Slave13Defect: diagnostic-event=EventLIN6Slave13Defect, operation-cycle=DefaultOperationCycle  # Event_Oper_Cycle_Map_LIN 6 Slave 13_Defect
  diagnostic event to debounce algorithm mapping EventDebounceMapLIN6Slave13Defect: debounce-algorithm=counter_based, diagnostic-event=EventLIN6Slave13Defect  # EventDebounceMap_LIN 6 Slave 13_Defect
package /ZeC/DTC/DTC/Power_Path_130_Not_Found_Failure
  diagnostic trouble code uds Power_Path_130_Not_Found_Failure: dtc-props=Dtc_Props_293e441f, uds-dtc-value=0x005682
  diagnostic event EventPowerPath130NotFoundFailure: aging-allowed=true, event-kind=SWC, prestorage-freeze-frame=false  # Event_Power_Path_130_Not_Found_Failure
  diagnostic event to trouble code uds mapping EventDtcMapPowerPath130NotFoundFailure: diagnostic-event=EventPowerPath130NotFoundFailure, trouble-code-uds=Power_Path_130_Not_Found_Failure  # Event_Dtc_Map_Power_Path_130_Not_Found_Failure
  diagnostic event to operation cycle mapping EventOperCycleMapPowerPath130NotFoundFailure: diagnostic-event=EventPowerPath130NotFoundFailure, operation-cycle=DefaultOperationCycle  # Event_Oper_Cycle_Map_Power_Path_130_Not_Found_Failure
  diagnostic event to debounce algorithm mapping EventDebounceMapPowerPath130NotFoundFailure: debounce-algorithm=time_based, diagnostic-event=EventPowerPath130NotFoundFailure  # EventDebounceMap_Power_Path_130_Not_Found_Failure
package /ZeC/DTC/DTC/Power_Path_129_Not_Found_Failure
  diagnostic trouble code uds Power_Path_129_Not_Found_Failure: dtc-props=Dtc_Props_e3155a51, uds-dtc-value=0x005681
  diagnostic event EventPowerPath129NotFoundFailure: aging-allowed=true, event-kind=SWC, prestorage-freeze-frame=false  # Event_Power_Path_129_Not_Found_Failure
  diagnostic event to trouble code uds mapping EventDtcMapPowerPath129NotFoundFailure: diagnostic-event=EventPowerPath129NotFoundFailure, trouble-code-uds=Power_Path_129_Not_Found_Failure  # Event_Dtc_Map_Power_Path_129_Not_Found_Failure
  diagnostic event to operation cycle mapping EventOperCycleMapPowerPath129NotFoundFailure: diagnostic-event=EventPowerPath129NotFoundFailure, operation-cycle=DefaultOperationCycle  # Event_Oper_Cycle_Map_Power_Path_129_Not_Found_Failure
  diagnostic event to debounce algorithm mapping EventDebounceMapPowerPath129NotFoundFailure: debounce-algorithm=time_based, diagnostic-event=EventPowerPath129NotFoundFailure  # EventDebounceMap_Power_Path_129_Not_Found_Failure
package /ZeC/DTC/DTC/CAN_02_ECU_5_No_Communication
  diagnostic trouble code uds CAN_02_ECU_5_No_Communication: dtc-props=Dtc_Props_14158306, uds-dtc-value=0x032209
  diagnostic event EventCAN02ECU5NoCommunication: aging-allowed=true, event-kind=SWC, prestorage-freeze-frame=false  # Event_CAN_02_ECU_5_No_Communication
  diagnostic event to trouble code uds mapping EventDtcMapCAN02ECU5NoCommunication: diagnostic-event=EventCAN02ECU5NoCommunication, trouble-code-uds=CAN_02_ECU_5_No_Communication  # Event_Dtc_Map_CAN_02_ECU_5_No_Communication
  diagnostic event to operation cycle mapping EventOperCycleMapCAN02ECU5NoCommunication: diagnostic-event=EventCAN02ECU5NoCommunication, operation-cycle=DefaultOperationCycle  # Event_Oper_Cycle_Map_CAN_02_ECU_5_No_Communication
  diagnostic event to debounce algorithm mapping EventDebounceMapCAN02ECU5NoCommunication: debounce-algorithm=counter_based, diagnostic-event=EventCAN02ECU5NoCommunication  # EventDebounceMap_CAN_02_ECU_5_No_Communication
package /ZeC/DTC/DTC/CAN_02_ECU_3_No_Communication
  diagnostic trouble code uds CAN_02_ECU_3_No_Communication: dtc-props=Dtc_Props_14158306, uds-dtc-value=0x032207
  diagnostic event EventCAN02ECU3NoCommunication: aging-allowed=true, event-kind=SWC, prestorage-freeze-frame=false  # Event_CAN_02_ECU_3_No_Communication
  diagnostic event to trouble code uds mapping EventDtcMapCAN02ECU3NoCommunication: diagnostic-event=EventCAN02ECU3NoCommunication, trouble-code-uds=CAN_02_ECU_3_No_Communication  # Event_Dtc_Map_CAN_02_ECU_3_No_Communication
  diagnostic event to operation cycle mapping EventOperCycleMapCAN02ECU3NoCommunication: diagnostic-event=EventCAN02ECU3NoCommunication, operation-cycle=DefaultOperationCycle  # Event_Oper_Cycle_Map_CAN_02_ECU_3_No_Communication
  diagnostic event to debounce algorithm mapping EventDebounceMapCAN02ECU3NoCommunication: debounce-algorithm=counter_based, diagnostic-event=EventCAN02ECU3NoCommunication  # EventDebounceMap_CAN_02_ECU_3_No_Communication
package /ZeC/DTC/DTC/CAN_02_ECU_4_No_Communication
  diagnostic trouble code uds CAN_02_ECU_4_No_Communication: dtc-props=Dtc_Props_14158306, uds-dtc-value=0x032208
  diagnostic event EventCAN02ECU4NoCommunication: aging-allowed=true, event-kind=SWC, prestorage-freeze-frame=false  # Event_CAN_02_ECU_4_No_Communication
  diagnostic event to trouble code uds mapping EventDtcMapCAN02ECU4NoCommunication: diagnostic-event=EventCAN02ECU4NoCommunication, trouble-code-uds=CAN_02_ECU_4_No_Communication  # Event_Dtc_Map_CAN_02_ECU_4_No_Communication
  diagnostic event to operation cycle mapping EventOperCycleMapCAN02ECU4NoCommunication: diagnostic-event=EventCAN02ECU4NoCommunication, operation-cycle=DefaultOperationCycle  # Event_Oper_Cycle_Map_CAN_02_ECU_4_No_Communication
  diagnostic event to debounce algorithm mapping EventDebounceMapCAN02ECU4NoCommunication: debounce-algorithm=counter_based, diagnostic-event=EventCAN02ECU4NoCommunication  # EventDebounceMap_CAN_02_ECU_4_No_Communication
package /ZeC/DTC/DTC/CAN_02_ECU_1_No_Communication
  diagnostic trouble code uds CAN_02_ECU_1_No_Communication: dtc-props=Dtc_Props_14158306, uds-dtc-value=0x032205
  diagnostic event EventCAN02ECU1NoCommunication: aging-allowed=true, event-kind=SWC, prestorage-freeze-frame=false  # Event_CAN_02_ECU_1_No_Communication
  diagnostic event to trouble code uds mapping EventDtcMapCAN02ECU1NoCommunication: diagnostic-event=EventCAN02ECU1NoCommunication, trouble-code-uds=CAN_02_ECU_1_No_Communication  # Event_Dtc_Map_CAN_02_ECU_1_No_Communication
  diagnostic event to operation cycle mapping EventOperCycleMapCAN02ECU1NoCommunication: diagnostic-event=EventCAN02ECU1NoCommunication, operation-cycle=DefaultOperationCycle  # Event_Oper_Cycle_Map_CAN_02_ECU_1_No_Communication
  diagnostic event to debounce algorithm mapping EventDebounceMapCAN02ECU1NoCommunication: debounce-algorithm=counter_based, diagnostic-event=EventCAN02ECU1NoCommunication  # EventDebounceMap_CAN_02_ECU_1_No_Communication
package /ZeC/DTC/DTC/CAN_02_ECU_2_No_Communication
  diagnostic trouble code uds CAN_02_ECU_2_No_Communication: dtc-props=Dtc_Props_14158306, uds-dtc-value=0x032206
  diagnostic event EventCAN02ECU2NoCommunication: aging-allowed=true, event-kind=SWC, prestorage-freeze-frame=false  # Event_CAN_02_ECU_2_No_Communication
  diagnostic event to trouble code uds mapping EventDtcMapCAN02ECU2NoCommunication: diagnostic-event=EventCAN02ECU2NoCommunication, trouble-code-uds=CAN_02_ECU_2_No_Communication  # Event_Dtc_Map_CAN_02_ECU_2_No_Communication
  diagnostic event to operation cycle mapping EventOperCycleMapCAN02ECU2NoCommunication: diagnostic-event=EventCAN02ECU2NoCommunication, operation-cycle=DefaultOperationCycle  # Event_Oper_Cycle_Map_CAN_02_ECU_2_No_Communication
  diagnostic event to debounce algorithm mapping EventDebounceMapCAN02ECU2NoCommunication: debounce-algorithm=counter_based, diagnostic-event=EventCAN02ECU2NoCommunication  # EventDebounceMap_CAN_02_ECU_2_No_Communication
package /ZeC/DTC/DTC/DB_CANFD_02_Single_Wire_Mode
  diagnostic trouble code uds DB_CANFD_02_Single_Wire_Mode: dtc-props=Dtc_Props_14158306, uds-dtc-value=0x032203
  diagnostic event EventDBCANFD02SingleWireMode: aging-allowed=true, event-kind=SWC, prestorage-freeze-frame=false  # Event_DB_CANFD_02_Single_Wire_Mode
  diagnostic event to trouble code uds mapping EventDtcMapDBCANFD02SingleWireMode: diagnostic-event=EventDBCANFD02SingleWireMode, trouble-code-uds=DB_CANFD_02_Single_Wire_Mode  # Event_Dtc_Map_DB_CANFD_02_Single_Wire_Mode
  diagnostic event to operation cycle mapping EventOperCycleMapDBCANFD02SingleWireMode: diagnostic-event=EventDBCANFD02SingleWireMode, operation-cycle=DefaultOperationCycle  # Event_Oper_Cycle_Map_DB_CANFD_02_Single_Wire_Mode
  diagnostic event to debounce algorithm mapping EventDebounceMapDBCANFD02SingleWireMode: debounce-algorithm=counter_based, diagnostic-event=EventDBCANFD02SingleWireMode  # EventDebounceMap_DB_CANFD_02_Single_Wire_Mode
package /ZeC/DTC/DTC/DB_CANFD_02_Error_Received_Value
  diagnostic trouble code uds DB_CANFD_02_Error_Received_Value: dtc-props=Dtc_Props_b618fb9, uds-dtc-value=0x032204
  diagnostic event EventDBCANFD02ErrorReceivedValue: aging-allowed=true, event-kind=SWC, prestorage-freeze-frame=false  # Event_DB_CANFD_02_Error_Received_Value
  diagnostic event to trouble code uds mapping EventDtcMapDBCANFD02ErrorReceivedValue: diagnostic-event=EventDBCANFD02ErrorReceivedValue, trouble-code-uds=DB_CANFD_02_Error_Received_Value  # Event_Dtc_Map_DB_CANFD_02_Error_Received_Value
  diagnostic event to operation cycle mapping EventOperCycleMapDBCANFD02ErrorReceivedValue: diagnostic-event=EventDBCANFD02ErrorReceivedValue, operation-cycle=DefaultOperationCycle  # Event_Oper_Cycle_Map_DB_CANFD_02_Error_Received_Value
  diagnostic event to debounce algorithm mapping EventDebounceMapDBCANFD02ErrorReceivedValue: debounce-algorithm=counter_based, diagnostic-event=EventDBCANFD02ErrorReceivedValue  # EventDebounceMap_DB_CANFD_02_Error_Received_Value
package /ZeC/DTC/DTC/DB_CANFD_02_Defect
  diagnostic trouble code uds DB_CANFD_02_Defect: dtc-props=Dtc_Props_14158306, uds-dtc-value=0x032201
  diagnostic event EventDBCANFD02Defect: aging-allowed=true, event-kind=SWC, prestorage-freeze-frame=false  # Event_DB_CANFD_02_Defect
  diagnostic event to trouble code uds mapping EventDtcMapDBCANFD02Defect: diagnostic-event=EventDBCANFD02Defect, trouble-code-uds=DB_CANFD_02_Defect  # Event_Dtc_Map_DB_CANFD_02_Defect
  diagnostic event to operation cycle mapping EventOperCycleMapDBCANFD02Defect: diagnostic-event=EventDBCANFD02Defect, operation-cycle=DefaultOperationCycle  # Event_Oper_Cycle_Map_DB_CANFD_02_Defect
  diagnostic event to debounce algorithm mapping EventDebounceMapDBCANFD02Defect: debounce-algorithm=counter_based, diagnostic-event=EventDBCANFD02Defect  # EventDebounceMap_DB_CANFD_02_Defect
package /ZeC/DTC/DTC/DB_CANFD_02_No_Communication
  diagnostic trouble code uds DB_CANFD_02_No_Communication: dtc-props=Dtc_Props_14158306, uds-dtc-value=0x032202
  diagnostic event EventDBCANFD02NoCommunication: aging-allowed=true, event-kind=SWC, prestorage-freeze-frame=false  # Event_DB_CANFD_02_No_Communication
  diagnostic event to trouble code uds mapping EventDtcMapDBCANFD02NoCommunication: diagnostic-event=EventDBCANFD02NoCommunication, trouble-code-uds=DB_CANFD_02_No_Communication  # Event_Dtc_Map_DB_CANFD_02_No_Communication
  diagnostic event to operation cycle mapping EventOperCycleMapDBCANFD02NoCommunication: diagnostic-event=EventDBCANFD02NoCommunication, operation-cycle=DefaultOperationCycle  # Event_Oper_Cycle_Map_DB_CANFD_02_No_Communication
  diagnostic event to debounce algorithm mapping EventDebounceMapDBCANFD02NoCommunication: debounce-algorithm=counter_based, diagnostic-event=EventDBCANFD02NoCommunication  # EventDebounceMap_DB_CANFD_02_No_Communication
package /ZeC/DTC/DTC/CAN_02_ECU_6_No_Communication
  diagnostic trouble code uds CAN_02_ECU_6_No_Communication: dtc-props=Dtc_Props_14158306, uds-dtc-value=0x032210
  diagnostic event EventCAN02ECU6NoCommunication: aging-allowed=true, event-kind=SWC, prestorage-freeze-frame=false  # Event_CAN_02_ECU_6_No_Communication
  diagnostic event to trouble code uds mapping EventDtcMapCAN02ECU6NoCommunication: diagnostic-event=EventCAN02ECU6NoCommunication, trouble-code-uds=CAN_02_ECU_6_No_Communication  # Event_Dtc_Map_CAN_02_ECU_6_No_Communication
  diagnostic event to operation cycle mapping EventOperCycleMapCAN02ECU6NoCommunication: diagnostic-event=EventCAN02ECU6NoCommunication, operation-cycle=DefaultOperationCycle  # Event_Oper_Cycle_Map_CAN_02_ECU_6_No_Communication
  diagnostic event to debounce algorithm mapping EventDebounceMapCAN02ECU6NoCommunication: debounce-algorithm=counter_based, diagnostic-event=EventCAN02ECU6NoCommunication  # EventDebounceMap_CAN_02_ECU_6_No_Communication
package /ZeC/DTC/DTC/LIN_10_Slave_8_NoCommunication
  diagnostic trouble code uds LIN_10_Slave_8_NoCommunication: dtc-props=Dtc_Props_358996c7, uds-dtc-value=0x030a1e  # LIN 10 Slave 8_NoCommunication
  diagnostic event EventLIN10Slave8NoCommunication: aging-allowed=true, event-kind=SWC, prestorage-freeze-frame=false  # Event_LIN 10 Slave 8_NoCommunication
  diagnostic event to trouble code uds mapping EventDtcMapLIN10Slave8NoCommunication: diagnostic-event=EventLIN10Slave8NoCommunication, trouble-code-uds=LIN_10_Slave_8_NoCommunication  # Event_Dtc_Map_LIN 10 Slave 8_NoCommunication
  diagnostic event to operation cycle mapping EventOperCycleMapLIN10Slave8NoCommunication: diagnostic-event=EventLIN10Slave8NoCommunication, operation-cycle=DefaultOperationCycle  # Event_Oper_Cycle_Map_LIN 10 Slave 8_NoCommunication
  diagnostic event to debounce algorithm mapping EventDebounceMapLIN10Slave8NoCommunication: debounce-algorithm=counter_based, diagnostic-event=EventLIN10Slave8NoCommunication  # EventDebounceMap_LIN 10 Slave 8_NoCommunication
package /ZeC/DTC/DTC/LIN_10_Slave_9_Defect
  diagnostic trouble code uds LIN_10_Slave_9_Defect: dtc-props=Dtc_Props_358996c7, uds-dtc-value=0x030a1f  # LIN 10 Slave 9_Defect
  diagnostic event EventLIN10Slave9Defect: aging-allowed=true, event-kind=SWC, prestorage-freeze-frame=false  # Event_LIN 10 Slave 9_Defect
  diagnostic event to trouble code uds mapping EventDtcMapLIN10Slave9Defect: diagnostic-event=EventLIN10Slave9Defect, trouble-code-uds=LIN_10_Slave_9_Defect  # Event_Dtc_Map_LIN 10 Slave 9_Defect
  diagnostic event to operation cycle mapping EventOperCycleMapLIN10Slave9Defect: diagnostic-event=EventLIN10Slave9Defect, operation-cycle=DefaultOperationCycle  # Event_Oper_Cycle_Map_LIN 10 Slave 9_Defect
  diagnostic event to debounce algorithm mapping EventDebounceMapLIN10Slave9Defect: debounce-algorithm=counter_based, diagnostic-event=EventLIN10Slave9Defect  # EventDebounceMap_LIN 10 Slave 9_Defect
package /ZeC/DTC/DTC/LIN_10_Slave_7_NoCommunication
  diagnostic trouble code uds LIN_10_Slave_7_NoCommunication: dtc-props=Dtc_Props_358996c7, uds-dtc-value=0x030a1c  # LIN 10 Slave 7_NoCommunication
  diagnostic event EventLIN10Slave7NoCommunication: aging-allowed=true, event-kind=SWC, prestorage-freeze-frame=false  # Event_LIN 10 Slave 7_NoCommunication
  diagnostic event to trouble code uds mapping EventDtcMapLIN10Slave7NoCommunication: diagnostic-event=EventLIN10Slave7NoCommunication, trouble-code-uds=LIN_10_Slave_7_NoCommunication  # Event_Dtc_Map_LIN 10 Slave 7_NoCommunication
  diagnostic event to operation cycle mapping EventOperCycleMapLIN10Slave7NoCommunication: diagnostic-event=EventLIN10Slave7NoCommunication, operation-cycle=DefaultOperationCycle  # Event_Oper_Cycle_Map_LIN 10 Slave 7_NoCommunication
  diagnostic event to debounce algorithm mapping EventDebounceMapLIN10Slave7NoCommunication: debounce-algorithm=counter_based, diagnostic-event=EventLIN10Slave7NoCommunication  # EventDebounceMap_LIN 10 Slave 7_NoCommunication
package /ZeC/DTC/DTC/LIN_10_Slave_8_Defect
  diagnostic trouble code uds LIN_10_Slave_8_Defect: dtc-props=Dtc_Props_358996c7, uds-dtc-value=0x030a1d  # LIN 10 Slave 8_Defect
  diagnostic event EventLIN10Slave8Defect: aging-allowed=true, event-kind=SWC, prestorage-freeze-frame=false  # Event_LIN 10 Slave 8_Defect
  diagnostic event to trouble code uds mapping EventDtcMapLIN10Slave8Defect: diagnostic-event=EventLIN10Slave8Defect, trouble-code-uds=LIN_10_Slave_8_Defect  # Event_Dtc_Map_LIN 10 Slave 8_Defect
  diagnostic event to operation cycle mapping EventOperCycleMapLIN10Slave8Defect: diagnostic-event=EventLIN10Slave8Defect, operation-cycle=DefaultOperationCycle  # Event_Oper_Cycle_Map_LIN 10 Slave 8_Defect
  diagnostic event to debounce algorithm mapping EventDebounceMapLIN10Slave8Defect: debounce-algorithm=counter_based, diagnostic-event=EventLIN10Slave8Defect  # EventDebounceMap_LIN 10 Slave 8_Defect
package /ZeC/DTC/DTC/LIN_10_Slave_6_NoCommunication
  diagnostic trouble code uds LIN_10_Slave_6_NoCommunication: dtc-props=Dtc_Props_358996c7, uds-dtc-value=0x030a1a  # LIN 10 Slave 6_NoCommunication
  diagnostic event EventLIN10Slave6NoCommunication: aging-allowed=true, event-kind=SWC, prestorage-freeze-frame=false  # Event_LIN 10 Slave 6_NoCommunication
  diagnostic event to trouble code uds mapping EventDtcMapLIN10Slave6NoCommunication: diagnostic-event=EventLIN10Slave6NoCommunication, trouble-code-uds=LIN_10_Slave_6_NoCommunication  # Event_Dtc_Map_LIN 10 Slave 6_NoCommunication
  diagnostic event to operation cycle mapping EventOperCycleMapLIN10Slave6NoCommunication: diagnostic-event=EventLIN10Slave6NoCommunication, operation-cycle=DefaultOperationCycle  # Event_Oper_Cycle_Map_LIN 10 Slave 6_NoCommunication
  diagnostic event to debounce algorithm mapping EventDebounceMapLIN10Slave6NoCommunication: debounce-algorithm=counter_based, diagnostic-event=EventLIN10Slave6NoCommunication  # EventDebounceMap_LIN 10 Slave 6_NoCommunication
package /ZeC/DTC/DTC/LIN_10_Slave_7_Defect
  diagnostic trouble code uds LIN_10_Slave_7_Defect: dtc-props=Dtc_Props_358996c7, uds-dtc-value=0x030a1b  # LIN 10 Slave 7_Defect
  diagnostic event EventLIN10Slave7Defect: aging-allowed=true, event-kind=SWC, prestorage-freeze-frame=false  # Event_LIN 10 Slave 7_Defect
  diagnostic event to trouble code uds mapping EventDtcMapLIN10Slave7Defect: diagnostic-event=EventLIN10Slave7Defect, trouble-code-uds=LIN_10_Slave_7_Defect  # Event_Dtc_Map_LIN 10 Slave 7_Defect
  diagnostic event to operation cycle mapping EventOperCycleMapLIN10Slave7Defect: diagnostic-event=EventLIN10Slave7Defect, operation-cycle=DefaultOperationCycle  # Event_Oper_Cycle_Map_LIN 10 Slave 7_Defect
  diagnostic event to debounce algorithm mapping EventDebounceMapLIN10Slave7Defect: debounce-algorithm=counter_based, diagnostic-event=EventLIN10Slave7Defect  # EventDebounceMap_LIN 10 Slave 7_Defect
package /ZeC/DTC/DTC/Power_Path_160_Load_Failure
  diagnostic trouble code uds Power_Path_160_Load_Failure: dtc-props=Dtc_Props_c92c78b3, uds-dtc-value=0x0054a0
  diagnostic event EventPowerPath160LoadFailure: aging-allowed=true, event-kind=SWC, prestorage-freeze-frame=false  # Event_Power_Path_160_Load_Failure
  diagnostic event to trouble code uds mapping EventDtcMapPowerPath160LoadFailure: diagnostic-event=EventPowerPath160LoadFailure, trouble-code-uds=Power_Path_160_Load_Failure  # Event_Dtc_Map_Power_Path_160_Load_Failure
  diagnostic event to operation cycle mapping EventOperCycleMapPowerPath160LoadFailure: diagnostic-event=EventPowerPath160LoadFailure, operation-cycle=DefaultOperationCycle  # Event_Oper_Cycle_Map_Power_Path_160_Load_Failure
  diagnostic event to debounce algorithm mapping EventDebounceMapPowerPath160LoadFailure: debounce-algorithm=time_based, diagnostic-event=EventPowerPath160LoadFailure  # EventDebounceMap_Power_Path_160_Load_Failure
package /ZeC/DTC/DTC/LIN_10_Slave_9_NoCommunication
  diagnostic trouble code uds LIN_10_Slave_9_NoCommunication: dtc-props=Dtc_Props_358996c7, uds-dtc-value=0x030a20  # LIN 10 Slave 9_NoCommunication
  diagnostic event EventLIN10Slave9NoCommunication: aging-allowed=true, event-kind=SWC, prestorage-freeze-frame=false  # Event_LIN 10 Slave 9_NoCommunication
  diagnostic event to trouble code uds mapping EventDtcMapLIN10Slave9NoCommunication: diagnostic-event=EventLIN10Slave9NoCommunication, trouble-code-uds=LIN_10_Slave_9_NoCommunication  # Event_Dtc_Map_LIN 10 Slave 9_NoCommunication
  diagnostic event to operation cycle mapping EventOperCycleMapLIN10Slave9NoCommunication: diagnostic-event=EventLIN10Slave9NoCommunication, operation-cycle=DefaultOperationCycle  # Event_Oper_Cycle_Map_LIN 10 Slave 9_NoCommunication
  diagnostic event to debounce algorithm mapping EventDebounceMapLIN10Slave9NoCommunication: debounce-algorithm=counter_based, diagnostic-event=EventLIN10Slave9NoCommunication  # EventDebounceMap_LIN 10 Slave 9_NoCommunication
package /ZeC/DTC/DTC/LIN_19_Slave_13_Defect
  diagnostic trouble code uds LIN_19_Slave_13_Defect: dtc-props=Dtc_Props_358996c7, uds-dtc-value=0x031318  # LIN 19 Slave 13_Defect
  diagnostic event EventLIN19Slave13Defect: aging-allowed=true, event-kind=SWC, prestorage-freeze-frame=false  # Event_LIN 19 Slave 13_Defect
  diagnostic event to trouble code uds mapping EventDtcMapLIN19Slave13Defect: diagnostic-event=EventLIN19Slave13Defect, trouble-code-uds=LIN_19_Slave_13_Defect  # Event_Dtc_Map_LIN 19 Slave 13_Defect
  diagnostic event to operation cycle mapping EventOperCycleMapLIN19Slave13Defect: diagnostic-event=EventLIN19Slave13Defect, operation-cycle=DefaultOperationCycle  # Event_Oper_Cycle_Map_LIN 19 Slave 13_Defect
  diagnostic event to debounce algorithm mapping EventDebounceMapLIN19Slave13Defect: debounce-algorithm=counter_based, diagnostic-event=EventLIN19Slave13Defect  # EventDebounceMap_LIN 19 Slave 13_Defect
package /ZeC/DTC/DTC/LIN_19_Slave_13_NoCommunication
  diagnostic trouble code uds LIN_19_Slave_13_NoCommunication: dtc-props=Dtc_Props_358996c7, uds-dtc-value=0x031319  # LIN 19 Slave 13_NoCommunication
  diagnostic event EventLIN19Slave13NoCommunication: aging-allowed=true, event-kind=SWC, prestorage-freeze-frame=false  # Event_LIN 19 Slave 13_NoCommunication
  diagnostic event to trouble code uds mapping EventDtcMapLIN19Slave13NoCommunication: diagnostic-event=EventLIN19Slave13NoCommunication, trouble-code-uds=LIN_19_Slave_13_NoCommunication  # Event_Dtc_Map_LIN 19 Slave 13_NoCommunication
  diagnostic event to operation cycle mapping EventOperCycleMapLIN19Slave13NoCommunication: diagnostic-event=EventLIN19Slave13NoCommunication, operation-cycle=DefaultOperationCycle  # Event_Oper_Cycle_Map_LIN 19 Slave 13_NoCommunication
  diagnostic event to debounce algorithm mapping EventDebounceMapLIN19Slave13NoCommunication: debounce-algorithm=counter_based, diagnostic-event=EventLIN19Slave13NoCommunication  # EventDebounceMap_LIN 19 Slave 13_NoCommunication
package /ZeC/DTC/DTC/LIN_19_Slave_12_Defect
  diagnostic trouble code uds LIN_19_Slave_12_Defect: dtc-props=Dtc_Props_358996c7, uds-dtc-value=0x031316  # LIN 19 Slave 12_Defect
  diagnostic event EventLIN19Slave12Defect: aging-allowed=true, event-kind=SWC, prestorage-freeze-frame=false  # Event_LIN 19 Slave 12_Defect
  diagnostic event to trouble code uds mapping EventDtcMapLIN19Slave12Defect: diagnostic-event=EventLIN19Slave12Defect, trouble-code-uds=LIN_19_Slave_12_Defect  # Event_Dtc_Map_LIN 19 Slave 12_Defect
  diagnostic event to operation cycle mapping EventOperCycleMapLIN19Slave12Defect: diagnostic-event=EventLIN19Slave12Defect, operation-cycle=DefaultOperationCycle  # Event_Oper_Cycle_Map_LIN 19 Slave 12_Defect
  diagnostic event to debounce algorithm mapping EventDebounceMapLIN19Slave12Defect: debounce-algorithm=counter_based, diagnostic-event=EventLIN19Slave12Defect  # EventDebounceMap_LIN 19 Slave 12_Defect
package /ZeC/DTC/DTC/LIN_19_Slave_12_NoCommunication
  diagnostic trouble code uds LIN_19_Slave_12_NoCommunication: dtc-props=Dtc_Props_358996c7, uds-dtc-value=0x031317  # LIN 19 Slave 12_NoCommunication
  diagnostic event EventLIN19Slave12NoCommunication: aging-allowed=true, event-kind=SWC, prestorage-freeze-frame=false  # Event_LIN 19 Slave 12_NoCommunication
  diagnostic event to trouble code uds mapping EventDtcMapLIN19Slave12NoCommunication: diagnostic-event=EventLIN19Slave12NoCommunication, trouble-code-uds=LIN_19_Slave_12_NoCommunication  # Event_Dtc_Map_LIN 19 Slave 12_NoCommunication
  diagnostic event to operation cycle mapping EventOperCycleMapLIN19Slave12NoCommunication: diagnostic-event=EventLIN19Slave12NoCommunication, operation-cycle=DefaultOperationCycle  # Event_Oper_Cycle_Map_LIN 19 Slave 12_NoCommunication
  diagnostic event to debounce algorithm mapping EventDebounceMapLIN19Slave12NoCommunication: debounce-algorithm=counter_based, diagnostic-event=EventLIN19Slave12NoCommunication  # EventDebounceMap_LIN 19 Slave 12_NoCommunication
package /ZeC/DTC/DTC/LIN_19_Slave_11_Defect
  diagnostic trouble code uds LIN_19_Slave_11_Defect: dtc-props=Dtc_Props_358996c7, uds-dtc-value=0x031314  # LIN 19 Slave 11_Defect
  diagnostic event EventLIN19Slave11Defect: aging-allowed=true, event-kind=SWC, prestorage-freeze-frame=false  # Event_LIN 19 Slave 11_Defect
  diagnostic event to trouble code uds mapping EventDtcMapLIN19Slave11Defect: diagnostic-event=EventLIN19Slave11Defect, trouble-code-uds=LIN_19_Slave_11_Defect  # Event_Dtc_Map_LIN 19 Slave 11_Defect
  diagnostic event to operation cycle mapping EventOperCycleMapLIN19Slave11Defect: diagnostic-event=EventLIN19Slave11Defect, operation-cycle=DefaultOperationCycle  # Event_Oper_Cycle_Map_LIN 19 Slave 11_Defect
  diagnostic event to debounce algorithm mapping EventDebounceMapLIN19Slave11Defect: debounce-algorithm=counter_based, diagnostic-event=EventLIN19Slave11Defect  # EventDebounceMap_LIN 19 Slave 11_Defect
package /ZeC/DTC/DTC/LIN_19_Slave_11_NoCommunication
  diagnostic trouble code uds LIN_19_Slave_11_NoCommunication: dtc-props=Dtc_Props_358996c7, uds-dtc-value=0x031315  # LIN 19 Slave 11_NoCommunication
  diagnostic event EventLIN19Slave11NoCommunication: aging-allowed=true, event-kind=SWC, prestorage-freeze-frame=false  # Event_LIN 19 Slave 11_NoCommunication
  diagnostic event to trouble code uds mapping EventDtcMapLIN19Slave11NoCommunication: diagnostic-event=EventLIN19Slave11NoCommunication, trouble-code-uds=LIN_19_Slave_11_NoCommunication  # Event_Dtc_Map_LIN 19 Slave 11_NoCommunication
  diagnostic event to operation cycle mapping EventOperCycleMapLIN19Slave11NoCommunication: diagnostic-event=EventLIN19Slave11NoCommunication, operation-cycle=DefaultOperationCycle  # Event_Oper_Cycle_Map_LIN 19 Slave 11_NoCommunication
  diagnostic event to debounce algorithm mapping EventDebounceMapLIN19Slave11NoCommunication: debounce-algorithm=counter_based, diagnostic-event=EventLIN19Slave11NoCommunication  # EventDebounceMap_LIN 19 Slave 11_NoCommunication
package /ZeC/DTC/DTC/LIN_19_Slave_10_Defect
  diagnostic trouble code uds LIN_19_Slave_10_Defect: dtc-props=Dtc_Props_358996c7, uds-dtc-value=0x031312  # LIN 19 Slave 10_Defect
  diagnostic event EventLIN19Slave10Defect: aging-allowed=true, event-kind=SWC, prestorage-freeze-frame=false  # Event_LIN 19 Slave 10_Defect
  diagnostic event to trouble code uds mapping EventDtcMapLIN19Slave10Defect: diagnostic-event=EventLIN19Slave10Defect, trouble-code-uds=LIN_19_Slave_10_Defect  # Event_Dtc_Map_LIN 19 Slave 10_Defect
  diagnostic event to operation cycle mapping EventOperCycleMapLIN19Slave10Defect: diagnostic-event=EventLIN19Slave10Defect, operation-cycle=DefaultOperationCycle  # Event_Oper_Cycle_Map_LIN 19 Slave 10_Defect
  diagnostic event to debounce algorithm mapping EventDebounceMapLIN19Slave10Defect: debounce-algorithm=counter_based, diagnostic-event=EventLIN19Slave10Defect  # EventDebounceMap_LIN 19 Slave 10_Defect
package /ZeC/DTC/DTC/LIN_19_Slave_10_NoCommunication
  diagnostic trouble code uds LIN_19_Slave_10_NoCommunication: dtc-props=Dtc_Props_358996c7, uds-dtc-value=0x031313  # LIN 19 Slave 10_NoCommunication
  diagnostic event EventLIN19Slave10NoCommunication: aging-allowed=true, event-kind=SWC, prestorage-freeze-frame=false  # Event_LIN 19 Slave 10_NoCommunication
  diagnostic event to trouble code uds mapping EventDtcMapLIN19Slave10NoCommunication: diagnostic-event=EventLIN19Slave10NoCommunication, trouble-code-uds=LIN_19_Slave_10_NoCommunication  # Event_Dtc_Map_LIN 19 Slave 10_NoCommunication
  diagnostic event to operation cycle mapping EventOperCycleMapLIN19Slave10NoCommunication: diagnostic-event=EventLIN19Slave10NoCommunication, operation-cycle=DefaultOperationCycle  # Event_Oper_Cycle_Map_LIN 19 Slave 10_NoCommunication
  diagnostic event to debounce algorithm mapping EventDebounceMapLIN19Slave10NoCommunication: debounce-algorithm=counter_based, diagnostic-event=EventLIN19Slave10NoCommunication  # EventDebounceMap_LIN 19 Slave 10_NoCommunication
package /ZeC/DTC/DTC/LIN_19_Slave_1_Defect
  diagnostic trouble code uds LIN_19_Slave_1_Defect: dtc-props=Dtc_Props_358996c7, uds-dtc-value=0x031310  # LIN 19 Slave 1_Defect
  diagnostic event EventLIN19Slave1Defect: aging-allowed=true, event-kind=SWC, prestorage-freeze-frame=false  # Event_LIN 19 Slave 1_Defect
  diagnostic event to trouble code uds mapping EventDtcMapLIN19Slave1Defect: diagnostic-event=EventLIN19Slave1Defect, trouble-code-uds=LIN_19_Slave_1_Defect  # Event_Dtc_Map_LIN 19 Slave 1_Defect
  diagnostic event to operation cycle mapping EventOperCycleMapLIN19Slave1Defect: diagnostic-event=EventLIN19Slave1Defect, operation-cycle=DefaultOperationCycle  # Event_Oper_Cycle_Map_LIN 19 Slave 1_Defect
  diagnostic event to debounce algorithm mapping EventDebounceMapLIN19Slave1Defect: debounce-algorithm=counter_based, diagnostic-event=EventLIN19Slave1Defect  # EventDebounceMap_LIN 19 Slave 1_Defect
package /ZeC/DTC/DTC/LIN_19_Slave_1_NoCommunication
  diagnostic trouble code uds LIN_19_Slave_1_NoCommunication: dtc-props=Dtc_Props_358996c7, uds-dtc-value=0x031311  # LIN 19 Slave 1_NoCommunication
  diagnostic event EventLIN19Slave1NoCommunication: aging-allowed=true, event-kind=SWC, prestorage-freeze-frame=false  # Event_LIN 19 Slave 1_NoCommunication
  diagnostic event to trouble code uds mapping EventDtcMapLIN19Slave1NoCommunication: diagnostic-event=EventLIN19Slave1NoCommunication, trouble-code-uds=LIN_19_Slave_1_NoCommunication  # Event_Dtc_Map_LIN 19 Slave 1_NoCommunication
  diagnostic event to operation cycle mapping EventOperCycleMapLIN19Slave1NoCommunication: diagnostic-event=EventLIN19Slave1NoCommunication, operation-cycle=DefaultOperationCycle  # Event_Oper_Cycle_Map_LIN 19 Slave 1_NoCommunication
  diagnostic event to debounce algorithm mapping EventDebounceMapLIN19Slave1NoCommunication: debounce-algorithm=counter_based, diagnostic-event=EventLIN19Slave1NoCommunication  # EventDebounceMap_LIN 19 Slave 1_NoCommunication
package /ZeC/DTC/DTC/LIN_10_Slave_11_NoCommunication
  diagnostic trouble code uds LIN_10_Slave_11_NoCommunication: dtc-props=Dtc_Props_358996c7, uds-dtc-value=0x030a08  # LIN 10 Slave 11_NoCommunication
  diagnostic event EventLIN10Slave11NoCommunication: aging-allowed=true, event-kind=SWC, prestorage-freeze-frame=false  # Event_LIN 10 Slave 11_NoCommunication
  diagnostic event to trouble code uds mapping EventDtcMapLIN10Slave11NoCommunication: diagnostic-event=EventLIN10Slave11NoCommunication, trouble-code-uds=LIN_10_Slave_11_NoCommunication  # Event_Dtc_Map_LIN 10 Slave 11_NoCommunication
  diagnostic event to operation cycle mapping EventOperCycleMapLIN10Slave11NoCommunication: diagnostic-event=EventLIN10Slave11NoCommunication, operation-cycle=DefaultOperationCycle  # Event_Oper_Cycle_Map_LIN 10 Slave 11_NoCommunication
  diagnostic event to debounce algorithm mapping EventDebounceMapLIN10Slave11NoCommunication: debounce-algorithm=counter_based, diagnostic-event=EventLIN10Slave11NoCommunication  # EventDebounceMap_LIN 10 Slave 11_NoCommunication
package /ZeC/DTC/DTC/LIN_10_Slave_12_Defect
  diagnostic trouble code uds LIN_10_Slave_12_Defect: dtc-props=Dtc_Props_358996c7, uds-dtc-value=0x030a09  # LIN 10 Slave 12_Defect
  diagnostic event EventLIN10Slave12Defect: aging-allowed=true, event-kind=SWC, prestorage-freeze-frame=false  # Event_LIN 10 Slave 12_Defect
  diagnostic event to trouble code uds mapping EventDtcMapLIN10Slave12Defect: diagnostic-event=EventLIN10Slave12Defect, trouble-code-uds=LIN_10_Slave_12_Defect  # Event_Dtc_Map_LIN 10 Slave 12_Defect
  diagnostic event to operation cycle mapping EventOperCycleMapLIN10Slave12Defect: diagnostic-event=EventLIN10Slave12Defect, operation-cycle=DefaultOperationCycle  # Event_Oper_Cycle_Map_LIN 10 Slave 12_Defect
  diagnostic event to debounce algorithm mapping EventDebounceMapLIN10Slave12Defect: debounce-algorithm=counter_based, diagnostic-event=EventLIN10Slave12Defect  # EventDebounceMap_LIN 10 Slave 12_Defect
package /ZeC/DTC/DTC/LIN_10_Slave_10_NoCommunication
  diagnostic trouble code uds LIN_10_Slave_10_NoCommunication: dtc-props=Dtc_Props_358996c7, uds-dtc-value=0x030a06  # LIN 10 Slave 10_NoCommunication
  diagnostic event EventLIN10Slave10NoCommunication: aging-allowed=true, event-kind=SWC, prestorage-freeze-frame=false  # Event_LIN 10 Slave 10_NoCommunication
  diagnostic event to trouble code uds mapping EventDtcMapLIN10Slave10NoCommunication: diagnostic-event=EventLIN10Slave10NoCommunication, trouble-code-uds=LIN_10_Slave_10_NoCommunication  # Event_Dtc_Map_LIN 10 Slave 10_NoCommunication
  diagnostic event to operation cycle mapping EventOperCycleMapLIN10Slave10NoCommunication: diagnostic-event=EventLIN10Slave10NoCommunication, operation-cycle=DefaultOperationCycle  # Event_Oper_Cycle_Map_LIN 10 Slave 10_NoCommunication
  diagnostic event to debounce algorithm mapping EventDebounceMapLIN10Slave10NoCommunication: debounce-algorithm=counter_based, diagnostic-event=EventLIN10Slave10NoCommunication  # EventDebounceMap_LIN 10 Slave 10_NoCommunication
package /ZeC/DTC/DTC/LIN_10_Slave_11_Defect
  diagnostic trouble code uds LIN_10_Slave_11_Defect: dtc-props=Dtc_Props_358996c7, uds-dtc-value=0x030a07  # LIN 10 Slave 11_Defect
  diagnostic event EventLIN10Slave11Defect: aging-allowed=true, event-kind=SWC, prestorage-freeze-frame=false  # Event_LIN 10 Slave 11_Defect
  diagnostic event to trouble code uds mapping EventDtcMapLIN10Slave11Defect: diagnostic-event=EventLIN10Slave11Defect, trouble-code-uds=LIN_10_Slave_11_Defect  # Event_Dtc_Map_LIN 10 Slave 11_Defect
  diagnostic event to operation cycle mapping EventOperCycleMapLIN10Slave11Defect: diagnostic-event=EventLIN10Slave11Defect, operation-cycle=DefaultOperationCycle  # Event_Oper_Cycle_Map_LIN 10 Slave 11_Defect
  diagnostic event to debounce algorithm mapping EventDebounceMapLIN10Slave11Defect: debounce-algorithm=counter_based, diagnostic-event=EventLIN10Slave11Defect  # EventDebounceMap_LIN 10 Slave 11_Defect
package /ZeC/DTC/DTC/LIN_10_Slave_1_NoCommunication
  diagnostic trouble code uds LIN_10_Slave_1_NoCommunication: dtc-props=Dtc_Props_358996c7, uds-dtc-value=0x030a04  # LIN 10 Slave 1_NoCommunication
  diagnostic event EventLIN10Slave1NoCommunication: aging-allowed=true, event-kind=SWC, prestorage-freeze-frame=false  # Event_LIN 10 Slave 1_NoCommunication
  diagnostic event to trouble code uds mapping EventDtcMapLIN10Slave1NoCommunication: diagnostic-event=EventLIN10Slave1NoCommunication, trouble-code-uds=LIN_10_Slave_1_NoCommunication  # Event_Dtc_Map_LIN 10 Slave 1_NoCommunication
  diagnostic event to operation cycle mapping EventOperCycleMapLIN10Slave1NoCommunication: diagnostic-event=EventLIN10Slave1NoCommunication, operation-cycle=DefaultOperationCycle  # Event_Oper_Cycle_Map_LIN 10 Slave 1_NoCommunication
  diagnostic event to debounce algorithm mapping EventDebounceMapLIN10Slave1NoCommunication: debounce-algorithm=counter_based, diagnostic-event=EventLIN10Slave1NoCommunication  # EventDebounceMap_LIN 10 Slave 1_NoCommunication
package /ZeC/DTC/DTC/LIN_19_Slave_15_NoCommunication
  diagnostic trouble code uds LIN_19_Slave_15_NoCommunication: dtc-props=Dtc_Props_358996c7, uds-dtc-value=0x03131d  # LIN 19 Slave 15_NoCommunication
  diagnostic event EventLIN19Slave15NoCommunication: aging-allowed=true, event-kind=SWC, prestorage-freeze-frame=false  # Event_LIN 19 Slave 15_NoCommunication
  diagnostic event to trouble code uds mapping EventDtcMapLIN19Slave15NoCommunication: diagnostic-event=EventLIN19Slave15NoCommunication, trouble-code-uds=LIN_19_Slave_15_NoCommunication  # Event_Dtc_Map_LIN 19 Slave 15_NoCommunication
  diagnostic event to operation cycle mapping EventOperCycleMapLIN19Slave15NoCommunication: diagnostic-event=EventLIN19Slave15NoCommunication, operation-cycle=DefaultOperationCycle  # Event_Oper_Cycle_Map_LIN 19 Slave 15_NoCommunication
  diagnostic event to debounce algorithm mapping EventDebounceMapLIN19Slave15NoCommunication: debounce-algorithm=counter_based, diagnostic-event=EventLIN19Slave15NoCommunication  # EventDebounceMap_LIN 19 Slave 15_NoCommunication
package /ZeC/DTC/DTC/LIN_10_Slave_10_Defect
  diagnostic trouble code uds LIN_10_Slave_10_Defect: dtc-props=Dtc_Props_358996c7, uds-dtc-value=0x030a05  # LIN 10 Slave 10_Defect
  diagnostic event EventLIN10Slave10Defect: aging-allowed=true, event-kind=SWC, prestorage-freeze-frame=false  # Event_LIN 10 Slave 10_Defect
  diagnostic event to trouble code uds mapping EventDtcMapLIN10Slave10Defect: diagnostic-event=EventLIN10Slave10Defect, trouble-code-uds=LIN_10_Slave_10_Defect  # Event_Dtc_Map_LIN 10 Slave 10_Defect
  diagnostic event to operation cycle mapping EventOperCycleMapLIN10Slave10Defect: diagnostic-event=EventLIN10Slave10Defect, operation-cycle=DefaultOperationCycle  # Event_Oper_Cycle_Map_LIN 10 Slave 10_Defect
  diagnostic event to debounce algorithm mapping EventDebounceMapLIN10Slave10Defect: debounce-algorithm=counter_based, diagnostic-event=EventLIN10Slave10Defect  # EventDebounceMap_LIN 10 Slave 10_Defect
package /ZeC/DTC/DTC/LIN_19_Slave_2_Defect
  diagnostic trouble code uds LIN_19_Slave_2_Defect: dtc-props=Dtc_Props_358996c7, uds-dtc-value=0x03131e  # LIN 19 Slave 2_Defect
  diagnostic event EventLIN19Slave2Defect: aging-allowed=true, event-kind=SWC, prestorage-freeze-frame=false  # Event_LIN 19 Slave 2_Defect
  diagnostic event to trouble code uds mapping EventDtcMapLIN19Slave2Defect: diagnostic-event=EventLIN19Slave2Defect, trouble-code-uds=LIN_19_Slave_2_Defect  # Event_Dtc_Map_LIN 19 Slave 2_Defect
  diagnostic event to operation cycle mapping EventOperCycleMapLIN19Slave2Defect: diagnostic-event=EventLIN19Slave2Defect, operation-cycle=DefaultOperationCycle  # Event_Oper_Cycle_Map_LIN 19 Slave 2_Defect
  diagnostic event to debounce algorithm mapping EventDebounceMapLIN19Slave2Defect: debounce-algorithm=counter_based, diagnostic-event=EventLIN19Slave2Defect  # EventDebounceMap_LIN 19 Slave 2_Defect
package /ZeC/DTC/DTC/LIN_10_Local_Databus_Electrical_Failure
  diagnostic trouble code uds LIN_10_Local_Databus_Electrical_Failure: dtc-props=Dtc_Props_358996c7, uds-dtc-value=0x030a02  # LIN 10 Local_Databus_Electrical_Failure
  diagnostic event EventLIN10LocalDatabusElectricalFailure: aging-allowed=true, event-kind=SWC, prestorage-freeze-frame=false  # Event_LIN 10 Local_Databus_Electrical_Failure
  diagnostic event to trouble code uds mapping EventDtcMapLIN10LocalDatabusElectricalFailure: diagnostic-event=EventLIN10LocalDatabusElectricalFailure, trouble-code-uds=LIN_10_Local_Databus_Electrical_Failure  # Event_Dtc_Map_LIN 10 Local_Databus_Electrical_Failure
  diagnostic event to operation cycle mapping EventOperCycleMapLIN10LocalDatabusElectricalFailure: diagnostic-event=EventLIN10LocalDatabusElectricalFailure, operation-cycle=DefaultOperationCycle  # Event_Oper_Cycle_Map_LIN 10 Local_Databus_Electrical_Failure
  diagnostic event to debounce algorithm mapping EventDebounceMapLIN10LocalDatabusElectricalFailure: debounce-algorithm=counter_based, diagnostic-event=EventLIN10LocalDatabusElectricalFailure  # EventDebounceMap_LIN 10 Local_Databus_Electrical_Failure
package /ZeC/DTC/DTC/LIN_19_Slave_14_NoCommunication
  diagnostic trouble code uds LIN_19_Slave_14_NoCommunication: dtc-props=Dtc_Props_358996c7, uds-dtc-value=0x03131b  # LIN 19 Slave 14_NoCommunication
  diagnostic event EventLIN19Slave14NoCommunication: aging-allowed=true, event-kind=SWC, prestorage-freeze-frame=false  # Event_LIN 19 Slave 14_NoCommunication
  diagnostic event to trouble code uds mapping EventDtcMapLIN19Slave14NoCommunication: diagnostic-event=EventLIN19Slave14NoCommunication, trouble-code-uds=LIN_19_Slave_14_NoCommunication  # Event_Dtc_Map_LIN 19 Slave 14_NoCommunication
  diagnostic event to operation cycle mapping EventOperCycleMapLIN19Slave14NoCommunication: diagnostic-event=EventLIN19Slave14NoCommunication, operation-cycle=DefaultOperationCycle  # Event_Oper_Cycle_Map_LIN 19 Slave 14_NoCommunication
  diagnostic event to debounce algorithm mapping EventDebounceMapLIN19Slave14NoCommunication: debounce-algorithm=counter_based, diagnostic-event=EventLIN19Slave14NoCommunication  # EventDebounceMap_LIN 19 Slave 14_NoCommunication
package /ZeC/DTC/DTC/LIN_10_Slave_1_Defect
  diagnostic trouble code uds LIN_10_Slave_1_Defect: dtc-props=Dtc_Props_358996c7, uds-dtc-value=0x030a03  # LIN 10 Slave 1_Defect
  diagnostic event EventLIN10Slave1Defect: aging-allowed=true, event-kind=SWC, prestorage-freeze-frame=false  # Event_LIN 10 Slave 1_Defect
  diagnostic event to trouble code uds mapping EventDtcMapLIN10Slave1Defect: diagnostic-event=EventLIN10Slave1Defect, trouble-code-uds=LIN_10_Slave_1_Defect  # Event_Dtc_Map_LIN 10 Slave 1_Defect
  diagnostic event to operation cycle mapping EventOperCycleMapLIN10Slave1Defect: diagnostic-event=EventLIN10Slave1Defect, operation-cycle=DefaultOperationCycle  # Event_Oper_Cycle_Map_LIN 10 Slave 1_Defect
  diagnostic event to debounce algorithm mapping EventDebounceMapLIN10Slave1Defect: debounce-algorithm=counter_based, diagnostic-event=EventLIN10Slave1Defect  # EventDebounceMap_LIN 10 Slave 1_Defect
package /ZeC/DTC/DTC/LIN_19_Slave_15_Defect
  diagnostic trouble code uds LIN_19_Slave_15_Defect: dtc-props=Dtc_Props_358996c7, uds-dtc-value=0x03131c  # LIN 19 Slave 15_Defect
  diagnostic event EventLIN19Slave15Defect: aging-allowed=true, event-kind=SWC, prestorage-freeze-frame=false  # Event_LIN 19 Slave 15_Defect
  diagnostic event to trouble code uds mapping EventDtcMapLIN19Slave15Defect: diagnostic-event=EventLIN19Slave15Defect, trouble-code-uds=LIN_19_Slave_15_Defect  # Event_Dtc_Map_LIN 19 Slave 15_Defect
  diagnostic event to operation cycle mapping EventOperCycleMapLIN19Slave15Defect: diagnostic-event=EventLIN19Slave15Defect, operation-cycle=DefaultOperationCycle  # Event_Oper_Cycle_Map_LIN 19 Slave 15_Defect
  diagnostic event to debounce algorithm mapping EventDebounceMapLIN19Slave15Defect: debounce-algorithm=counter_based, diagnostic-event=EventLIN19Slave15Defect  # EventDebounceMap_LIN 19 Slave 15_Defect
package /ZeC/DTC/DTC/LIN_10_Databus_No_Comm
  diagnostic trouble code uds LIN_10_Databus_No_Comm: dtc-props=Dtc_Props_358996c7, uds-dtc-value=0x030a01  # LIN 10 Databus_No_Comm
  diagnostic event EventLIN10DatabusNoComm: aging-allowed=true, event-kind=SWC, prestorage-freeze-frame=false  # Event_LIN 10 Databus_No_Comm
  diagnostic event to trouble code uds mapping EventDtcMapLIN10DatabusNoComm: diagnostic-event=EventLIN10DatabusNoComm, trouble-code-uds=LIN_10_Databus_No_Comm  # Event_Dtc_Map_LIN 10 Databus_No_Comm
  diagnostic event to operation cycle mapping EventOperCycleMapLIN10DatabusNoComm: diagnostic-event=EventLIN10DatabusNoComm, operation-cycle=DefaultOperationCycle  # Event_Oper_Cycle_Map_LIN 10 Databus_No_Comm
  diagnostic event to debounce algorithm mapping EventDebounceMapLIN10DatabusNoComm: debounce-algorithm=counter_based, diagnostic-event=EventLIN10DatabusNoComm  # EventDebounceMap_LIN 10 Databus_No_Comm
package /ZeC/DTC/DTC/LIN_19_Slave_14_Defect
  diagnostic trouble code uds LIN_19_Slave_14_Defect: dtc-props=Dtc_Props_358996c7, uds-dtc-value=0x03131a  # LIN 19 Slave 14_Defect
  diagnostic event EventLIN19Slave14Defect: aging-allowed=true, event-kind=SWC, prestorage-freeze-frame=false  # Event_LIN 19 Slave 14_Defect
  diagnostic event to trouble code uds mapping EventDtcMapLIN19Slave14Defect: diagnostic-event=EventLIN19Slave14Defect, trouble-code-uds=LIN_19_Slave_14_Defect  # Event_Dtc_Map_LIN 19 Slave 14_Defect
  diagnostic event to operation cycle mapping EventOperCycleMapLIN19Slave14Defect: diagnostic-event=EventLIN19Slave14Defect, operation-cycle=DefaultOperationCycle  # Event_Oper_Cycle_Map_LIN 19 Slave 14_Defect
  diagnostic event to debounce algorithm mapping EventDebounceMapLIN19Slave14Defect: debounce-algorithm=counter_based, diagnostic-event=EventLIN19Slave14Defect  # EventDebounceMap_LIN 19 Slave 14_Defect
package /ZeC/DTC/DTC/Power_Path_154_Load_Failure
  diagnostic trouble code uds Power_Path_154_Load_Failure: dtc-props=Dtc_Props_18a0fe94, uds-dtc-value=0x00549a
  diagnostic event EventPowerPath154LoadFailure: aging-allowed=true, event-kind=SWC, prestorage-freeze-frame=false  # Event_Power_Path_154_Load_Failure
  diagnostic event to trouble code uds mapping EventDtcMapPowerPath154LoadFailure: diagnostic-event=EventPowerPath154LoadFailure, trouble-code-uds=Power_Path_154_Load_Failure  # Event_Dtc_Map_Power_Path_154_Load_Failure
  diagnostic event to operation cycle mapping EventOperCycleMapPowerPath154LoadFailure: diagnostic-event=EventPowerPath154LoadFailure, operation-cycle=DefaultOperationCycle  # Event_Oper_Cycle_Map_Power_Path_154_Load_Failure
  diagnostic event to debounce algorithm mapping EventDebounceMapPowerPath154LoadFailure: debounce-algorithm=time_based, diagnostic-event=EventPowerPath154LoadFailure  # EventDebounceMap_Power_Path_154_Load_Failure
package /ZeC/DTC/DTC/Ip_clock_sync_outage
  diagnostic trouble code uds Ip_clock_sync_outage: dtc-props=Dtc_Props_14158306, uds-dtc-value=0x033506
  diagnostic event EventIpClockSyncOutage: aging-allowed=true, event-kind=SWC, prestorage-freeze-frame=false  # Event_Ip_clock_sync_outage
  diagnostic event to trouble code uds mapping EventDtcMapIpClockSyncOutage: diagnostic-event=EventIpClockSyncOutage, trouble-code-uds=Ip_clock_sync_outage  # Event_Dtc_Map_Ip_clock_sync_outage
  diagnostic event to operation cycle mapping EventOperCycleMapIpClockSyncOutage: diagnostic-event=EventIpClockSyncOutage, operation-cycle=DefaultOperationCycle  # Event_Oper_Cycle_Map_Ip_clock_sync_outage
  diagnostic event to debounce algorithm mapping EventDebounceMapIpClockSyncOutage: debounce-algorithm=time_based, diagnostic-event=EventIpClockSyncOutage  # EventDebounceMap_Ip_clock_sync_outage
package /ZeC/DTC/DTC/LIN_10_Slave_15_Defect
  diagnostic trouble code uds LIN_10_Slave_15_Defect: dtc-props=Dtc_Props_358996c7, uds-dtc-value=0x030a0f  # LIN 10 Slave 15_Defect
  diagnostic event EventLIN10Slave15Defect: aging-allowed=true, event-kind=SWC, prestorage-freeze-frame=false  # Event_LIN 10 Slave 15_Defect
  diagnostic event to trouble code uds mapping EventDtcMapLIN10Slave15Defect: diagnostic-event=EventLIN10Slave15Defect, trouble-code-uds=LIN_10_Slave_15_Defect  # Event_Dtc_Map_LIN 10 Slave 15_Defect
  diagnostic event to operation cycle mapping EventOperCycleMapLIN10Slave15Defect: diagnostic-event=EventLIN10Slave15Defect, operation-cycle=DefaultOperationCycle  # Event_Oper_Cycle_Map_LIN 10 Slave 15_Defect
  diagnostic event to debounce algorithm mapping EventDebounceMapLIN10Slave15Defect: debounce-algorithm=counter_based, diagnostic-event=EventLIN10Slave15Defect  # EventDebounceMap_LIN 10 Slave 15_Defect
package /ZeC/DTC/DTC/Ip_clock_sync_invalid_master_count_toECUSlave4
  diagnostic trouble code uds Ip_clock_sync_invalid_master_count_toECUSlave4: dtc-props=Dtc_Props_14158306, uds-dtc-value=0x033505
  diagnostic event EventIpClockSyncInvalidMasterCountToECUSlave4: aging-allowed=true, event-kind=SWC, prestorage-freeze-frame=false  # Event_Ip_clock_sync_invalid_master_count_toECUSlave4
  diagnostic event to trouble code uds mapping EventDtcMapIpClockSyncInvalidMasterCountToECUSlave4: diagnostic-event=EventIpClockSyncInvalidMasterCountToECUSlave4, trouble-code-uds=Ip_clock_sync_invalid_master_count_toECUSlave4  # Event_Dtc_Map_Ip_clock_sync_invalid_master_count_toECUSlave4
  diagnostic event to operation cycle mapping EventOperCycleMapIpClockSyncInvalidMasterCountToECUSlave4: diagnostic-event=EventIpClockSyncInvalidMasterCountToECUSlave4, operation-cycle=DefaultOperationCycle  # Event_Oper_Cycle_Map_Ip_clock_sync_invalid_master_count_toECUSlave4
  diagnostic event to debounce algorithm mapping EventDebounceMapIpClockSyncInvalidMasterCountToECUSlave4: debounce-algorithm=time_based, diagnostic-event=EventIpClockSyncInvalidMasterCountToECUSlave4  # EventDebounceMap_Ip_clock_sync_invalid_master_count_toECUSlave4
package /ZeC/DTC/DTC/Ip_clock_sync_invalid_master_count_toECUSlave3
  diagnostic trouble code uds Ip_clock_sync_invalid_master_count_toECUSlave3: dtc-props=Dtc_Props_b618fb9, uds-dtc-value=0x033504
  diagnostic event EventIpClockSyncInvalidMasterCountToECUSlave3: aging-allowed=true, event-kind=SWC, prestorage-freeze-frame=false  # Event_Ip_clock_sync_invalid_master_count_toECUSlave3
  diagnostic event to trouble code uds mapping EventDtcMapIpClockSyncInvalidMasterCountToECUSlave3: diagnostic-event=EventIpClockSyncInvalidMasterCountToECUSlave3, trouble-code-uds=Ip_clock_sync_invalid_master_count_toECUSlave3  # Event_Dtc_Map_Ip_clock_sync_invalid_master_count_toECUSlave3
  diagnostic event to operation cycle mapping EventOperCycleMapIpClockSyncInvalidMasterCountToECUSlave3: diagnostic-event=EventIpClockSyncInvalidMasterCountToECUSlave3, operation-cycle=DefaultOperationCycle  # Event_Oper_Cycle_Map_Ip_clock_sync_invalid_master_count_toECUSlave3
  diagnostic event to debounce algorithm mapping EventDebounceMapIpClockSyncInvalidMasterCountToECUSlave3: debounce-algorithm=time_based, diagnostic-event=EventIpClockSyncInvalidMasterCountToECUSlave3  # EventDebounceMap_Ip_clock_sync_invalid_master_count_toECUSlave3
package /ZeC/DTC/DTC/LIN_10_Slave_14_Defect
  diagnostic trouble code uds LIN_10_Slave_14_Defect: dtc-props=Dtc_Props_358996c7, uds-dtc-value=0x030a0d  # LIN 10 Slave 14_Defect
  diagnostic event EventLIN10Slave14Defect: aging-allowed=true, event-kind=SWC, prestorage-freeze-frame=false  # Event_LIN 10 Slave 14_Defect
  diagnostic event to trouble code uds mapping EventDtcMapLIN10Slave14Defect: diagnostic-event=EventLIN10Slave14Defect, trouble-code-uds=LIN_10_Slave_14_Defect  # Event_Dtc_Map_LIN 10 Slave 14_Defect
  diagnostic event to operation cycle mapping EventOperCycleMapLIN10Slave14Defect: diagnostic-event=EventLIN10Slave14Defect, operation-cycle=DefaultOperationCycle  # Event_Oper_Cycle_Map_LIN 10 Slave 14_Defect
  diagnostic event to debounce algorithm mapping EventDebounceMapLIN10Slave14Defect: debounce-algorithm=counter_based, diagnostic-event=EventLIN10Slave14Defect  # EventDebounceMap_LIN 10 Slave 14_Defect
package /ZeC/DTC/DTC/Ip_clock_sync_invalid_master_count_toECUSlave2
  diagnostic trouble code uds Ip_clock_sync_invalid_master_count_toECUSlave2: dtc-props=Dtc_Props_b618fb9, uds-dtc-value=0x033503
  diagnostic event EventIpClockSyncInvalidMasterCountToECUSlave2: aging-allowed=true, event-kind=SWC, prestorage-freeze-frame=false  # Event_Ip_clock_sync_invalid_master_count_toECUSlave2
  diagnostic event to trouble code uds mapping EventDtcMapIpClockSyncInvalidMasterCountToECUSlave2: diagnostic-event=EventIpClockSyncInvalidMasterCountToECUSlave2, trouble-code-uds=Ip_clock_sync_invalid_master_count_toECUSlave2  # Event_Dtc_Map_Ip_clock_sync_invalid_master_count_toECUSlave2
  diagnostic event to operation cycle mapping EventOperCycleMapIpClockSyncInvalidMasterCountToECUSlave2: diagnostic-event=EventIpClockSyncInvalidMasterCountToECUSlave2, operation-cycle=DefaultOperationCycle  # Event_Oper_Cycle_Map_Ip_clock_sync_invalid_master_count_toECUSlave2
  diagnostic event to debounce algorithm mapping EventDebounceMapIpClockSyncInvalidMasterCountToECUSlave2: debounce-algorithm=time_based, diagnostic-event=EventIpClockSyncInvalidMasterCountToECUSlave2  # EventDebounceMap_Ip_clock_sync_invalid_master_count_toECUSlave2
package /ZeC/DTC/DTC/LIN_10_Slave_14_NoCommunication
  diagnostic trouble code uds LIN_10_Slave_14_NoCommunication: dtc-props=Dtc_Props_358996c7, uds-dtc-value=0x030a0e  # LIN 10 Slave 14_NoCommunication
  diagnostic event EventLIN10Slave14NoCommunication: aging-allowed=true, event-kind=SWC, prestorage-freeze-frame=false  # Event_LIN 10 Slave 14_NoCommunication
  diagnostic event to trouble code uds mapping EventDtcMapLIN10Slave14NoCommunication: diagnostic-event=EventLIN10Slave14NoCommunication, trouble-code-uds=LIN_10_Slave_14_NoCommunication  # Event_Dtc_Map_LIN 10 Slave 14_NoCommunication
  diagnostic event to operation cycle mapping EventOperCycleMapLIN10Slave14NoCommunication: diagnostic-event=EventLIN10Slave14NoCommunication, operation-cycle=DefaultOperationCycle  # Event_Oper_Cycle_Map_LIN 10 Slave 14_NoCommunication
  diagnostic event to debounce algorithm mapping EventDebounceMapLIN10Slave14NoCommunication: debounce-algorithm=counter_based, diagnostic-event=EventLIN10Slave14NoCommunication  # EventDebounceMap_LIN 10 Slave 14_NoCommunication
package /ZeC/DTC/DTC/Ip_clock_sync_invalid_master_count_toECUSlave1
  diagnostic trouble code uds Ip_clock_sync_invalid_master_count_toECUSlave1: dtc-props=Dtc_Props_b618fb9, uds-dtc-value=0x033502
  diagnostic event EventIpClockSyncInvalidMasterCountToECUSlave1: aging-allowed=true, event-kind=SWC, prestorage-freeze-frame=false  # Event_Ip_clock_sync_invalid_master_count_toECUSlave1
  diagnostic event to trouble code uds mapping EventDtcMapIpClockSyncInvalidMasterCountToECUSlave1: diagnostic-event=EventIpClockSyncInvalidMasterCountToECUSlave1, trouble-code-uds=Ip_clock_sync_invalid_master_count_toECUSlave1  # Event_Dtc_Map_Ip_clock_sync_invalid_master_count_toECUSlave1
  diagnostic event to operation cycle mapping EventOperCycleMapIpClockSyncInvalidMasterCountToECUSlave1: diagnostic-event=EventIpClockSyncInvalidMasterCountToECUSlave1, operation-cycle=DefaultOperationCycle  # Event_Oper_Cycle_Map_Ip_clock_sync_invalid_master_count_toECUSlave1
  diagnostic event to debounce algorithm mapping EventDebounceMapIpClockSyncInvalidMasterCountToECUSlave1: debounce-algorithm=time_based, diagnostic-event=EventIpClockSyncInvalidMasterCountToECUSlave1  # EventDebounceMap_Ip_clock_sync_invalid_master_count_toECUSlave1
package /ZeC/DTC/DTC/LIN_10_Slave_13_Defect
  diagnostic trouble code uds LIN_10_Slave_13_Defect: dtc-props=Dtc_Props_358996c7, uds-dtc-value=0x030a0b  # LIN 10 Slave 13_Defect
  diagnostic event EventLIN10Slave13Defect: aging-allowed=true, event-kind=SWC, prestorage-freeze-frame=false  # Event_LIN 10 Slave 13_Defect
  diagnostic event to trouble code uds mapping EventDtcMapLIN10Slave13Defect: diagnostic-event=EventLIN10Slave13Defect, trouble-code-uds=LIN_10_Slave_13_Defect  # Event_Dtc_Map_LIN 10 Slave 13_Defect
  diagnostic event to operation cycle mapping EventOperCycleMapLIN10Slave13Defect: diagnostic-event=EventLIN10Slave13Defect, operation-cycle=DefaultOperationCycle  # Event_Oper_Cycle_Map_LIN 10 Slave 13_Defect
  diagnostic event to debounce algorithm mapping EventDebounceMapLIN10Slave13Defect: debounce-algorithm=counter_based, diagnostic-event=EventLIN10Slave13Defect  # EventDebounceMap_LIN 10 Slave 13_Defect
package /ZeC/DTC/DTC/Ip_clock_sync_invalid_master_count_ECUMaster
  diagnostic trouble code uds Ip_clock_sync_invalid_master_count_ECUMaster: dtc-props=Dtc_Props_b618fb9, uds-dtc-value=0x033501
  diagnostic event EventIpClockSyncInvalidMasterCountECUMaster: aging-allowed=true, event-kind=SWC, prestorage-freeze-frame=false  # Event_Ip_clock_sync_invalid_master_count_ECUMaster
  diagnostic event to trouble code uds mapping EventDtcMapIpClockSyncInvalidMasterCountECUMaster: diagnostic-event=EventIpClockSyncInvalidMasterCountECUMaster, trouble-code-uds=Ip_clock_sync_invalid_master_count_ECUMaster  # Event_Dtc_Map_Ip_clock_sync_invalid_master_count_ECUMaster
  diagnostic event to operation cycle mapping EventOperCycleMapIpClockSyncInvalidMasterCountECUMaster: diagnostic-event=EventIpClockSyncInvalidMasterCountECUMaster, operation-cycle=DefaultOperationCycle  # Event_Oper_Cycle_Map_Ip_clock_sync_invalid_master_count_ECUMaster
  diagnostic event to debounce algorithm mapping EventDebounceMapIpClockSyncInvalidMasterCountECUMaster: debounce-algorithm=time_based, diagnostic-event=EventIpClockSyncInvalidMasterCountECUMaster  # EventDebounceMap_Ip_clock_sync_invalid_master_count_ECUMaster
package /ZeC/DTC/DTC/LIN_10_Slave_13_NoCommunication
  diagnostic trouble code uds LIN_10_Slave_13_NoCommunication: dtc-props=Dtc_Props_358996c7, uds-dtc-value=0x030a0c  # LIN 10 Slave 13_NoCommunication
  diagnostic event EventLIN10Slave13NoCommunication: aging-allowed=true, event-kind=SWC, prestorage-freeze-frame=false  # Event_LIN 10 Slave 13_NoCommunication
  diagnostic event to trouble code uds mapping EventDtcMapLIN10Slave13NoCommunication: diagnostic-event=EventLIN10Slave13NoCommunication, trouble-code-uds=LIN_10_Slave_13_NoCommunication  # Event_Dtc_Map_LIN 10 Slave 13_NoCommunication
  diagnostic event to operation cycle mapping EventOperCycleMapLIN10Slave13NoCommunication: diagnostic-event=EventLIN10Slave13NoCommunication, operation-cycle=DefaultOperationCycle  # Event_Oper_Cycle_Map_LIN 10 Slave 13_NoCommunication
  diagnostic event to debounce algorithm mapping EventDebounceMapLIN10Slave13NoCommunication: debounce-algorithm=counter_based, diagnostic-event=EventLIN10Slave13NoCommunication  # EventDebounceMap_LIN 10 Slave 13_NoCommunication
package /ZeC/DTC/DTC/Power_Path_159_Load_Failure
  diagnostic trouble code uds Power_Path_159_Load_Failure: dtc-props=Dtc_Props_119ece73, uds-dtc-value=0x00549f
  diagnostic event EventPowerPath159LoadFailure: aging-allowed=true, event-kind=SWC, prestorage-freeze-frame=false  # Event_Power_Path_159_Load_Failure
  diagnostic event to trouble code uds mapping EventDtcMapPowerPath159LoadFailure: diagnostic-event=EventPowerPath159LoadFailure, trouble-code-uds=Power_Path_159_Load_Failure  # Event_Dtc_Map_Power_Path_159_Load_Failure
  diagnostic event to operation cycle mapping EventOperCycleMapPowerPath159LoadFailure: diagnostic-event=EventPowerPath159LoadFailure, operation-cycle=DefaultOperationCycle  # Event_Oper_Cycle_Map_Power_Path_159_Load_Failure
  diagnostic event to debounce algorithm mapping EventDebounceMapPowerPath159LoadFailure: debounce-algorithm=time_based, diagnostic-event=EventPowerPath159LoadFailure  # EventDebounceMap_Power_Path_159_Load_Failure
package /ZeC/DTC/DTC/LIN_19_Local_Databus_Electrical_Failure
  diagnostic trouble code uds LIN_19_Local_Databus_Electrical_Failure: dtc-props=Dtc_Props_358996c7, uds-dtc-value=0x031321  # LIN 19 Local_Databus_Electrical_Failure
  diagnostic event EventLIN19LocalDatabusElectricalFailure: aging-allowed=true, event-kind=SWC, prestorage-freeze-frame=false  # Event_LIN 19 Local_Databus_Electrical_Failure
  diagnostic event to trouble code uds mapping EventDtcMapLIN19LocalDatabusElectricalFailure: diagnostic-event=EventLIN19LocalDatabusElectricalFailure, trouble-code-uds=LIN_19_Local_Databus_Electrical_Failure  # Event_Dtc_Map_LIN 19 Local_Databus_Electrical_Failure
  diagnostic event to operation cycle mapping EventOperCycleMapLIN19LocalDatabusElectricalFailure: diagnostic-event=EventLIN19LocalDatabusElectricalFailure, operation-cycle=DefaultOperationCycle  # Event_Oper_Cycle_Map_LIN 19 Local_Databus_Electrical_Failure
  diagnostic event to debounce algorithm mapping EventDebounceMapLIN19LocalDatabusElectricalFailure: debounce-algorithm=counter_based, diagnostic-event=EventLIN19LocalDatabusElectricalFailure  # EventDebounceMap_LIN 19 Local_Databus_Electrical_Failure
package /ZeC/DTC/DTC/LIN_10_Slave_12_NoCommunication
  diagnostic trouble code uds LIN_10_Slave_12_NoCommunication: dtc-props=Dtc_Props_358996c7, uds-dtc-value=0x030a0a  # LIN 10 Slave 12_NoCommunication
  diagnostic event EventLIN10Slave12NoCommunication: aging-allowed=true, event-kind=SWC, prestorage-freeze-frame=false  # Event_LIN 10 Slave 12_NoCommunication
  diagnostic event to trouble code uds mapping EventDtcMapLIN10Slave12NoCommunication: diagnostic-event=EventLIN10Slave12NoCommunication, trouble-code-uds=LIN_10_Slave_12_NoCommunication  # Event_Dtc_Map_LIN 10 Slave 12_NoCommunication
  diagnostic event to operation cycle mapping EventOperCycleMapLIN10Slave12NoCommunication: diagnostic-event=EventLIN10Slave12NoCommunication, operation-cycle=DefaultOperationCycle  # Event_Oper_Cycle_Map_LIN 10 Slave 12_NoCommunication
  diagnostic event to debounce algorithm mapping EventDebounceMapLIN10Slave12NoCommunication: debounce-algorithm=counter_based, diagnostic-event=EventLIN10Slave12NoCommunication  # EventDebounceMap_LIN 10 Slave 12_NoCommunication
package /ZeC/DTC/DTC/Power_Path_156_Load_Failure
  diagnostic trouble code uds Power_Path_156_Load_Failure: dtc-props=Dtc_Props_9492eae0, uds-dtc-value=0x00549c
  diagnostic event EventPowerPath156LoadFailure: aging-allowed=true, event-kind=SWC, prestorage-freeze-frame=false  # Event_Power_Path_156_Load_Failure
  diagnostic event to trouble code uds mapping EventDtcMapPowerPath156LoadFailure: diagnostic-event=EventPowerPath156LoadFailure, trouble-code-uds=Power_Path_156_Load_Failure  # Event_Dtc_Map_Power_Path_156_Load_Failure
  diagnostic event to operation cycle mapping EventOperCycleMapPowerPath156LoadFailure: diagnostic-event=EventPowerPath156LoadFailure, operation-cycle=DefaultOperationCycle  # Event_Oper_Cycle_Map_Power_Path_156_Load_Failure
  diagnostic event to debounce algorithm mapping EventDebounceMapPowerPath156LoadFailure: debounce-algorithm=time_based, diagnostic-event=EventPowerPath156LoadFailure  # EventDebounceMap_Power_Path_156_Load_Failure
package /ZeC/DTC/DTC/LIN_19_Databus_No_Comm
  diagnostic trouble code uds LIN_19_Databus_No_Comm: dtc-props=Dtc_Props_358996c7, uds-dtc-value=0x031320  # LIN 19 Databus_No_Comm
  diagnostic event EventLIN19DatabusNoComm: aging-allowed=true, event-kind=SWC, prestorage-freeze-frame=false  # Event_LIN 19 Databus_No_Comm
  diagnostic event to trouble code uds mapping EventDtcMapLIN19DatabusNoComm: diagnostic-event=EventLIN19DatabusNoComm, trouble-code-uds=LIN_19_Databus_No_Comm  # Event_Dtc_Map_LIN 19 Databus_No_Comm
  diagnostic event to operation cycle mapping EventOperCycleMapLIN19DatabusNoComm: diagnostic-event=EventLIN19DatabusNoComm, operation-cycle=DefaultOperationCycle  # Event_Oper_Cycle_Map_LIN 19 Databus_No_Comm
  diagnostic event to debounce algorithm mapping EventDebounceMapLIN19DatabusNoComm: debounce-algorithm=counter_based, diagnostic-event=EventLIN19DatabusNoComm  # EventDebounceMap_LIN 19 Databus_No_Comm
package /ZeC/DTC/DTC/Power_Path_155_Load_Failure
  diagnostic trouble code uds Power_Path_155_Load_Failure: dtc-props=Dtc_Props_d28be0da, uds-dtc-value=0x00549b
  diagnostic event EventPowerPath155LoadFailure: aging-allowed=true, event-kind=SWC, prestorage-freeze-frame=false  # Event_Power_Path_155_Load_Failure
  diagnostic event to trouble code uds mapping EventDtcMapPowerPath155LoadFailure: diagnostic-event=EventPowerPath155LoadFailure, trouble-code-uds=Power_Path_155_Load_Failure  # Event_Dtc_Map_Power_Path_155_Load_Failure
  diagnostic event to operation cycle mapping EventOperCycleMapPowerPath155LoadFailure: diagnostic-event=EventPowerPath155LoadFailure, operation-cycle=DefaultOperationCycle  # Event_Oper_Cycle_Map_Power_Path_155_Load_Failure
  diagnostic event to debounce algorithm mapping EventDebounceMapPowerPath155LoadFailure: debounce-algorithm=time_based, diagnostic-event=EventPowerPath155LoadFailure  # EventDebounceMap_Power_Path_155_Load_Failure
package /ZeC/DTC/DTC/Power_Path_158_Load_Failure
  diagnostic trouble code uds Power_Path_158_Load_Failure: dtc-props=Dtc_Props_dbb5d03d, uds-dtc-value=0x00549e
  diagnostic event EventPowerPath158LoadFailure: aging-allowed=true, event-kind=SWC, prestorage-freeze-frame=false  # Event_Power_Path_158_Load_Failure
  diagnostic event to trouble code uds mapping EventDtcMapPowerPath158LoadFailure: diagnostic-event=EventPowerPath158LoadFailure, trouble-code-uds=Power_Path_158_Load_Failure  # Event_Dtc_Map_Power_Path_158_Load_Failure
  diagnostic event to operation cycle mapping EventOperCycleMapPowerPath158LoadFailure: diagnostic-event=EventPowerPath158LoadFailure, operation-cycle=DefaultOperationCycle  # Event_Oper_Cycle_Map_Power_Path_158_Load_Failure
  diagnostic event to debounce algorithm mapping EventDebounceMapPowerPath158LoadFailure: debounce-algorithm=time_based, diagnostic-event=EventPowerPath158LoadFailure  # EventDebounceMap_Power_Path_158_Load_Failure
package /ZeC/DTC/DTC/Power_Path_157_Load_Failure
  diagnostic trouble code uds Power_Path_157_Load_Failure: dtc-props=Dtc_Props_9dacda07, uds-dtc-value=0x00549d
  diagnostic event EventPowerPath157LoadFailure: aging-allowed=true, event-kind=SWC, prestorage-freeze-frame=false  # Event_Power_Path_157_Load_Failure
  diagnostic event to trouble code uds mapping EventDtcMapPowerPath157LoadFailure: diagnostic-event=EventPowerPath157LoadFailure, trouble-code-uds=Power_Path_157_Load_Failure  # Event_Dtc_Map_Power_Path_157_Load_Failure
  diagnostic event to operation cycle mapping EventOperCycleMapPowerPath157LoadFailure: diagnostic-event=EventPowerPath157LoadFailure, operation-cycle=DefaultOperationCycle  # Event_Oper_Cycle_Map_Power_Path_157_Load_Failure
  diagnostic event to debounce algorithm mapping EventDebounceMapPowerPath157LoadFailure: debounce-algorithm=time_based, diagnostic-event=EventPowerPath157LoadFailure  # EventDebounceMap_Power_Path_157_Load_Failure
package /ZeC/DTC/DTC/LIN_10_Slave_6_Defect
  diagnostic trouble code uds LIN_10_Slave_6_Defect: dtc-props=Dtc_Props_358996c7, uds-dtc-value=0x030a19  # LIN 10 Slave 6_Defect
  diagnostic event EventLIN10Slave6Defect: aging-allowed=true, event-kind=SWC, prestorage-freeze-frame=false  # Event_LIN 10 Slave 6_Defect
  diagnostic event to trouble code uds mapping EventDtcMapLIN10Slave6Defect: diagnostic-event=EventLIN10Slave6Defect, trouble-code-uds=LIN_10_Slave_6_Defect  # Event_Dtc_Map_LIN 10 Slave 6_Defect
  diagnostic event to operation cycle mapping EventOperCycleMapLIN10Slave6Defect: diagnostic-event=EventLIN10Slave6Defect, operation-cycle=DefaultOperationCycle  # Event_Oper_Cycle_Map_LIN 10 Slave 6_Defect
  diagnostic event to debounce algorithm mapping EventDebounceMapLIN10Slave6Defect: debounce-algorithm=counter_based, diagnostic-event=EventLIN10Slave6Defect  # EventDebounceMap_LIN 10 Slave 6_Defect
package /ZeC/DTC/DTC/LIN_10_Slave_5_Defect
  diagnostic trouble code uds LIN_10_Slave_5_Defect: dtc-props=Dtc_Props_358996c7, uds-dtc-value=0x030a17  # LIN 10 Slave 5_Defect
  diagnostic event EventLIN10Slave5Defect: aging-allowed=true, event-kind=SWC, prestorage-freeze-frame=false  # Event_LIN 10 Slave 5_Defect
  diagnostic event to trouble code uds mapping EventDtcMapLIN10Slave5Defect: diagnostic-event=EventLIN10Slave5Defect, trouble-code-uds=LIN_10_Slave_5_Defect  # Event_Dtc_Map_LIN 10 Slave 5_Defect
  diagnostic event to operation cycle mapping EventOperCycleMapLIN10Slave5Defect: diagnostic-event=EventLIN10Slave5Defect, operation-cycle=DefaultOperationCycle  # Event_Oper_Cycle_Map_LIN 10 Slave 5_Defect
  diagnostic event to debounce algorithm mapping EventDebounceMapLIN10Slave5Defect: debounce-algorithm=counter_based, diagnostic-event=EventLIN10Slave5Defect  # EventDebounceMap_LIN 10 Slave 5_Defect
package /ZeC/DTC/DTC/LIN_10_Slave_5_NoCommunication
  diagnostic trouble code uds LIN_10_Slave_5_NoCommunication: dtc-props=Dtc_Props_358996c7, uds-dtc-value=0x030a18  # LIN 10 Slave 5_NoCommunication
  diagnostic event EventLIN10Slave5NoCommunication: aging-allowed=true, event-kind=SWC, prestorage-freeze-frame=false  # Event_LIN 10 Slave 5_NoCommunication
  diagnostic event to trouble code uds mapping EventDtcMapLIN10Slave5NoCommunication: diagnostic-event=EventLIN10Slave5NoCommunication, trouble-code-uds=LIN_10_Slave_5_NoCommunication  # Event_Dtc_Map_LIN 10 Slave 5_NoCommunication
  diagnostic event to operation cycle mapping EventOperCycleMapLIN10Slave5NoCommunication: diagnostic-event=EventLIN10Slave5NoCommunication, operation-cycle=DefaultOperationCycle  # Event_Oper_Cycle_Map_LIN 10 Slave 5_NoCommunication
  diagnostic event to debounce algorithm mapping EventDebounceMapLIN10Slave5NoCommunication: debounce-algorithm=counter_based, diagnostic-event=EventLIN10Slave5NoCommunication  # EventDebounceMap_LIN 10 Slave 5_NoCommunication
package /ZeC/DTC/DTC/LIN_10_Slave_4_Defect
  diagnostic trouble code uds LIN_10_Slave_4_Defect: dtc-props=Dtc_Props_358996c7, uds-dtc-value=0x030a15  # LIN 10 Slave 4_Defect
  diagnostic event EventLIN10Slave4Defect: aging-allowed=true, event-kind=SWC, prestorage-freeze-frame=false  # Event_LIN 10 Slave 4_Defect
  diagnostic event to trouble code uds mapping EventDtcMapLIN10Slave4Defect: diagnostic-event=EventLIN10Slave4Defect, trouble-code-uds=LIN_10_Slave_4_Defect  # Event_Dtc_Map_LIN 10 Slave 4_Defect
  diagnostic event to operation cycle mapping EventOperCycleMapLIN10Slave4Defect: diagnostic-event=EventLIN10Slave4Defect, operation-cycle=DefaultOperationCycle  # Event_Oper_Cycle_Map_LIN 10 Slave 4_Defect
  diagnostic event to debounce algorithm mapping EventDebounceMapLIN10Slave4Defect: debounce-algorithm=counter_based, diagnostic-event=EventLIN10Slave4Defect  # EventDebounceMap_LIN 10 Slave 4_Defect
package /ZeC/DTC/DTC/LIN_10_Slave_4_NoCommunication
  diagnostic trouble code uds LIN_10_Slave_4_NoCommunication: dtc-props=Dtc_Props_358996c7, uds-dtc-value=0x030a16  # LIN 10 Slave 4_NoCommunication
  diagnostic event EventLIN10Slave4NoCommunication: aging-allowed=true, event-kind=SWC, prestorage-freeze-frame=false  # Event_LIN 10 Slave 4_NoCommunication
  diagnostic event to trouble code uds mapping EventDtcMapLIN10Slave4NoCommunication: diagnostic-event=EventLIN10Slave4NoCommunication, trouble-code-uds=LIN_10_Slave_4_NoCommunication  # Event_Dtc_Map_LIN 10 Slave 4_NoCommunication
  diagnostic event to operation cycle mapping EventOperCycleMapLIN10Slave4NoCommunication: diagnostic-event=EventLIN10Slave4NoCommunication, operation-cycle=DefaultOperationCycle  # Event_Oper_Cycle_Map_LIN 10 Slave 4_NoCommunication
  diagnostic event to debounce algorithm mapping EventDebounceMapLIN10Slave4NoCommunication: debounce-algorithm=counter_based, diagnostic-event=EventLIN10Slave4NoCommunication  # EventDebounceMap_LIN 10 Slave 4_NoCommunication
package /ZeC/DTC/DTC/LIN_10_Slave_3_Defect
  diagnostic trouble code uds LIN_10_Slave_3_Defect: dtc-props=Dtc_Props_358996c7, uds-dtc-value=0x030a13  # LIN 10 Slave 3_Defect
  diagnostic event EventLIN10Slave3Defect: aging-allowed=true, event-kind=SWC, prestorage-freeze-frame=false  # Event_LIN 10 Slave 3_Defect
  diagnostic event to trouble code uds mapping EventDtcMapLIN10Slave3Defect: diagnostic-event=EventLIN10Slave3Defect, trouble-code-uds=LIN_10_Slave_3_Defect  # Event_Dtc_Map_LIN 10 Slave 3_Defect
  diagnostic event to operation cycle mapping EventOperCycleMapLIN10Slave3Defect: diagnostic-event=EventLIN10Slave3Defect, operation-cycle=DefaultOperationCycle  # Event_Oper_Cycle_Map_LIN 10 Slave 3_Defect
  diagnostic event to debounce algorithm mapping EventDebounceMapLIN10Slave3Defect: debounce-algorithm=counter_based, diagnostic-event=EventLIN10Slave3Defect  # EventDebounceMap_LIN 10 Slave 3_Defect
package /ZeC/DTC/DTC/LIN_10_Slave_3_NoCommunication
  diagnostic trouble code uds LIN_10_Slave_3_NoCommunication: dtc-props=Dtc_Props_358996c7, uds-dtc-value=0x030a14  # LIN 10 Slave 3_NoCommunication
  diagnostic event EventLIN10Slave3NoCommunication: aging-allowed=true, event-kind=SWC, prestorage-freeze-frame=false  # Event_LIN 10 Slave 3_NoCommunication
  diagnostic event to trouble code uds mapping EventDtcMapLIN10Slave3NoCommunication: diagnostic-event=EventLIN10Slave3NoCommunication, trouble-code-uds=LIN_10_Slave_3_NoCommunication  # Event_Dtc_Map_LIN 10 Slave 3_NoCommunication
  diagnostic event to operation cycle mapping EventOperCycleMapLIN10Slave3NoCommunication: diagnostic-event=EventLIN10Slave3NoCommunication, operation-cycle=DefaultOperationCycle  # Event_Oper_Cycle_Map_LIN 10 Slave 3_NoCommunication
  diagnostic event to debounce algorithm mapping EventDebounceMapLIN10Slave3NoCommunication: debounce-algorithm=counter_based, diagnostic-event=EventLIN10Slave3NoCommunication  # EventDebounceMap_LIN 10 Slave 3_NoCommunication
package /ZeC/DTC/DTC/LIN_10_Slave_2_Defect
  diagnostic trouble code uds LIN_10_Slave_2_Defect: dtc-props=Dtc_Props_358996c7, uds-dtc-value=0x030a11  # LIN 10 Slave 2_Defect
  diagnostic event EventLIN10Slave2Defect: aging-allowed=true, event-kind=SWC, prestorage-freeze-frame=false  # Event_LIN 10 Slave 2_Defect
  diagnostic event to trouble code uds mapping EventDtcMapLIN10Slave2Defect: diagnostic-event=EventLIN10Slave2Defect, trouble-code-uds=LIN_10_Slave_2_Defect  # Event_Dtc_Map_LIN 10 Slave 2_Defect
  diagnostic event to operation cycle mapping EventOperCycleMapLIN10Slave2Defect: diagnostic-event=EventLIN10Slave2Defect, operation-cycle=DefaultOperationCycle  # Event_Oper_Cycle_Map_LIN 10 Slave 2_Defect
  diagnostic event to debounce algorithm mapping EventDebounceMapLIN10Slave2Defect: debounce-algorithm=counter_based, diagnostic-event=EventLIN10Slave2Defect  # EventDebounceMap_LIN 10 Slave 2_Defect
package /ZeC/DTC/DTC/LIN_10_Slave_2_NoCommunication
  diagnostic trouble code uds LIN_10_Slave_2_NoCommunication: dtc-props=Dtc_Props_358996c7, uds-dtc-value=0x030a12  # LIN 10 Slave 2_NoCommunication
  diagnostic event EventLIN10Slave2NoCommunication: aging-allowed=true, event-kind=SWC, prestorage-freeze-frame=false  # Event_LIN 10 Slave 2_NoCommunication
  diagnostic event to trouble code uds mapping EventDtcMapLIN10Slave2NoCommunication: diagnostic-event=EventLIN10Slave2NoCommunication, trouble-code-uds=LIN_10_Slave_2_NoCommunication  # Event_Dtc_Map_LIN 10 Slave 2_NoCommunication
  diagnostic event to operation cycle mapping EventOperCycleMapLIN10Slave2NoCommunication: diagnostic-event=EventLIN10Slave2NoCommunication, operation-cycle=DefaultOperationCycle  # Event_Oper_Cycle_Map_LIN 10 Slave 2_NoCommunication
  diagnostic event to debounce algorithm mapping EventDebounceMapLIN10Slave2NoCommunication: debounce-algorithm=counter_based, diagnostic-event=EventLIN10Slave2NoCommunication  # EventDebounceMap_LIN 10 Slave 2_NoCommunication
package /ZeC/DTC/DTC/LIN_10_Slave_15_NoCommunication
  diagnostic trouble code uds LIN_10_Slave_15_NoCommunication: dtc-props=Dtc_Props_358996c7, uds-dtc-value=0x030a10  # LIN 10 Slave 15_NoCommunication
  diagnostic event EventLIN10Slave15NoCommunication: aging-allowed=true, event-kind=SWC, prestorage-freeze-frame=false  # Event_LIN 10 Slave 15_NoCommunication
  diagnostic event to trouble code uds mapping EventDtcMapLIN10Slave15NoCommunication: diagnostic-event=EventLIN10Slave15NoCommunication, trouble-code-uds=LIN_10_Slave_15_NoCommunication  # Event_Dtc_Map_LIN 10 Slave 15_NoCommunication
  diagnostic event to operation cycle mapping EventOperCycleMapLIN10Slave15NoCommunication: diagnostic-event=EventLIN10Slave15NoCommunication, operation-cycle=DefaultOperationCycle  # Event_Oper_Cycle_Map_LIN 10 Slave 15_NoCommunication
  diagnostic event to debounce algorithm mapping EventDebounceMapLIN10Slave15NoCommunication: debounce-algorithm=counter_based, diagnostic-event=EventLIN10Slave15NoCommunication  # EventDebounceMap_LIN 10 Slave 15_NoCommunication
package /ZeC/DTC/DTC/LIN_19_Slave_6_NoCommunication
  diagnostic trouble code uds LIN_19_Slave_6_NoCommunication: dtc-props=Dtc_Props_358996c7, uds-dtc-value=0x031309  # LIN 19 Slave 6_NoCommunication
  diagnostic event EventLIN19Slave6NoCommunication: aging-allowed=true, event-kind=SWC, prestorage-freeze-frame=false  # Event_LIN 19 Slave 6_NoCommunication
  diagnostic event to trouble code uds mapping EventDtcMapLIN19Slave6NoCommunication: diagnostic-event=EventLIN19Slave6NoCommunication, trouble-code-uds=LIN_19_Slave_6_NoCommunication  # Event_Dtc_Map_LIN 19 Slave 6_NoCommunication
  diagnostic event to operation cycle mapping EventOperCycleMapLIN19Slave6NoCommunication: diagnostic-event=EventLIN19Slave6NoCommunication, operation-cycle=DefaultOperationCycle  # Event_Oper_Cycle_Map_LIN 19 Slave 6_NoCommunication
  diagnostic event to debounce algorithm mapping EventDebounceMapLIN19Slave6NoCommunication: debounce-algorithm=counter_based, diagnostic-event=EventLIN19Slave6NoCommunication  # EventDebounceMap_LIN 19 Slave 6_NoCommunication
package /ZeC/DTC/DTC/LIN_19_Slave_5_NoCommunication
  diagnostic trouble code uds LIN_19_Slave_5_NoCommunication: dtc-props=Dtc_Props_358996c7, uds-dtc-value=0x031307  # LIN 19 Slave 5_NoCommunication
  diagnostic event EventLIN19Slave5NoCommunication: aging-allowed=true, event-kind=SWC, prestorage-freeze-frame=false  # Event_LIN 19 Slave 5_NoCommunication
  diagnostic event to trouble code uds mapping EventDtcMapLIN19Slave5NoCommunication: diagnostic-event=EventLIN19Slave5NoCommunication, trouble-code-uds=LIN_19_Slave_5_NoCommunication  # Event_Dtc_Map_LIN 19 Slave 5_NoCommunication
  diagnostic event to operation cycle mapping EventOperCycleMapLIN19Slave5NoCommunication: diagnostic-event=EventLIN19Slave5NoCommunication, operation-cycle=DefaultOperationCycle  # Event_Oper_Cycle_Map_LIN 19 Slave 5_NoCommunication
  diagnostic event to debounce algorithm mapping EventDebounceMapLIN19Slave5NoCommunication: debounce-algorithm=counter_based, diagnostic-event=EventLIN19Slave5NoCommunication  # EventDebounceMap_LIN 19 Slave 5_NoCommunication
package /ZeC/DTC/DTC/LIN_19_Slave_6_Defect
  diagnostic trouble code uds LIN_19_Slave_6_Defect: dtc-props=Dtc_Props_358996c7, uds-dtc-value=0x031308  # LIN 19 Slave 6_Defect
  diagnostic event EventLIN19Slave6Defect: aging-allowed=true, event-kind=SWC, prestorage-freeze-frame=false  # Event_LIN 19 Slave 6_Defect
  diagnostic event to trouble code uds mapping EventDtcMapLIN19Slave6Defect: diagnostic-event=EventLIN19Slave6Defect, trouble-code-uds=LIN_19_Slave_6_Defect  # Event_Dtc_Map_LIN 19 Slave 6_Defect
  diagnostic event to operation cycle mapping EventOperCycleMapLIN19Slave6Defect: diagnostic-event=EventLIN19Slave6Defect, operation-cycle=DefaultOperationCycle  # Event_Oper_Cycle_Map_LIN 19 Slave 6_Defect
  diagnostic event to debounce algorithm mapping EventDebounceMapLIN19Slave6Defect: debounce-algorithm=counter_based, diagnostic-event=EventLIN19Slave6Defect  # EventDebounceMap_LIN 19 Slave 6_Defect
package /ZeC/DTC/DTC/LIN_19_Slave_4_NoCommunication
  diagnostic trouble code uds LIN_19_Slave_4_NoCommunication: dtc-props=Dtc_Props_358996c7, uds-dtc-value=0x031305  # LIN 19 Slave 4_NoCommunication
  diagnostic event EventLIN19Slave4NoCommunication: aging-allowed=true, event-kind=SWC, prestorage-freeze-frame=false  # Event_LIN 19 Slave 4_NoCommunication
  diagnostic event to trouble code uds mapping EventDtcMapLIN19Slave4NoCommunication: diagnostic-event=EventLIN19Slave4NoCommunication, trouble-code-uds=LIN_19_Slave_4_NoCommunication  # Event_Dtc_Map_LIN 19 Slave 4_NoCommunication
  diagnostic event to operation cycle mapping EventOperCycleMapLIN19Slave4NoCommunication: diagnostic-event=EventLIN19Slave4NoCommunication, operation-cycle=DefaultOperationCycle  # Event_Oper_Cycle_Map_LIN 19 Slave 4_NoCommunication
  diagnostic event to debounce algorithm mapping EventDebounceMapLIN19Slave4NoCommunication: debounce-algorithm=counter_based, diagnostic-event=EventLIN19Slave4NoCommunication  # EventDebounceMap_LIN 19 Slave 4_NoCommunication
package /ZeC/DTC/DTC/LIN_19_Slave_5_Defect
  diagnostic trouble code uds LIN_19_Slave_5_Defect: dtc-props=Dtc_Props_358996c7, uds-dtc-value=0x031306  # LIN 19 Slave 5_Defect
  diagnostic event EventLIN19Slave5Defect: aging-allowed=true, event-kind=SWC, prestorage-freeze-frame=false  # Event_LIN 19 Slave 5_Defect
  diagnostic event to trouble code uds mapping EventDtcMapLIN19Slave5Defect: diagnostic-event=EventLIN19Slave5Defect, trouble-code-uds=LIN_19_Slave_5_Defect  # Event_Dtc_Map_LIN 19 Slave 5_Defect
  diagnostic event to operation cycle mapping EventOperCycleMapLIN19Slave5Defect: diagnostic-event=EventLIN19Slave5Defect, operation-cycle=DefaultOperationCycle  # Event_Oper_Cycle_Map_LIN 19 Slave 5_Defect
  diagnostic event to debounce algorithm mapping EventDebounceMapLIN19Slave5Defect: debounce-algorithm=counter_based, diagnostic-event=EventLIN19Slave5Defect  # EventDebounceMap_LIN 19 Slave 5_Defect
package /ZeC/DTC/DTC/LIN_19_Slave_3_NoCommunication
  diagnostic trouble code uds LIN_19_Slave_3_NoCommunication: dtc-props=Dtc_Props_358996c7, uds-dtc-value=0x031303  # LIN 19 Slave 3_NoCommunication
  diagnostic event EventLIN19Slave3NoCommunication: aging-allowed=true, event-kind=SWC, prestorage-freeze-frame=false  # Event_LIN 19 Slave 3_NoCommunication
  diagnostic event to trouble code uds mapping EventDtcMapLIN19Slave3NoCommunication: diagnostic-event=EventLIN19Slave3NoCommunication, trouble-code-uds=LIN_19_Slave_3_NoCommunication  # Event_Dtc_Map_LIN 19 Slave 3_NoCommunication
  diagnostic event to operation cycle mapping EventOperCycleMapLIN19Slave3NoCommunication: diagnostic-event=EventLIN19Slave3NoCommunication, operation-cycle=DefaultOperationCycle  # Event_Oper_Cycle_Map_LIN 19 Slave 3_NoCommunication
  diagnostic event to debounce algorithm mapping EventDebounceMapLIN19Slave3NoCommunication: debounce-algorithm=counter_based, diagnostic-event=EventLIN19Slave3NoCommunication  # EventDebounceMap_LIN 19 Slave 3_NoCommunication
package /ZeC/DTC/DTC/LIN_19_Slave_4_Defect
  diagnostic trouble code uds LIN_19_Slave_4_Defect: dtc-props=Dtc_Props_358996c7, uds-dtc-value=0x031304  # LIN 19 Slave 4_Defect
  diagnostic event EventLIN19Slave4Defect: aging-allowed=true, event-kind=SWC, prestorage-freeze-frame=false  # Event_LIN 19 Slave 4_Defect
  diagnostic event to trouble code uds mapping EventDtcMapLIN19Slave4Defect: diagnostic-event=EventLIN19Slave4Defect, trouble-code-uds=LIN_19_Slave_4_Defect  # Event_Dtc_Map_LIN 19 Slave 4_Defect
  diagnostic event to operation cycle mapping EventOperCycleMapLIN19Slave4Defect: diagnostic-event=EventLIN19Slave4Defect, operation-cycle=DefaultOperationCycle  # Event_Oper_Cycle_Map_LIN 19 Slave 4_Defect
  diagnostic event to debounce algorithm mapping EventDebounceMapLIN19Slave4Defect: debounce-algorithm=counter_based, diagnostic-event=EventLIN19Slave4Defect  # EventDebounceMap_LIN 19 Slave 4_Defect
package /ZeC/DTC/DTC/LIN_19_Slave_2_NoCommunication
  diagnostic trouble code uds LIN_19_Slave_2_NoCommunication: dtc-props=Dtc_Props_358996c7, uds-dtc-value=0x031301  # LIN 19 Slave 2_NoCommunication
  diagnostic event EventLIN19Slave2NoCommunication: aging-allowed=true, event-kind=SWC, prestorage-freeze-frame=false  # Event_LIN 19 Slave 2_NoCommunication
  diagnostic event to trouble code uds mapping EventDtcMapLIN19Slave2NoCommunication: diagnostic-event=EventLIN19Slave2NoCommunication, trouble-code-uds=LIN_19_Slave_2_NoCommunication  # Event_Dtc_Map_LIN 19 Slave 2_NoCommunication
  diagnostic event to operation cycle mapping EventOperCycleMapLIN19Slave2NoCommunication: diagnostic-event=EventLIN19Slave2NoCommunication, operation-cycle=DefaultOperationCycle  # Event_Oper_Cycle_Map_LIN 19 Slave 2_NoCommunication
  diagnostic event to debounce algorithm mapping EventDebounceMapLIN19Slave2NoCommunication: debounce-algorithm=counter_based, diagnostic-event=EventLIN19Slave2NoCommunication  # EventDebounceMap_LIN 19 Slave 2_NoCommunication
package /ZeC/DTC/DTC/LIN_19_Slave_3_Defect
  diagnostic trouble code uds LIN_19_Slave_3_Defect: dtc-props=Dtc_Props_358996c7, uds-dtc-value=0x031302  # LIN 19 Slave 3_Defect
  diagnostic event EventLIN19Slave3Defect: aging-allowed=true, event-kind=SWC, prestorage-freeze-frame=false  # Event_LIN 19 Slave 3_Defect
  diagnostic event to trouble code uds mapping EventDtcMapLIN19Slave3Defect: diagnostic-event=EventLIN19Slave3Defect, trouble-code-uds=LIN_19_Slave_3_Defect  # Event_Dtc_Map_LIN 19 Slave 3_Defect
  diagnostic event to operation cycle mapping EventOperCycleMapLIN19Slave3Defect: diagnostic-event=EventLIN19Slave3Defect, operation-cycle=DefaultOperationCycle  # Event_Oper_Cycle_Map_LIN 19 Slave 3_Defect
  diagnostic event to debounce algorithm mapping EventDebounceMapLIN19Slave3Defect: debounce-algorithm=counter_based, diagnostic-event=EventLIN19Slave3Defect  # EventDebounceMap_LIN 19 Slave 3_Defect
package /ZeC/DTC/DTC/LIN_19_Slave_9_Defect
  diagnostic trouble code uds LIN_19_Slave_9_Defect: dtc-props=Dtc_Props_358996c7, uds-dtc-value=0x03130e  # LIN 19 Slave 9_Defect
  diagnostic event EventLIN19Slave9Defect: aging-allowed=true, event-kind=SWC, prestorage-freeze-frame=false  # Event_LIN 19 Slave 9_Defect
  diagnostic event to trouble code uds mapping EventDtcMapLIN19Slave9Defect: diagnostic-event=EventLIN19Slave9Defect, trouble-code-uds=LIN_19_Slave_9_Defect  # Event_Dtc_Map_LIN 19 Slave 9_Defect
  diagnostic event to operation cycle mapping EventOperCycleMapLIN19Slave9Defect: diagnostic-event=EventLIN19Slave9Defect, operation-cycle=DefaultOperationCycle  # Event_Oper_Cycle_Map_LIN 19 Slave 9_Defect
  diagnostic event to debounce algorithm mapping EventDebounceMapLIN19Slave9Defect: debounce-algorithm=counter_based, diagnostic-event=EventLIN19Slave9Defect  # EventDebounceMap_LIN 19 Slave 9_Defect
package /ZeC/DTC/DTC/LIN_19_Slave_9_NoCommunication
  diagnostic trouble code uds LIN_19_Slave_9_NoCommunication: dtc-props=Dtc_Props_358996c7, uds-dtc-value=0x03130f  # LIN 19 Slave 9_NoCommunication
  diagnostic event EventLIN19Slave9NoCommunication: aging-allowed=true, event-kind=SWC, prestorage-freeze-frame=false  # Event_LIN 19 Slave 9_NoCommunication
  diagnostic event to trouble code uds mapping EventDtcMapLIN19Slave9NoCommunication: diagnostic-event=EventLIN19Slave9NoCommunication, trouble-code-uds=LIN_19_Slave_9_NoCommunication  # Event_Dtc_Map_LIN 19 Slave 9_NoCommunication
  diagnostic event to operation cycle mapping EventOperCycleMapLIN19Slave9NoCommunication: diagnostic-event=EventLIN19Slave9NoCommunication, operation-cycle=DefaultOperationCycle  # Event_Oper_Cycle_Map_LIN 19 Slave 9_NoCommunication
  diagnostic event to debounce algorithm mapping EventDebounceMapLIN19Slave9NoCommunication: debounce-algorithm=counter_based, diagnostic-event=EventLIN19Slave9NoCommunication  # EventDebounceMap_LIN 19 Slave 9_NoCommunication
package /ZeC/DTC/DTC/LIN_19_Slave_8_Defect
  diagnostic trouble code uds LIN_19_Slave_8_Defect: dtc-props=Dtc_Props_358996c7, uds-dtc-value=0x03130c  # LIN 19 Slave 8_Defect
  diagnostic event EventLIN19Slave8Defect: aging-allowed=true, event-kind=SWC, prestorage-freeze-frame=false  # Event_LIN 19 Slave 8_Defect
  diagnostic event to trouble code uds mapping EventDtcMapLIN19Slave8Defect: diagnostic-event=EventLIN19Slave8Defect, trouble-code-uds=LIN_19_Slave_8_Defect  # Event_Dtc_Map_LIN 19 Slave 8_Defect
  diagnostic event to operation cycle mapping EventOperCycleMapLIN19Slave8Defect: diagnostic-event=EventLIN19Slave8Defect, operation-cycle=DefaultOperationCycle  # Event_Oper_Cycle_Map_LIN 19 Slave 8_Defect
  diagnostic event to debounce algorithm mapping EventDebounceMapLIN19Slave8Defect: debounce-algorithm=counter_based, diagnostic-event=EventLIN19Slave8Defect  # EventDebounceMap_LIN 19 Slave 8_Defect
package /ZeC/DTC/DTC/LIN_19_Slave_8_NoCommunication
  diagnostic trouble code uds LIN_19_Slave_8_NoCommunication: dtc-props=Dtc_Props_358996c7, uds-dtc-value=0x03130d  # LIN 19 Slave 8_NoCommunication
  diagnostic event EventLIN19Slave8NoCommunication: aging-allowed=true, event-kind=SWC, prestorage-freeze-frame=false  # Event_LIN 19 Slave 8_NoCommunication
  diagnostic event to trouble code uds mapping EventDtcMapLIN19Slave8NoCommunication: diagnostic-event=EventLIN19Slave8NoCommunication, trouble-code-uds=LIN_19_Slave_8_NoCommunication  # Event_Dtc_Map_LIN 19 Slave 8_NoCommunication
  diagnostic event to operation cycle mapping EventOperCycleMapLIN19Slave8NoCommunication: diagnostic-event=EventLIN19Slave8NoCommunication, operation-cycle=DefaultOperationCycle  # Event_Oper_Cycle_Map_LIN 19 Slave 8_NoCommunication
  diagnostic event to debounce algorithm mapping EventDebounceMapLIN19Slave8NoCommunication: debounce-algorithm=counter_based, diagnostic-event=EventLIN19Slave8NoCommunication  # EventDebounceMap_LIN 19 Slave 8_NoCommunication
package /ZeC/DTC/DTC/LIN_19_Slave_7_Defect
  diagnostic trouble code uds LIN_19_Slave_7_Defect: dtc-props=Dtc_Props_358996c7, uds-dtc-value=0x03130a  # LIN 19 Slave 7_Defect
  diagnostic event EventLIN19Slave7Defect: aging-allowed=true, event-kind=SWC, prestorage-freeze-frame=false  # Event_LIN 19 Slave 7_Defect
  diagnostic event to trouble code uds mapping EventDtcMapLIN19Slave7Defect: diagnostic-event=EventLIN19Slave7Defect, trouble-code-uds=LIN_19_Slave_7_Defect  # Event_Dtc_Map_LIN 19 Slave 7_Defect
  diagnostic event to operation cycle mapping EventOperCycleMapLIN19Slave7Defect: diagnostic-event=EventLIN19Slave7Defect, operation-cycle=DefaultOperationCycle  # Event_Oper_Cycle_Map_LIN 19 Slave 7_Defect
  diagnostic event to debounce algorithm mapping EventDebounceMapLIN19Slave7Defect: debounce-algorithm=counter_based, diagnostic-event=EventLIN19Slave7Defect  # EventDebounceMap_LIN 19 Slave 7_Defect
package /ZeC/DTC/DTC/LIN_19_Slave_7_NoCommunication
  diagnostic trouble code uds LIN_19_Slave_7_NoCommunication: dtc-props=Dtc_Props_358996c7, uds-dtc-value=0x03130b  # LIN 19 Slave 7_NoCommunication
  diagnostic event EventLIN19Slave7NoCommunication: aging-allowed=true, event-kind=SWC, prestorage-freeze-frame=false  # Event_LIN 19 Slave 7_NoCommunication
  diagnostic event to trouble code uds mapping EventDtcMapLIN19Slave7NoCommunication: diagnostic-event=EventLIN19Slave7NoCommunication, trouble-code-uds=LIN_19_Slave_7_NoCommunication  # Event_Dtc_Map_LIN 19 Slave 7_NoCommunication
  diagnostic event to operation cycle mapping EventOperCycleMapLIN19Slave7NoCommunication: diagnostic-event=EventLIN19Slave7NoCommunication, operation-cycle=DefaultOperationCycle  # Event_Oper_Cycle_Map_LIN 19 Slave 7_NoCommunication
  diagnostic event to debounce algorithm mapping EventDebounceMapLIN19Slave7NoCommunication: debounce-algorithm=counter_based, diagnostic-event=EventLIN19Slave7NoCommunication  # EventDebounceMap_LIN 19 Slave 7_NoCommunication
package /ZeC/DTC/DTC/Power_Path_001_Single_Device_Failure
  diagnostic trouble code uds Power_Path_001_Single_Device_Failure: dtc-props=Dtc_Props_67f640d4, uds-dtc-value=0x005901
  diagnostic event EventPowerPath001SingleDeviceFailure: aging-allowed=true, event-kind=SWC, prestorage-freeze-frame=false  # Event_Power_Path_001_Single_Device_Failure
  diagnostic event to trouble code uds mapping EventDtcMapPowerPath001SingleDeviceFailure: diagnostic-event=EventPowerPath001SingleDeviceFailure, trouble-code-uds=Power_Path_001_Single_Device_Failure  # Event_Dtc_Map_Power_Path_001_Single_Device_Failure
  diagnostic event to operation cycle mapping EventOperCycleMapPowerPath001SingleDeviceFailure: diagnostic-event=EventPowerPath001SingleDeviceFailure, operation-cycle=DefaultOperationCycle  # Event_Oper_Cycle_Map_Power_Path_001_Single_Device_Failure
  diagnostic event to debounce algorithm mapping EventDebounceMapPowerPath001SingleDeviceFailure: debounce-algorithm=time_based, diagnostic-event=EventPowerPath001SingleDeviceFailure  # EventDebounceMap_Power_Path_001_Single_Device_Failure
package /ZeC/DTC/DTC/Power_Path_003_Single_Device_Failure
  diagnostic trouble code uds Power_Path_003_Single_Device_Failure: dtc-props=Dtc_Props_ebc454a0, uds-dtc-value=0x005903
  diagnostic event EventPowerPath003SingleDeviceFailure: aging-allowed=true, event-kind=SWC, prestorage-freeze-frame=false  # Event_Power_Path_003_Single_Device_Failure
  diagnostic event to trouble code uds mapping EventDtcMapPowerPath003SingleDeviceFailure: diagnostic-event=EventPowerPath003SingleDeviceFailure, trouble-code-uds=Power_Path_003_Single_Device_Failure  # Event_Dtc_Map_Power_Path_003_Single_Device_Failure
  diagnostic event to operation cycle mapping EventOperCycleMapPowerPath003SingleDeviceFailure: diagnostic-event=EventPowerPath003SingleDeviceFailure, operation-cycle=DefaultOperationCycle  # Event_Oper_Cycle_Map_Power_Path_003_Single_Device_Failure
  diagnostic event to debounce algorithm mapping EventDebounceMapPowerPath003SingleDeviceFailure: debounce-algorithm=time_based, diagnostic-event=EventPowerPath003SingleDeviceFailure  # EventDebounceMap_Power_Path_003_Single_Device_Failure
package /ZeC/DTC/DTC/Power_Path_002_Single_Device_Failure
  diagnostic trouble code uds Power_Path_002_Single_Device_Failure: dtc-props=Dtc_Props_addd5e9a, uds-dtc-value=0x005902
  diagnostic event EventPowerPath002SingleDeviceFailure: aging-allowed=true, event-kind=SWC, prestorage-freeze-frame=false  # Event_Power_Path_002_Single_Device_Failure
  diagnostic event to trouble code uds mapping EventDtcMapPowerPath002SingleDeviceFailure: diagnostic-event=EventPowerPath002SingleDeviceFailure, trouble-code-uds=Power_Path_002_Single_Device_Failure  # Event_Dtc_Map_Power_Path_002_Single_Device_Failure
  diagnostic event to operation cycle mapping EventOperCycleMapPowerPath002SingleDeviceFailure: diagnostic-event=EventPowerPath002SingleDeviceFailure, operation-cycle=DefaultOperationCycle  # Event_Oper_Cycle_Map_Power_Path_002_Single_Device_Failure
  diagnostic event to debounce algorithm mapping EventDebounceMapPowerPath002SingleDeviceFailure: debounce-algorithm=time_based, diagnostic-event=EventPowerPath002SingleDeviceFailure  # EventDebounceMap_Power_Path_002_Single_Device_Failure
package /ZeC/DTC/DTC/Power_Path_009_Single_Device_Failure
  diagnostic trouble code uds Power_Path_009_Single_Device_Failure: dtc-props=Dtc_Props_3aad1bc7, uds-dtc-value=0x005909
  diagnostic event EventPowerPath009SingleDeviceFailure: aging-allowed=true, event-kind=SWC, prestorage-freeze-frame=false  # Event_Power_Path_009_Single_Device_Failure
  diagnostic event to trouble code uds mapping EventDtcMapPowerPath009SingleDeviceFailure: diagnostic-event=EventPowerPath009SingleDeviceFailure, trouble-code-uds=Power_Path_009_Single_Device_Failure  # Event_Dtc_Map_Power_Path_009_Single_Device_Failure
  diagnostic event to operation cycle mapping EventOperCycleMapPowerPath009SingleDeviceFailure: diagnostic-event=EventPowerPath009SingleDeviceFailure, operation-cycle=DefaultOperationCycle  # Event_Oper_Cycle_Map_Power_Path_009_Single_Device_Failure
  diagnostic event to debounce algorithm mapping EventDebounceMapPowerPath009SingleDeviceFailure: debounce-algorithm=time_based, diagnostic-event=EventPowerPath009SingleDeviceFailure  # EventDebounceMap_Power_Path_009_Single_Device_Failure
package /ZeC/DTC/DTC/Power_Path_008_Single_Device_Failure
  diagnostic trouble code uds Power_Path_008_Single_Device_Failure: dtc-props=Dtc_Props_7cb411fd, uds-dtc-value=0x005908
  diagnostic event EventPowerPath008SingleDeviceFailure: aging-allowed=true, event-kind=SWC, prestorage-freeze-frame=false  # Event_Power_Path_008_Single_Device_Failure
  diagnostic event to trouble code uds mapping EventDtcMapPowerPath008SingleDeviceFailure: diagnostic-event=EventPowerPath008SingleDeviceFailure, trouble-code-uds=Power_Path_008_Single_Device_Failure  # Event_Dtc_Map_Power_Path_008_Single_Device_Failure
  diagnostic event to operation cycle mapping EventOperCycleMapPowerPath008SingleDeviceFailure: diagnostic-event=EventPowerPath008SingleDeviceFailure, operation-cycle=DefaultOperationCycle  # Event_Oper_Cycle_Map_Power_Path_008_Single_Device_Failure
  diagnostic event to debounce algorithm mapping EventDebounceMapPowerPath008SingleDeviceFailure: debounce-algorithm=time_based, diagnostic-event=EventPowerPath008SingleDeviceFailure  # EventDebounceMap_Power_Path_008_Single_Device_Failure
package /ZeC/DTC/DTC/Power_Path_005_Single_Device_Failure
  diagnostic trouble code uds Power_Path_005_Single_Device_Failure: dtc-props=Dtc_Props_67f640d4, uds-dtc-value=0x005905
  diagnostic event EventPowerPath005SingleDeviceFailure: aging-allowed=true, event-kind=SWC, prestorage-freeze-frame=false  # Event_Power_Path_005_Single_Device_Failure
  diagnostic event to trouble code uds mapping EventDtcMapPowerPath005SingleDeviceFailure: diagnostic-event=EventPowerPath005SingleDeviceFailure, trouble-code-uds=Power_Path_005_Single_Device_Failure  # Event_Dtc_Map_Power_Path_005_Single_Device_Failure
  diagnostic event to operation cycle mapping EventOperCycleMapPowerPath005SingleDeviceFailure: diagnostic-event=EventPowerPath005SingleDeviceFailure, operation-cycle=DefaultOperationCycle  # Event_Oper_Cycle_Map_Power_Path_005_Single_Device_Failure
  diagnostic event to debounce algorithm mapping EventDebounceMapPowerPath005SingleDeviceFailure: debounce-algorithm=time_based, diagnostic-event=EventPowerPath005SingleDeviceFailure  # EventDebounceMap_Power_Path_005_Single_Device_Failure
package /ZeC/DTC/DTC/Power_Path_004_Single_Device_Failure
  diagnostic trouble code uds Power_Path_004_Single_Device_Failure: dtc-props=Dtc_Props_e2fa6447, uds-dtc-value=0x005904
  diagnostic event EventPowerPath004SingleDeviceFailure: aging-allowed=true, event-kind=SWC, prestorage-freeze-frame=false  # Event_Power_Path_004_Single_Device_Failure
  diagnostic event to trouble code uds mapping EventDtcMapPowerPath004SingleDeviceFailure: diagnostic-event=EventPowerPath004SingleDeviceFailure, trouble-code-uds=Power_Path_004_Single_Device_Failure  # Event_Dtc_Map_Power_Path_004_Single_Device_Failure
  diagnostic event to operation cycle mapping EventOperCycleMapPowerPath004SingleDeviceFailure: diagnostic-event=EventPowerPath004SingleDeviceFailure, operation-cycle=DefaultOperationCycle  # Event_Oper_Cycle_Map_Power_Path_004_Single_Device_Failure
  diagnostic event to debounce algorithm mapping EventDebounceMapPowerPath004SingleDeviceFailure: debounce-algorithm=time_based, diagnostic-event=EventPowerPath004SingleDeviceFailure  # EventDebounceMap_Power_Path_004_Single_Device_Failure
package /ZeC/DTC/DTC/Power_Path_007_Single_Device_Failure
  diagnostic trouble code uds Power_Path_007_Single_Device_Failure: dtc-props=Dtc_Props_28d17a09, uds-dtc-value=0x005907
  diagnostic event EventPowerPath007SingleDeviceFailure: aging-allowed=true, event-kind=SWC, prestorage-freeze-frame=false  # Event_Power_Path_007_Single_Device_Failure
  diagnostic event to trouble code uds mapping EventDtcMapPowerPath007SingleDeviceFailure: diagnostic-event=EventPowerPath007SingleDeviceFailure, trouble-code-uds=Power_Path_007_Single_Device_Failure  # Event_Dtc_Map_Power_Path_007_Single_Device_Failure
  diagnostic event to operation cycle mapping EventOperCycleMapPowerPath007SingleDeviceFailure: diagnostic-event=EventPowerPath007SingleDeviceFailure, operation-cycle=DefaultOperationCycle  # Event_Oper_Cycle_Map_Power_Path_007_Single_Device_Failure
  diagnostic event to debounce algorithm mapping EventDebounceMapPowerPath007SingleDeviceFailure: debounce-algorithm=time_based, diagnostic-event=EventPowerPath007SingleDeviceFailure  # EventDebounceMap_Power_Path_007_Single_Device_Failure
package /ZeC/DTC/DTC/Power_Path_006_Single_Device_Failure
  diagnostic trouble code uds Power_Path_006_Single_Device_Failure: dtc-props=Dtc_Props_6ec87033, uds-dtc-value=0x005906
  diagnostic event EventPowerPath006SingleDeviceFailure: aging-allowed=true, event-kind=SWC, prestorage-freeze-frame=false  # Event_Power_Path_006_Single_Device_Failure
  diagnostic event to trouble code uds mapping EventDtcMapPowerPath006SingleDeviceFailure: diagnostic-event=EventPowerPath006SingleDeviceFailure, trouble-code-uds=Power_Path_006_Single_Device_Failure  # Event_Dtc_Map_Power_Path_006_Single_Device_Failure
  diagnostic event to operation cycle mapping EventOperCycleMapPowerPath006SingleDeviceFailure: diagnostic-event=EventPowerPath006SingleDeviceFailure, operation-cycle=DefaultOperationCycle  # Event_Oper_Cycle_Map_Power_Path_006_Single_Device_Failure
  diagnostic event to debounce algorithm mapping EventDebounceMapPowerPath006SingleDeviceFailure: debounce-algorithm=time_based, diagnostic-event=EventPowerPath006SingleDeviceFailure  # EventDebounceMap_Power_Path_006_Single_Device_Failure
package /ZeC/DTC/DTC/Power_Path_010_Single_Device_Failure
  diagnostic trouble code uds Power_Path_010_Single_Device_Failure: dtc-props=Dtc_Props_5a0924a9, uds-dtc-value=0x00590a
  diagnostic event EventPowerPath010SingleDeviceFailure: aging-allowed=true, event-kind=SWC, prestorage-freeze-frame=false  # Event_Power_Path_010_Single_Device_Failure
  diagnostic event to trouble code uds mapping EventDtcMapPowerPath010SingleDeviceFailure: diagnostic-event=EventPowerPath010SingleDeviceFailure, trouble-code-uds=Power_Path_010_Single_Device_Failure  # Event_Dtc_Map_Power_Path_010_Single_Device_Failure
  diagnostic event to operation cycle mapping EventOperCycleMapPowerPath010SingleDeviceFailure: diagnostic-event=EventPowerPath010SingleDeviceFailure, operation-cycle=DefaultOperationCycle  # Event_Oper_Cycle_Map_Power_Path_010_Single_Device_Failure
  diagnostic event to debounce algorithm mapping EventDebounceMapPowerPath010SingleDeviceFailure: debounce-algorithm=time_based, diagnostic-event=EventPowerPath010SingleDeviceFailure  # EventDebounceMap_Power_Path_010_Single_Device_Failure
package /ZeC/DTC/DTC/Power_Path_012_Single_Device_Failure
  diagnostic trouble code uds Power_Path_012_Single_Device_Failure: dtc-props=Dtc_Props_d63b30dd, uds-dtc-value=0x00590c
  diagnostic event EventPowerPath012SingleDeviceFailure: aging-allowed=true, event-kind=SWC, prestorage-freeze-frame=false  # Event_Power_Path_012_Single_Device_Failure
  diagnostic event to trouble code uds mapping EventDtcMapPowerPath012SingleDeviceFailure: diagnostic-event=EventPowerPath012SingleDeviceFailure, trouble-code-uds=Power_Path_012_Single_Device_Failure  # Event_Dtc_Map_Power_Path_012_Single_Device_Failure
  diagnostic event to operation cycle mapping EventOperCycleMapPowerPath012SingleDeviceFailure: diagnostic-event=EventPowerPath012SingleDeviceFailure, operation-cycle=DefaultOperationCycle  # Event_Oper_Cycle_Map_Power_Path_012_Single_Device_Failure
  diagnostic event to debounce algorithm mapping EventDebounceMapPowerPath012SingleDeviceFailure: debounce-algorithm=time_based, diagnostic-event=EventPowerPath012SingleDeviceFailure  # EventDebounceMap_Power_Path_012_Single_Device_Failure
package /ZeC/DTC/DTC/Power_Path_011_Single_Device_Failure
  diagnostic trouble code uds Power_Path_011_Single_Device_Failure: dtc-props=Dtc_Props_90223ae7, uds-dtc-value=0x00590b
  diagnostic event EventPowerPath011SingleDeviceFailure: aging-allowed=true, event-kind=SWC, prestorage-freeze-frame=false  # Event_Power_Path_011_Single_Device_Failure
  diagnostic event to trouble code uds mapping EventDtcMapPowerPath011SingleDeviceFailure: diagnostic-event=EventPowerPath011SingleDeviceFailure, trouble-code-uds=Power_Path_011_Single_Device_Failure  # Event_Dtc_Map_Power_Path_011_Single_Device_Failure
  diagnostic event to operation cycle mapping EventOperCycleMapPowerPath011SingleDeviceFailure: diagnostic-event=EventPowerPath011SingleDeviceFailure, operation-cycle=DefaultOperationCycle  # Event_Oper_Cycle_Map_Power_Path_011_Single_Device_Failure
  diagnostic event to debounce algorithm mapping EventDebounceMapPowerPath011SingleDeviceFailure: debounce-algorithm=time_based, diagnostic-event=EventPowerPath011SingleDeviceFailure  # EventDebounceMap_Power_Path_011_Single_Device_Failure
package /ZeC/DTC/DTC/Power_Path_014_Single_Device_Failure
  diagnostic trouble code uds Power_Path_014_Single_Device_Failure: dtc-props=Dtc_Props_991c0a00, uds-dtc-value=0x00590e
  diagnostic event EventPowerPath014SingleDeviceFailure: aging-allowed=true, event-kind=SWC, prestorage-freeze-frame=false  # Event_Power_Path_014_Single_Device_Failure
  diagnostic event to trouble code uds mapping EventDtcMapPowerPath014SingleDeviceFailure: diagnostic-event=EventPowerPath014SingleDeviceFailure, trouble-code-uds=Power_Path_014_Single_Device_Failure  # Event_Dtc_Map_Power_Path_014_Single_Device_Failure
  diagnostic event to operation cycle mapping EventOperCycleMapPowerPath014SingleDeviceFailure: diagnostic-event=EventPowerPath014SingleDeviceFailure, operation-cycle=DefaultOperationCycle  # Event_Oper_Cycle_Map_Power_Path_014_Single_Device_Failure
  diagnostic event to debounce algorithm mapping EventDebounceMapPowerPath014SingleDeviceFailure: debounce-algorithm=time_based, diagnostic-event=EventPowerPath014SingleDeviceFailure  # EventDebounceMap_Power_Path_014_Single_Device_Failure
package /ZeC/DTC/DTC/Power_Path_013_Single_Device_Failure
  diagnostic trouble code uds Power_Path_013_Single_Device_Failure: dtc-props=Dtc_Props_df05003a, uds-dtc-value=0x00590d
  diagnostic event EventPowerPath013SingleDeviceFailure: aging-allowed=true, event-kind=SWC, prestorage-freeze-frame=false  # Event_Power_Path_013_Single_Device_Failure
  diagnostic event to trouble code uds mapping EventDtcMapPowerPath013SingleDeviceFailure: diagnostic-event=EventPowerPath013SingleDeviceFailure, trouble-code-uds=Power_Path_013_Single_Device_Failure  # Event_Dtc_Map_Power_Path_013_Single_Device_Failure
  diagnostic event to operation cycle mapping EventOperCycleMapPowerPath013SingleDeviceFailure: diagnostic-event=EventPowerPath013SingleDeviceFailure, operation-cycle=DefaultOperationCycle  # Event_Oper_Cycle_Map_Power_Path_013_Single_Device_Failure
  diagnostic event to debounce algorithm mapping EventDebounceMapPowerPath013SingleDeviceFailure: debounce-algorithm=time_based, diagnostic-event=EventPowerPath013SingleDeviceFailure  # EventDebounceMap_Power_Path_013_Single_Device_Failure
package /ZeC/DTC/DTC/Power_Path_015_Single_Device_Failure
  diagnostic trouble code uds Power_Path_015_Single_Device_Failure: dtc-props=Dtc_Props_5337144e, uds-dtc-value=0x00590f
  diagnostic event EventPowerPath015SingleDeviceFailure: aging-allowed=true, event-kind=SWC, prestorage-freeze-frame=false  # Event_Power_Path_015_Single_Device_Failure
  diagnostic event to trouble code uds mapping EventDtcMapPowerPath015SingleDeviceFailure: diagnostic-event=EventPowerPath015SingleDeviceFailure, trouble-code-uds=Power_Path_015_Single_Device_Failure  # Event_Dtc_Map_Power_Path_015_Single_Device_Failure
  diagnostic event to operation cycle mapping EventOperCycleMapPowerPath015SingleDeviceFailure: diagnostic-event=EventPowerPath015SingleDeviceFailure, operation-cycle=DefaultOperationCycle  # Event_Oper_Cycle_Map_Power_Path_015_Single_Device_Failure
  diagnostic event to debounce algorithm mapping EventDebounceMapPowerPath015SingleDeviceFailure: debounce-algorithm=time_based, diagnostic-event=EventPowerPath015SingleDeviceFailure  # EventDebounceMap_Power_Path_015_Single_Device_Failure
package /ZeC/DTC/DTC/Power_Path_035_Single_Device_Failure
  diagnostic trouble code uds Power_Path_035_Single_Device_Failure: dtc-props=Dtc_Props_bc20d391, uds-dtc-value=0x005923
  diagnostic event EventPowerPath035SingleDeviceFailure: aging-allowed=true, event-kind=SWC, prestorage-freeze-frame=false  # Event_Power_Path_035_Single_Device_Failure
  diagnostic event to trouble code uds mapping EventDtcMapPowerPath035SingleDeviceFailure: diagnostic-event=EventPowerPath035SingleDeviceFailure, trouble-code-uds=Power_Path_035_Single_Device_Failure  # Event_Dtc_Map_Power_Path_035_Single_Device_Failure
  diagnostic event to operation cycle mapping EventOperCycleMapPowerPath035SingleDeviceFailure: diagnostic-event=EventPowerPath035SingleDeviceFailure, operation-cycle=DefaultOperationCycle  # Event_Oper_Cycle_Map_Power_Path_035_Single_Device_Failure
  diagnostic event to debounce algorithm mapping EventDebounceMapPowerPath035SingleDeviceFailure: debounce-algorithm=time_based, diagnostic-event=EventPowerPath035SingleDeviceFailure  # EventDebounceMap_Power_Path_035_Single_Device_Failure
package /ZeC/DTC/DTC/Power_Path_034_Single_Device_Failure
  diagnostic trouble code uds Power_Path_034_Single_Device_Failure: dtc-props=Dtc_Props_fa39d9ab, uds-dtc-value=0x005922
  diagnostic event EventPowerPath034SingleDeviceFailure: aging-allowed=true, event-kind=SWC, prestorage-freeze-frame=false  # Event_Power_Path_034_Single_Device_Failure
  diagnostic event to trouble code uds mapping EventDtcMapPowerPath034SingleDeviceFailure: diagnostic-event=EventPowerPath034SingleDeviceFailure, trouble-code-uds=Power_Path_034_Single_Device_Failure  # Event_Dtc_Map_Power_Path_034_Single_Device_Failure
  diagnostic event to operation cycle mapping EventOperCycleMapPowerPath034SingleDeviceFailure: diagnostic-event=EventPowerPath034SingleDeviceFailure, operation-cycle=DefaultOperationCycle  # Event_Oper_Cycle_Map_Power_Path_034_Single_Device_Failure
  diagnostic event to debounce algorithm mapping EventDebounceMapPowerPath034SingleDeviceFailure: debounce-algorithm=time_based, diagnostic-event=EventPowerPath034SingleDeviceFailure  # EventDebounceMap_Power_Path_034_Single_Device_Failure
package /ZeC/DTC/DTC/Power_Path_037_Single_Device_Failure
  diagnostic trouble code uds Power_Path_037_Single_Device_Failure: dtc-props=Dtc_Props_f307e94c, uds-dtc-value=0x005925
  diagnostic event EventPowerPath037SingleDeviceFailure: aging-allowed=true, event-kind=SWC, prestorage-freeze-frame=false  # Event_Power_Path_037_Single_Device_Failure
  diagnostic event to trouble code uds mapping EventDtcMapPowerPath037SingleDeviceFailure: diagnostic-event=EventPowerPath037SingleDeviceFailure, trouble-code-uds=Power_Path_037_Single_Device_Failure  # Event_Dtc_Map_Power_Path_037_Single_Device_Failure
  diagnostic event to operation cycle mapping EventOperCycleMapPowerPath037SingleDeviceFailure: diagnostic-event=EventPowerPath037SingleDeviceFailure, operation-cycle=DefaultOperationCycle  # Event_Oper_Cycle_Map_Power_Path_037_Single_Device_Failure
  diagnostic event to debounce algorithm mapping EventDebounceMapPowerPath037SingleDeviceFailure: debounce-algorithm=time_based, diagnostic-event=EventPowerPath037SingleDeviceFailure  # EventDebounceMap_Power_Path_037_Single_Device_Failure
package /ZeC/DTC/DTC/Power_Path_036_Single_Device_Failure
  diagnostic trouble code uds Power_Path_036_Single_Device_Failure: dtc-props=Dtc_Props_b51ee376, uds-dtc-value=0x005924
  diagnostic event EventPowerPath036SingleDeviceFailure: aging-allowed=true, event-kind=SWC, prestorage-freeze-frame=false  # Event_Power_Path_036_Single_Device_Failure
  diagnostic event to trouble code uds mapping EventDtcMapPowerPath036SingleDeviceFailure: diagnostic-event=EventPowerPath036SingleDeviceFailure, trouble-code-uds=Power_Path_036_Single_Device_Failure  # Event_Dtc_Map_Power_Path_036_Single_Device_Failure
  diagnostic event to operation cycle mapping EventOperCycleMapPowerPath036SingleDeviceFailure: diagnostic-event=EventPowerPath036SingleDeviceFailure, operation-cycle=DefaultOperationCycle  # Event_Oper_Cycle_Map_Power_Path_036_Single_Device_Failure
  diagnostic event to debounce algorithm mapping EventDebounceMapPowerPath036SingleDeviceFailure: debounce-algorithm=time_based, diagnostic-event=EventPowerPath036SingleDeviceFailure  # EventDebounceMap_Power_Path_036_Single_Device_Failure
package /ZeC/DTC/DTC/Power_Path_033_Single_Device_Failure
  diagnostic trouble code uds Power_Path_033_Single_Device_Failure: dtc-props=Dtc_Props_3012c7e5, uds-dtc-value=0x005921
  diagnostic event EventPowerPath033SingleDeviceFailure: aging-allowed=true, event-kind=SWC, prestorage-freeze-frame=false  # Event_Power_Path_033_Single_Device_Failure
  diagnostic event to trouble code uds mapping EventDtcMapPowerPath033SingleDeviceFailure: diagnostic-event=EventPowerPath033SingleDeviceFailure, trouble-code-uds=Power_Path_033_Single_Device_Failure  # Event_Dtc_Map_Power_Path_033_Single_Device_Failure
  diagnostic event to operation cycle mapping EventOperCycleMapPowerPath033SingleDeviceFailure: diagnostic-event=EventPowerPath033SingleDeviceFailure, operation-cycle=DefaultOperationCycle  # Event_Oper_Cycle_Map_Power_Path_033_Single_Device_Failure
  diagnostic event to debounce algorithm mapping EventDebounceMapPowerPath033SingleDeviceFailure: debounce-algorithm=time_based, diagnostic-event=EventPowerPath033SingleDeviceFailure  # EventDebounceMap_Power_Path_033_Single_Device_Failure
package /ZeC/DTC/DTC/Power_Path_032_Single_Device_Failure
  diagnostic trouble code uds Power_Path_032_Single_Device_Failure: dtc-props=Dtc_Props_760bcddf, uds-dtc-value=0x005920
  diagnostic event EventPowerPath032SingleDeviceFailure: aging-allowed=true, event-kind=SWC, prestorage-freeze-frame=false  # Event_Power_Path_032_Single_Device_Failure
  diagnostic event to trouble code uds mapping EventDtcMapPowerPath032SingleDeviceFailure: diagnostic-event=EventPowerPath032SingleDeviceFailure, trouble-code-uds=Power_Path_032_Single_Device_Failure  # Event_Dtc_Map_Power_Path_032_Single_Device_Failure
  diagnostic event to operation cycle mapping EventOperCycleMapPowerPath032SingleDeviceFailure: diagnostic-event=EventPowerPath032SingleDeviceFailure, operation-cycle=DefaultOperationCycle  # Event_Oper_Cycle_Map_Power_Path_032_Single_Device_Failure
  diagnostic event to debounce algorithm mapping EventDebounceMapPowerPath032SingleDeviceFailure: debounce-algorithm=time_based, diagnostic-event=EventPowerPath032SingleDeviceFailure  # EventDebounceMap_Power_Path_032_Single_Device_Failure
package /ZeC/DTC/DTC/Power_Path_039_Single_Device_Failure
  diagnostic trouble code uds Power_Path_039_Single_Device_Failure: dtc-props=Dtc_Props_7f35fd38, uds-dtc-value=0x005927
  diagnostic event EventPowerPath039SingleDeviceFailure: aging-allowed=true, event-kind=SWC, prestorage-freeze-frame=false  # Event_Power_Path_039_Single_Device_Failure
  diagnostic event to trouble code uds mapping EventDtcMapPowerPath039SingleDeviceFailure: diagnostic-event=EventPowerPath039SingleDeviceFailure, trouble-code-uds=Power_Path_039_Single_Device_Failure  # Event_Dtc_Map_Power_Path_039_Single_Device_Failure
  diagnostic event to operation cycle mapping EventOperCycleMapPowerPath039SingleDeviceFailure: diagnostic-event=EventPowerPath039SingleDeviceFailure, operation-cycle=DefaultOperationCycle  # Event_Oper_Cycle_Map_Power_Path_039_Single_Device_Failure
  diagnostic event to debounce algorithm mapping EventDebounceMapPowerPath039SingleDeviceFailure: debounce-algorithm=time_based, diagnostic-event=EventPowerPath039SingleDeviceFailure  # EventDebounceMap_Power_Path_039_Single_Device_Failure
package /ZeC/DTC/DTC/Power_Path_038_Single_Device_Failure
  diagnostic trouble code uds Power_Path_038_Single_Device_Failure: dtc-props=Dtc_Props_392cf702, uds-dtc-value=0x005926
  diagnostic event EventPowerPath038SingleDeviceFailure: aging-allowed=true, event-kind=SWC, prestorage-freeze-frame=false  # Event_Power_Path_038_Single_Device_Failure
  diagnostic event to trouble code uds mapping EventDtcMapPowerPath038SingleDeviceFailure: diagnostic-event=EventPowerPath038SingleDeviceFailure, trouble-code-uds=Power_Path_038_Single_Device_Failure  # Event_Dtc_Map_Power_Path_038_Single_Device_Failure
  diagnostic event to operation cycle mapping EventOperCycleMapPowerPath038SingleDeviceFailure: diagnostic-event=EventPowerPath038SingleDeviceFailure, operation-cycle=DefaultOperationCycle  # Event_Oper_Cycle_Map_Power_Path_038_Single_Device_Failure
  diagnostic event to debounce algorithm mapping EventDebounceMapPowerPath038SingleDeviceFailure: debounce-algorithm=time_based, diagnostic-event=EventPowerPath038SingleDeviceFailure  # EventDebounceMap_Power_Path_038_Single_Device_Failure
package /ZeC/DTC/DTC/Power_Path_041_Single_Device_Failure
  diagnostic trouble code uds Power_Path_041_Single_Device_Failure: dtc-props=Dtc_Props_6d499cf6, uds-dtc-value=0x005929
  diagnostic event EventPowerPath041SingleDeviceFailure: aging-allowed=true, event-kind=SWC, prestorage-freeze-frame=false  # Event_Power_Path_041_Single_Device_Failure
  diagnostic event to trouble code uds mapping EventDtcMapPowerPath041SingleDeviceFailure: diagnostic-event=EventPowerPath041SingleDeviceFailure, trouble-code-uds=Power_Path_041_Single_Device_Failure  # Event_Dtc_Map_Power_Path_041_Single_Device_Failure
  diagnostic event to operation cycle mapping EventOperCycleMapPowerPath041SingleDeviceFailure: diagnostic-event=EventPowerPath041SingleDeviceFailure, operation-cycle=DefaultOperationCycle  # Event_Oper_Cycle_Map_Power_Path_041_Single_Device_Failure
  diagnostic event to debounce algorithm mapping EventDebounceMapPowerPath041SingleDeviceFailure: debounce-algorithm=time_based, diagnostic-event=EventPowerPath041SingleDeviceFailure  # EventDebounceMap_Power_Path_041_Single_Device_Failure
package /ZeC/DTC/DTC/Power_Path_040_Single_Device_Failure
  diagnostic trouble code uds Power_Path_040_Single_Device_Failure: dtc-props=Dtc_Props_2b5096cc, uds-dtc-value=0x005928
  diagnostic event EventPowerPath040SingleDeviceFailure: aging-allowed=true, event-kind=SWC, prestorage-freeze-frame=false  # Event_Power_Path_040_Single_Device_Failure
  diagnostic event to trouble code uds mapping EventDtcMapPowerPath040SingleDeviceFailure: diagnostic-event=EventPowerPath040SingleDeviceFailure, trouble-code-uds=Power_Path_040_Single_Device_Failure  # Event_Dtc_Map_Power_Path_040_Single_Device_Failure
  diagnostic event to operation cycle mapping EventOperCycleMapPowerPath040SingleDeviceFailure: diagnostic-event=EventPowerPath040SingleDeviceFailure, operation-cycle=DefaultOperationCycle  # Event_Oper_Cycle_Map_Power_Path_040_Single_Device_Failure
  diagnostic event to debounce algorithm mapping EventDebounceMapPowerPath040SingleDeviceFailure: debounce-algorithm=time_based, diagnostic-event=EventPowerPath040SingleDeviceFailure  # EventDebounceMap_Power_Path_040_Single_Device_Failure
package /ZeC/DTC/DTC/Power_Path_044_Single_Device_Failure
  diagnostic trouble code uds Power_Path_044_Single_Device_Failure: dtc-props=Dtc_Props_81dfb7ec, uds-dtc-value=0x00592c
  diagnostic event EventPowerPath044SingleDeviceFailure: aging-allowed=true, event-kind=SWC, prestorage-freeze-frame=false  # Event_Power_Path_044_Single_Device_Failure
  diagnostic event to trouble code uds mapping EventDtcMapPowerPath044SingleDeviceFailure: diagnostic-event=EventPowerPath044SingleDeviceFailure, trouble-code-uds=Power_Path_044_Single_Device_Failure  # Event_Dtc_Map_Power_Path_044_Single_Device_Failure
  diagnostic event to operation cycle mapping EventOperCycleMapPowerPath044SingleDeviceFailure: diagnostic-event=EventPowerPath044SingleDeviceFailure, operation-cycle=DefaultOperationCycle  # Event_Oper_Cycle_Map_Power_Path_044_Single_Device_Failure
  diagnostic event to debounce algorithm mapping EventDebounceMapPowerPath044SingleDeviceFailure: debounce-algorithm=time_based, diagnostic-event=EventPowerPath044SingleDeviceFailure  # EventDebounceMap_Power_Path_044_Single_Device_Failure
package /ZeC/DTC/DTC/Power_Path_043_Single_Device_Failure
  diagnostic trouble code uds Power_Path_043_Single_Device_Failure: dtc-props=Dtc_Props_c7c6bdd6, uds-dtc-value=0x00592b
  diagnostic event EventPowerPath043SingleDeviceFailure: aging-allowed=true, event-kind=SWC, prestorage-freeze-frame=false  # Event_Power_Path_043_Single_Device_Failure
  diagnostic event to trouble code uds mapping EventDtcMapPowerPath043SingleDeviceFailure: diagnostic-event=EventPowerPath043SingleDeviceFailure, trouble-code-uds=Power_Path_043_Single_Device_Failure  # Event_Dtc_Map_Power_Path_043_Single_Device_Failure
  diagnostic event to operation cycle mapping EventOperCycleMapPowerPath043SingleDeviceFailure: diagnostic-event=EventPowerPath043SingleDeviceFailure, operation-cycle=DefaultOperationCycle  # Event_Oper_Cycle_Map_Power_Path_043_Single_Device_Failure
  diagnostic event to debounce algorithm mapping EventDebounceMapPowerPath043SingleDeviceFailure: debounce-algorithm=time_based, diagnostic-event=EventPowerPath043SingleDeviceFailure  # EventDebounceMap_Power_Path_043_Single_Device_Failure
package /ZeC/DTC/DTC/Power_Path_046_Single_Device_Failure
  diagnostic trouble code uds Power_Path_046_Single_Device_Failure: dtc-props=Dtc_Props_cef88d31, uds-dtc-value=0x00592e
  diagnostic event EventPowerPath046SingleDeviceFailure: aging-allowed=true, event-kind=SWC, prestorage-freeze-frame=false  # Event_Power_Path_046_Single_Device_Failure
  diagnostic event to trouble code uds mapping EventDtcMapPowerPath046SingleDeviceFailure: diagnostic-event=EventPowerPath046SingleDeviceFailure, trouble-code-uds=Power_Path_046_Single_Device_Failure  # Event_Dtc_Map_Power_Path_046_Single_Device_Failure
  diagnostic event to operation cycle mapping EventOperCycleMapPowerPath046SingleDeviceFailure: diagnostic-event=EventPowerPath046SingleDeviceFailure, operation-cycle=DefaultOperationCycle  # Event_Oper_Cycle_Map_Power_Path_046_Single_Device_Failure
  diagnostic event to debounce algorithm mapping EventDebounceMapPowerPath046SingleDeviceFailure: debounce-algorithm=time_based, diagnostic-event=EventPowerPath046SingleDeviceFailure  # EventDebounceMap_Power_Path_046_Single_Device_Failure
package /ZeC/DTC/DTC/Power_Path_045_Single_Device_Failure
  diagnostic trouble code uds Power_Path_045_Single_Device_Failure: dtc-props=Dtc_Props_88e1870b, uds-dtc-value=0x00592d
  diagnostic event EventPowerPath045SingleDeviceFailure: aging-allowed=true, event-kind=SWC, prestorage-freeze-frame=false  # Event_Power_Path_045_Single_Device_Failure
  diagnostic event to trouble code uds mapping EventDtcMapPowerPath045SingleDeviceFailure: diagnostic-event=EventPowerPath045SingleDeviceFailure, trouble-code-uds=Power_Path_045_Single_Device_Failure  # Event_Dtc_Map_Power_Path_045_Single_Device_Failure
  diagnostic event to operation cycle mapping EventOperCycleMapPowerPath045SingleDeviceFailure: diagnostic-event=EventPowerPath045SingleDeviceFailure, operation-cycle=DefaultOperationCycle  # Event_Oper_Cycle_Map_Power_Path_045_Single_Device_Failure
  diagnostic event to debounce algorithm mapping EventDebounceMapPowerPath045SingleDeviceFailure: debounce-algorithm=time_based, diagnostic-event=EventPowerPath045SingleDeviceFailure  # EventDebounceMap_Power_Path_045_Single_Device_Failure
package /ZeC/DTC/DTC/Power_Path_042_Single_Device_Failure
  diagnostic trouble code uds Power_Path_042_Single_Device_Failure: dtc-props=Dtc_Props_deda398, uds-dtc-value=0x00592a
  diagnostic event EventPowerPath042SingleDeviceFailure: aging-allowed=true, event-kind=SWC, prestorage-freeze-frame=false  # Event_Power_Path_042_Single_Device_Failure
  diagnostic event to trouble code uds mapping EventDtcMapPowerPath042SingleDeviceFailure: diagnostic-event=EventPowerPath042SingleDeviceFailure, trouble-code-uds=Power_Path_042_Single_Device_Failure  # Event_Dtc_Map_Power_Path_042_Single_Device_Failure
  diagnostic event to operation cycle mapping EventOperCycleMapPowerPath042SingleDeviceFailure: diagnostic-event=EventPowerPath042SingleDeviceFailure, operation-cycle=DefaultOperationCycle  # Event_Oper_Cycle_Map_Power_Path_042_Single_Device_Failure
  diagnostic event to debounce algorithm mapping EventDebounceMapPowerPath042SingleDeviceFailure: debounce-algorithm=time_based, diagnostic-event=EventPowerPath042SingleDeviceFailure  # EventDebounceMap_Power_Path_042_Single_Device_Failure
package /ZeC/DTC/DTC/Power_Path_047_Single_Device_Failure
  diagnostic trouble code uds Power_Path_047_Single_Device_Failure: dtc-props=Dtc_Props_4d3937f, uds-dtc-value=0x00592f
  diagnostic event EventPowerPath047SingleDeviceFailure: aging-allowed=true, event-kind=SWC, prestorage-freeze-frame=false  # Event_Power_Path_047_Single_Device_Failure
  diagnostic event to trouble code uds mapping EventDtcMapPowerPath047SingleDeviceFailure: diagnostic-event=EventPowerPath047SingleDeviceFailure, trouble-code-uds=Power_Path_047_Single_Device_Failure  # Event_Dtc_Map_Power_Path_047_Single_Device_Failure
  diagnostic event to operation cycle mapping EventOperCycleMapPowerPath047SingleDeviceFailure: diagnostic-event=EventPowerPath047SingleDeviceFailure, operation-cycle=DefaultOperationCycle  # Event_Oper_Cycle_Map_Power_Path_047_Single_Device_Failure
  diagnostic event to debounce algorithm mapping EventDebounceMapPowerPath047SingleDeviceFailure: debounce-algorithm=time_based, diagnostic-event=EventPowerPath047SingleDeviceFailure  # EventDebounceMap_Power_Path_047_Single_Device_Failure
package /ZeC/DTC/DTC/Power_Path_018_Single_Device_Failure
  diagnostic trouble code uds Power_Path_018_Single_Device_Failure: dtc-props=Dtc_Props_6b979e22, uds-dtc-value=0x005912
  diagnostic event EventPowerPath018SingleDeviceFailure: aging-allowed=true, event-kind=SWC, prestorage-freeze-frame=false  # Event_Power_Path_018_Single_Device_Failure
  diagnostic event to trouble code uds mapping EventDtcMapPowerPath018SingleDeviceFailure: diagnostic-event=EventPowerPath018SingleDeviceFailure, trouble-code-uds=Power_Path_018_Single_Device_Failure  # Event_Dtc_Map_Power_Path_018_Single_Device_Failure
  diagnostic event to operation cycle mapping EventOperCycleMapPowerPath018SingleDeviceFailure: diagnostic-event=EventPowerPath018SingleDeviceFailure, operation-cycle=DefaultOperationCycle  # Event_Oper_Cycle_Map_Power_Path_018_Single_Device_Failure
  diagnostic event to debounce algorithm mapping EventDebounceMapPowerPath018SingleDeviceFailure: debounce-algorithm=time_based, diagnostic-event=EventPowerPath018SingleDeviceFailure  # EventDebounceMap_Power_Path_018_Single_Device_Failure
package /ZeC/DTC/DTC/Power_Path_017_Single_Device_Failure
  diagnostic trouble code uds Power_Path_017_Single_Device_Failure: dtc-props=Dtc_Props_a1bc806c, uds-dtc-value=0x005911
  diagnostic event EventPowerPath017SingleDeviceFailure: aging-allowed=true, event-kind=SWC, prestorage-freeze-frame=false  # Event_Power_Path_017_Single_Device_Failure
  diagnostic event to trouble code uds mapping EventDtcMapPowerPath017SingleDeviceFailure: diagnostic-event=EventPowerPath017SingleDeviceFailure, trouble-code-uds=Power_Path_017_Single_Device_Failure  # Event_Dtc_Map_Power_Path_017_Single_Device_Failure
  diagnostic event to operation cycle mapping EventOperCycleMapPowerPath017SingleDeviceFailure: diagnostic-event=EventPowerPath017SingleDeviceFailure, operation-cycle=DefaultOperationCycle  # Event_Oper_Cycle_Map_Power_Path_017_Single_Device_Failure
  diagnostic event to debounce algorithm mapping EventDebounceMapPowerPath017SingleDeviceFailure: debounce-algorithm=time_based, diagnostic-event=EventPowerPath017SingleDeviceFailure  # EventDebounceMap_Power_Path_017_Single_Device_Failure
package /ZeC/DTC/DTC/Power_Path_020_Single_Device_Failure
  diagnostic trouble code uds Power_Path_020_Single_Device_Failure: dtc-props=Dtc_Props_24b0a4ff, uds-dtc-value=0x005914
  diagnostic event EventPowerPath020SingleDeviceFailure: aging-allowed=true, event-kind=SWC, prestorage-freeze-frame=false  # Event_Power_Path_020_Single_Device_Failure
  diagnostic event to trouble code uds mapping EventDtcMapPowerPath020SingleDeviceFailure: diagnostic-event=EventPowerPath020SingleDeviceFailure, trouble-code-uds=Power_Path_020_Single_Device_Failure  # Event_Dtc_Map_Power_Path_020_Single_Device_Failure
  diagnostic event to operation cycle mapping EventOperCycleMapPowerPath020SingleDeviceFailure: diagnostic-event=EventPowerPath020SingleDeviceFailure, operation-cycle=DefaultOperationCycle  # Event_Oper_Cycle_Map_Power_Path_020_Single_Device_Failure
  diagnostic event to debounce algorithm mapping EventDebounceMapPowerPath020SingleDeviceFailure: debounce-algorithm=time_based, diagnostic-event=EventPowerPath020SingleDeviceFailure  # EventDebounceMap_Power_Path_020_Single_Device_Failure
package /ZeC/DTC/DTC/Power_Path_019_Single_Device_Failure
  diagnostic trouble code uds Power_Path_019_Single_Device_Failure: dtc-props=Dtc_Props_2d8e9418, uds-dtc-value=0x005913
  diagnostic event EventPowerPath019SingleDeviceFailure: aging-allowed=true, event-kind=SWC, prestorage-freeze-frame=false  # Event_Power_Path_019_Single_Device_Failure
  diagnostic event to trouble code uds mapping EventDtcMapPowerPath019SingleDeviceFailure: diagnostic-event=EventPowerPath019SingleDeviceFailure, trouble-code-uds=Power_Path_019_Single_Device_Failure  # Event_Dtc_Map_Power_Path_019_Single_Device_Failure
  diagnostic event to operation cycle mapping EventOperCycleMapPowerPath019SingleDeviceFailure: diagnostic-event=EventPowerPath019SingleDeviceFailure, operation-cycle=DefaultOperationCycle  # Event_Oper_Cycle_Map_Power_Path_019_Single_Device_Failure
  diagnostic event to debounce algorithm mapping EventDebounceMapPowerPath019SingleDeviceFailure: debounce-algorithm=time_based, diagnostic-event=EventPowerPath019SingleDeviceFailure  # EventDebounceMap_Power_Path_019_Single_Device_Failure
package /ZeC/DTC/DTC/Power_Path_016_Single_Device_Failure
  diagnostic trouble code uds Power_Path_016_Single_Device_Failure: dtc-props=Dtc_Props_e7a58a56, uds-dtc-value=0x005910
  diagnostic event EventPowerPath016SingleDeviceFailure: aging-allowed=true, event-kind=SWC, prestorage-freeze-frame=false  # Event_Power_Path_016_Single_Device_Failure
  diagnostic event to trouble code uds mapping EventDtcMapPowerPath016SingleDeviceFailure: diagnostic-event=EventPowerPath016SingleDeviceFailure, trouble-code-uds=Power_Path_016_Single_Device_Failure  # Event_Dtc_Map_Power_Path_016_Single_Device_Failure
  diagnostic event to operation cycle mapping EventOperCycleMapPowerPath016SingleDeviceFailure: diagnostic-event=EventPowerPath016SingleDeviceFailure, operation-cycle=DefaultOperationCycle  # Event_Oper_Cycle_Map_Power_Path_016_Single_Device_Failure
  diagnostic event to debounce algorithm mapping EventDebounceMapPowerPath016SingleDeviceFailure: debounce-algorithm=time_based, diagnostic-event=EventPowerPath016SingleDeviceFailure  # EventDebounceMap_Power_Path_016_Single_Device_Failure
package /ZeC/DTC/DTC/Power_Path_025_Single_Device_Failure
  diagnostic trouble code uds Power_Path_025_Single_Device_Failure: dtc-props=Dtc_Props_fce7db7f, uds-dtc-value=0x005919
  diagnostic event EventPowerPath025SingleDeviceFailure: aging-allowed=true, event-kind=SWC, prestorage-freeze-frame=false  # Event_Power_Path_025_Single_Device_Failure
  diagnostic event to trouble code uds mapping EventDtcMapPowerPath025SingleDeviceFailure: diagnostic-event=EventPowerPath025SingleDeviceFailure, trouble-code-uds=Power_Path_025_Single_Device_Failure  # Event_Dtc_Map_Power_Path_025_Single_Device_Failure
  diagnostic event to operation cycle mapping EventOperCycleMapPowerPath025SingleDeviceFailure: diagnostic-event=EventPowerPath025SingleDeviceFailure, operation-cycle=DefaultOperationCycle  # Event_Oper_Cycle_Map_Power_Path_025_Single_Device_Failure
  diagnostic event to debounce algorithm mapping EventDebounceMapPowerPath025SingleDeviceFailure: debounce-algorithm=time_based, diagnostic-event=EventPowerPath025SingleDeviceFailure  # EventDebounceMap_Power_Path_025_Single_Device_Failure
package /ZeC/DTC/DTC/Power_Path_022_Single_Device_Failure
  diagnostic trouble code uds Power_Path_022_Single_Device_Failure: dtc-props=Dtc_Props_a882b08b, uds-dtc-value=0x005916
  diagnostic event EventPowerPath022SingleDeviceFailure: aging-allowed=true, event-kind=SWC, prestorage-freeze-frame=false  # Event_Power_Path_022_Single_Device_Failure
  diagnostic event to trouble code uds mapping EventDtcMapPowerPath022SingleDeviceFailure: diagnostic-event=EventPowerPath022SingleDeviceFailure, trouble-code-uds=Power_Path_022_Single_Device_Failure  # Event_Dtc_Map_Power_Path_022_Single_Device_Failure
  diagnostic event to operation cycle mapping EventOperCycleMapPowerPath022SingleDeviceFailure: diagnostic-event=EventPowerPath022SingleDeviceFailure, operation-cycle=DefaultOperationCycle  # Event_Oper_Cycle_Map_Power_Path_022_Single_Device_Failure
  diagnostic event to debounce algorithm mapping EventDebounceMapPowerPath022SingleDeviceFailure: debounce-algorithm=time_based, diagnostic-event=EventPowerPath022SingleDeviceFailure  # EventDebounceMap_Power_Path_022_Single_Device_Failure
package /ZeC/DTC/DTC/Power_Path_021_Single_Device_Failure
  diagnostic trouble code uds Power_Path_021_Single_Device_Failure: dtc-props=Dtc_Props_62a9aec5, uds-dtc-value=0x005915
  diagnostic event EventPowerPath021SingleDeviceFailure: aging-allowed=true, event-kind=SWC, prestorage-freeze-frame=false  # Event_Power_Path_021_Single_Device_Failure
  diagnostic event to trouble code uds mapping EventDtcMapPowerPath021SingleDeviceFailure: diagnostic-event=EventPowerPath021SingleDeviceFailure, trouble-code-uds=Power_Path_021_Single_Device_Failure  # Event_Dtc_Map_Power_Path_021_Single_Device_Failure
  diagnostic event to operation cycle mapping EventOperCycleMapPowerPath021SingleDeviceFailure: diagnostic-event=EventPowerPath021SingleDeviceFailure, operation-cycle=DefaultOperationCycle  # Event_Oper_Cycle_Map_Power_Path_021_Single_Device_Failure
  diagnostic event to debounce algorithm mapping EventDebounceMapPowerPath021SingleDeviceFailure: debounce-algorithm=time_based, diagnostic-event=EventPowerPath021SingleDeviceFailure  # EventDebounceMap_Power_Path_021_Single_Device_Failure
package /ZeC/DTC/DTC/Power_Path_024_Single_Device_Failure
  diagnostic trouble code uds Power_Path_024_Single_Device_Failure: dtc-props=Dtc_Props_bafed145, uds-dtc-value=0x005918
  diagnostic event EventPowerPath024SingleDeviceFailure: aging-allowed=true, event-kind=SWC, prestorage-freeze-frame=false  # Event_Power_Path_024_Single_Device_Failure
  diagnostic event to trouble code uds mapping EventDtcMapPowerPath024SingleDeviceFailure: diagnostic-event=EventPowerPath024SingleDeviceFailure, trouble-code-uds=Power_Path_024_Single_Device_Failure  # Event_Dtc_Map_Power_Path_024_Single_Device_Failure
  diagnostic event to operation cycle mapping EventOperCycleMapPowerPath024SingleDeviceFailure: diagnostic-event=EventPowerPath024SingleDeviceFailure, operation-cycle=DefaultOperationCycle  # Event_Oper_Cycle_Map_Power_Path_024_Single_Device_Failure
  diagnostic event to debounce algorithm mapping EventDebounceMapPowerPath024SingleDeviceFailure: debounce-algorithm=time_based, diagnostic-event=EventPowerPath024SingleDeviceFailure  # EventDebounceMap_Power_Path_024_Single_Device_Failure
package /ZeC/DTC/DTC/Power_Path_023_Single_Device_Failure
  diagnostic trouble code uds Power_Path_023_Single_Device_Failure: dtc-props=Dtc_Props_ee9bbab1, uds-dtc-value=0x005917
  diagnostic event EventPowerPath023SingleDeviceFailure: aging-allowed=true, event-kind=SWC, prestorage-freeze-frame=false  # Event_Power_Path_023_Single_Device_Failure
  diagnostic event to trouble code uds mapping EventDtcMapPowerPath023SingleDeviceFailure: diagnostic-event=EventPowerPath023SingleDeviceFailure, trouble-code-uds=Power_Path_023_Single_Device_Failure  # Event_Dtc_Map_Power_Path_023_Single_Device_Failure
  diagnostic event to operation cycle mapping EventOperCycleMapPowerPath023SingleDeviceFailure: diagnostic-event=EventPowerPath023SingleDeviceFailure, operation-cycle=DefaultOperationCycle  # Event_Oper_Cycle_Map_Power_Path_023_Single_Device_Failure
  diagnostic event to debounce algorithm mapping EventDebounceMapPowerPath023SingleDeviceFailure: debounce-algorithm=time_based, diagnostic-event=EventPowerPath023SingleDeviceFailure  # EventDebounceMap_Power_Path_023_Single_Device_Failure
package /ZeC/DTC/DTC/Power_Path_027_Single_Device_Failure
  diagnostic trouble code uds Power_Path_027_Single_Device_Failure: dtc-props=Dtc_Props_5668fa5f, uds-dtc-value=0x00591b
  diagnostic event EventPowerPath027SingleDeviceFailure: aging-allowed=true, event-kind=SWC, prestorage-freeze-frame=false  # Event_Power_Path_027_Single_Device_Failure
  diagnostic event to trouble code uds mapping EventDtcMapPowerPath027SingleDeviceFailure: diagnostic-event=EventPowerPath027SingleDeviceFailure, trouble-code-uds=Power_Path_027_Single_Device_Failure  # Event_Dtc_Map_Power_Path_027_Single_Device_Failure
  diagnostic event to operation cycle mapping EventOperCycleMapPowerPath027SingleDeviceFailure: diagnostic-event=EventPowerPath027SingleDeviceFailure, operation-cycle=DefaultOperationCycle  # Event_Oper_Cycle_Map_Power_Path_027_Single_Device_Failure
  diagnostic event to debounce algorithm mapping EventDebounceMapPowerPath027SingleDeviceFailure: debounce-algorithm=time_based, diagnostic-event=EventPowerPath027SingleDeviceFailure  # EventDebounceMap_Power_Path_027_Single_Device_Failure
package /ZeC/DTC/DTC/Power_Path_026_Single_Device_Failure
  diagnostic trouble code uds Power_Path_026_Single_Device_Failure: dtc-props=Dtc_Props_9c43e411, uds-dtc-value=0x00591a
  diagnostic event EventPowerPath026SingleDeviceFailure: aging-allowed=true, event-kind=SWC, prestorage-freeze-frame=false  # Event_Power_Path_026_Single_Device_Failure
  diagnostic event to trouble code uds mapping EventDtcMapPowerPath026SingleDeviceFailure: diagnostic-event=EventPowerPath026SingleDeviceFailure, trouble-code-uds=Power_Path_026_Single_Device_Failure  # Event_Dtc_Map_Power_Path_026_Single_Device_Failure
  diagnostic event to operation cycle mapping EventOperCycleMapPowerPath026SingleDeviceFailure: diagnostic-event=EventPowerPath026SingleDeviceFailure, operation-cycle=DefaultOperationCycle  # Event_Oper_Cycle_Map_Power_Path_026_Single_Device_Failure
  diagnostic event to debounce algorithm mapping EventDebounceMapPowerPath026SingleDeviceFailure: debounce-algorithm=time_based, diagnostic-event=EventPowerPath026SingleDeviceFailure  # EventDebounceMap_Power_Path_026_Single_Device_Failure
package /ZeC/DTC/DTC/Power_Path_029_Single_Device_Failure
  diagnostic trouble code uds Power_Path_029_Single_Device_Failure: dtc-props=Dtc_Props_194fc082, uds-dtc-value=0x00591d
  diagnostic event EventPowerPath029SingleDeviceFailure: aging-allowed=true, event-kind=SWC, prestorage-freeze-frame=false  # Event_Power_Path_029_Single_Device_Failure
  diagnostic event to trouble code uds mapping EventDtcMapPowerPath029SingleDeviceFailure: diagnostic-event=EventPowerPath029SingleDeviceFailure, trouble-code-uds=Power_Path_029_Single_Device_Failure  # Event_Dtc_Map_Power_Path_029_Single_Device_Failure
  diagnostic event to operation cycle mapping EventOperCycleMapPowerPath029SingleDeviceFailure: diagnostic-event=EventPowerPath029SingleDeviceFailure, operation-cycle=DefaultOperationCycle  # Event_Oper_Cycle_Map_Power_Path_029_Single_Device_Failure
  diagnostic event to debounce algorithm mapping EventDebounceMapPowerPath029SingleDeviceFailure: debounce-algorithm=time_based, diagnostic-event=EventPowerPath029SingleDeviceFailure  # EventDebounceMap_Power_Path_029_Single_Device_Failure
package /ZeC/DTC/DTC/Power_Path_028_Single_Device_Failure
  diagnostic trouble code uds Power_Path_028_Single_Device_Failure: dtc-props=Dtc_Props_1071f065, uds-dtc-value=0x00591c
  diagnostic event EventPowerPath028SingleDeviceFailure: aging-allowed=true, event-kind=SWC, prestorage-freeze-frame=false  # Event_Power_Path_028_Single_Device_Failure
  diagnostic event to trouble code uds mapping EventDtcMapPowerPath028SingleDeviceFailure: diagnostic-event=EventPowerPath028SingleDeviceFailure, trouble-code-uds=Power_Path_028_Single_Device_Failure  # Event_Dtc_Map_Power_Path_028_Single_Device_Failure
  diagnostic event to operation cycle mapping EventOperCycleMapPowerPath028SingleDeviceFailure: diagnostic-event=EventPowerPath028SingleDeviceFailure, operation-cycle=DefaultOperationCycle  # Event_Oper_Cycle_Map_Power_Path_028_Single_Device_Failure
  diagnostic event to debounce algorithm mapping EventDebounceMapPowerPath028SingleDeviceFailure: debounce-algorithm=time_based, diagnostic-event=EventPowerPath028SingleDeviceFailure  # EventDebounceMap_Power_Path_028_Single_Device_Failure
package /ZeC/DTC/DTC/Power_Path_031_Single_Device_Failure
  diagnostic trouble code uds Power_Path_031_Single_Device_Failure: dtc-props=Dtc_Props_957dd4f6, uds-dtc-value=0x00591f
  diagnostic event EventPowerPath031SingleDeviceFailure: aging-allowed=true, event-kind=SWC, prestorage-freeze-frame=false  # Event_Power_Path_031_Single_Device_Failure
  diagnostic event to trouble code uds mapping EventDtcMapPowerPath031SingleDeviceFailure: diagnostic-event=EventPowerPath031SingleDeviceFailure, trouble-code-uds=Power_Path_031_Single_Device_Failure  # Event_Dtc_Map_Power_Path_031_Single_Device_Failure
  diagnostic event to operation cycle mapping EventOperCycleMapPowerPath031SingleDeviceFailure: diagnostic-event=EventPowerPath031SingleDeviceFailure, operation-cycle=DefaultOperationCycle  # Event_Oper_Cycle_Map_Power_Path_031_Single_Device_Failure
  diagnostic event to debounce algorithm mapping EventDebounceMapPowerPath031SingleDeviceFailure: debounce-algorithm=time_based, diagnostic-event=EventPowerPath031SingleDeviceFailure  # EventDebounceMap_Power_Path_031_Single_Device_Failure
package /ZeC/DTC/DTC/Power_Path_030_Single_Device_Failure
  diagnostic trouble code uds Power_Path_030_Single_Device_Failure: dtc-props=Dtc_Props_5f56cab8, uds-dtc-value=0x00591e
  diagnostic event EventPowerPath030SingleDeviceFailure: aging-allowed=true, event-kind=SWC, prestorage-freeze-frame=false  # Event_Power_Path_030_Single_Device_Failure
  diagnostic event to trouble code uds mapping EventDtcMapPowerPath030SingleDeviceFailure: diagnostic-event=EventPowerPath030SingleDeviceFailure, trouble-code-uds=Power_Path_030_Single_Device_Failure  # Event_Dtc_Map_Power_Path_030_Single_Device_Failure
  diagnostic event to operation cycle mapping EventOperCycleMapPowerPath030SingleDeviceFailure: diagnostic-event=EventPowerPath030SingleDeviceFailure, operation-cycle=DefaultOperationCycle  # Event_Oper_Cycle_Map_Power_Path_030_Single_Device_Failure
  diagnostic event to debounce algorithm mapping EventDebounceMapPowerPath030SingleDeviceFailure: debounce-algorithm=time_based, diagnostic-event=EventPowerPath030SingleDeviceFailure  # EventDebounceMap_Power_Path_030_Single_Device_Failure
package /ZeC/DTC/DTC/Ethernet_databus_Port3_1000BT_no_communication
  diagnostic trouble code uds Ethernet_databus_Port3_1000BT_no_communication: dtc-props=Dtc_Props_9585e9dc, uds-dtc-value=0x033105  # Ethernet_databus_Port3 1000BT_no_communication
  diagnostic event EventEthernetDatabusPort31000BTNoCommunication: aging-allowed=true, event-kind=SWC, prestorage-freeze-frame=false  # Event_Ethernet_databus_Port3 1000BT_no_communication
  diagnostic event to trouble code uds mapping EventDtcMapEthernetDatabusPort31000BTNoCommunication: diagnostic-event=EventEthernetDatabusPort31000BTNoCommunication, trouble-code-uds=Ethernet_databus_Port3_1000BT_no_communication  # Event_Dtc_Map_Ethernet_databus_Port3 1000BT_no_communication
  diagnostic event to operation cycle mapping EventOperCycleMapEthernetDatabusPort31000BTNoCommunication: diagnostic-event=EventEthernetDatabusPort31000BTNoCommunication, operation-cycle=DefaultOperationCycle  # Event_Oper_Cycle_Map_Ethernet_databus_Port3 1000BT_no_communication
  diagnostic event to debounce algorithm mapping EventDebounceMapEthernetDatabusPort31000BTNoCommunication: debounce-algorithm=time_based, diagnostic-event=EventEthernetDatabusPort31000BTNoCommunication  # EventDebounceMap_Ethernet_databus_Port3 1000BT_no_communication
package /ZeC/DTC/DTC/Ethernet_databus_Port1_2500BT_no_communication
  diagnostic trouble code uds Ethernet_databus_Port1_2500BT_no_communication: dtc-props=Dtc_Props_9585e9dc, uds-dtc-value=0x033104  # Ethernet_databus_Port1 2500BT_no_communication
  diagnostic event EventEthernetDatabusPort12500BTNoCommunication: aging-allowed=true, event-kind=SWC, prestorage-freeze-frame=false  # Event_Ethernet_databus_Port1 2500BT_no_communication
  diagnostic event to trouble code uds mapping EventDtcMapEthernetDatabusPort12500BTNoCommunication: diagnostic-event=EventEthernetDatabusPort12500BTNoCommunication, trouble-code-uds=Ethernet_databus_Port1_2500BT_no_communication  # Event_Dtc_Map_Ethernet_databus_Port1 2500BT_no_communication
  diagnostic event to operation cycle mapping EventOperCycleMapEthernetDatabusPort12500BTNoCommunication: diagnostic-event=EventEthernetDatabusPort12500BTNoCommunication, operation-cycle=DefaultOperationCycle  # Event_Oper_Cycle_Map_Ethernet_databus_Port1 2500BT_no_communication
  diagnostic event to debounce algorithm mapping EventDebounceMapEthernetDatabusPort12500BTNoCommunication: debounce-algorithm=time_based, diagnostic-event=EventEthernetDatabusPort12500BTNoCommunication  # EventDebounceMap_Ethernet_databus_Port1 2500BT_no_communication
package /ZeC/DTC/DTC/Ethernet_databus_Port2_1000BT_no_communication
  diagnostic trouble code uds Ethernet_databus_Port2_1000BT_no_communication: dtc-props=Dtc_Props_9585e9dc, uds-dtc-value=0x033103  # Ethernet_databus_Port2 1000BT_no_communication
  diagnostic event EventEthernetDatabusPort21000BTNoCommunication: aging-allowed=true, event-kind=SWC, prestorage-freeze-frame=false  # Event_Ethernet_databus_Port2 1000BT_no_communication
  diagnostic event to trouble code uds mapping EventDtcMapEthernetDatabusPort21000BTNoCommunication: diagnostic-event=EventEthernetDatabusPort21000BTNoCommunication, trouble-code-uds=Ethernet_databus_Port2_1000BT_no_communication  # Event_Dtc_Map_Ethernet_databus_Port2 1000BT_no_communication
  diagnostic event to operation cycle mapping EventOperCycleMapEthernetDatabusPort21000BTNoCommunication: diagnostic-event=EventEthernetDatabusPort21000BTNoCommunication, operation-cycle=DefaultOperationCycle  # Event_Oper_Cycle_Map_Ethernet_databus_Port2 1000BT_no_communication
  diagnostic event to debounce algorithm mapping EventDebounceMapEthernetDatabusPort21000BTNoCommunication: debounce-algorithm=time_based, diagnostic-event=EventEthernetDatabusPort21000BTNoCommunication  # EventDebounceMap_Ethernet_databus_Port2 1000BT_no_communication
package /ZeC/DTC/DTC/Ethernet_databus_Port1_1000BT_no_communication
  diagnostic trouble code uds Ethernet_databus_Port1_1000BT_no_communication: dtc-props=Dtc_Props_9585e9dc, uds-dtc-value=0x033102  # Ethernet_databus_Port1 1000BT_no_communication
  diagnostic event EventEthernetDatabusPort11000BTNoCommunication: aging-allowed=true, event-kind=SWC, prestorage-freeze-frame=false  # Event_Ethernet_databus_Port1 1000BT_no_communication
  diagnostic event to trouble code uds mapping EventDtcMapEthernetDatabusPort11000BTNoCommunication: diagnostic-event=EventEthernetDatabusPort11000BTNoCommunication, trouble-code-uds=Ethernet_databus_Port1_1000BT_no_communication  # Event_Dtc_Map_Ethernet_databus_Port1 1000BT_no_communication
  diagnostic event to operation cycle mapping EventOperCycleMapEthernetDatabusPort11000BTNoCommunication: diagnostic-event=EventEthernetDatabusPort11000BTNoCommunication, operation-cycle=DefaultOperationCycle  # Event_Oper_Cycle_Map_Ethernet_databus_Port1 1000BT_no_communication
  diagnostic event to debounce algorithm mapping EventDebounceMapEthernetDatabusPort11000BTNoCommunication: debounce-algorithm=time_based, diagnostic-event=EventEthernetDatabusPort11000BTNoCommunication  # EventDebounceMap_Ethernet_databus_Port1 1000BT_no_communication
package /ZeC/DTC/DTC/Ethernet_databus_Port1_100BT_no_communication
  diagnostic trouble code uds Ethernet_databus_Port1_100BT_no_communication: dtc-props=Dtc_Props_9585e9dc, uds-dtc-value=0x033101  # Ethernet_databus_Port1 100BT_no_communication
  diagnostic event EventEthernetDatabusPort1100BTNoCommunication: aging-allowed=true, event-kind=SWC, prestorage-freeze-frame=false  # Event_Ethernet_databus_Port1 100BT_no_communication
  diagnostic event to trouble code uds mapping EventDtcMapEthernetDatabusPort1100BTNoCommunication: diagnostic-event=EventEthernetDatabusPort1100BTNoCommunication, trouble-code-uds=Ethernet_databus_Port1_100BT_no_communication  # Event_Dtc_Map_Ethernet_databus_Port1 100BT_no_communication
  diagnostic event to operation cycle mapping EventOperCycleMapEthernetDatabusPort1100BTNoCommunication: diagnostic-event=EventEthernetDatabusPort1100BTNoCommunication, operation-cycle=DefaultOperationCycle  # Event_Oper_Cycle_Map_Ethernet_databus_Port1 100BT_no_communication
  diagnostic event to debounce algorithm mapping EventDebounceMapEthernetDatabusPort1100BTNoCommunication: debounce-algorithm=time_based, diagnostic-event=EventEthernetDatabusPort1100BTNoCommunication  # EventDebounceMap_Ethernet_databus_Port1 100BT_no_communication
package /ZeC/DTC/DTC/Power_Path_005_Over_Load_Failure
  diagnostic trouble code uds Power_Path_005_Over_Load_Failure: dtc-props=Dtc_Props_a4e36e7d, uds-dtc-value=0x005505
  diagnostic event EventPowerPath005OverLoadFailure: aging-allowed=true, event-kind=SWC, prestorage-freeze-frame=false  # Event_Power_Path_005_Over_Load_Failure
  diagnostic event to trouble code uds mapping EventDtcMapPowerPath005OverLoadFailure: diagnostic-event=EventPowerPath005OverLoadFailure, trouble-code-uds=Power_Path_005_Over_Load_Failure  # Event_Dtc_Map_Power_Path_005_Over_Load_Failure
  diagnostic event to operation cycle mapping EventOperCycleMapPowerPath005OverLoadFailure: diagnostic-event=EventPowerPath005OverLoadFailure, operation-cycle=DefaultOperationCycle  # Event_Oper_Cycle_Map_Power_Path_005_Over_Load_Failure
  diagnostic event to debounce algorithm mapping EventDebounceMapPowerPath005OverLoadFailure: debounce-algorithm=time_based, diagnostic-event=EventPowerPath005OverLoadFailure  # EventDebounceMap_Power_Path_005_Over_Load_Failure
package /ZeC/DTC/DTC/Power_Path_137_Single_Device_Failure
  diagnostic trouble code uds Power_Path_137_Single_Device_Failure: dtc-props=Dtc_Props_be4e0142, uds-dtc-value=0x005989
  diagnostic event EventPowerPath137SingleDeviceFailure: aging-allowed=true, event-kind=SWC, prestorage-freeze-frame=false  # Event_Power_Path_137_Single_Device_Failure
  diagnostic event to trouble code uds mapping EventDtcMapPowerPath137SingleDeviceFailure: diagnostic-event=EventPowerPath137SingleDeviceFailure, trouble-code-uds=Power_Path_137_Single_Device_Failure  # Event_Dtc_Map_Power_Path_137_Single_Device_Failure
  diagnostic event to operation cycle mapping EventOperCycleMapPowerPath137SingleDeviceFailure: diagnostic-event=EventPowerPath137SingleDeviceFailure, operation-cycle=DefaultOperationCycle  # Event_Oper_Cycle_Map_Power_Path_137_Single_Device_Failure
  diagnostic event to debounce algorithm mapping EventDebounceMapPowerPath137SingleDeviceFailure: debounce-algorithm=time_based, diagnostic-event=EventPowerPath137SingleDeviceFailure  # EventDebounceMap_Power_Path_137_Single_Device_Failure
package /ZeC/DTC/DTC/Power_Path_004_Over_Load_Failure
  diagnostic trouble code uds Power_Path_004_Over_Load_Failure: dtc-props=Dtc_Props_e2fa6447, uds-dtc-value=0x005504
  diagnostic event EventPowerPath004OverLoadFailure: aging-allowed=true, event-kind=SWC, prestorage-freeze-frame=false  # Event_Power_Path_004_Over_Load_Failure
  diagnostic event to trouble code uds mapping EventDtcMapPowerPath004OverLoadFailure: diagnostic-event=EventPowerPath004OverLoadFailure, trouble-code-uds=Power_Path_004_Over_Load_Failure  # Event_Dtc_Map_Power_Path_004_Over_Load_Failure
  diagnostic event to operation cycle mapping EventOperCycleMapPowerPath004OverLoadFailure: diagnostic-event=EventPowerPath004OverLoadFailure, operation-cycle=DefaultOperationCycle  # Event_Oper_Cycle_Map_Power_Path_004_Over_Load_Failure
  diagnostic event to debounce algorithm mapping EventDebounceMapPowerPath004OverLoadFailure: debounce-algorithm=time_based, diagnostic-event=EventPowerPath004OverLoadFailure  # EventDebounceMap_Power_Path_004_Over_Load_Failure
package /ZeC/DTC/DTC/Power_Path_136_Single_Device_Failure
  diagnostic trouble code uds Power_Path_136_Single_Device_Failure: dtc-props=Dtc_Props_f8570b78, uds-dtc-value=0x005988
  diagnostic event EventPowerPath136SingleDeviceFailure: aging-allowed=true, event-kind=SWC, prestorage-freeze-frame=false  # Event_Power_Path_136_Single_Device_Failure
  diagnostic event to trouble code uds mapping EventDtcMapPowerPath136SingleDeviceFailure: diagnostic-event=EventPowerPath136SingleDeviceFailure, trouble-code-uds=Power_Path_136_Single_Device_Failure  # Event_Dtc_Map_Power_Path_136_Single_Device_Failure
  diagnostic event to operation cycle mapping EventOperCycleMapPowerPath136SingleDeviceFailure: diagnostic-event=EventPowerPath136SingleDeviceFailure, operation-cycle=DefaultOperationCycle  # Event_Oper_Cycle_Map_Power_Path_136_Single_Device_Failure
  diagnostic event to debounce algorithm mapping EventDebounceMapPowerPath136SingleDeviceFailure: debounce-algorithm=time_based, diagnostic-event=EventPowerPath136SingleDeviceFailure  # EventDebounceMap_Power_Path_136_Single_Device_Failure
package /ZeC/DTC/DTC/Power_Path_007_Over_Load_Failure
  diagnostic trouble code uds Power_Path_007_Over_Load_Failure: dtc-props=Dtc_Props_28d17a09, uds-dtc-value=0x005507
  diagnostic event EventPowerPath007OverLoadFailure: aging-allowed=true, event-kind=SWC, prestorage-freeze-frame=false  # Event_Power_Path_007_Over_Load_Failure
  diagnostic event to trouble code uds mapping EventDtcMapPowerPath007OverLoadFailure: diagnostic-event=EventPowerPath007OverLoadFailure, trouble-code-uds=Power_Path_007_Over_Load_Failure  # Event_Dtc_Map_Power_Path_007_Over_Load_Failure
  diagnostic event to operation cycle mapping EventOperCycleMapPowerPath007OverLoadFailure: diagnostic-event=EventPowerPath007OverLoadFailure, operation-cycle=DefaultOperationCycle  # Event_Oper_Cycle_Map_Power_Path_007_Over_Load_Failure
  diagnostic event to debounce algorithm mapping EventDebounceMapPowerPath007OverLoadFailure: debounce-algorithm=time_based, diagnostic-event=EventPowerPath007OverLoadFailure  # EventDebounceMap_Power_Path_007_Over_Load_Failure
package /ZeC/DTC/DTC/Power_Path_006_Over_Load_Failure
  diagnostic trouble code uds Power_Path_006_Over_Load_Failure: dtc-props=Dtc_Props_6ec87033, uds-dtc-value=0x005506
  diagnostic event EventPowerPath006OverLoadFailure: aging-allowed=true, event-kind=SWC, prestorage-freeze-frame=false  # Event_Power_Path_006_Over_Load_Failure
  diagnostic event to trouble code uds mapping EventDtcMapPowerPath006OverLoadFailure: diagnostic-event=EventPowerPath006OverLoadFailure, trouble-code-uds=Power_Path_006_Over_Load_Failure  # Event_Dtc_Map_Power_Path_006_Over_Load_Failure
  diagnostic event to operation cycle mapping EventOperCycleMapPowerPath006OverLoadFailure: diagnostic-event=EventPowerPath006OverLoadFailure, operation-cycle=DefaultOperationCycle  # Event_Oper_Cycle_Map_Power_Path_006_Over_Load_Failure
  diagnostic event to debounce algorithm mapping EventDebounceMapPowerPath006OverLoadFailure: debounce-algorithm=time_based, diagnostic-event=EventPowerPath006OverLoadFailure  # EventDebounceMap_Power_Path_006_Over_Load_Failure
package /ZeC/DTC/DTC/Power_Path_001_Over_Load_Failure
  diagnostic trouble code uds Power_Path_001_Over_Load_Failure: dtc-props=Dtc_Props_67f640d4, uds-dtc-value=0x005501
  diagnostic event EventPowerPath001OverLoadFailure: aging-allowed=true, event-kind=SWC, prestorage-freeze-frame=false  # Event_Power_Path_001_Over_Load_Failure
  diagnostic event to trouble code uds mapping EventDtcMapPowerPath001OverLoadFailure: diagnostic-event=EventPowerPath001OverLoadFailure, trouble-code-uds=Power_Path_001_Over_Load_Failure  # Event_Dtc_Map_Power_Path_001_Over_Load_Failure
  diagnostic event to operation cycle mapping EventOperCycleMapPowerPath001OverLoadFailure: diagnostic-event=EventPowerPath001OverLoadFailure, operation-cycle=DefaultOperationCycle  # Event_Oper_Cycle_Map_Power_Path_001_Over_Load_Failure
  diagnostic event to debounce algorithm mapping EventDebounceMapPowerPath001OverLoadFailure: debounce-algorithm=time_based, diagnostic-event=EventPowerPath001OverLoadFailure  # EventDebounceMap_Power_Path_001_Over_Load_Failure
package /ZeC/DTC/DTC/Power_Path_133_Single_Device_Failure
  diagnostic trouble code uds Power_Path_133_Single_Device_Failure: dtc-props=Dtc_Props_200074f8, uds-dtc-value=0x005985
  diagnostic event EventPowerPath133SingleDeviceFailure: aging-allowed=true, event-kind=SWC, prestorage-freeze-frame=false  # Event_Power_Path_133_Single_Device_Failure
  diagnostic event to trouble code uds mapping EventDtcMapPowerPath133SingleDeviceFailure: diagnostic-event=EventPowerPath133SingleDeviceFailure, trouble-code-uds=Power_Path_133_Single_Device_Failure  # Event_Dtc_Map_Power_Path_133_Single_Device_Failure
  diagnostic event to operation cycle mapping EventOperCycleMapPowerPath133SingleDeviceFailure: diagnostic-event=EventPowerPath133SingleDeviceFailure, operation-cycle=DefaultOperationCycle  # Event_Oper_Cycle_Map_Power_Path_133_Single_Device_Failure
  diagnostic event to debounce algorithm mapping EventDebounceMapPowerPath133SingleDeviceFailure: debounce-algorithm=time_based, diagnostic-event=EventPowerPath133SingleDeviceFailure  # EventDebounceMap_Power_Path_133_Single_Device_Failure
package /ZeC/DTC/DTC/Power_Path_132_Single_Device_Failure
  diagnostic trouble code uds Power_Path_132_Single_Device_Failure: dtc-props=Dtc_Props_66197ec2, uds-dtc-value=0x005984
  diagnostic event EventPowerPath132SingleDeviceFailure: aging-allowed=true, event-kind=SWC, prestorage-freeze-frame=false  # Event_Power_Path_132_Single_Device_Failure
  diagnostic event to trouble code uds mapping EventDtcMapPowerPath132SingleDeviceFailure: diagnostic-event=EventPowerPath132SingleDeviceFailure, trouble-code-uds=Power_Path_132_Single_Device_Failure  # Event_Dtc_Map_Power_Path_132_Single_Device_Failure
  diagnostic event to operation cycle mapping EventOperCycleMapPowerPath132SingleDeviceFailure: diagnostic-event=EventPowerPath132SingleDeviceFailure, operation-cycle=DefaultOperationCycle  # Event_Oper_Cycle_Map_Power_Path_132_Single_Device_Failure
  diagnostic event to debounce algorithm mapping EventDebounceMapPowerPath132SingleDeviceFailure: debounce-algorithm=time_based, diagnostic-event=EventPowerPath132SingleDeviceFailure  # EventDebounceMap_Power_Path_132_Single_Device_Failure
package /ZeC/DTC/DTC/Power_Path_003_Over_Load_Failure
  diagnostic trouble code uds Power_Path_003_Over_Load_Failure: dtc-props=Dtc_Props_ebc454a0, uds-dtc-value=0x005503
  diagnostic event EventPowerPath003OverLoadFailure: aging-allowed=true, event-kind=SWC, prestorage-freeze-frame=false  # Event_Power_Path_003_Over_Load_Failure
  diagnostic event to trouble code uds mapping EventDtcMapPowerPath003OverLoadFailure: diagnostic-event=EventPowerPath003OverLoadFailure, trouble-code-uds=Power_Path_003_Over_Load_Failure  # Event_Dtc_Map_Power_Path_003_Over_Load_Failure
  diagnostic event to operation cycle mapping EventOperCycleMapPowerPath003OverLoadFailure: diagnostic-event=EventPowerPath003OverLoadFailure, operation-cycle=DefaultOperationCycle  # Event_Oper_Cycle_Map_Power_Path_003_Over_Load_Failure
  diagnostic event to debounce algorithm mapping EventDebounceMapPowerPath003OverLoadFailure: debounce-algorithm=time_based, diagnostic-event=EventPowerPath003OverLoadFailure  # EventDebounceMap_Power_Path_003_Over_Load_Failure
package /ZeC/DTC/DTC/Power_Path_135_Single_Device_Failure
  diagnostic trouble code uds Power_Path_135_Single_Device_Failure: dtc-props=Dtc_Props_ac32608c, uds-dtc-value=0x005987
  diagnostic event EventPowerPath135SingleDeviceFailure: aging-allowed=true, event-kind=SWC, prestorage-freeze-frame=false  # Event_Power_Path_135_Single_Device_Failure
  diagnostic event to trouble code uds mapping EventDtcMapPowerPath135SingleDeviceFailure: diagnostic-event=EventPowerPath135SingleDeviceFailure, trouble-code-uds=Power_Path_135_Single_Device_Failure  # Event_Dtc_Map_Power_Path_135_Single_Device_Failure
  diagnostic event to operation cycle mapping EventOperCycleMapPowerPath135SingleDeviceFailure: diagnostic-event=EventPowerPath135SingleDeviceFailure, operation-cycle=DefaultOperationCycle  # Event_Oper_Cycle_Map_Power_Path_135_Single_Device_Failure
  diagnostic event to debounce algorithm mapping EventDebounceMapPowerPath135SingleDeviceFailure: debounce-algorithm=time_based, diagnostic-event=EventPowerPath135SingleDeviceFailure  # EventDebounceMap_Power_Path_135_Single_Device_Failure
package /ZeC/DTC/DTC/Power_Path_002_Over_Load_Failure
  diagnostic trouble code uds Power_Path_002_Over_Load_Failure: dtc-props=Dtc_Props_addd5e9a, uds-dtc-value=0x005502
  diagnostic event EventPowerPath002OverLoadFailure: aging-allowed=true, event-kind=SWC, prestorage-freeze-frame=false  # Event_Power_Path_002_Over_Load_Failure
  diagnostic event to trouble code uds mapping EventDtcMapPowerPath002OverLoadFailure: diagnostic-event=EventPowerPath002OverLoadFailure, trouble-code-uds=Power_Path_002_Over_Load_Failure  # Event_Dtc_Map_Power_Path_002_Over_Load_Failure
  diagnostic event to operation cycle mapping EventOperCycleMapPowerPath002OverLoadFailure: diagnostic-event=EventPowerPath002OverLoadFailure, operation-cycle=DefaultOperationCycle  # Event_Oper_Cycle_Map_Power_Path_002_Over_Load_Failure
  diagnostic event to debounce algorithm mapping EventDebounceMapPowerPath002OverLoadFailure: debounce-algorithm=time_based, diagnostic-event=EventPowerPath002OverLoadFailure  # EventDebounceMap_Power_Path_002_Over_Load_Failure
package /ZeC/DTC/DTC/Power_Path_134_Single_Device_Failure
  diagnostic trouble code uds Power_Path_134_Single_Device_Failure: dtc-props=Dtc_Props_ea2b6ab6, uds-dtc-value=0x005986
  diagnostic event EventPowerPath134SingleDeviceFailure: aging-allowed=true, event-kind=SWC, prestorage-freeze-frame=false  # Event_Power_Path_134_Single_Device_Failure
  diagnostic event to trouble code uds mapping EventDtcMapPowerPath134SingleDeviceFailure: diagnostic-event=EventPowerPath134SingleDeviceFailure, trouble-code-uds=Power_Path_134_Single_Device_Failure  # Event_Dtc_Map_Power_Path_134_Single_Device_Failure
  diagnostic event to operation cycle mapping EventOperCycleMapPowerPath134SingleDeviceFailure: diagnostic-event=EventPowerPath134SingleDeviceFailure, operation-cycle=DefaultOperationCycle  # Event_Oper_Cycle_Map_Power_Path_134_Single_Device_Failure
  diagnostic event to debounce algorithm mapping EventDebounceMapPowerPath134SingleDeviceFailure: debounce-algorithm=time_based, diagnostic-event=EventPowerPath134SingleDeviceFailure  # EventDebounceMap_Power_Path_134_Single_Device_Failure
package /ZeC/DTC/DTC/Power_Path_138_Single_Device_Failure
  diagnostic trouble code uds Power_Path_138_Single_Device_Failure: dtc-props=Dtc_Props_deea3e2c, uds-dtc-value=0x00598a
  diagnostic event EventPowerPath138SingleDeviceFailure: aging-allowed=true, event-kind=SWC, prestorage-freeze-frame=false  # Event_Power_Path_138_Single_Device_Failure
  diagnostic event to trouble code uds mapping EventDtcMapPowerPath138SingleDeviceFailure: diagnostic-event=EventPowerPath138SingleDeviceFailure, trouble-code-uds=Power_Path_138_Single_Device_Failure  # Event_Dtc_Map_Power_Path_138_Single_Device_Failure
  diagnostic event to operation cycle mapping EventOperCycleMapPowerPath138SingleDeviceFailure: diagnostic-event=EventPowerPath138SingleDeviceFailure, operation-cycle=DefaultOperationCycle  # Event_Oper_Cycle_Map_Power_Path_138_Single_Device_Failure
  diagnostic event to debounce algorithm mapping EventDebounceMapPowerPath138SingleDeviceFailure: debounce-algorithm=time_based, diagnostic-event=EventPowerPath138SingleDeviceFailure  # EventDebounceMap_Power_Path_138_Single_Device_Failure
package /ZeC/DTC/DTC/Power_Path_140_Single_Device_Failure
  diagnostic trouble code uds Power_Path_140_Single_Device_Failure: dtc-props=Dtc_Props_52d82a58, uds-dtc-value=0x00598c
  diagnostic event EventPowerPath140SingleDeviceFailure: aging-allowed=true, event-kind=SWC, prestorage-freeze-frame=false  # Event_Power_Path_140_Single_Device_Failure
  diagnostic event to trouble code uds mapping EventDtcMapPowerPath140SingleDeviceFailure: diagnostic-event=EventPowerPath140SingleDeviceFailure, trouble-code-uds=Power_Path_140_Single_Device_Failure  # Event_Dtc_Map_Power_Path_140_Single_Device_Failure
  diagnostic event to operation cycle mapping EventOperCycleMapPowerPath140SingleDeviceFailure: diagnostic-event=EventPowerPath140SingleDeviceFailure, operation-cycle=DefaultOperationCycle  # Event_Oper_Cycle_Map_Power_Path_140_Single_Device_Failure
  diagnostic event to debounce algorithm mapping EventDebounceMapPowerPath140SingleDeviceFailure: debounce-algorithm=time_based, diagnostic-event=EventPowerPath140SingleDeviceFailure  # EventDebounceMap_Power_Path_140_Single_Device_Failure
package /ZeC/DTC/DTC/Power_Path_139_Single_Device_Failure
  diagnostic trouble code uds Power_Path_139_Single_Device_Failure: dtc-props=Dtc_Props_14c12062, uds-dtc-value=0x00598b
  diagnostic event EventPowerPath139SingleDeviceFailure: aging-allowed=true, event-kind=SWC, prestorage-freeze-frame=false  # Event_Power_Path_139_Single_Device_Failure
  diagnostic event to trouble code uds mapping EventDtcMapPowerPath139SingleDeviceFailure: diagnostic-event=EventPowerPath139SingleDeviceFailure, trouble-code-uds=Power_Path_139_Single_Device_Failure  # Event_Dtc_Map_Power_Path_139_Single_Device_Failure
  diagnostic event to operation cycle mapping EventOperCycleMapPowerPath139SingleDeviceFailure: diagnostic-event=EventPowerPath139SingleDeviceFailure, operation-cycle=DefaultOperationCycle  # Event_Oper_Cycle_Map_Power_Path_139_Single_Device_Failure
  diagnostic event to debounce algorithm mapping EventDebounceMapPowerPath139SingleDeviceFailure: debounce-algorithm=time_based, diagnostic-event=EventPowerPath139SingleDeviceFailure  # EventDebounceMap_Power_Path_139_Single_Device_Failure
package /ZeC/DTC/DTC/Power_Path_009_Over_Load_Failure
  diagnostic trouble code uds Power_Path_009_Over_Load_Failure: dtc-props=Dtc_Props_3aad1bc7, uds-dtc-value=0x005509
  diagnostic event EventPowerPath009OverLoadFailure: aging-allowed=true, event-kind=SWC, prestorage-freeze-frame=false  # Event_Power_Path_009_Over_Load_Failure
  diagnostic event to trouble code uds mapping EventDtcMapPowerPath009OverLoadFailure: diagnostic-event=EventPowerPath009OverLoadFailure, trouble-code-uds=Power_Path_009_Over_Load_Failure  # Event_Dtc_Map_Power_Path_009_Over_Load_Failure
  diagnostic event to operation cycle mapping EventOperCycleMapPowerPath009OverLoadFailure: diagnostic-event=EventPowerPath009OverLoadFailure, operation-cycle=DefaultOperationCycle  # Event_Oper_Cycle_Map_Power_Path_009_Over_Load_Failure
  diagnostic event to debounce algorithm mapping EventDebounceMapPowerPath009OverLoadFailure: debounce-algorithm=time_based, diagnostic-event=EventPowerPath009OverLoadFailure  # EventDebounceMap_Power_Path_009_Over_Load_Failure
package /ZeC/DTC/DTC/Power_Path_008_Over_Load_Failure
  diagnostic trouble code uds Power_Path_008_Over_Load_Failure: dtc-props=Dtc_Props_7cb411fd, uds-dtc-value=0x005508
  diagnostic event EventPowerPath008OverLoadFailure: aging-allowed=true, event-kind=SWC, prestorage-freeze-frame=false  # Event_Power_Path_008_Over_Load_Failure
  diagnostic event to trouble code uds mapping EventDtcMapPowerPath008OverLoadFailure: diagnostic-event=EventPowerPath008OverLoadFailure, trouble-code-uds=Power_Path_008_Over_Load_Failure  # Event_Dtc_Map_Power_Path_008_Over_Load_Failure
  diagnostic event to operation cycle mapping EventOperCycleMapPowerPath008OverLoadFailure: diagnostic-event=EventPowerPath008OverLoadFailure, operation-cycle=DefaultOperationCycle  # Event_Oper_Cycle_Map_Power_Path_008_Over_Load_Failure
  diagnostic event to debounce algorithm mapping EventDebounceMapPowerPath008OverLoadFailure: debounce-algorithm=time_based, diagnostic-event=EventPowerPath008OverLoadFailure  # EventDebounceMap_Power_Path_008_Over_Load_Failure
package /ZeC/DTC/DTC/Power_Path_014_Over_Load_Failure
  diagnostic trouble code uds Power_Path_014_Over_Load_Failure: dtc-props=Dtc_Props_991c0a00, uds-dtc-value=0x00550e
  diagnostic event EventPowerPath014OverLoadFailure: aging-allowed=true, event-kind=SWC, prestorage-freeze-frame=false  # Event_Power_Path_014_Over_Load_Failure
  diagnostic event to trouble code uds mapping EventDtcMapPowerPath014OverLoadFailure: diagnostic-event=EventPowerPath014OverLoadFailure, trouble-code-uds=Power_Path_014_Over_Load_Failure  # Event_Dtc_Map_Power_Path_014_Over_Load_Failure
  diagnostic event to operation cycle mapping EventOperCycleMapPowerPath014OverLoadFailure: diagnostic-event=EventPowerPath014OverLoadFailure, operation-cycle=DefaultOperationCycle  # Event_Oper_Cycle_Map_Power_Path_014_Over_Load_Failure
  diagnostic event to debounce algorithm mapping EventDebounceMapPowerPath014OverLoadFailure: debounce-algorithm=time_based, diagnostic-event=EventPowerPath014OverLoadFailure  # EventDebounceMap_Power_Path_014_Over_Load_Failure
package /ZeC/DTC/DTC/Power_Path_013_Over_Load_Failure
  diagnostic trouble code uds Power_Path_013_Over_Load_Failure: dtc-props=Dtc_Props_df05003a, uds-dtc-value=0x00550d
  diagnostic event EventPowerPath013OverLoadFailure: aging-allowed=true, event-kind=SWC, prestorage-freeze-frame=false  # Event_Power_Path_013_Over_Load_Failure
  diagnostic event to trouble code uds mapping EventDtcMapPowerPath013OverLoadFailure: diagnostic-event=EventPowerPath013OverLoadFailure, trouble-code-uds=Power_Path_013_Over_Load_Failure  # Event_Dtc_Map_Power_Path_013_Over_Load_Failure
  diagnostic event to operation cycle mapping EventOperCycleMapPowerPath013OverLoadFailure: diagnostic-event=EventPowerPath013OverLoadFailure, operation-cycle=DefaultOperationCycle  # Event_Oper_Cycle_Map_Power_Path_013_Over_Load_Failure
  diagnostic event to debounce algorithm mapping EventDebounceMapPowerPath013OverLoadFailure: debounce-algorithm=time_based, diagnostic-event=EventPowerPath013OverLoadFailure  # EventDebounceMap_Power_Path_013_Over_Load_Failure
package /ZeC/DTC/DTC/Power_Path_015_Over_Load_Failure
  diagnostic trouble code uds Power_Path_015_Over_Load_Failure: dtc-props=Dtc_Props_5337144e, uds-dtc-value=0x00550f
  diagnostic event EventPowerPath015OverLoadFailure: aging-allowed=true, event-kind=SWC, prestorage-freeze-frame=false  # Event_Power_Path_015_Over_Load_Failure
  diagnostic event to trouble code uds mapping EventDtcMapPowerPath015OverLoadFailure: diagnostic-event=EventPowerPath015OverLoadFailure, trouble-code-uds=Power_Path_015_Over_Load_Failure  # Event_Dtc_Map_Power_Path_015_Over_Load_Failure
  diagnostic event to operation cycle mapping EventOperCycleMapPowerPath015OverLoadFailure: diagnostic-event=EventPowerPath015OverLoadFailure, operation-cycle=DefaultOperationCycle  # Event_Oper_Cycle_Map_Power_Path_015_Over_Load_Failure
  diagnostic event to debounce algorithm mapping EventDebounceMapPowerPath015OverLoadFailure: debounce-algorithm=time_based, diagnostic-event=EventPowerPath015OverLoadFailure  # EventDebounceMap_Power_Path_015_Over_Load_Failure
package /ZeC/DTC/DTC/Power_Path_142_Single_Device_Failure
  diagnostic trouble code uds Power_Path_142_Single_Device_Failure: dtc-props=Dtc_Props_1dff1085, uds-dtc-value=0x00598e
  diagnostic event EventPowerPath142SingleDeviceFailure: aging-allowed=true, event-kind=SWC, prestorage-freeze-frame=false  # Event_Power_Path_142_Single_Device_Failure
  diagnostic event to trouble code uds mapping EventDtcMapPowerPath142SingleDeviceFailure: diagnostic-event=EventPowerPath142SingleDeviceFailure, trouble-code-uds=Power_Path_142_Single_Device_Failure  # Event_Dtc_Map_Power_Path_142_Single_Device_Failure
  diagnostic event to operation cycle mapping EventOperCycleMapPowerPath142SingleDeviceFailure: diagnostic-event=EventPowerPath142SingleDeviceFailure, operation-cycle=DefaultOperationCycle  # Event_Oper_Cycle_Map_Power_Path_142_Single_Device_Failure
  diagnostic event to debounce algorithm mapping EventDebounceMapPowerPath142SingleDeviceFailure: debounce-algorithm=time_based, diagnostic-event=EventPowerPath142SingleDeviceFailure  # EventDebounceMap_Power_Path_142_Single_Device_Failure
package /ZeC/DTC/DTC/Power_Path_010_Over_Load_Failure
  diagnostic trouble code uds Power_Path_010_Over_Load_Failure: dtc-props=Dtc_Props_5a0924a9, uds-dtc-value=0x00550a
  diagnostic event EventPowerPath010OverLoadFailure: aging-allowed=true, event-kind=SWC, prestorage-freeze-frame=false  # Event_Power_Path_010_Over_Load_Failure
  diagnostic event to trouble code uds mapping EventDtcMapPowerPath010OverLoadFailure: diagnostic-event=EventPowerPath010OverLoadFailure, trouble-code-uds=Power_Path_010_Over_Load_Failure  # Event_Dtc_Map_Power_Path_010_Over_Load_Failure
  diagnostic event to operation cycle mapping EventOperCycleMapPowerPath010OverLoadFailure: diagnostic-event=EventPowerPath010OverLoadFailure, operation-cycle=DefaultOperationCycle  # Event_Oper_Cycle_Map_Power_Path_010_Over_Load_Failure
  diagnostic event to debounce algorithm mapping EventDebounceMapPowerPath010OverLoadFailure: debounce-algorithm=time_based, diagnostic-event=EventPowerPath010OverLoadFailure  # EventDebounceMap_Power_Path_010_Over_Load_Failure
package /ZeC/DTC/DTC/Power_Path_141_Single_Device_Failure
  diagnostic trouble code uds Power_Path_141_Single_Device_Failure: dtc-props=Dtc_Props_5be61abf, uds-dtc-value=0x00598d
  diagnostic event EventPowerPath141SingleDeviceFailure: aging-allowed=true, event-kind=SWC, prestorage-freeze-frame=false  # Event_Power_Path_141_Single_Device_Failure
  diagnostic event to trouble code uds mapping EventDtcMapPowerPath141SingleDeviceFailure: diagnostic-event=EventPowerPath141SingleDeviceFailure, trouble-code-uds=Power_Path_141_Single_Device_Failure  # Event_Dtc_Map_Power_Path_141_Single_Device_Failure
  diagnostic event to operation cycle mapping EventOperCycleMapPowerPath141SingleDeviceFailure: diagnostic-event=EventPowerPath141SingleDeviceFailure, operation-cycle=DefaultOperationCycle  # Event_Oper_Cycle_Map_Power_Path_141_Single_Device_Failure
  diagnostic event to debounce algorithm mapping EventDebounceMapPowerPath141SingleDeviceFailure: debounce-algorithm=time_based, diagnostic-event=EventPowerPath141SingleDeviceFailure  # EventDebounceMap_Power_Path_141_Single_Device_Failure
package /ZeC/DTC/DTC/Power_Path_012_Over_Load_Failure
  diagnostic trouble code uds Power_Path_012_Over_Load_Failure: dtc-props=Dtc_Props_d63b30dd, uds-dtc-value=0x00550c
  diagnostic event EventPowerPath012OverLoadFailure: aging-allowed=true, event-kind=SWC, prestorage-freeze-frame=false  # Event_Power_Path_012_Over_Load_Failure
  diagnostic event to trouble code uds mapping EventDtcMapPowerPath012OverLoadFailure: diagnostic-event=EventPowerPath012OverLoadFailure, trouble-code-uds=Power_Path_012_Over_Load_Failure  # Event_Dtc_Map_Power_Path_012_Over_Load_Failure
  diagnostic event to operation cycle mapping EventOperCycleMapPowerPath012OverLoadFailure: diagnostic-event=EventPowerPath012OverLoadFailure, operation-cycle=DefaultOperationCycle  # Event_Oper_Cycle_Map_Power_Path_012_Over_Load_Failure
  diagnostic event to debounce algorithm mapping EventDebounceMapPowerPath012OverLoadFailure: debounce-algorithm=time_based, diagnostic-event=EventPowerPath012OverLoadFailure  # EventDebounceMap_Power_Path_012_Over_Load_Failure
package /ZeC/DTC/DTC/Power_Path_143_Single_Device_Failure
  diagnostic trouble code uds Power_Path_143_Single_Device_Failure: dtc-props=Dtc_Props_d7d40ecb, uds-dtc-value=0x00598f
  diagnostic event EventPowerPath143SingleDeviceFailure: aging-allowed=true, event-kind=SWC, prestorage-freeze-frame=false  # Event_Power_Path_143_Single_Device_Failure
  diagnostic event to trouble code uds mapping EventDtcMapPowerPath143SingleDeviceFailure: diagnostic-event=EventPowerPath143SingleDeviceFailure, trouble-code-uds=Power_Path_143_Single_Device_Failure  # Event_Dtc_Map_Power_Path_143_Single_Device_Failure
  diagnostic event to operation cycle mapping EventOperCycleMapPowerPath143SingleDeviceFailure: diagnostic-event=EventPowerPath143SingleDeviceFailure, operation-cycle=DefaultOperationCycle  # Event_Oper_Cycle_Map_Power_Path_143_Single_Device_Failure
  diagnostic event to debounce algorithm mapping EventDebounceMapPowerPath143SingleDeviceFailure: debounce-algorithm=time_based, diagnostic-event=EventPowerPath143SingleDeviceFailure  # EventDebounceMap_Power_Path_143_Single_Device_Failure
package /ZeC/DTC/DTC/Power_Path_011_Over_Load_Failure
  diagnostic trouble code uds Power_Path_011_Over_Load_Failure: dtc-props=Dtc_Props_90223ae7, uds-dtc-value=0x00550b
  diagnostic event EventPowerPath011OverLoadFailure: aging-allowed=true, event-kind=SWC, prestorage-freeze-frame=false  # Event_Power_Path_011_Over_Load_Failure
  diagnostic event to trouble code uds mapping EventDtcMapPowerPath011OverLoadFailure: diagnostic-event=EventPowerPath011OverLoadFailure, trouble-code-uds=Power_Path_011_Over_Load_Failure  # Event_Dtc_Map_Power_Path_011_Over_Load_Failure
  diagnostic event to operation cycle mapping EventOperCycleMapPowerPath011OverLoadFailure: diagnostic-event=EventPowerPath011OverLoadFailure, operation-cycle=DefaultOperationCycle  # Event_Oper_Cycle_Map_Power_Path_011_Over_Load_Failure
  diagnostic event to debounce algorithm mapping EventDebounceMapPowerPath011OverLoadFailure: debounce-algorithm=time_based, diagnostic-event=EventPowerPath011OverLoadFailure  # EventDebounceMap_Power_Path_011_Over_Load_Failure
