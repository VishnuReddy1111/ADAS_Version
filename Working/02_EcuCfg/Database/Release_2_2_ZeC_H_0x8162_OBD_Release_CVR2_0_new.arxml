[part 7 of 19: packages /ZeC/DTC/DTC/LIN_8_Slave_3_NoCommunication to /ZeC/DTC/DTC/Power_Path_093_Load_Failure]
AUTOSAR XML (schema 00047)
package /ZeC/DTC/DTC/LIN_8_Slave_3_NoCommunication
  diagnostic trouble code uds LIN_8_Slave_3_NoCommunication: dtc-props=Dtc_Props_358996c7, uds-dtc-value=0x030803  # LIN 8 Slave 3_NoCommunication
  diagnostic event EventLIN8Slave3NoCommunication: aging-allowed=true, event-kind=SWC, prestorage-freeze-frame=false  # Event_LIN 8 Slave 3_NoCommunication
  diagnostic event to trouble code uds mapping EventDtcMapLIN8Slave3NoCommunication: diagnostic-event=EventLIN8Slave3NoCommunication, trouble-code-uds=LIN_8_Slave_3_NoCommunication  # Event_Dtc_Map_LIN 8 Slave 3_NoCommunication
  diagnostic event to operation cycle mapping EventOperCycleMapLIN8Slave3NoCommunication: diagnostic-event=EventLIN8Slave3NoCommunication, operation-cycle=DefaultOperationCycle  # Event_Oper_Cycle_Map_LIN 8 Slave 3_NoCommunication
  diagnostic event to debounce algorithm mapping EventDebounceMapLIN8Slave3NoCommunication: debounce-algorithm=counter_based, diagnostic-event=EventLIN8Slave3NoCommunication  # EventDebounceMap_LIN 8 Slave 3_NoCommunication
package /ZeC/DTC/DTC/Power_Path_007_Load_Failure
  diagnostic trouble code uds Power_Path_007_Load_Failure: dtc-props=Dtc_Props_28d17a09, uds-dtc-value=0x005407
  diagnostic event EventPowerPath007LoadFailure: aging-allowed=true, event-kind=SWC, prestorage-freeze-frame=false  # Event_Power_Path_007_Load_Failure
  diagnostic event to trouble code uds mapping EventDtcMapPowerPath007LoadFailure: diagnostic-event=EventPowerPath007LoadFailure, trouble-code-uds=Power_Path_007_Load_Failure  # Event_Dtc_Map_Power_Path_007_Load_Failure
  diagnostic event to operation cycle mapping EventOperCycleMapPowerPath007LoadFailure: diagnostic-event=EventPowerPath007LoadFailure, operation-cycle=DefaultOperationCycle  # Event_Oper_Cycle_Map_Power_Path_007_Load_Failure
  diagnostic event to debounce algorithm mapping EventDebounceMapPowerPath007LoadFailure: debounce-algorithm=time_based, diagnostic-event=EventPowerPath007LoadFailure  # EventDebounceMap_Power_Path_007_Load_Failure
package /ZeC/DTC/DTC/Power_Path_002_Load_Failure
  diagnostic trouble code uds Power_Path_002_Load_Failure: dtc-props=Dtc_Props_addd5e9a, uds-dtc-value=0x005402
  diagnostic event EventPowerPath002LoadFailure: aging-allowed=true, event-kind=SWC, prestorage-freeze-frame=false  # Event_Power_Path_002_Load_Failure
  diagnostic event to trouble code uds mapping EventDtcMapPowerPath002LoadFailure: diagnostic-event=EventPowerPath002LoadFailure, trouble-code-uds=Power_Path_002_Load_Failure  # Event_Dtc_Map_Power_Path_002_Load_Failure
  diagnostic event to operation cycle mapping EventOperCycleMapPowerPath002LoadFailure: diagnostic-event=EventPowerPath002LoadFailure, operation-cycle=DefaultOperationCycle  # Event_Oper_Cycle_Map_Power_Path_002_Load_Failure
  diagnostic event to debounce algorithm mapping EventDebounceMapPowerPath002LoadFailure: debounce-algorithm=time_based, diagnostic-event=EventPowerPath002LoadFailure  # EventDebounceMap_Power_Path_002_Load_Failure
package /ZeC/DTC/DTC/Power_Path_134_Cable_Protection_Failure
  diagnostic trouble code uds Power_Path_134_Cable_Protection_Failure: dtc-props=Dtc_Props_ea2b6ab6, uds-dtc-value=0x005886
  diagnostic event EventPowerPath134CableProtectionFailure: aging-allowed=true, event-kind=SWC, prestorage-freeze-frame=false  # Event_Power_Path_134_Cable_Protection_Failure
  diagnostic event to trouble code uds mapping EventDtcMapPowerPath134CableProtectionFailure: diagnostic-event=EventPowerPath134CableProtectionFailure, trouble-code-uds=Power_Path_134_Cable_Protection_Failure  # Event_Dtc_Map_Power_Path_134_Cable_Protection_Failure
  diagnostic event to operation cycle mapping EventOperCycleMapPowerPath134CableProtectionFailure: diagnostic-event=EventPowerPath134CableProtectionFailure, operation-cycle=DefaultOperationCycle  # Event_Oper_Cycle_Map_Power_Path_134_Cable_Protection_Failure
  diagnostic event to debounce algorithm mapping EventDebounceMapPowerPath134CableProtectionFailure: debounce-algorithm=time_based, diagnostic-event=EventPowerPath134CableProtectionFailure  # EventDebounceMap_Power_Path_134_Cable_Protection_Failure
package /ZeC/DTC/DTC/Power_Path_001_Load_Failure
  diagnostic trouble code uds Power_Path_001_Load_Failure: dtc-props=Dtc_Props_67f640d4, uds-dtc-value=0x005401
  diagnostic event EventPowerPath001LoadFailure: aging-allowed=true, event-kind=SWC, prestorage-freeze-frame=false  # Event_Power_Path_001_Load_Failure
  diagnostic event to trouble code uds mapping EventDtcMapPowerPath001LoadFailure: diagnostic-event=EventPowerPath001LoadFailure, trouble-code-uds=Power_Path_001_Load_Failure  # Event_Dtc_Map_Power_Path_001_Load_Failure
  diagnostic event to operation cycle mapping EventOperCycleMapPowerPath001LoadFailure: diagnostic-event=EventPowerPath001LoadFailure, operation-cycle=DefaultOperationCycle  # Event_Oper_Cycle_Map_Power_Path_001_Load_Failure
  diagnostic event to debounce algorithm mapping EventDebounceMapPowerPath001LoadFailure: debounce-algorithm=time_based, diagnostic-event=EventPowerPath001LoadFailure  # EventDebounceMap_Power_Path_001_Load_Failure
package /ZeC/DTC/DTC/Power_Path_133_Cable_Protection_Failure
  diagnostic trouble code uds Power_Path_133_Cable_Protection_Failure: dtc-props=Dtc_Props_200074f8, uds-dtc-value=0x005885
  diagnostic event EventPowerPath133CableProtectionFailure: aging-allowed=true, event-kind=SWC, prestorage-freeze-frame=false  # Event_Power_Path_133_Cable_Protection_Failure
  diagnostic event to trouble code uds mapping EventDtcMapPowerPath133CableProtectionFailure: diagnostic-event=EventPowerPath133CableProtectionFailure, trouble-code-uds=Power_Path_133_Cable_Protection_Failure  # Event_Dtc_Map_Power_Path_133_Cable_Protection_Failure
  diagnostic event to operation cycle mapping EventOperCycleMapPowerPath133CableProtectionFailure: diagnostic-event=EventPowerPath133CableProtectionFailure, operation-cycle=DefaultOperationCycle  # Event_Oper_Cycle_Map_Power_Path_133_Cable_Protection_Failure
  diagnostic event to debounce algorithm mapping EventDebounceMapPowerPath133CableProtectionFailure: debounce-algorithm=time_based, diagnostic-event=EventPowerPath133CableProtectionFailure  # EventDebounceMap_Power_Path_133_Cable_Protection_Failure
package /ZeC/DTC/DTC/Power_Path_004_Load_Failure
  diagnostic trouble code uds Power_Path_004_Load_Failure: dtc-props=Dtc_Props_e2fa6447, uds-dtc-value=0x005404
  diagnostic event EventPowerPath004LoadFailure: aging-allowed=true, event-kind=SWC, prestorage-freeze-frame=false  # Event_Power_Path_004_Load_Failure
  diagnostic event to trouble code uds mapping EventDtcMapPowerPath004LoadFailure: diagnostic-event=EventPowerPath004LoadFailure, trouble-code-uds=Power_Path_004_Load_Failure  # Event_Dtc_Map_Power_Path_004_Load_Failure
  diagnostic event to operation cycle mapping EventOperCycleMapPowerPath004LoadFailure: diagnostic-event=EventPowerPath004LoadFailure, operation-cycle=DefaultOperationCycle  # Event_Oper_Cycle_Map_Power_Path_004_Load_Failure
  diagnostic event to debounce algorithm mapping EventDebounceMapPowerPath004LoadFailure: debounce-algorithm=time_based, diagnostic-event=EventPowerPath004LoadFailure  # EventDebounceMap_Power_Path_004_Load_Failure
package /ZeC/DTC/DTC/Power_Path_136_Cable_Protection_Failure
  diagnostic trouble code uds Power_Path_136_Cable_Protection_Failure: dtc-props=Dtc_Props_f8570b78, uds-dtc-value=0x005888
  diagnostic event EventPowerPath136CableProtectionFailure: aging-allowed=true, event-kind=SWC, prestorage-freeze-frame=false  # Event_Power_Path_136_Cable_Protection_Failure
  diagnostic event to trouble code uds mapping EventDtcMapPowerPath136CableProtectionFailure: diagnostic-event=EventPowerPath136CableProtectionFailure, trouble-code-uds=Power_Path_136_Cable_Protection_Failure  # Event_Dtc_Map_Power_Path_136_Cable_Protection_Failure
  diagnostic event to operation cycle mapping EventOperCycleMapPowerPath136CableProtectionFailure: diagnostic-event=EventPowerPath136CableProtectionFailure, operation-cycle=DefaultOperationCycle  # Event_Oper_Cycle_Map_Power_Path_136_Cable_Protection_Failure
  diagnostic event to debounce algorithm mapping EventDebounceMapPowerPath136CableProtectionFailure: debounce-algorithm=time_based, diagnostic-event=EventPowerPath136CableProtectionFailure  # EventDebounceMap_Power_Path_136_Cable_Protection_Failure
package /ZeC/DTC/DTC/Power_Path_003_Load_Failure
  diagnostic trouble code uds Power_Path_003_Load_Failure: dtc-props=Dtc_Props_ebc454a0, uds-dtc-value=0x005403
  diagnostic event EventPowerPath003LoadFailure: aging-allowed=true, event-kind=SWC, prestorage-freeze-frame=false  # Event_Power_Path_003_Load_Failure
  diagnostic event to trouble code uds mapping EventDtcMapPowerPath003LoadFailure: diagnostic-event=EventPowerPath003LoadFailure, trouble-code-uds=Power_Path_003_Load_Failure  # Event_Dtc_Map_Power_Path_003_Load_Failure
  diagnostic event to operation cycle mapping EventOperCycleMapPowerPath003LoadFailure: diagnostic-event=EventPowerPath003LoadFailure, operation-cycle=DefaultOperationCycle  # Event_Oper_Cycle_Map_Power_Path_003_Load_Failure
  diagnostic event to debounce algorithm mapping EventDebounceMapPowerPath003LoadFailure: debounce-algorithm=time_based, diagnostic-event=EventPowerPath003LoadFailure  # EventDebounceMap_Power_Path_003_Load_Failure
package /ZeC/DTC/DTC/Power_Path_135_Cable_Protection_Failure
  diagnostic trouble code uds Power_Path_135_Cable_Protection_Failure: dtc-props=Dtc_Props_ac32608c, uds-dtc-value=0x005887
  diagnostic event EventPowerPath135CableProtectionFailure: aging-allowed=true, event-kind=SWC, prestorage-freeze-frame=false  # Event_Power_Path_135_Cable_Protection_Failure
  diagnostic event to trouble code uds mapping EventDtcMapPowerPath135CableProtectionFailure: diagnostic-event=EventPowerPath135CableProtectionFailure, trouble-code-uds=Power_Path_135_Cable_Protection_Failure  # Event_Dtc_Map_Power_Path_135_Cable_Protection_Failure
  diagnostic event to operation cycle mapping EventOperCycleMapPowerPath135CableProtectionFailure: diagnostic-event=EventPowerPath135CableProtectionFailure, operation-cycle=DefaultOperationCycle  # Event_Oper_Cycle_Map_Power_Path_135_Cable_Protection_Failure
  diagnostic event to debounce algorithm mapping EventDebounceMapPowerPath135CableProtectionFailure: debounce-algorithm=time_based, diagnostic-event=EventPowerPath135CableProtectionFailure  # EventDebounceMap_Power_Path_135_Cable_Protection_Failure
package /ZeC/DTC/DTC/Power_Path_139_Cable_Protection_Failure
  diagnostic trouble code uds Power_Path_139_Cable_Protection_Failure: dtc-props=Dtc_Props_14c12062, uds-dtc-value=0x00588b
  diagnostic event EventPowerPath139CableProtectionFailure: aging-allowed=true, event-kind=SWC, prestorage-freeze-frame=false  # Event_Power_Path_139_Cable_Protection_Failure
  diagnostic event to trouble code uds mapping EventDtcMapPowerPath139CableProtectionFailure: diagnostic-event=EventPowerPath139CableProtectionFailure, trouble-code-uds=Power_Path_139_Cable_Protection_Failure  # Event_Dtc_Map_Power_Path_139_Cable_Protection_Failure
  diagnostic event to operation cycle mapping EventOperCycleMapPowerPath139CableProtectionFailure: diagnostic-event=EventPowerPath139CableProtectionFailure, operation-cycle=DefaultOperationCycle  # Event_Oper_Cycle_Map_Power_Path_139_Cable_Protection_Failure
  diagnostic event to debounce algorithm mapping EventDebounceMapPowerPath139CableProtectionFailure: debounce-algorithm=time_based, diagnostic-event=EventPowerPath139CableProtectionFailure  # EventDebounceMap_Power_Path_139_Cable_Protection_Failure
package /ZeC/DTC/DTC/Power_Path_138_Cable_Protection_Failure
  diagnostic trouble code uds Power_Path_138_Cable_Protection_Failure: dtc-props=Dtc_Props_deea3e2c, uds-dtc-value=0x00588a
  diagnostic event EventPowerPath138CableProtectionFailure: aging-allowed=true, event-kind=SWC, prestorage-freeze-frame=false  # Event_Power_Path_138_Cable_Protection_Failure
  diagnostic event to trouble code uds mapping EventDtcMapPowerPath138CableProtectionFailure: diagnostic-event=EventPowerPath138CableProtectionFailure, trouble-code-uds=Power_Path_138_Cable_Protection_Failure  # Event_Dtc_Map_Power_Path_138_Cable_Protection_Failure
  diagnostic event to operation cycle mapping EventOperCycleMapPowerPath138CableProtectionFailure: diagnostic-event=EventPowerPath138CableProtectionFailure, operation-cycle=DefaultOperationCycle  # Event_Oper_Cycle_Map_Power_Path_138_Cable_Protection_Failure
  diagnostic event to debounce algorithm mapping EventDebounceMapPowerPath138CableProtectionFailure: debounce-algorithm=time_based, diagnostic-event=EventPowerPath138CableProtectionFailure  # EventDebounceMap_Power_Path_138_Cable_Protection_Failure
package /ZeC/DTC/DTC/Power_Path_141_Cable_Protection_Failure
  diagnostic trouble code uds Power_Path_141_Cable_Protection_Failure: dtc-props=Dtc_Props_5be61abf, uds-dtc-value=0x00588d
  diagnostic event EventPowerPath141CableProtectionFailure: aging-allowed=true, event-kind=SWC, prestorage-freeze-frame=false  # Event_Power_Path_141_Cable_Protection_Failure
  diagnostic event to trouble code uds mapping EventDtcMapPowerPath141CableProtectionFailure: diagnostic-event=EventPowerPath141CableProtectionFailure, trouble-code-uds=Power_Path_141_Cable_Protection_Failure  # Event_Dtc_Map_Power_Path_141_Cable_Protection_Failure
  diagnostic event to operation cycle mapping EventOperCycleMapPowerPath141CableProtectionFailure: diagnostic-event=EventPowerPath141CableProtectionFailure, operation-cycle=DefaultOperationCycle  # Event_Oper_Cycle_Map_Power_Path_141_Cable_Protection_Failure
  diagnostic event to debounce algorithm mapping EventDebounceMapPowerPath141CableProtectionFailure: debounce-algorithm=time_based, diagnostic-event=EventPowerPath141CableProtectionFailure  # EventDebounceMap_Power_Path_141_Cable_Protection_Failure
package /ZeC/DTC/DTC/Power_Path_140_Cable_Protection_Failure
  diagnostic trouble code uds Power_Path_140_Cable_Protection_Failure: dtc-props=Dtc_Props_52d82a58, uds-dtc-value=0x00588c
  diagnostic event EventPowerPath140CableProtectionFailure: aging-allowed=true, event-kind=SWC, prestorage-freeze-frame=false  # Event_Power_Path_140_Cable_Protection_Failure
  diagnostic event to trouble code uds mapping EventDtcMapPowerPath140CableProtectionFailure: diagnostic-event=EventPowerPath140CableProtectionFailure, trouble-code-uds=Power_Path_140_Cable_Protection_Failure  # Event_Dtc_Map_Power_Path_140_Cable_Protection_Failure
  diagnostic event to operation cycle mapping EventOperCycleMapPowerPath140CableProtectionFailure: diagnostic-event=EventPowerPath140CableProtectionFailure, operation-cycle=DefaultOperationCycle  # Event_Oper_Cycle_Map_Power_Path_140_Cable_Protection_Failure
  diagnostic event to debounce algorithm mapping EventDebounceMapPowerPath140CableProtectionFailure: debounce-algorithm=time_based, diagnostic-event=EventPowerPath140CableProtectionFailure  # EventDebounceMap_Power_Path_140_Cable_Protection_Failure
package /ZeC/DTC/DTC/Power_Path_009_Load_Failure
  diagnostic trouble code uds Power_Path_009_Load_Failure: dtc-props=Dtc_Props_3aad1bc7, uds-dtc-value=0x005409
  diagnostic event EventPowerPath009LoadFailure: aging-allowed=true, event-kind=SWC, prestorage-freeze-frame=false  # Event_Power_Path_009_Load_Failure
  diagnostic event to trouble code uds mapping EventDtcMapPowerPath009LoadFailure: diagnostic-event=EventPowerPath009LoadFailure, trouble-code-uds=Power_Path_009_Load_Failure  # Event_Dtc_Map_Power_Path_009_Load_Failure
  diagnostic event to operation cycle mapping EventOperCycleMapPowerPath009LoadFailure: diagnostic-event=EventPowerPath009LoadFailure, operation-cycle=DefaultOperationCycle  # Event_Oper_Cycle_Map_Power_Path_009_Load_Failure
  diagnostic event to debounce algorithm mapping EventDebounceMapPowerPath009LoadFailure: debounce-algorithm=time_based, diagnostic-event=EventPowerPath009LoadFailure  # EventDebounceMap_Power_Path_009_Load_Failure
package /ZeC/DTC/DTC/LIN_8_Slave_7_NoCommunication
  diagnostic trouble code uds LIN_8_Slave_7_NoCommunication: dtc-props=Dtc_Props_358996c7, uds-dtc-value=0x03080b  # LIN 8 Slave 7_NoCommunication
  diagnostic event EventLIN8Slave7NoCommunication: aging-allowed=true, event-kind=SWC, prestorage-freeze-frame=false  # Event_LIN 8 Slave 7_NoCommunication
  diagnostic event to trouble code uds mapping EventDtcMapLIN8Slave7NoCommunication: diagnostic-event=EventLIN8Slave7NoCommunication, trouble-code-uds=LIN_8_Slave_7_NoCommunication  # Event_Dtc_Map_LIN 8 Slave 7_NoCommunication
  diagnostic event to operation cycle mapping EventOperCycleMapLIN8Slave7NoCommunication: diagnostic-event=EventLIN8Slave7NoCommunication, operation-cycle=DefaultOperationCycle  # Event_Oper_Cycle_Map_LIN 8 Slave 7_NoCommunication
  diagnostic event to debounce algorithm mapping EventDebounceMapLIN8Slave7NoCommunication: debounce-algorithm=counter_based, diagnostic-event=EventLIN8Slave7NoCommunication  # EventDebounceMap_LIN 8 Slave 7_NoCommunication
package /ZeC/DTC/DTC/Power_Path_015_Load_Failure
  diagnostic trouble code uds Power_Path_015_Load_Failure: dtc-props=Dtc_Props_5337144e, uds-dtc-value=0x00540f
  diagnostic event EventPowerPath015LoadFailure: aging-allowed=true, event-kind=SWC, prestorage-freeze-frame=false  # Event_Power_Path_015_Load_Failure
  diagnostic event to trouble code uds mapping EventDtcMapPowerPath015LoadFailure: diagnostic-event=EventPowerPath015LoadFailure, trouble-code-uds=Power_Path_015_Load_Failure  # Event_Dtc_Map_Power_Path_015_Load_Failure
  diagnostic event to operation cycle mapping EventOperCycleMapPowerPath015LoadFailure: diagnostic-event=EventPowerPath015LoadFailure, operation-cycle=DefaultOperationCycle  # Event_Oper_Cycle_Map_Power_Path_015_Load_Failure
  diagnostic event to debounce algorithm mapping EventDebounceMapPowerPath015LoadFailure: debounce-algorithm=time_based, diagnostic-event=EventPowerPath015LoadFailure  # EventDebounceMap_Power_Path_015_Load_Failure
package /ZeC/DTC/DTC/LIN_8_Slave_7_Defect
  diagnostic trouble code uds LIN_8_Slave_7_Defect: dtc-props=Dtc_Props_358996c7, uds-dtc-value=0x03080a  # LIN 8 Slave 7_Defect
  diagnostic event EventLIN8Slave7Defect: aging-allowed=true, event-kind=SWC, prestorage-freeze-frame=false  # Event_LIN 8 Slave 7_Defect
  diagnostic event to trouble code uds mapping EventDtcMapLIN8Slave7Defect: diagnostic-event=EventLIN8Slave7Defect, trouble-code-uds=LIN_8_Slave_7_Defect  # Event_Dtc_Map_LIN 8 Slave 7_Defect
  diagnostic event to operation cycle mapping EventOperCycleMapLIN8Slave7Defect: diagnostic-event=EventLIN8Slave7Defect, operation-cycle=DefaultOperationCycle  # Event_Oper_Cycle_Map_LIN 8 Slave 7_Defect
  diagnostic event to debounce algorithm mapping EventDebounceMapLIN8Slave7Defect: debounce-algorithm=counter_based, diagnostic-event=EventLIN8Slave7Defect  # EventDebounceMap_LIN 8 Slave 7_Defect
package /ZeC/DTC/DTC/Power_Path_014_Load_Failure
  diagnostic trouble code uds Power_Path_014_Load_Failure: dtc-props=Dtc_Props_991c0a00, uds-dtc-value=0x00540e
  diagnostic event EventPowerPath014LoadFailure: aging-allowed=true, event-kind=SWC, prestorage-freeze-frame=false  # Event_Power_Path_014_Load_Failure
  diagnostic event to trouble code uds mapping EventDtcMapPowerPath014LoadFailure: diagnostic-event=EventPowerPath014LoadFailure, trouble-code-uds=Power_Path_014_Load_Failure  # Event_Dtc_Map_Power_Path_014_Load_Failure
  diagnostic event to operation cycle mapping EventOperCycleMapPowerPath014LoadFailure: diagnostic-event=EventPowerPath014LoadFailure, operation-cycle=DefaultOperationCycle  # Event_Oper_Cycle_Map_Power_Path_014_Load_Failure
  diagnostic event to debounce algorithm mapping EventDebounceMapPowerPath014LoadFailure: debounce-algorithm=time_based, diagnostic-event=EventPowerPath014LoadFailure  # EventDebounceMap_Power_Path_014_Load_Failure
package /ZeC/DTC/DTC/LIN_8_Slave_8_NoCommunication
  diagnostic trouble code uds LIN_8_Slave_8_NoCommunication: dtc-props=Dtc_Props_358996c7, uds-dtc-value=0x03080d  # LIN 8 Slave 8_NoCommunication
  diagnostic event EventLIN8Slave8NoCommunication: aging-allowed=true, event-kind=SWC, prestorage-freeze-frame=false  # Event_LIN 8 Slave 8_NoCommunication
  diagnostic event to trouble code uds mapping EventDtcMapLIN8Slave8NoCommunication: diagnostic-event=EventLIN8Slave8NoCommunication, trouble-code-uds=LIN_8_Slave_8_NoCommunication  # Event_Dtc_Map_LIN 8 Slave 8_NoCommunication
  diagnostic event to operation cycle mapping EventOperCycleMapLIN8Slave8NoCommunication: diagnostic-event=EventLIN8Slave8NoCommunication, operation-cycle=DefaultOperationCycle  # Event_Oper_Cycle_Map_LIN 8 Slave 8_NoCommunication
  diagnostic event to debounce algorithm mapping EventDebounceMapLIN8Slave8NoCommunication: debounce-algorithm=counter_based, diagnostic-event=EventLIN8Slave8NoCommunication  # EventDebounceMap_LIN 8 Slave 8_NoCommunication
package /ZeC/DTC/DTC/LIN_8_Slave_8_Defect
  diagnostic trouble code uds LIN_8_Slave_8_Defect: dtc-props=Dtc_Props_358996c7, uds-dtc-value=0x03080c  # LIN 8 Slave 8_Defect
  diagnostic event EventLIN8Slave8Defect: aging-allowed=true, event-kind=SWC, prestorage-freeze-frame=false  # Event_LIN 8 Slave 8_Defect
  diagnostic event to trouble code uds mapping EventDtcMapLIN8Slave8Defect: diagnostic-event=EventLIN8Slave8Defect, trouble-code-uds=LIN_8_Slave_8_Defect  # Event_Dtc_Map_LIN 8 Slave 8_Defect
  diagnostic event to operation cycle mapping EventOperCycleMapLIN8Slave8Defect: diagnostic-event=EventLIN8Slave8Defect, operation-cycle=DefaultOperationCycle  # Event_Oper_Cycle_Map_LIN 8 Slave 8_Defect
  diagnostic event to debounce algorithm mapping EventDebounceMapLIN8Slave8Defect: debounce-algorithm=counter_based, diagnostic-event=EventLIN8Slave8Defect  # EventDebounceMap_LIN 8 Slave 8_Defect
package /ZeC/DTC/DTC/Power_Path_143_Cable_Protection_Failure
  diagnostic trouble code uds Power_Path_143_Cable_Protection_Failure: dtc-props=Dtc_Props_d7d40ecb, uds-dtc-value=0x00588f
  diagnostic event EventPowerPath143CableProtectionFailure: aging-allowed=true, event-kind=SWC, prestorage-freeze-frame=false  # Event_Power_Path_143_Cable_Protection_Failure
  diagnostic event to trouble code uds mapping EventDtcMapPowerPath143CableProtectionFailure: diagnostic-event=EventPowerPath143CableProtectionFailure, trouble-code-uds=Power_Path_143_Cable_Protection_Failure  # Event_Dtc_Map_Power_Path_143_Cable_Protection_Failure
  diagnostic event to operation cycle mapping EventOperCycleMapPowerPath143CableProtectionFailure: diagnostic-event=EventPowerPath143CableProtectionFailure, operation-cycle=DefaultOperationCycle  # Event_Oper_Cycle_Map_Power_Path_143_Cable_Protection_Failure
  diagnostic event to debounce algorithm mapping EventDebounceMapPowerPath143CableProtectionFailure: debounce-algorithm=time_based, diagnostic-event=EventPowerPath143CableProtectionFailure  # EventDebounceMap_Power_Path_143_Cable_Protection_Failure
package /ZeC/DTC/DTC/Power_Path_011_Load_Failure
  diagnostic trouble code uds Power_Path_011_Load_Failure: dtc-props=Dtc_Props_90223ae7, uds-dtc-value=0x00540b
  diagnostic event EventPowerPath011LoadFailure: aging-allowed=true, event-kind=SWC, prestorage-freeze-frame=false  # Event_Power_Path_011_Load_Failure
  diagnostic event to trouble code uds mapping EventDtcMapPowerPath011LoadFailure: diagnostic-event=EventPowerPath011LoadFailure, trouble-code-uds=Power_Path_011_Load_Failure  # Event_Dtc_Map_Power_Path_011_Load_Failure
  diagnostic event to operation cycle mapping EventOperCycleMapPowerPath011LoadFailure: diagnostic-event=EventPowerPath011LoadFailure, operation-cycle=DefaultOperationCycle  # Event_Oper_Cycle_Map_Power_Path_011_Load_Failure
  diagnostic event to debounce algorithm mapping EventDebounceMapPowerPath011LoadFailure: debounce-algorithm=time_based, diagnostic-event=EventPowerPath011LoadFailure  # EventDebounceMap_Power_Path_011_Load_Failure
package /ZeC/DTC/DTC/Power_Path_142_Cable_Protection_Failure
  diagnostic trouble code uds Power_Path_142_Cable_Protection_Failure: dtc-props=Dtc_Props_1dff1085, uds-dtc-value=0x00588e
  diagnostic event EventPowerPath142CableProtectionFailure: aging-allowed=true, event-kind=SWC, prestorage-freeze-frame=false  # Event_Power_Path_142_Cable_Protection_Failure
  diagnostic event to trouble code uds mapping EventDtcMapPowerPath142CableProtectionFailure: diagnostic-event=EventPowerPath142CableProtectionFailure, trouble-code-uds=Power_Path_142_Cable_Protection_Failure  # Event_Dtc_Map_Power_Path_142_Cable_Protection_Failure
  diagnostic event to operation cycle mapping EventOperCycleMapPowerPath142CableProtectionFailure: diagnostic-event=EventPowerPath142CableProtectionFailure, operation-cycle=DefaultOperationCycle  # Event_Oper_Cycle_Map_Power_Path_142_Cable_Protection_Failure
  diagnostic event to debounce algorithm mapping EventDebounceMapPowerPath142CableProtectionFailure: debounce-algorithm=time_based, diagnostic-event=EventPowerPath142CableProtectionFailure  # EventDebounceMap_Power_Path_142_Cable_Protection_Failure
package /ZeC/DTC/DTC/Power_Path_010_Load_Failure
  diagnostic trouble code uds Power_Path_010_Load_Failure: dtc-props=Dtc_Props_5a0924a9, uds-dtc-value=0x00540a
  diagnostic event EventPowerPath010LoadFailure: aging-allowed=true, event-kind=SWC, prestorage-freeze-frame=false  # Event_Power_Path_010_Load_Failure
  diagnostic event to trouble code uds mapping EventDtcMapPowerPath010LoadFailure: diagnostic-event=EventPowerPath010LoadFailure, trouble-code-uds=Power_Path_010_Load_Failure  # Event_Dtc_Map_Power_Path_010_Load_Failure
  diagnostic event to operation cycle mapping EventOperCycleMapPowerPath010LoadFailure: diagnostic-event=EventPowerPath010LoadFailure, operation-cycle=DefaultOperationCycle  # Event_Oper_Cycle_Map_Power_Path_010_Load_Failure
  diagnostic event to debounce algorithm mapping EventDebounceMapPowerPath010LoadFailure: debounce-algorithm=time_based, diagnostic-event=EventPowerPath010LoadFailure  # EventDebounceMap_Power_Path_010_Load_Failure
package /ZeC/DTC/DTC/Power_Path_013_Load_Failure
  diagnostic trouble code uds Power_Path_013_Load_Failure: dtc-props=Dtc_Props_df05003a, uds-dtc-value=0x00540d
  diagnostic event EventPowerPath013LoadFailure: aging-allowed=true, event-kind=SWC, prestorage-freeze-frame=false  # Event_Power_Path_013_Load_Failure
  diagnostic event to trouble code uds mapping EventDtcMapPowerPath013LoadFailure: diagnostic-event=EventPowerPath013LoadFailure, trouble-code-uds=Power_Path_013_Load_Failure  # Event_Dtc_Map_Power_Path_013_Load_Failure
  diagnostic event to operation cycle mapping EventOperCycleMapPowerPath013LoadFailure: diagnostic-event=EventPowerPath013LoadFailure, operation-cycle=DefaultOperationCycle  # Event_Oper_Cycle_Map_Power_Path_013_Load_Failure
  diagnostic event to debounce algorithm mapping EventDebounceMapPowerPath013LoadFailure: debounce-algorithm=time_based, diagnostic-event=EventPowerPath013LoadFailure  # EventDebounceMap_Power_Path_013_Load_Failure
package /ZeC/DTC/DTC/Power_Path_012_Load_Failure
  diagnostic trouble code uds Power_Path_012_Load_Failure: dtc-props=Dtc_Props_d63b30dd, uds-dtc-value=0x00540c
  diagnostic event EventPowerPath012LoadFailure: aging-allowed=true, event-kind=SWC, prestorage-freeze-frame=false  # Event_Power_Path_012_Load_Failure
  diagnostic event to trouble code uds mapping EventDtcMapPowerPath012LoadFailure: diagnostic-event=EventPowerPath012LoadFailure, trouble-code-uds=Power_Path_012_Load_Failure  # Event_Dtc_Map_Power_Path_012_Load_Failure
  diagnostic event to operation cycle mapping EventOperCycleMapPowerPath012LoadFailure: diagnostic-event=EventPowerPath012LoadFailure, operation-cycle=DefaultOperationCycle  # Event_Oper_Cycle_Map_Power_Path_012_Load_Failure
  diagnostic event to debounce algorithm mapping EventDebounceMapPowerPath012LoadFailure: debounce-algorithm=time_based, diagnostic-event=EventPowerPath012LoadFailure  # EventDebounceMap_Power_Path_012_Load_Failure
package /ZeC/DTC/DTC/Power_Path_147_Cable_Protection_Failure
  diagnostic trouble code uds Power_Path_147_Cable_Protection_Failure: dtc-props=Dtc_Props_a96d8e9d, uds-dtc-value=0x005893
  diagnostic event EventPowerPath147CableProtectionFailure: aging-allowed=true, event-kind=SWC, prestorage-freeze-frame=false  # Event_Power_Path_147_Cable_Protection_Failure
  diagnostic event to trouble code uds mapping EventDtcMapPowerPath147CableProtectionFailure: diagnostic-event=EventPowerPath147CableProtectionFailure, trouble-code-uds=Power_Path_147_Cable_Protection_Failure  # Event_Dtc_Map_Power_Path_147_Cable_Protection_Failure
  diagnostic event to operation cycle mapping EventOperCycleMapPowerPath147CableProtectionFailure: diagnostic-event=EventPowerPath147CableProtectionFailure, operation-cycle=DefaultOperationCycle  # Event_Oper_Cycle_Map_Power_Path_147_Cable_Protection_Failure
  diagnostic event to debounce algorithm mapping EventDebounceMapPowerPath147CableProtectionFailure: debounce-algorithm=time_based, diagnostic-event=EventPowerPath147CableProtectionFailure  # EventDebounceMap_Power_Path_147_Cable_Protection_Failure
package /ZeC/DTC/DTC/LIN_8_Slave_6_NoCommunication
  diagnostic trouble code uds LIN_8_Slave_6_NoCommunication: dtc-props=Dtc_Props_358996c7, uds-dtc-value=0x030809  # LIN 8 Slave 6_NoCommunication
  diagnostic event EventLIN8Slave6NoCommunication: aging-allowed=true, event-kind=SWC, prestorage-freeze-frame=false  # Event_LIN 8 Slave 6_NoCommunication
  diagnostic event to trouble code uds mapping EventDtcMapLIN8Slave6NoCommunication: diagnostic-event=EventLIN8Slave6NoCommunication, trouble-code-uds=LIN_8_Slave_6_NoCommunication  # Event_Dtc_Map_LIN 8 Slave 6_NoCommunication
  diagnostic event to operation cycle mapping EventOperCycleMapLIN8Slave6NoCommunication: diagnostic-event=EventLIN8Slave6NoCommunication, operation-cycle=DefaultOperationCycle  # Event_Oper_Cycle_Map_LIN 8 Slave 6_NoCommunication
  diagnostic event to debounce algorithm mapping EventDebounceMapLIN8Slave6NoCommunication: debounce-algorithm=counter_based, diagnostic-event=EventLIN8Slave6NoCommunication  # EventDebounceMap_LIN 8 Slave 6_NoCommunication
package /ZeC/DTC/DTC/Power_Path_146_Cable_Protection_Failure
  diagnostic trouble code uds Power_Path_146_Cable_Protection_Failure: dtc-props=Dtc_Props_ef7484a7, uds-dtc-value=0x005892
  diagnostic event EventPowerPath146CableProtectionFailure: aging-allowed=true, event-kind=SWC, prestorage-freeze-frame=false  # Event_Power_Path_146_Cable_Protection_Failure
  diagnostic event to trouble code uds mapping EventDtcMapPowerPath146CableProtectionFailure: diagnostic-event=EventPowerPath146CableProtectionFailure, trouble-code-uds=Power_Path_146_Cable_Protection_Failure  # Event_Dtc_Map_Power_Path_146_Cable_Protection_Failure
  diagnostic event to operation cycle mapping EventOperCycleMapPowerPath146CableProtectionFailure: diagnostic-event=EventPowerPath146CableProtectionFailure, operation-cycle=DefaultOperationCycle  # Event_Oper_Cycle_Map_Power_Path_146_Cable_Protection_Failure
  diagnostic event to debounce algorithm mapping EventDebounceMapPowerPath146CableProtectionFailure: debounce-algorithm=time_based, diagnostic-event=EventPowerPath146CableProtectionFailure  # EventDebounceMap_Power_Path_146_Cable_Protection_Failure
package /ZeC/DTC/DTC/Power_Path_149_Cable_Protection_Failure
  diagnostic trouble code uds Power_Path_149_Cable_Protection_Failure: dtc-props=Dtc_Props_e64ab440, uds-dtc-value=0x005895
  diagnostic event EventPowerPath149CableProtectionFailure: aging-allowed=true, event-kind=SWC, prestorage-freeze-frame=false  # Event_Power_Path_149_Cable_Protection_Failure
  diagnostic event to trouble code uds mapping EventDtcMapPowerPath149CableProtectionFailure: diagnostic-event=EventPowerPath149CableProtectionFailure, trouble-code-uds=Power_Path_149_Cable_Protection_Failure  # Event_Dtc_Map_Power_Path_149_Cable_Protection_Failure
  diagnostic event to operation cycle mapping EventOperCycleMapPowerPath149CableProtectionFailure: diagnostic-event=EventPowerPath149CableProtectionFailure, operation-cycle=DefaultOperationCycle  # Event_Oper_Cycle_Map_Power_Path_149_Cable_Protection_Failure
  diagnostic event to debounce algorithm mapping EventDebounceMapPowerPath149CableProtectionFailure: debounce-algorithm=time_based, diagnostic-event=EventPowerPath149CableProtectionFailure  # EventDebounceMap_Power_Path_149_Cable_Protection_Failure
package /ZeC/DTC/DTC/Power_Path_017_Load_Failure
  diagnostic trouble code uds Power_Path_017_Load_Failure: dtc-props=Dtc_Props_a1bc806c, uds-dtc-value=0x005411
  diagnostic event EventPowerPath017LoadFailure: aging-allowed=true, event-kind=SWC, prestorage-freeze-frame=false  # Event_Power_Path_017_Load_Failure
  diagnostic event to trouble code uds mapping EventDtcMapPowerPath017LoadFailure: diagnostic-event=EventPowerPath017LoadFailure, trouble-code-uds=Power_Path_017_Load_Failure  # Event_Dtc_Map_Power_Path_017_Load_Failure
  diagnostic event to operation cycle mapping EventOperCycleMapPowerPath017LoadFailure: diagnostic-event=EventPowerPath017LoadFailure, operation-cycle=DefaultOperationCycle  # Event_Oper_Cycle_Map_Power_Path_017_Load_Failure
  diagnostic event to debounce algorithm mapping EventDebounceMapPowerPath017LoadFailure: debounce-algorithm=time_based, diagnostic-event=EventPowerPath017LoadFailure  # EventDebounceMap_Power_Path_017_Load_Failure
package /ZeC/DTC/DTC/Power_Path_148_Cable_Protection_Failure
  diagnostic trouble code uds Power_Path_148_Cable_Protection_Failure: dtc-props=Dtc_Props_a053be7a, uds-dtc-value=0x005894
  diagnostic event EventPowerPath148CableProtectionFailure: aging-allowed=true, event-kind=SWC, prestorage-freeze-frame=false  # Event_Power_Path_148_Cable_Protection_Failure
  diagnostic event to trouble code uds mapping EventDtcMapPowerPath148CableProtectionFailure: diagnostic-event=EventPowerPath148CableProtectionFailure, trouble-code-uds=Power_Path_148_Cable_Protection_Failure  # Event_Dtc_Map_Power_Path_148_Cable_Protection_Failure
  diagnostic event to operation cycle mapping EventOperCycleMapPowerPath148CableProtectionFailure: diagnostic-event=EventPowerPath148CableProtectionFailure, operation-cycle=DefaultOperationCycle  # Event_Oper_Cycle_Map_Power_Path_148_Cable_Protection_Failure
  diagnostic event to debounce algorithm mapping EventDebounceMapPowerPath148CableProtectionFailure: debounce-algorithm=time_based, diagnostic-event=EventPowerPath148CableProtectionFailure  # EventDebounceMap_Power_Path_148_Cable_Protection_Failure
package /ZeC/DTC/DTC/Power_Path_016_Load_Failure
  diagnostic trouble code uds Power_Path_016_Load_Failure: dtc-props=Dtc_Props_e7a58a56, uds-dtc-value=0x005410
  diagnostic event EventPowerPath016LoadFailure: aging-allowed=true, event-kind=SWC, prestorage-freeze-frame=false  # Event_Power_Path_016_Load_Failure
  diagnostic event to trouble code uds mapping EventDtcMapPowerPath016LoadFailure: diagnostic-event=EventPowerPath016LoadFailure, trouble-code-uds=Power_Path_016_Load_Failure  # Event_Dtc_Map_Power_Path_016_Load_Failure
  diagnostic event to operation cycle mapping EventOperCycleMapPowerPath016LoadFailure: diagnostic-event=EventPowerPath016LoadFailure, operation-cycle=DefaultOperationCycle  # Event_Oper_Cycle_Map_Power_Path_016_Load_Failure
  diagnostic event to debounce algorithm mapping EventDebounceMapPowerPath016LoadFailure: debounce-algorithm=time_based, diagnostic-event=EventPowerPath016LoadFailure  # EventDebounceMap_Power_Path_016_Load_Failure
package /ZeC/DTC/DTC/LIN_8_Slave_5_Defect
  diagnostic trouble code uds LIN_8_Slave_5_Defect: dtc-props=Dtc_Props_358996c7, uds-dtc-value=0x030806  # LIN 8 Slave 5_Defect
  diagnostic event EventLIN8Slave5Defect: aging-allowed=true, event-kind=SWC, prestorage-freeze-frame=false  # Event_LIN 8 Slave 5_Defect
  diagnostic event to trouble code uds mapping EventDtcMapLIN8Slave5Defect: diagnostic-event=EventLIN8Slave5Defect, trouble-code-uds=LIN_8_Slave_5_Defect  # Event_Dtc_Map_LIN 8 Slave 5_Defect
  diagnostic event to operation cycle mapping EventOperCycleMapLIN8Slave5Defect: diagnostic-event=EventLIN8Slave5Defect, operation-cycle=DefaultOperationCycle  # Event_Oper_Cycle_Map_LIN 8 Slave 5_Defect
  diagnostic event to debounce algorithm mapping EventDebounceMapLIN8Slave5Defect: debounce-algorithm=counter_based, diagnostic-event=EventLIN8Slave5Defect  # EventDebounceMap_LIN 8 Slave 5_Defect
package /ZeC/DTC/DTC/LIN_8_Slave_4_NoCommunication
  diagnostic trouble code uds LIN_8_Slave_4_NoCommunication: dtc-props=Dtc_Props_358996c7, uds-dtc-value=0x030805  # LIN 8 Slave 4_NoCommunication
  diagnostic event EventLIN8Slave4NoCommunication: aging-allowed=true, event-kind=SWC, prestorage-freeze-frame=false  # Event_LIN 8 Slave 4_NoCommunication
  diagnostic event to trouble code uds mapping EventDtcMapLIN8Slave4NoCommunication: diagnostic-event=EventLIN8Slave4NoCommunication, trouble-code-uds=LIN_8_Slave_4_NoCommunication  # Event_Dtc_Map_LIN 8 Slave 4_NoCommunication
  diagnostic event to operation cycle mapping EventOperCycleMapLIN8Slave4NoCommunication: diagnostic-event=EventLIN8Slave4NoCommunication, operation-cycle=DefaultOperationCycle  # Event_Oper_Cycle_Map_LIN 8 Slave 4_NoCommunication
  diagnostic event to debounce algorithm mapping EventDebounceMapLIN8Slave4NoCommunication: debounce-algorithm=counter_based, diagnostic-event=EventLIN8Slave4NoCommunication  # EventDebounceMap_LIN 8 Slave 4_NoCommunication
package /ZeC/DTC/DTC/Productionmode_P_Mode_active
  diagnostic trouble code uds Productionmode_P_Mode_active: dtc-props=Dtc_Props_c8ff1f07, uds-dtc-value=0x001050  # Productionmode P-Mode active
  diagnostic event EventProductionmodePModeActive: aging-allowed=true, event-kind=SWC, prestorage-freeze-frame=false  # Event_Productionmode P-Mode active
  diagnostic event to trouble code uds mapping EventDtcMapProductionmodePModeActive: diagnostic-event=EventProductionmodePModeActive, trouble-code-uds=Productionmode_P_Mode_active  # Event_Dtc_Map_Productionmode P-Mode active
  diagnostic event to operation cycle mapping EventOperCycleMapProductionmodePModeActive: diagnostic-event=EventProductionmodePModeActive, operation-cycle=DefaultOperationCycle  # Event_Oper_Cycle_Map_Productionmode P-Mode active
  diagnostic event to debounce algorithm mapping EventDebounceMapProductionmodePModeActive: debounce-algorithm=time_based, diagnostic-event=EventProductionmodePModeActive  # EventDebounceMap_Productionmode P-Mode active
package /ZeC/DTC/DTC/LIN_8_Slave_6_Defect
  diagnostic trouble code uds LIN_8_Slave_6_Defect: dtc-props=Dtc_Props_358996c7, uds-dtc-value=0x030808  # LIN 8 Slave 6_Defect
  diagnostic event EventLIN8Slave6Defect: aging-allowed=true, event-kind=SWC, prestorage-freeze-frame=false  # Event_LIN 8 Slave 6_Defect
  diagnostic event to trouble code uds mapping EventDtcMapLIN8Slave6Defect: diagnostic-event=EventLIN8Slave6Defect, trouble-code-uds=LIN_8_Slave_6_Defect  # Event_Dtc_Map_LIN 8 Slave 6_Defect
  diagnostic event to operation cycle mapping EventOperCycleMapLIN8Slave6Defect: diagnostic-event=EventLIN8Slave6Defect, operation-cycle=DefaultOperationCycle  # Event_Oper_Cycle_Map_LIN 8 Slave 6_Defect
  diagnostic event to debounce algorithm mapping EventDebounceMapLIN8Slave6Defect: debounce-algorithm=counter_based, diagnostic-event=EventLIN8Slave6Defect  # EventDebounceMap_LIN 8 Slave 6_Defect
package /ZeC/DTC/DTC/Power_Path_145_Cable_Protection_Failure
  diagnostic trouble code uds Power_Path_145_Cable_Protection_Failure: dtc-props=Dtc_Props_255f9ae9, uds-dtc-value=0x005891
  diagnostic event EventPowerPath145CableProtectionFailure: aging-allowed=true, event-kind=SWC, prestorage-freeze-frame=false  # Event_Power_Path_145_Cable_Protection_Failure
  diagnostic event to trouble code uds mapping EventDtcMapPowerPath145CableProtectionFailure: diagnostic-event=EventPowerPath145CableProtectionFailure, trouble-code-uds=Power_Path_145_Cable_Protection_Failure  # Event_Dtc_Map_Power_Path_145_Cable_Protection_Failure
  diagnostic event to operation cycle mapping EventOperCycleMapPowerPath145CableProtectionFailure: diagnostic-event=EventPowerPath145CableProtectionFailure, operation-cycle=DefaultOperationCycle  # Event_Oper_Cycle_Map_Power_Path_145_Cable_Protection_Failure
  diagnostic event to debounce algorithm mapping EventDebounceMapPowerPath145CableProtectionFailure: debounce-algorithm=time_based, diagnostic-event=EventPowerPath145CableProtectionFailure  # EventDebounceMap_Power_Path_145_Cable_Protection_Failure
package /ZeC/DTC/DTC/LIN_8_Slave_5_NoCommunication
  diagnostic trouble code uds LIN_8_Slave_5_NoCommunication: dtc-props=Dtc_Props_358996c7, uds-dtc-value=0x030807  # LIN 8 Slave 5_NoCommunication
  diagnostic event EventLIN8Slave5NoCommunication: aging-allowed=true, event-kind=SWC, prestorage-freeze-frame=false  # Event_LIN 8 Slave 5_NoCommunication
  diagnostic event to trouble code uds mapping EventDtcMapLIN8Slave5NoCommunication: diagnostic-event=EventLIN8Slave5NoCommunication, trouble-code-uds=LIN_8_Slave_5_NoCommunication  # Event_Dtc_Map_LIN 8 Slave 5_NoCommunication
  diagnostic event to operation cycle mapping EventOperCycleMapLIN8Slave5NoCommunication: diagnostic-event=EventLIN8Slave5NoCommunication, operation-cycle=DefaultOperationCycle  # Event_Oper_Cycle_Map_LIN 8 Slave 5_NoCommunication
  diagnostic event to debounce algorithm mapping EventDebounceMapLIN8Slave5NoCommunication: debounce-algorithm=counter_based, diagnostic-event=EventLIN8Slave5NoCommunication  # EventDebounceMap_LIN 8 Slave 5_NoCommunication
package /ZeC/DTC/DTC/Power_Path_144_Cable_Protection_Failure
  diagnostic trouble code uds Power_Path_144_Cable_Protection_Failure: dtc-props=Dtc_Props_634690d3, uds-dtc-value=0x005890
  diagnostic event EventPowerPath144CableProtectionFailure: aging-allowed=true, event-kind=SWC, prestorage-freeze-frame=false  # Event_Power_Path_144_Cable_Protection_Failure
  diagnostic event to trouble code uds mapping EventDtcMapPowerPath144CableProtectionFailure: diagnostic-event=EventPowerPath144CableProtectionFailure, trouble-code-uds=Power_Path_144_Cable_Protection_Failure  # Event_Dtc_Map_Power_Path_144_Cable_Protection_Failure
  diagnostic event to operation cycle mapping EventOperCycleMapPowerPath144CableProtectionFailure: diagnostic-event=EventPowerPath144CableProtectionFailure, operation-cycle=DefaultOperationCycle  # Event_Oper_Cycle_Map_Power_Path_144_Cable_Protection_Failure
  diagnostic event to debounce algorithm mapping EventDebounceMapPowerPath144CableProtectionFailure: debounce-algorithm=time_based, diagnostic-event=EventPowerPath144CableProtectionFailure  # EventDebounceMap_Power_Path_144_Cable_Protection_Failure
package /ZeC/DTC/DTC/LIN_8_Slave_10_NoCommunication
  diagnostic trouble code uds LIN_8_Slave_10_NoCommunication: dtc-props=Dtc_Props_358996c7, uds-dtc-value=0x030813  # LIN 8 Slave 10_NoCommunication
  diagnostic event EventLIN8Slave10NoCommunication: aging-allowed=true, event-kind=SWC, prestorage-freeze-frame=false  # Event_LIN 8 Slave 10_NoCommunication
  diagnostic event to trouble code uds mapping EventDtcMapLIN8Slave10NoCommunication: diagnostic-event=EventLIN8Slave10NoCommunication, trouble-code-uds=LIN_8_Slave_10_NoCommunication  # Event_Dtc_Map_LIN 8 Slave 10_NoCommunication
  diagnostic event to operation cycle mapping EventOperCycleMapLIN8Slave10NoCommunication: diagnostic-event=EventLIN8Slave10NoCommunication, operation-cycle=DefaultOperationCycle  # Event_Oper_Cycle_Map_LIN 8 Slave 10_NoCommunication
  diagnostic event to debounce algorithm mapping EventDebounceMapLIN8Slave10NoCommunication: debounce-algorithm=counter_based, diagnostic-event=EventLIN8Slave10NoCommunication  # EventDebounceMap_LIN 8 Slave 10_NoCommunication
package /ZeC/DTC/DTC/Power_Path_121_Cable_Protection_Failure
  diagnostic trouble code uds Power_Path_121_Cable_Protection_Failure: dtc-props=Dtc_Props_4ca522c, uds-dtc-value=0x005879
  diagnostic event EventPowerPath121CableProtectionFailure: aging-allowed=true, event-kind=SWC, prestorage-freeze-frame=false  # Event_Power_Path_121_Cable_Protection_Failure
  diagnostic event to trouble code uds mapping EventDtcMapPowerPath121CableProtectionFailure: diagnostic-event=EventPowerPath121CableProtectionFailure, trouble-code-uds=Power_Path_121_Cable_Protection_Failure  # Event_Dtc_Map_Power_Path_121_Cable_Protection_Failure
  diagnostic event to operation cycle mapping EventOperCycleMapPowerPath121CableProtectionFailure: diagnostic-event=EventPowerPath121CableProtectionFailure, operation-cycle=DefaultOperationCycle  # Event_Oper_Cycle_Map_Power_Path_121_Cable_Protection_Failure
  diagnostic event to debounce algorithm mapping EventDebounceMapPowerPath121CableProtectionFailure: debounce-algorithm=time_based, diagnostic-event=EventPowerPath121CableProtectionFailure  # EventDebounceMap_Power_Path_121_Cable_Protection_Failure
package /ZeC/DTC/DTC/LIN_8_Slave_10_Defect
  diagnostic trouble code uds LIN_8_Slave_10_Defect: dtc-props=Dtc_Props_358996c7, uds-dtc-value=0x030812  # LIN 8 Slave 10_Defect
  diagnostic event EventLIN8Slave10Defect: aging-allowed=true, event-kind=SWC, prestorage-freeze-frame=false  # Event_LIN 8 Slave 10_Defect
  diagnostic event to trouble code uds mapping EventDtcMapLIN8Slave10Defect: diagnostic-event=EventLIN8Slave10Defect, trouble-code-uds=LIN_8_Slave_10_Defect  # Event_Dtc_Map_LIN 8 Slave 10_Defect
  diagnostic event to operation cycle mapping EventOperCycleMapLIN8Slave10Defect: diagnostic-event=EventLIN8Slave10Defect, operation-cycle=DefaultOperationCycle  # Event_Oper_Cycle_Map_LIN 8 Slave 10_Defect
  diagnostic event to debounce algorithm mapping EventDebounceMapLIN8Slave10Defect: debounce-algorithm=counter_based, diagnostic-event=EventLIN8Slave10Defect  # EventDebounceMap_LIN 8 Slave 10_Defect
package /ZeC/DTC/DTC/Power_Path_120_Cable_Protection_Failure
  diagnostic trouble code uds Power_Path_120_Cable_Protection_Failure: dtc-props=Dtc_Props_42d35816, uds-dtc-value=0x005878
  diagnostic event EventPowerPath120CableProtectionFailure: aging-allowed=true, event-kind=SWC, prestorage-freeze-frame=false  # Event_Power_Path_120_Cable_Protection_Failure
  diagnostic event to trouble code uds mapping EventDtcMapPowerPath120CableProtectionFailure: diagnostic-event=EventPowerPath120CableProtectionFailure, trouble-code-uds=Power_Path_120_Cable_Protection_Failure  # Event_Dtc_Map_Power_Path_120_Cable_Protection_Failure
  diagnostic event to operation cycle mapping EventOperCycleMapPowerPath120CableProtectionFailure: diagnostic-event=EventPowerPath120CableProtectionFailure, operation-cycle=DefaultOperationCycle  # Event_Oper_Cycle_Map_Power_Path_120_Cable_Protection_Failure
  diagnostic event to debounce algorithm mapping EventDebounceMapPowerPath120CableProtectionFailure: debounce-algorithm=time_based, diagnostic-event=EventPowerPath120CableProtectionFailure  # EventDebounceMap_Power_Path_120_Cable_Protection_Failure
package /ZeC/DTC/DTC/LIN_8_Slave_11_NoCommunication
  diagnostic trouble code uds LIN_8_Slave_11_NoCommunication: dtc-props=Dtc_Props_358996c7, uds-dtc-value=0x030815  # LIN 8 Slave 11_NoCommunication
  diagnostic event EventLIN8Slave11NoCommunication: aging-allowed=true, event-kind=SWC, prestorage-freeze-frame=false  # Event_LIN 8 Slave 11_NoCommunication
  diagnostic event to trouble code uds mapping EventDtcMapLIN8Slave11NoCommunication: diagnostic-event=EventLIN8Slave11NoCommunication, trouble-code-uds=LIN_8_Slave_11_NoCommunication  # Event_Dtc_Map_LIN 8 Slave 11_NoCommunication
  diagnostic event to operation cycle mapping EventOperCycleMapLIN8Slave11NoCommunication: diagnostic-event=EventLIN8Slave11NoCommunication, operation-cycle=DefaultOperationCycle  # Event_Oper_Cycle_Map_LIN 8 Slave 11_NoCommunication
  diagnostic event to debounce algorithm mapping EventDebounceMapLIN8Slave11NoCommunication: debounce-algorithm=counter_based, diagnostic-event=EventLIN8Slave11NoCommunication  # EventDebounceMap_LIN 8 Slave 11_NoCommunication
package /ZeC/DTC/DTC/LIN_8_Slave_11_Defect
  diagnostic trouble code uds LIN_8_Slave_11_Defect: dtc-props=Dtc_Props_358996c7, uds-dtc-value=0x030814  # LIN 8 Slave 11_Defect
  diagnostic event EventLIN8Slave11Defect: aging-allowed=true, event-kind=SWC, prestorage-freeze-frame=false  # Event_LIN 8 Slave 11_Defect
  diagnostic event to trouble code uds mapping EventDtcMapLIN8Slave11Defect: diagnostic-event=EventLIN8Slave11Defect, trouble-code-uds=LIN_8_Slave_11_Defect  # Event_Dtc_Map_LIN 8 Slave 11_Defect
  diagnostic event to operation cycle mapping EventOperCycleMapLIN8Slave11Defect: diagnostic-event=EventLIN8Slave11Defect, operation-cycle=DefaultOperationCycle  # Event_Oper_Cycle_Map_LIN 8 Slave 11_Defect
  diagnostic event to debounce algorithm mapping EventDebounceMapLIN8Slave11Defect: debounce-algorithm=counter_based, diagnostic-event=EventLIN8Slave11Defect  # EventDebounceMap_LIN 8 Slave 11_Defect
package /ZeC/DTC/DTC/Supply_voltage_exceeded_upper_limit_input_2
  diagnostic trouble code uds Supply_voltage_exceeded_upper_limit_input_2: dtc-props=Dtc_Props_d78b13b8, uds-dtc-value=0x001034
  diagnostic event EventSupplyVoltageExceededUpperLimitInput2: aging-allowed=true, event-kind=SWC, prestorage-freeze-frame=false  # Event_Supply_voltage_exceeded_upper_limit_input_2
  diagnostic event to trouble code uds mapping EventDtcMapSupplyVoltageExceededUpperLimitInput2: diagnostic-event=EventSupplyVoltageExceededUpperLimitInput2, trouble-code-uds=Supply_voltage_exceeded_upper_limit_input_2  # Event_Dtc_Map_Supply_voltage_exceeded_upper_limit_input_2
  diagnostic event to operation cycle mapping EventOperCycleMapSupplyVoltageExceededUpperLimitInput2: diagnostic-event=EventSupplyVoltageExceededUpperLimitInput2, operation-cycle=DefaultOperationCycle  # Event_Oper_Cycle_Map_Supply_voltage_exceeded_upper_limit_input_2
  diagnostic event to debounce algorithm mapping EventDebounceMapSupplyVoltageExceededUpperLimitInput2: debounce-algorithm=time_based, diagnostic-event=EventSupplyVoltageExceededUpperLimitInput2  # EventDebounceMap_Supply_voltage_exceeded_upper_limit_input_2
package /ZeC/DTC/DTC/Power_Path_117_Cable_Protection_Failure
  diagnostic trouble code uds Power_Path_117_Cable_Protection_Failure: dtc-props=Dtc_Props_9a842796, uds-dtc-value=0x005875
  diagnostic event EventPowerPath117CableProtectionFailure: aging-allowed=true, event-kind=SWC, prestorage-freeze-frame=false  # Event_Power_Path_117_Cable_Protection_Failure
  diagnostic event to trouble code uds mapping EventDtcMapPowerPath117CableProtectionFailure: diagnostic-event=EventPowerPath117CableProtectionFailure, trouble-code-uds=Power_Path_117_Cable_Protection_Failure  # Event_Dtc_Map_Power_Path_117_Cable_Protection_Failure
  diagnostic event to operation cycle mapping EventOperCycleMapPowerPath117CableProtectionFailure: diagnostic-event=EventPowerPath117CableProtectionFailure, operation-cycle=DefaultOperationCycle  # Event_Oper_Cycle_Map_Power_Path_117_Cable_Protection_Failure
  diagnostic event to debounce algorithm mapping EventDebounceMapPowerPath117CableProtectionFailure: debounce-algorithm=time_based, diagnostic-event=EventPowerPath117CableProtectionFailure  # EventDebounceMap_Power_Path_117_Cable_Protection_Failure
package /ZeC/DTC/DTC/Power_Path_116_Cable_Protection_Failure
  diagnostic trouble code uds Power_Path_116_Cable_Protection_Failure: dtc-props=Dtc_Props_dc9d2dac, uds-dtc-value=0x005874
  diagnostic event EventPowerPath116CableProtectionFailure: aging-allowed=true, event-kind=SWC, prestorage-freeze-frame=false  # Event_Power_Path_116_Cable_Protection_Failure
  diagnostic event to trouble code uds mapping EventDtcMapPowerPath116CableProtectionFailure: diagnostic-event=EventPowerPath116CableProtectionFailure, trouble-code-uds=Power_Path_116_Cable_Protection_Failure  # Event_Dtc_Map_Power_Path_116_Cable_Protection_Failure
  diagnostic event to operation cycle mapping EventOperCycleMapPowerPath116CableProtectionFailure: diagnostic-event=EventPowerPath116CableProtectionFailure, operation-cycle=DefaultOperationCycle  # Event_Oper_Cycle_Map_Power_Path_116_Cable_Protection_Failure
  diagnostic event to debounce algorithm mapping EventDebounceMapPowerPath116CableProtectionFailure: debounce-algorithm=time_based, diagnostic-event=EventPowerPath116CableProtectionFailure  # EventDebounceMap_Power_Path_116_Cable_Protection_Failure
package /ZeC/DTC/DTC/LIN_8_Slave_1_NoCommunication
  diagnostic trouble code uds LIN_8_Slave_1_NoCommunication: dtc-props=Dtc_Props_358996c7, uds-dtc-value=0x030811  # LIN 8 Slave 1_NoCommunication
  diagnostic event EventLIN8Slave1NoCommunication: aging-allowed=true, event-kind=SWC, prestorage-freeze-frame=false  # Event_LIN 8 Slave 1_NoCommunication
  diagnostic event to trouble code uds mapping EventDtcMapLIN8Slave1NoCommunication: diagnostic-event=EventLIN8Slave1NoCommunication, trouble-code-uds=LIN_8_Slave_1_NoCommunication  # Event_Dtc_Map_LIN 8 Slave 1_NoCommunication
  diagnostic event to operation cycle mapping EventOperCycleMapLIN8Slave1NoCommunication: diagnostic-event=EventLIN8Slave1NoCommunication, operation-cycle=DefaultOperationCycle  # Event_Oper_Cycle_Map_LIN 8 Slave 1_NoCommunication
  diagnostic event to debounce algorithm mapping EventDebounceMapLIN8Slave1NoCommunication: debounce-algorithm=counter_based, diagnostic-event=EventLIN8Slave1NoCommunication  # EventDebounceMap_LIN 8 Slave 1_NoCommunication
package /ZeC/DTC/DTC/Power_Path_119_Cable_Protection_Failure
  diagnostic trouble code uds Power_Path_119_Cable_Protection_Failure: dtc-props=Dtc_Props_16b633e2, uds-dtc-value=0x005877
  diagnostic event EventPowerPath119CableProtectionFailure: aging-allowed=true, event-kind=SWC, prestorage-freeze-frame=false  # Event_Power_Path_119_Cable_Protection_Failure
  diagnostic event to trouble code uds mapping EventDtcMapPowerPath119CableProtectionFailure: diagnostic-event=EventPowerPath119CableProtectionFailure, trouble-code-uds=Power_Path_119_Cable_Protection_Failure  # Event_Dtc_Map_Power_Path_119_Cable_Protection_Failure
  diagnostic event to operation cycle mapping EventOperCycleMapPowerPath119CableProtectionFailure: diagnostic-event=EventPowerPath119CableProtectionFailure, operation-cycle=DefaultOperationCycle  # Event_Oper_Cycle_Map_Power_Path_119_Cable_Protection_Failure
  diagnostic event to debounce algorithm mapping EventDebounceMapPowerPath119CableProtectionFailure: debounce-algorithm=time_based, diagnostic-event=EventPowerPath119CableProtectionFailure  # EventDebounceMap_Power_Path_119_Cable_Protection_Failure
package /ZeC/DTC/DTC/LIN_8_Slave_1_Defect
  diagnostic trouble code uds LIN_8_Slave_1_Defect: dtc-props=Dtc_Props_358996c7, uds-dtc-value=0x030810  # LIN 8 Slave 1_Defect
  diagnostic event EventLIN8Slave1Defect: aging-allowed=true, event-kind=SWC, prestorage-freeze-frame=false  # Event_LIN 8 Slave 1_Defect
  diagnostic event to trouble code uds mapping EventDtcMapLIN8Slave1Defect: diagnostic-event=EventLIN8Slave1Defect, trouble-code-uds=LIN_8_Slave_1_Defect  # Event_Dtc_Map_LIN 8 Slave 1_Defect
  diagnostic event to operation cycle mapping EventOperCycleMapLIN8Slave1Defect: diagnostic-event=EventLIN8Slave1Defect, operation-cycle=DefaultOperationCycle  # Event_Oper_Cycle_Map_LIN 8 Slave 1_Defect
  diagnostic event to debounce algorithm mapping EventDebounceMapLIN8Slave1Defect: debounce-algorithm=counter_based, diagnostic-event=EventLIN8Slave1Defect  # EventDebounceMap_LIN 8 Slave 1_Defect
package /ZeC/DTC/DTC/Power_Path_118_Cable_Protection_Failure
  diagnostic trouble code uds Power_Path_118_Cable_Protection_Failure: dtc-props=Dtc_Props_50af39d8, uds-dtc-value=0x005876
  diagnostic event EventPowerPath118CableProtectionFailure: aging-allowed=true, event-kind=SWC, prestorage-freeze-frame=false  # Event_Power_Path_118_Cable_Protection_Failure
  diagnostic event to trouble code uds mapping EventDtcMapPowerPath118CableProtectionFailure: diagnostic-event=EventPowerPath118CableProtectionFailure, trouble-code-uds=Power_Path_118_Cable_Protection_Failure  # Event_Dtc_Map_Power_Path_118_Cable_Protection_Failure
  diagnostic event to operation cycle mapping EventOperCycleMapPowerPath118CableProtectionFailure: diagnostic-event=EventPowerPath118CableProtectionFailure, operation-cycle=DefaultOperationCycle  # Event_Oper_Cycle_Map_Power_Path_118_Cable_Protection_Failure
  diagnostic event to debounce algorithm mapping EventDebounceMapPowerPath118CableProtectionFailure: debounce-algorithm=time_based, diagnostic-event=EventPowerPath118CableProtectionFailure  # EventDebounceMap_Power_Path_118_Cable_Protection_Failure
package /ZeC/DTC/DTC/Power_Path_122_Cable_Protection_Failure
  diagnostic trouble code uds Power_Path_122_Cable_Protection_Failure: dtc-props=Dtc_Props_646e6d42, uds-dtc-value=0x00587a
  diagnostic event EventPowerPath122CableProtectionFailure: aging-allowed=true, event-kind=SWC, prestorage-freeze-frame=false  # Event_Power_Path_122_Cable_Protection_Failure
  diagnostic event to trouble code uds mapping EventDtcMapPowerPath122CableProtectionFailure: diagnostic-event=EventPowerPath122CableProtectionFailure, trouble-code-uds=Power_Path_122_Cable_Protection_Failure  # Event_Dtc_Map_Power_Path_122_Cable_Protection_Failure
  diagnostic event to operation cycle mapping EventOperCycleMapPowerPath122CableProtectionFailure: diagnostic-event=EventPowerPath122CableProtectionFailure, operation-cycle=DefaultOperationCycle  # Event_Oper_Cycle_Map_Power_Path_122_Cable_Protection_Failure
  diagnostic event to debounce algorithm mapping EventDebounceMapPowerPath122CableProtectionFailure: debounce-algorithm=time_based, diagnostic-event=EventPowerPath122CableProtectionFailure  # EventDebounceMap_Power_Path_122_Cable_Protection_Failure
package /ZeC/DTC/DTC/Power_Path_124_Cable_Protection_Failure
  diagnostic trouble code uds Power_Path_124_Cable_Protection_Failure: dtc-props=Dtc_Props_e85c7936, uds-dtc-value=0x00587c
  diagnostic event EventPowerPath124CableProtectionFailure: aging-allowed=true, event-kind=SWC, prestorage-freeze-frame=false  # Event_Power_Path_124_Cable_Protection_Failure
  diagnostic event to trouble code uds mapping EventDtcMapPowerPath124CableProtectionFailure: diagnostic-event=EventPowerPath124CableProtectionFailure, trouble-code-uds=Power_Path_124_Cable_Protection_Failure  # Event_Dtc_Map_Power_Path_124_Cable_Protection_Failure
  diagnostic event to operation cycle mapping EventOperCycleMapPowerPath124CableProtectionFailure: diagnostic-event=EventPowerPath124CableProtectionFailure, operation-cycle=DefaultOperationCycle  # Event_Oper_Cycle_Map_Power_Path_124_Cable_Protection_Failure
  diagnostic event to debounce algorithm mapping EventDebounceMapPowerPath124CableProtectionFailure: debounce-algorithm=time_based, diagnostic-event=EventPowerPath124CableProtectionFailure  # EventDebounceMap_Power_Path_124_Cable_Protection_Failure
package /ZeC/DTC/DTC/Power_Path_123_Cable_Protection_Failure
  diagnostic trouble code uds Power_Path_123_Cable_Protection_Failure: dtc-props=Dtc_Props_ae45730c, uds-dtc-value=0x00587b
  diagnostic event EventPowerPath123CableProtectionFailure: aging-allowed=true, event-kind=SWC, prestorage-freeze-frame=false  # Event_Power_Path_123_Cable_Protection_Failure
  diagnostic event to trouble code uds mapping EventDtcMapPowerPath123CableProtectionFailure: diagnostic-event=EventPowerPath123CableProtectionFailure, trouble-code-uds=Power_Path_123_Cable_Protection_Failure  # Event_Dtc_Map_Power_Path_123_Cable_Protection_Failure
  diagnostic event to operation cycle mapping EventOperCycleMapPowerPath123CableProtectionFailure: diagnostic-event=EventPowerPath123CableProtectionFailure, operation-cycle=DefaultOperationCycle  # Event_Oper_Cycle_Map_Power_Path_123_Cable_Protection_Failure
  diagnostic event to debounce algorithm mapping EventDebounceMapPowerPath123CableProtectionFailure: debounce-algorithm=time_based, diagnostic-event=EventPowerPath123CableProtectionFailure  # EventDebounceMap_Power_Path_123_Cable_Protection_Failure
package /ZeC/DTC/DTC/LIN_8_Slave_9_NoCommunication
  diagnostic trouble code uds LIN_8_Slave_9_NoCommunication: dtc-props=Dtc_Props_358996c7, uds-dtc-value=0x03080f  # LIN 8 Slave 9_NoCommunication
  diagnostic event EventLIN8Slave9NoCommunication: aging-allowed=true, event-kind=SWC, prestorage-freeze-frame=false  # Event_LIN 8 Slave 9_NoCommunication
  diagnostic event to trouble code uds mapping EventDtcMapLIN8Slave9NoCommunication: diagnostic-event=EventLIN8Slave9NoCommunication, trouble-code-uds=LIN_8_Slave_9_NoCommunication  # Event_Dtc_Map_LIN 8 Slave 9_NoCommunication
  diagnostic event to operation cycle mapping EventOperCycleMapLIN8Slave9NoCommunication: diagnostic-event=EventLIN8Slave9NoCommunication, operation-cycle=DefaultOperationCycle  # Event_Oper_Cycle_Map_LIN 8 Slave 9_NoCommunication
  diagnostic event to debounce algorithm mapping EventDebounceMapLIN8Slave9NoCommunication: debounce-algorithm=counter_based, diagnostic-event=EventLIN8Slave9NoCommunication  # EventDebounceMap_LIN 8 Slave 9_NoCommunication
package /ZeC/DTC/DTC/LIN_8_Slave_9_Defect
  diagnostic trouble code uds LIN_8_Slave_9_Defect: dtc-props=Dtc_Props_358996c7, uds-dtc-value=0x03080e  # LIN 8 Slave 9_Defect
  diagnostic event EventLIN8Slave9Defect: aging-allowed=true, event-kind=SWC, prestorage-freeze-frame=false  # Event_LIN 8 Slave 9_Defect
  diagnostic event to trouble code uds mapping EventDtcMapLIN8Slave9Defect: diagnostic-event=EventLIN8Slave9Defect, trouble-code-uds=LIN_8_Slave_9_Defect  # Event_Dtc_Map_LIN 8 Slave 9_Defect
  diagnostic event to operation cycle mapping EventOperCycleMapLIN8Slave9Defect: diagnostic-event=EventLIN8Slave9Defect, operation-cycle=DefaultOperationCycle  # Event_Oper_Cycle_Map_LIN 8 Slave 9_Defect
  diagnostic event to debounce algorithm mapping EventDebounceMapLIN8Slave9Defect: debounce-algorithm=counter_based, diagnostic-event=EventLIN8Slave9Defect  # EventDebounceMap_LIN 8 Slave 9_Defect
package /ZeC/DTC/DTC/LIN_8_Slave_15_Defect
  diagnostic trouble code uds LIN_8_Slave_15_Defect: dtc-props=Dtc_Props_358996c7, uds-dtc-value=0x03081c  # LIN 8 Slave 15_Defect
  diagnostic event EventLIN8Slave15Defect: aging-allowed=true, event-kind=SWC, prestorage-freeze-frame=false  # Event_LIN 8 Slave 15_Defect
  diagnostic event to trouble code uds mapping EventDtcMapLIN8Slave15Defect: diagnostic-event=EventLIN8Slave15Defect, trouble-code-uds=LIN_8_Slave_15_Defect  # Event_Dtc_Map_LIN 8 Slave 15_Defect
  diagnostic event to operation cycle mapping EventOperCycleMapLIN8Slave15Defect: diagnostic-event=EventLIN8Slave15Defect, operation-cycle=DefaultOperationCycle  # Event_Oper_Cycle_Map_LIN 8 Slave 15_Defect
  diagnostic event to debounce algorithm mapping EventDebounceMapLIN8Slave15Defect: debounce-algorithm=counter_based, diagnostic-event=EventLIN8Slave15Defect  # EventDebounceMap_LIN 8 Slave 15_Defect
package /ZeC/DTC/DTC/LIN_8_Slave_14_NoCommunication
  diagnostic trouble code uds LIN_8_Slave_14_NoCommunication: dtc-props=Dtc_Props_358996c7, uds-dtc-value=0x03081b  # LIN 8 Slave 14_NoCommunication
  diagnostic event EventLIN8Slave14NoCommunication: aging-allowed=true, event-kind=SWC, prestorage-freeze-frame=false  # Event_LIN 8 Slave 14_NoCommunication
  diagnostic event to trouble code uds mapping EventDtcMapLIN8Slave14NoCommunication: diagnostic-event=EventLIN8Slave14NoCommunication, trouble-code-uds=LIN_8_Slave_14_NoCommunication  # Event_Dtc_Map_LIN 8 Slave 14_NoCommunication
  diagnostic event to operation cycle mapping EventOperCycleMapLIN8Slave14NoCommunication: diagnostic-event=EventLIN8Slave14NoCommunication, operation-cycle=DefaultOperationCycle  # Event_Oper_Cycle_Map_LIN 8 Slave 14_NoCommunication
  diagnostic event to debounce algorithm mapping EventDebounceMapLIN8Slave14NoCommunication: debounce-algorithm=counter_based, diagnostic-event=EventLIN8Slave14NoCommunication  # EventDebounceMap_LIN 8 Slave 14_NoCommunication
package /ZeC/DTC/DTC/LIN_8_Slave_2_Defect
  diagnostic trouble code uds LIN_8_Slave_2_Defect: dtc-props=Dtc_Props_358996c7, uds-dtc-value=0x03081e  # LIN 8 Slave 2_Defect
  diagnostic event EventLIN8Slave2Defect: aging-allowed=true, event-kind=SWC, prestorage-freeze-frame=false  # Event_LIN 8 Slave 2_Defect
  diagnostic event to trouble code uds mapping EventDtcMapLIN8Slave2Defect: diagnostic-event=EventLIN8Slave2Defect, trouble-code-uds=LIN_8_Slave_2_Defect  # Event_Dtc_Map_LIN 8 Slave 2_Defect
  diagnostic event to operation cycle mapping EventOperCycleMapLIN8Slave2Defect: diagnostic-event=EventLIN8Slave2Defect, operation-cycle=DefaultOperationCycle  # Event_Oper_Cycle_Map_LIN 8 Slave 2_Defect
  diagnostic event to debounce algorithm mapping EventDebounceMapLIN8Slave2Defect: debounce-algorithm=counter_based, diagnostic-event=EventLIN8Slave2Defect  # EventDebounceMap_LIN 8 Slave 2_Defect
package /ZeC/DTC/DTC/LIN_8_Slave_15_NoCommunication
  diagnostic trouble code uds LIN_8_Slave_15_NoCommunication: dtc-props=Dtc_Props_358996c7, uds-dtc-value=0x03081d  # LIN 8 Slave 15_NoCommunication
  diagnostic event EventLIN8Slave15NoCommunication: aging-allowed=true, event-kind=SWC, prestorage-freeze-frame=false  # Event_LIN 8 Slave 15_NoCommunication
  diagnostic event to trouble code uds mapping EventDtcMapLIN8Slave15NoCommunication: diagnostic-event=EventLIN8Slave15NoCommunication, trouble-code-uds=LIN_8_Slave_15_NoCommunication  # Event_Dtc_Map_LIN 8 Slave 15_NoCommunication
  diagnostic event to operation cycle mapping EventOperCycleMapLIN8Slave15NoCommunication: diagnostic-event=EventLIN8Slave15NoCommunication, operation-cycle=DefaultOperationCycle  # Event_Oper_Cycle_Map_LIN 8 Slave 15_NoCommunication
  diagnostic event to debounce algorithm mapping EventDebounceMapLIN8Slave15NoCommunication: debounce-algorithm=counter_based, diagnostic-event=EventLIN8Slave15NoCommunication  # EventDebounceMap_LIN 8 Slave 15_NoCommunication
package /ZeC/DTC/DTC/Power_Path_126_Cable_Protection_Failure
  diagnostic trouble code uds Power_Path_126_Cable_Protection_Failure: dtc-props=Dtc_Props_a77b43eb, uds-dtc-value=0x00587e
  diagnostic event EventPowerPath126CableProtectionFailure: aging-allowed=true, event-kind=SWC, prestorage-freeze-frame=false  # Event_Power_Path_126_Cable_Protection_Failure
  diagnostic event to trouble code uds mapping EventDtcMapPowerPath126CableProtectionFailure: diagnostic-event=EventPowerPath126CableProtectionFailure, trouble-code-uds=Power_Path_126_Cable_Protection_Failure  # Event_Dtc_Map_Power_Path_126_Cable_Protection_Failure
  diagnostic event to operation cycle mapping EventOperCycleMapPowerPath126CableProtectionFailure: diagnostic-event=EventPowerPath126CableProtectionFailure, operation-cycle=DefaultOperationCycle  # Event_Oper_Cycle_Map_Power_Path_126_Cable_Protection_Failure
  diagnostic event to debounce algorithm mapping EventDebounceMapPowerPath126CableProtectionFailure: debounce-algorithm=time_based, diagnostic-event=EventPowerPath126CableProtectionFailure  # EventDebounceMap_Power_Path_126_Cable_Protection_Failure
package /ZeC/DTC/DTC/Power_Path_125_Cable_Protection_Failure
  diagnostic trouble code uds Power_Path_125_Cable_Protection_Failure: dtc-props=Dtc_Props_e16249d1, uds-dtc-value=0x00587d
  diagnostic event EventPowerPath125CableProtectionFailure: aging-allowed=true, event-kind=SWC, prestorage-freeze-frame=false  # Event_Power_Path_125_Cable_Protection_Failure
  diagnostic event to trouble code uds mapping EventDtcMapPowerPath125CableProtectionFailure: diagnostic-event=EventPowerPath125CableProtectionFailure, trouble-code-uds=Power_Path_125_Cable_Protection_Failure  # Event_Dtc_Map_Power_Path_125_Cable_Protection_Failure
  diagnostic event to operation cycle mapping EventOperCycleMapPowerPath125CableProtectionFailure: diagnostic-event=EventPowerPath125CableProtectionFailure, operation-cycle=DefaultOperationCycle  # Event_Oper_Cycle_Map_Power_Path_125_Cable_Protection_Failure
  diagnostic event to debounce algorithm mapping EventDebounceMapPowerPath125CableProtectionFailure: debounce-algorithm=time_based, diagnostic-event=EventPowerPath125CableProtectionFailure  # EventDebounceMap_Power_Path_125_Cable_Protection_Failure
package /ZeC/DTC/DTC/LIN_8_Slave_14_Defect
  diagnostic trouble code uds LIN_8_Slave_14_Defect: dtc-props=Dtc_Props_358996c7, uds-dtc-value=0x03081a  # LIN 8 Slave 14_Defect
  diagnostic event EventLIN8Slave14Defect: aging-allowed=true, event-kind=SWC, prestorage-freeze-frame=false  # Event_LIN 8 Slave 14_Defect
  diagnostic event to trouble code uds mapping EventDtcMapLIN8Slave14Defect: diagnostic-event=EventLIN8Slave14Defect, trouble-code-uds=LIN_8_Slave_14_Defect  # Event_Dtc_Map_LIN 8 Slave 14_Defect
  diagnostic event to operation cycle mapping EventOperCycleMapLIN8Slave14Defect: diagnostic-event=EventLIN8Slave14Defect, operation-cycle=DefaultOperationCycle  # Event_Oper_Cycle_Map_LIN 8 Slave 14_Defect
  diagnostic event to debounce algorithm mapping EventDebounceMapLIN8Slave14Defect: debounce-algorithm=counter_based, diagnostic-event=EventLIN8Slave14Defect  # EventDebounceMap_LIN 8 Slave 14_Defect
package /ZeC/DTC/DTC/Power_Path_127_Cable_Protection_Failure
  diagnostic trouble code uds Power_Path_127_Cable_Protection_Failure: dtc-props=Dtc_Props_6d505da5, uds-dtc-value=0x00587f
  diagnostic event EventPowerPath127CableProtectionFailure: aging-allowed=true, event-kind=SWC, prestorage-freeze-frame=false  # Event_Power_Path_127_Cable_Protection_Failure
  diagnostic event to trouble code uds mapping EventDtcMapPowerPath127CableProtectionFailure: diagnostic-event=EventPowerPath127CableProtectionFailure, trouble-code-uds=Power_Path_127_Cable_Protection_Failure  # Event_Dtc_Map_Power_Path_127_Cable_Protection_Failure
  diagnostic event to operation cycle mapping EventOperCycleMapPowerPath127CableProtectionFailure: diagnostic-event=EventPowerPath127CableProtectionFailure, operation-cycle=DefaultOperationCycle  # Event_Oper_Cycle_Map_Power_Path_127_Cable_Protection_Failure
  diagnostic event to debounce algorithm mapping EventDebounceMapPowerPath127CableProtectionFailure: debounce-algorithm=time_based, diagnostic-event=EventPowerPath127CableProtectionFailure  # EventDebounceMap_Power_Path_127_Cable_Protection_Failure
package /ZeC/DTC/DTC/Fs_id_invalid_configuration
  diagnostic trouble code uds Fs_id_invalid_configuration: dtc-props=Dtc_Props_14158306, uds-dtc-value=0x001041
  diagnostic event EventFsIdInvalidConfiguration: aging-allowed=true, event-kind=SWC, prestorage-freeze-frame=false  # Event_Fs_id_invalid_configuration
  diagnostic event to trouble code uds mapping EventDtcMapFsIdInvalidConfiguration: diagnostic-event=EventFsIdInvalidConfiguration, trouble-code-uds=Fs_id_invalid_configuration  # Event_Dtc_Map_Fs_id_invalid_configuration
  diagnostic event to operation cycle mapping EventOperCycleMapFsIdInvalidConfiguration: diagnostic-event=EventFsIdInvalidConfiguration, operation-cycle=DefaultOperationCycle  # Event_Oper_Cycle_Map_Fs_id_invalid_configuration
  diagnostic event to debounce algorithm mapping EventDebounceMapFsIdInvalidConfiguration: debounce-algorithm=time_based, diagnostic-event=EventFsIdInvalidConfiguration  # EventDebounceMap_Fs_id_invalid_configuration
package /ZeC/DTC/DTC/Power_Path_130_Cable_Protection_Failure
  diagnostic trouble code uds Power_Path_130_Cable_Protection_Failure: dtc-props=Dtc_Props_293e441f, uds-dtc-value=0x005882
  diagnostic event EventPowerPath130CableProtectionFailure: aging-allowed=true, event-kind=SWC, prestorage-freeze-frame=false  # Event_Power_Path_130_Cable_Protection_Failure
  diagnostic event to trouble code uds mapping EventDtcMapPowerPath130CableProtectionFailure: diagnostic-event=EventPowerPath130CableProtectionFailure, trouble-code-uds=Power_Path_130_Cable_Protection_Failure  # Event_Dtc_Map_Power_Path_130_Cable_Protection_Failure
  diagnostic event to operation cycle mapping EventOperCycleMapPowerPath130CableProtectionFailure: diagnostic-event=EventPowerPath130CableProtectionFailure, operation-cycle=DefaultOperationCycle  # Event_Oper_Cycle_Map_Power_Path_130_Cable_Protection_Failure
  diagnostic event to debounce algorithm mapping EventDebounceMapPowerPath130CableProtectionFailure: debounce-algorithm=time_based, diagnostic-event=EventPowerPath130CableProtectionFailure  # EventDebounceMap_Power_Path_130_Cable_Protection_Failure
package /ZeC/DTC/DTC/Power_Path_129_Cable_Protection_Failure
  diagnostic trouble code uds Power_Path_129_Cable_Protection_Failure: dtc-props=Dtc_Props_e3155a51, uds-dtc-value=0x005881
  diagnostic event EventPowerPath129CableProtectionFailure: aging-allowed=true, event-kind=SWC, prestorage-freeze-frame=false  # Event_Power_Path_129_Cable_Protection_Failure
  diagnostic event to trouble code uds mapping EventDtcMapPowerPath129CableProtectionFailure: diagnostic-event=EventPowerPath129CableProtectionFailure, trouble-code-uds=Power_Path_129_Cable_Protection_Failure  # Event_Dtc_Map_Power_Path_129_Cable_Protection_Failure
  diagnostic event to operation cycle mapping EventOperCycleMapPowerPath129CableProtectionFailure: diagnostic-event=EventPowerPath129CableProtectionFailure, operation-cycle=DefaultOperationCycle  # Event_Oper_Cycle_Map_Power_Path_129_Cable_Protection_Failure
  diagnostic event to debounce algorithm mapping EventDebounceMapPowerPath129CableProtectionFailure: debounce-algorithm=time_based, diagnostic-event=EventPowerPath129CableProtectionFailure  # EventDebounceMap_Power_Path_129_Cable_Protection_Failure
package /ZeC/DTC/DTC/Power_Path_132_Cable_Protection_Failure
  diagnostic trouble code uds Power_Path_132_Cable_Protection_Failure: dtc-props=Dtc_Props_66197ec2, uds-dtc-value=0x005884
  diagnostic event EventPowerPath132CableProtectionFailure: aging-allowed=true, event-kind=SWC, prestorage-freeze-frame=false  # Event_Power_Path_132_Cable_Protection_Failure
  diagnostic event to trouble code uds mapping EventDtcMapPowerPath132CableProtectionFailure: diagnostic-event=EventPowerPath132CableProtectionFailure, trouble-code-uds=Power_Path_132_Cable_Protection_Failure  # Event_Dtc_Map_Power_Path_132_Cable_Protection_Failure
  diagnostic event to operation cycle mapping EventOperCycleMapPowerPath132CableProtectionFailure: diagnostic-event=EventPowerPath132CableProtectionFailure, operation-cycle=DefaultOperationCycle  # Event_Oper_Cycle_Map_Power_Path_132_Cable_Protection_Failure
  diagnostic event to debounce algorithm mapping EventDebounceMapPowerPath132CableProtectionFailure: debounce-algorithm=time_based, diagnostic-event=EventPowerPath132CableProtectionFailure  # EventDebounceMap_Power_Path_132_Cable_Protection_Failure
package /ZeC/DTC/DTC/Power_Path_131_Cable_Protection_Failure
  diagnostic trouble code uds Power_Path_131_Cable_Protection_Failure: dtc-props=Dtc_Props_6f274e25, uds-dtc-value=0x005883
  diagnostic event EventPowerPath131CableProtectionFailure: aging-allowed=true, event-kind=SWC, prestorage-freeze-frame=false  # Event_Power_Path_131_Cable_Protection_Failure
  diagnostic event to trouble code uds mapping EventDtcMapPowerPath131CableProtectionFailure: diagnostic-event=EventPowerPath131CableProtectionFailure, trouble-code-uds=Power_Path_131_Cable_Protection_Failure  # Event_Dtc_Map_Power_Path_131_Cable_Protection_Failure
  diagnostic event to operation cycle mapping EventOperCycleMapPowerPath131CableProtectionFailure: diagnostic-event=EventPowerPath131CableProtectionFailure, operation-cycle=DefaultOperationCycle  # Event_Oper_Cycle_Map_Power_Path_131_Cable_Protection_Failure
  diagnostic event to debounce algorithm mapping EventDebounceMapPowerPath131CableProtectionFailure: debounce-algorithm=time_based, diagnostic-event=EventPowerPath131CableProtectionFailure  # EventDebounceMap_Power_Path_131_Cable_Protection_Failure
package /ZeC/DTC/DTC/LIN_8_Slave_12_NoCommunication
  diagnostic trouble code uds LIN_8_Slave_12_NoCommunication: dtc-props=Dtc_Props_358996c7, uds-dtc-value=0x030817  # LIN 8 Slave 12_NoCommunication
  diagnostic event EventLIN8Slave12NoCommunication: aging-allowed=true, event-kind=SWC, prestorage-freeze-frame=false  # Event_LIN 8 Slave 12_NoCommunication
  diagnostic event to trouble code uds mapping EventDtcMapLIN8Slave12NoCommunication: diagnostic-event=EventLIN8Slave12NoCommunication, trouble-code-uds=LIN_8_Slave_12_NoCommunication  # Event_Dtc_Map_LIN 8 Slave 12_NoCommunication
  diagnostic event to operation cycle mapping EventOperCycleMapLIN8Slave12NoCommunication: diagnostic-event=EventLIN8Slave12NoCommunication, operation-cycle=DefaultOperationCycle  # Event_Oper_Cycle_Map_LIN 8 Slave 12_NoCommunication
  diagnostic event to debounce algorithm mapping EventDebounceMapLIN8Slave12NoCommunication: debounce-algorithm=counter_based, diagnostic-event=EventLIN8Slave12NoCommunication  # EventDebounceMap_LIN 8 Slave 12_NoCommunication
package /ZeC/DTC/DTC/LIN_8_Slave_12_Defect
  diagnostic trouble code uds LIN_8_Slave_12_Defect: dtc-props=Dtc_Props_358996c7, uds-dtc-value=0x030816  # LIN 8 Slave 12_Defect
  diagnostic event EventLIN8Slave12Defect: aging-allowed=true, event-kind=SWC, prestorage-freeze-frame=false  # Event_LIN 8 Slave 12_Defect
  diagnostic event to trouble code uds mapping EventDtcMapLIN8Slave12Defect: diagnostic-event=EventLIN8Slave12Defect, trouble-code-uds=LIN_8_Slave_12_Defect  # Event_Dtc_Map_LIN 8 Slave 12_Defect
  diagnostic event to operation cycle mapping EventOperCycleMapLIN8Slave12Defect: diagnostic-event=EventLIN8Slave12Defect, operation-cycle=DefaultOperationCycle  # Event_Oper_Cycle_Map_LIN 8 Slave 12_Defect
  diagnostic event to debounce algorithm mapping EventDebounceMapLIN8Slave12Defect: debounce-algorithm=counter_based, diagnostic-event=EventLIN8Slave12Defect  # EventDebounceMap_LIN 8 Slave 12_Defect
package /ZeC/DTC/DTC/LIN_8_Slave_13_NoCommunication
  diagnostic trouble code uds LIN_8_Slave_13_NoCommunication: dtc-props=Dtc_Props_358996c7, uds-dtc-value=0x030819  # LIN 8 Slave 13_NoCommunication
  diagnostic event EventLIN8Slave13NoCommunication: aging-allowed=true, event-kind=SWC, prestorage-freeze-frame=false  # Event_LIN 8 Slave 13_NoCommunication
  diagnostic event to trouble code uds mapping EventDtcMapLIN8Slave13NoCommunication: diagnostic-event=EventLIN8Slave13NoCommunication, trouble-code-uds=LIN_8_Slave_13_NoCommunication  # Event_Dtc_Map_LIN 8 Slave 13_NoCommunication
  diagnostic event to operation cycle mapping EventOperCycleMapLIN8Slave13NoCommunication: diagnostic-event=EventLIN8Slave13NoCommunication, operation-cycle=DefaultOperationCycle  # Event_Oper_Cycle_Map_LIN 8 Slave 13_NoCommunication
  diagnostic event to debounce algorithm mapping EventDebounceMapLIN8Slave13NoCommunication: debounce-algorithm=counter_based, diagnostic-event=EventLIN8Slave13NoCommunication  # EventDebounceMap_LIN 8 Slave 13_NoCommunication
package /ZeC/DTC/DTC/Power_Path_128_Cable_Protection_Failure
  diagnostic trouble code uds Power_Path_128_Cable_Protection_Failure: dtc-props=Dtc_Props_a50c506b, uds-dtc-value=0x005880
  diagnostic event EventPowerPath128CableProtectionFailure: aging-allowed=true, event-kind=SWC, prestorage-freeze-frame=false  # Event_Power_Path_128_Cable_Protection_Failure
  diagnostic event to trouble code uds mapping EventDtcMapPowerPath128CableProtectionFailure: diagnostic-event=EventPowerPath128CableProtectionFailure, trouble-code-uds=Power_Path_128_Cable_Protection_Failure  # Event_Dtc_Map_Power_Path_128_Cable_Protection_Failure
  diagnostic event to operation cycle mapping EventOperCycleMapPowerPath128CableProtectionFailure: diagnostic-event=EventPowerPath128CableProtectionFailure, operation-cycle=DefaultOperationCycle  # Event_Oper_Cycle_Map_Power_Path_128_Cable_Protection_Failure
  diagnostic event to debounce algorithm mapping EventDebounceMapPowerPath128CableProtectionFailure: debounce-algorithm=time_based, diagnostic-event=EventPowerPath128CableProtectionFailure  # EventDebounceMap_Power_Path_128_Cable_Protection_Failure
package /ZeC/DTC/DTC/Fs_id_authentification_failed
  diagnostic trouble code uds Fs_id_authentification_failed: dtc-props=Dtc_Props_14158306, uds-dtc-value=0x001040
  diagnostic event EventFsIdAuthentificationFailed: aging-allowed=true, event-kind=SWC, prestorage-freeze-frame=false  # Event_Fs_id_authentification_failed
  diagnostic event to trouble code uds mapping EventDtcMapFsIdAuthentificationFailed: diagnostic-event=EventFsIdAuthentificationFailed, trouble-code-uds=Fs_id_authentification_failed  # Event_Dtc_Map_Fs_id_authentification_failed
  diagnostic event to operation cycle mapping EventOperCycleMapFsIdAuthentificationFailed: diagnostic-event=EventFsIdAuthentificationFailed, operation-cycle=DefaultOperationCycle  # Event_Oper_Cycle_Map_Fs_id_authentification_failed
  diagnostic event to debounce algorithm mapping EventDebounceMapFsIdAuthentificationFailed: debounce-algorithm=time_based, diagnostic-event=EventFsIdAuthentificationFailed  # EventDebounceMap_Fs_id_authentification_failed
package /ZeC/DTC/DTC/LIN_8_Slave_13_Defect
  diagnostic trouble code uds LIN_8_Slave_13_Defect: dtc-props=Dtc_Props_358996c7, uds-dtc-value=0x030818  # LIN 8 Slave 13_Defect
  diagnostic event EventLIN8Slave13Defect: aging-allowed=true, event-kind=SWC, prestorage-freeze-frame=false  # Event_LIN 8 Slave 13_Defect
  diagnostic event to trouble code uds mapping EventDtcMapLIN8Slave13Defect: diagnostic-event=EventLIN8Slave13Defect, trouble-code-uds=LIN_8_Slave_13_Defect  # Event_Dtc_Map_LIN 8 Slave 13_Defect
  diagnostic event to operation cycle mapping EventOperCycleMapLIN8Slave13Defect: diagnostic-event=EventLIN8Slave13Defect, operation-cycle=DefaultOperationCycle  # Event_Oper_Cycle_Map_LIN 8 Slave 13_Defect
  diagnostic event to debounce algorithm mapping EventDebounceMapLIN8Slave13Defect: debounce-algorithm=counter_based, diagnostic-event=EventLIN8Slave13Defect  # EventDebounceMap_LIN 8 Slave 13_Defect
package /ZeC/DTC/DTC/Power_Path_036_Cable_Protection_Failure
  diagnostic trouble code uds Power_Path_036_Cable_Protection_Failure: dtc-props=Dtc_Props_b51ee376, uds-dtc-value=0x005824
  diagnostic event EventPowerPath036CableProtectionFailure: aging-allowed=true, event-kind=SWC, prestorage-freeze-frame=false  # Event_Power_Path_036_Cable_Protection_Failure
  diagnostic event to trouble code uds mapping EventDtcMapPowerPath036CableProtectionFailure: diagnostic-event=EventPowerPath036CableProtectionFailure, trouble-code-uds=Power_Path_036_Cable_Protection_Failure  # Event_Dtc_Map_Power_Path_036_Cable_Protection_Failure
  diagnostic event to operation cycle mapping EventOperCycleMapPowerPath036CableProtectionFailure: diagnostic-event=EventPowerPath036CableProtectionFailure, operation-cycle=DefaultOperationCycle  # Event_Oper_Cycle_Map_Power_Path_036_Cable_Protection_Failure
  diagnostic event to debounce algorithm mapping EventDebounceMapPowerPath036CableProtectionFailure: debounce-algorithm=time_based, diagnostic-event=EventPowerPath036CableProtectionFailure  # EventDebounceMap_Power_Path_036_Cable_Protection_Failure
package /ZeC/DTC/DTC/Power_Path_035_Cable_Protection_Failure
  diagnostic trouble code uds Power_Path_035_Cable_Protection_Failure: dtc-props=Dtc_Props_bc20d391, uds-dtc-value=0x005823
  diagnostic event EventPowerPath035CableProtectionFailure: aging-allowed=true, event-kind=SWC, prestorage-freeze-frame=false  # Event_Power_Path_035_Cable_Protection_Failure
  diagnostic event to trouble code uds mapping EventDtcMapPowerPath035CableProtectionFailure: diagnostic-event=EventPowerPath035CableProtectionFailure, trouble-code-uds=Power_Path_035_Cable_Protection_Failure  # Event_Dtc_Map_Power_Path_035_Cable_Protection_Failure
  diagnostic event to operation cycle mapping EventOperCycleMapPowerPath035CableProtectionFailure: diagnostic-event=EventPowerPath035CableProtectionFailure, operation-cycle=DefaultOperationCycle  # Event_Oper_Cycle_Map_Power_Path_035_Cable_Protection_Failure
  diagnostic event to debounce algorithm mapping EventDebounceMapPowerPath035CableProtectionFailure: debounce-algorithm=time_based, diagnostic-event=EventPowerPath035CableProtectionFailure  # EventDebounceMap_Power_Path_035_Cable_Protection_Failure
package /ZeC/DTC/DTC/Power_Path_038_Cable_Protection_Failure
  diagnostic trouble code uds Power_Path_038_Cable_Protection_Failure: dtc-props=Dtc_Props_392cf702, uds-dtc-value=0x005826
  diagnostic event EventPowerPath038CableProtectionFailure: aging-allowed=true, event-kind=SWC, prestorage-freeze-frame=false  # Event_Power_Path_038_Cable_Protection_Failure
  diagnostic event to trouble code uds mapping EventDtcMapPowerPath038CableProtectionFailure: diagnostic-event=EventPowerPath038CableProtectionFailure, trouble-code-uds=Power_Path_038_Cable_Protection_Failure  # Event_Dtc_Map_Power_Path_038_Cable_Protection_Failure
  diagnostic event to operation cycle mapping EventOperCycleMapPowerPath038CableProtectionFailure: diagnostic-event=EventPowerPath038CableProtectionFailure, operation-cycle=DefaultOperationCycle  # Event_Oper_Cycle_Map_Power_Path_038_Cable_Protection_Failure
  diagnostic event to debounce algorithm mapping EventDebounceMapPowerPath038CableProtectionFailure: debounce-algorithm=time_based, diagnostic-event=EventPowerPath038CableProtectionFailure  # EventDebounceMap_Power_Path_038_Cable_Protection_Failure
package /ZeC/DTC/DTC/Power_Path_037_Cable_Protection_Failure
  diagnostic trouble code uds Power_Path_037_Cable_Protection_Failure: dtc-props=Dtc_Props_f307e94c, uds-dtc-value=0x005825
  diagnostic event EventPowerPath037CableProtectionFailure: aging-allowed=true, event-kind=SWC, prestorage-freeze-frame=false  # Event_Power_Path_037_Cable_Protection_Failure
  diagnostic event to trouble code uds mapping EventDtcMapPowerPath037CableProtectionFailure: diagnostic-event=EventPowerPath037CableProtectionFailure, trouble-code-uds=Power_Path_037_Cable_Protection_Failure  # Event_Dtc_Map_Power_Path_037_Cable_Protection_Failure
  diagnostic event to operation cycle mapping EventOperCycleMapPowerPath037CableProtectionFailure: diagnostic-event=EventPowerPath037CableProtectionFailure, operation-cycle=DefaultOperationCycle  # Event_Oper_Cycle_Map_Power_Path_037_Cable_Protection_Failure
  diagnostic event to debounce algorithm mapping EventDebounceMapPowerPath037CableProtectionFailure: debounce-algorithm=time_based, diagnostic-event=EventPowerPath037CableProtectionFailure  # EventDebounceMap_Power_Path_037_Cable_Protection_Failure
package /ZeC/DTC/DTC/Power_Path_032_Cable_Protection_Failure
  diagnostic trouble code uds Power_Path_032_Cable_Protection_Failure: dtc-props=Dtc_Props_760bcddf, uds-dtc-value=0x005820
  diagnostic event EventPowerPath032CableProtectionFailure: aging-allowed=true, event-kind=SWC, prestorage-freeze-frame=false  # Event_Power_Path_032_Cable_Protection_Failure
  diagnostic event to trouble code uds mapping EventDtcMapPowerPath032CableProtectionFailure: diagnostic-event=EventPowerPath032CableProtectionFailure, trouble-code-uds=Power_Path_032_Cable_Protection_Failure  # Event_Dtc_Map_Power_Path_032_Cable_Protection_Failure
  diagnostic event to operation cycle mapping EventOperCycleMapPowerPath032CableProtectionFailure: diagnostic-event=EventPowerPath032CableProtectionFailure, operation-cycle=DefaultOperationCycle  # Event_Oper_Cycle_Map_Power_Path_032_Cable_Protection_Failure
  diagnostic event to debounce algorithm mapping EventDebounceMapPowerPath032CableProtectionFailure: debounce-algorithm=time_based, diagnostic-event=EventPowerPath032CableProtectionFailure  # EventDebounceMap_Power_Path_032_Cable_Protection_Failure
package /ZeC/DTC/DTC/Power_Path_034_Cable_Protection_Failure
  diagnostic trouble code uds Power_Path_034_Cable_Protection_Failure: dtc-props=Dtc_Props_fa39d9ab, uds-dtc-value=0x005822
  diagnostic event EventPowerPath034CableProtectionFailure: aging-allowed=true, event-kind=SWC, prestorage-freeze-frame=false  # Event_Power_Path_034_Cable_Protection_Failure
  diagnostic event to trouble code uds mapping EventDtcMapPowerPath034CableProtectionFailure: diagnostic-event=EventPowerPath034CableProtectionFailure, trouble-code-uds=Power_Path_034_Cable_Protection_Failure  # Event_Dtc_Map_Power_Path_034_Cable_Protection_Failure
  diagnostic event to operation cycle mapping EventOperCycleMapPowerPath034CableProtectionFailure: diagnostic-event=EventPowerPath034CableProtectionFailure, operation-cycle=DefaultOperationCycle  # Event_Oper_Cycle_Map_Power_Path_034_Cable_Protection_Failure
  diagnostic event to debounce algorithm mapping EventDebounceMapPowerPath034CableProtectionFailure: debounce-algorithm=time_based, diagnostic-event=EventPowerPath034CableProtectionFailure  # EventDebounceMap_Power_Path_034_Cable_Protection_Failure
package /ZeC/DTC/DTC/Power_Path_033_Cable_Protection_Failure
  diagnostic trouble code uds Power_Path_033_Cable_Protection_Failure: dtc-props=Dtc_Props_3012c7e5, uds-dtc-value=0x005821
  diagnostic event EventPowerPath033CableProtectionFailure: aging-allowed=true, event-kind=SWC, prestorage-freeze-frame=false  # Event_Power_Path_033_Cable_Protection_Failure
  diagnostic event to trouble code uds mapping EventDtcMapPowerPath033CableProtectionFailure: diagnostic-event=EventPowerPath033CableProtectionFailure, trouble-code-uds=Power_Path_033_Cable_Protection_Failure  # Event_Dtc_Map_Power_Path_033_Cable_Protection_Failure
  diagnostic event to operation cycle mapping EventOperCycleMapPowerPath033CableProtectionFailure: diagnostic-event=EventPowerPath033CableProtectionFailure, operation-cycle=DefaultOperationCycle  # Event_Oper_Cycle_Map_Power_Path_033_Cable_Protection_Failure
  diagnostic event to debounce algorithm mapping EventDebounceMapPowerPath033CableProtectionFailure: debounce-algorithm=time_based, diagnostic-event=EventPowerPath033CableProtectionFailure  # EventDebounceMap_Power_Path_033_Cable_Protection_Failure
package /ZeC/DTC/DTC/Power_Path_040_Cable_Protection_Failure
  diagnostic trouble code uds Power_Path_040_Cable_Protection_Failure: dtc-props=Dtc_Props_2b5096cc, uds-dtc-value=0x005828
  diagnostic event EventPowerPath040CableProtectionFailure: aging-allowed=true, event-kind=SWC, prestorage-freeze-frame=false  # Event_Power_Path_040_Cable_Protection_Failure
  diagnostic event to trouble code uds mapping EventDtcMapPowerPath040CableProtectionFailure: diagnostic-event=EventPowerPath040CableProtectionFailure, trouble-code-uds=Power_Path_040_Cable_Protection_Failure  # Event_Dtc_Map_Power_Path_040_Cable_Protection_Failure
  diagnostic event to operation cycle mapping EventOperCycleMapPowerPath040CableProtectionFailure: diagnostic-event=EventPowerPath040CableProtectionFailure, operation-cycle=DefaultOperationCycle  # Event_Oper_Cycle_Map_Power_Path_040_Cable_Protection_Failure
  diagnostic event to debounce algorithm mapping EventDebounceMapPowerPath040CableProtectionFailure: debounce-algorithm=time_based, diagnostic-event=EventPowerPath040CableProtectionFailure  # EventDebounceMap_Power_Path_040_Cable_Protection_Failure
package /ZeC/DTC/DTC/Power_Path_039_Cable_Protection_Failure
  diagnostic trouble code uds Power_Path_039_Cable_Protection_Failure: dtc-props=Dtc_Props_7f35fd38, uds-dtc-value=0x005827
  diagnostic event EventPowerPath039CableProtectionFailure: aging-allowed=true, event-kind=SWC, prestorage-freeze-frame=false  # Event_Power_Path_039_Cable_Protection_Failure
  diagnostic event to trouble code uds mapping EventDtcMapPowerPath039CableProtectionFailure: diagnostic-event=EventPowerPath039CableProtectionFailure, trouble-code-uds=Power_Path_039_Cable_Protection_Failure  # Event_Dtc_Map_Power_Path_039_Cable_Protection_Failure
  diagnostic event to operation cycle mapping EventOperCycleMapPowerPath039CableProtectionFailure: diagnostic-event=EventPowerPath039CableProtectionFailure, operation-cycle=DefaultOperationCycle  # Event_Oper_Cycle_Map_Power_Path_039_Cable_Protection_Failure
  diagnostic event to debounce algorithm mapping EventDebounceMapPowerPath039CableProtectionFailure: debounce-algorithm=time_based, diagnostic-event=EventPowerPath039CableProtectionFailure  # EventDebounceMap_Power_Path_039_Cable_Protection_Failure
package /ZeC/DTC/DTC/Power_Path_041_Cable_Protection_Failure
  diagnostic trouble code uds Power_Path_041_Cable_Protection_Failure: dtc-props=Dtc_Props_6d499cf6, uds-dtc-value=0x005829
  diagnostic event EventPowerPath041CableProtectionFailure: aging-allowed=true, event-kind=SWC, prestorage-freeze-frame=false  # Event_Power_Path_041_Cable_Protection_Failure
  diagnostic event to trouble code uds mapping EventDtcMapPowerPath041CableProtectionFailure: diagnostic-event=EventPowerPath041CableProtectionFailure, trouble-code-uds=Power_Path_041_Cable_Protection_Failure  # Event_Dtc_Map_Power_Path_041_Cable_Protection_Failure
  diagnostic event to operation cycle mapping EventOperCycleMapPowerPath041CableProtectionFailure: diagnostic-event=EventPowerPath041CableProtectionFailure, operation-cycle=DefaultOperationCycle  # Event_Oper_Cycle_Map_Power_Path_041_Cable_Protection_Failure
  diagnostic event to debounce algorithm mapping EventDebounceMapPowerPath041CableProtectionFailure: debounce-algorithm=time_based, diagnostic-event=EventPowerPath041CableProtectionFailure  # EventDebounceMap_Power_Path_041_Cable_Protection_Failure
package /ZeC/DTC/DTC/Power_Path_045_Cable_Protection_Failure
  diagnostic trouble code uds Power_Path_045_Cable_Protection_Failure: dtc-props=Dtc_Props_88e1870b, uds-dtc-value=0x00582d
  diagnostic event EventPowerPath045CableProtectionFailure: aging-allowed=true, event-kind=SWC, prestorage-freeze-frame=false  # Event_Power_Path_045_Cable_Protection_Failure
  diagnostic event to trouble code uds mapping EventDtcMapPowerPath045CableProtectionFailure: diagnostic-event=EventPowerPath045CableProtectionFailure, trouble-code-uds=Power_Path_045_Cable_Protection_Failure  # Event_Dtc_Map_Power_Path_045_Cable_Protection_Failure
  diagnostic event to operation cycle mapping EventOperCycleMapPowerPath045CableProtectionFailure: diagnostic-event=EventPowerPath045CableProtectionFailure, operation-cycle=DefaultOperationCycle  # Event_Oper_Cycle_Map_Power_Path_045_Cable_Protection_Failure
  diagnostic event to debounce algorithm mapping EventDebounceMapPowerPath045CableProtectionFailure: debounce-algorithm=time_based, diagnostic-event=EventPowerPath045CableProtectionFailure  # EventDebounceMap_Power_Path_045_Cable_Protection_Failure
package /ZeC/DTC/DTC/Power_Path_044_Cable_Protection_Failure
  diagnostic trouble code uds Power_Path_044_Cable_Protection_Failure: dtc-props=Dtc_Props_81dfb7ec, uds-dtc-value=0x00582c
  diagnostic event EventPowerPath044CableProtectionFailure: aging-allowed=true, event-kind=SWC, prestorage-freeze-frame=false  # Event_Power_Path_044_Cable_Protection_Failure
  diagnostic event to trouble code uds mapping EventDtcMapPowerPath044CableProtectionFailure: diagnostic-event=EventPowerPath044CableProtectionFailure, trouble-code-uds=Power_Path_044_Cable_Protection_Failure  # Event_Dtc_Map_Power_Path_044_Cable_Protection_Failure
  diagnostic event to operation cycle mapping EventOperCycleMapPowerPath044CableProtectionFailure: diagnostic-event=EventPowerPath044CableProtectionFailure, operation-cycle=DefaultOperationCycle  # Event_Oper_Cycle_Map_Power_Path_044_Cable_Protection_Failure
  diagnostic event to debounce algorithm mapping EventDebounceMapPowerPath044CableProtectionFailure: debounce-algorithm=time_based, diagnostic-event=EventPowerPath044CableProtectionFailure  # EventDebounceMap_Power_Path_044_Cable_Protection_Failure
package /ZeC/DTC/DTC/Power_Path_047_Cable_Protection_Failure
  diagnostic trouble code uds Power_Path_047_Cable_Protection_Failure: dtc-props=Dtc_Props_4d3937f, uds-dtc-value=0x00582f
  diagnostic event EventPowerPath047CableProtectionFailure: aging-allowed=true, event-kind=SWC, prestorage-freeze-frame=false  # Event_Power_Path_047_Cable_Protection_Failure
  diagnostic event to trouble code uds mapping EventDtcMapPowerPath047CableProtectionFailure: diagnostic-event=EventPowerPath047CableProtectionFailure, trouble-code-uds=Power_Path_047_Cable_Protection_Failure  # Event_Dtc_Map_Power_Path_047_Cable_Protection_Failure
  diagnostic event to operation cycle mapping EventOperCycleMapPowerPath047CableProtectionFailure: diagnostic-event=EventPowerPath047CableProtectionFailure, operation-cycle=DefaultOperationCycle  # Event_Oper_Cycle_Map_Power_Path_047_Cable_Protection_Failure
  diagnostic event to debounce algorithm mapping EventDebounceMapPowerPath047CableProtectionFailure: debounce-algorithm=time_based, diagnostic-event=EventPowerPath047CableProtectionFailure  # EventDebounceMap_Power_Path_047_Cable_Protection_Failure
package /ZeC/DTC/DTC/Power_Path_046_Cable_Protection_Failure
  diagnostic trouble code uds Power_Path_046_Cable_Protection_Failure: dtc-props=Dtc_Props_cef88d31, uds-dtc-value=0x00582e
  diagnostic event EventPowerPath046CableProtectionFailure: aging-allowed=true, event-kind=SWC, prestorage-freeze-frame=false  # Event_Power_Path_046_Cable_Protection_Failure
  diagnostic event to trouble code uds mapping EventDtcMapPowerPath046CableProtectionFailure: diagnostic-event=EventPowerPath046CableProtectionFailure, trouble-code-uds=Power_Path_046_Cable_Protection_Failure  # Event_Dtc_Map_Power_Path_046_Cable_Protection_Failure
  diagnostic event to operation cycle mapping EventOperCycleMapPowerPath046CableProtectionFailure: diagnostic-event=EventPowerPath046CableProtectionFailure, operation-cycle=DefaultOperationCycle  # Event_Oper_Cycle_Map_Power_Path_046_Cable_Protection_Failure
  diagnostic event to debounce algorithm mapping EventDebounceMapPowerPath046CableProtectionFailure: debounce-algorithm=time_based, diagnostic-event=EventPowerPath046CableProtectionFailure  # EventDebounceMap_Power_Path_046_Cable_Protection_Failure
package /ZeC/DTC/DTC/Power_Path_043_Cable_Protection_Failure
  diagnostic trouble code uds Power_Path_043_Cable_Protection_Failure: dtc-props=Dtc_Props_c7c6bdd6, uds-dtc-value=0x00582b
  diagnostic event EventPowerPath043CableProtectionFailure: aging-allowed=true, event-kind=SWC, prestorage-freeze-frame=false  # Event_Power_Path_043_Cable_Protection_Failure
  diagnostic event to trouble code uds mapping EventDtcMapPowerPath043CableProtectionFailure: diagnostic-event=EventPowerPath043CableProtectionFailure, trouble-code-uds=Power_Path_043_Cable_Protection_Failure  # Event_Dtc_Map_Power_Path_043_Cable_Protection_Failure
  diagnostic event to operation cycle mapping EventOperCycleMapPowerPath043CableProtectionFailure: diagnostic-event=EventPowerPath043CableProtectionFailure, operation-cycle=DefaultOperationCycle  # Event_Oper_Cycle_Map_Power_Path_043_Cable_Protection_Failure
  diagnostic event to debounce algorithm mapping EventDebounceMapPowerPath043CableProtectionFailure: debounce-algorithm=time_based, diagnostic-event=EventPowerPath043CableProtectionFailure  # EventDebounceMap_Power_Path_043_Cable_Protection_Failure
package /ZeC/DTC/DTC/Power_Path_042_Cable_Protection_Failure
  diagnostic trouble code uds Power_Path_042_Cable_Protection_Failure: dtc-props=Dtc_Props_deda398, uds-dtc-value=0x00582a
  diagnostic event EventPowerPath042CableProtectionFailure: aging-allowed=true, event-kind=SWC, prestorage-freeze-frame=false  # Event_Power_Path_042_Cable_Protection_Failure
  diagnostic event to trouble code uds mapping EventDtcMapPowerPath042CableProtectionFailure: diagnostic-event=EventPowerPath042CableProtectionFailure, trouble-code-uds=Power_Path_042_Cable_Protection_Failure  # Event_Dtc_Map_Power_Path_042_Cable_Protection_Failure
  diagnostic event to operation cycle mapping EventOperCycleMapPowerPath042CableProtectionFailure: diagnostic-event=EventPowerPath042CableProtectionFailure, operation-cycle=DefaultOperationCycle  # Event_Oper_Cycle_Map_Power_Path_042_Cable_Protection_Failure
  diagnostic event to debounce algorithm mapping EventDebounceMapPowerPath042CableProtectionFailure: debounce-algorithm=time_based, diagnostic-event=EventPowerPath042CableProtectionFailure  # EventDebounceMap_Power_Path_042_Cable_Protection_Failure
package /ZeC/DTC/DTC/Power_Path_019_Cable_Protection_Failure
  diagnostic trouble code uds Power_Path_019_Cable_Protection_Failure: dtc-props=Dtc_Props_2d8e9418, uds-dtc-value=0x005813
  diagnostic event EventPowerPath019CableProtectionFailure: aging-allowed=true, event-kind=SWC, prestorage-freeze-frame=false  # Event_Power_Path_019_Cable_Protection_Failure
  diagnostic event to trouble code uds mapping EventDtcMapPowerPath019CableProtectionFailure: diagnostic-event=EventPowerPath019CableProtectionFailure, trouble-code-uds=Power_Path_019_Cable_Protection_Failure  # Event_Dtc_Map_Power_Path_019_Cable_Protection_Failure
  diagnostic event to operation cycle mapping EventOperCycleMapPowerPath019CableProtectionFailure: diagnostic-event=EventPowerPath019CableProtectionFailure, operation-cycle=DefaultOperationCycle  # Event_Oper_Cycle_Map_Power_Path_019_Cable_Protection_Failure
  diagnostic event to debounce algorithm mapping EventDebounceMapPowerPath019CableProtectionFailure: debounce-algorithm=time_based, diagnostic-event=EventPowerPath019CableProtectionFailure  # EventDebounceMap_Power_Path_019_Cable_Protection_Failure
package /ZeC/DTC/DTC/Power_Path_018_Cable_Protection_Failure
  diagnostic trouble code uds Power_Path_018_Cable_Protection_Failure: dtc-props=Dtc_Props_6b979e22, uds-dtc-value=0x005812
  diagnostic event EventPowerPath018CableProtectionFailure: aging-allowed=true, event-kind=SWC, prestorage-freeze-frame=false  # Event_Power_Path_018_Cable_Protection_Failure
  diagnostic event to trouble code uds mapping EventDtcMapPowerPath018CableProtectionFailure: diagnostic-event=EventPowerPath018CableProtectionFailure, trouble-code-uds=Power_Path_018_Cable_Protection_Failure  # Event_Dtc_Map_Power_Path_018_Cable_Protection_Failure
  diagnostic event to operation cycle mapping EventOperCycleMapPowerPath018CableProtectionFailure: diagnostic-event=EventPowerPath018CableProtectionFailure, operation-cycle=DefaultOperationCycle  # Event_Oper_Cycle_Map_Power_Path_018_Cable_Protection_Failure
  diagnostic event to debounce algorithm mapping EventDebounceMapPowerPath018CableProtectionFailure: debounce-algorithm=time_based, diagnostic-event=EventPowerPath018CableProtectionFailure  # EventDebounceMap_Power_Path_018_Cable_Protection_Failure
package /ZeC/DTC/DTC/Power_Path_021_Cable_Protection_Failure
  diagnostic trouble code uds Power_Path_021_Cable_Protection_Failure: dtc-props=Dtc_Props_62a9aec5, uds-dtc-value=0x005815
  diagnostic event EventPowerPath021CableProtectionFailure: aging-allowed=true, event-kind=SWC, prestorage-freeze-frame=false  # Event_Power_Path_021_Cable_Protection_Failure
  diagnostic event to trouble code uds mapping EventDtcMapPowerPath021CableProtectionFailure: diagnostic-event=EventPowerPath021CableProtectionFailure, trouble-code-uds=Power_Path_021_Cable_Protection_Failure  # Event_Dtc_Map_Power_Path_021_Cable_Protection_Failure
  diagnostic event to operation cycle mapping EventOperCycleMapPowerPath021CableProtectionFailure: diagnostic-event=EventPowerPath021CableProtectionFailure, operation-cycle=DefaultOperationCycle  # Event_Oper_Cycle_Map_Power_Path_021_Cable_Protection_Failure
  diagnostic event to debounce algorithm mapping EventDebounceMapPowerPath021CableProtectionFailure: debounce-algorithm=time_based, diagnostic-event=EventPowerPath021CableProtectionFailure  # EventDebounceMap_Power_Path_021_Cable_Protection_Failure
package /ZeC/DTC/DTC/Power_Path_020_Cable_Protection_Failure
  diagnostic trouble code uds Power_Path_020_Cable_Protection_Failure: dtc-props=Dtc_Props_24b0a4ff, uds-dtc-value=0x005814
  diagnostic event EventPowerPath020CableProtectionFailure: aging-allowed=true, event-kind=SWC, prestorage-freeze-frame=false  # Event_Power_Path_020_Cable_Protection_Failure
  diagnostic event to trouble code uds mapping EventDtcMapPowerPath020CableProtectionFailure: diagnostic-event=EventPowerPath020CableProtectionFailure, trouble-code-uds=Power_Path_020_Cable_Protection_Failure  # Event_Dtc_Map_Power_Path_020_Cable_Protection_Failure
  diagnostic event to operation cycle mapping EventOperCycleMapPowerPath020CableProtectionFailure: diagnostic-event=EventPowerPath020CableProtectionFailure, operation-cycle=DefaultOperationCycle  # Event_Oper_Cycle_Map_Power_Path_020_Cable_Protection_Failure
  diagnostic event to debounce algorithm mapping EventDebounceMapPowerPath020CableProtectionFailure: debounce-algorithm=time_based, diagnostic-event=EventPowerPath020CableProtectionFailure  # EventDebounceMap_Power_Path_020_Cable_Protection_Failure
package /ZeC/DTC/DTC/Power_Path_017_Cable_Protection_Failure
  diagnostic trouble code uds Power_Path_017_Cable_Protection_Failure: dtc-props=Dtc_Props_a1bc806c, uds-dtc-value=0x005811
  diagnostic event EventPowerPath017CableProtectionFailure: aging-allowed=true, event-kind=SWC, prestorage-freeze-frame=false  # Event_Power_Path_017_Cable_Protection_Failure
  diagnostic event to trouble code uds mapping EventDtcMapPowerPath017CableProtectionFailure: diagnostic-event=EventPowerPath017CableProtectionFailure, trouble-code-uds=Power_Path_017_Cable_Protection_Failure  # Event_Dtc_Map_Power_Path_017_Cable_Protection_Failure
  diagnostic event to operation cycle mapping EventOperCycleMapPowerPath017CableProtectionFailure: diagnostic-event=EventPowerPath017CableProtectionFailure, operation-cycle=DefaultOperationCycle  # Event_Oper_Cycle_Map_Power_Path_017_Cable_Protection_Failure
  diagnostic event to debounce algorithm mapping EventDebounceMapPowerPath017CableProtectionFailure: debounce-algorithm=time_based, diagnostic-event=EventPowerPath017CableProtectionFailure  # EventDebounceMap_Power_Path_017_Cable_Protection_Failure
package /ZeC/DTC/DTC/Power_Path_016_Cable_Protection_Failure
  diagnostic trouble code uds Power_Path_016_Cable_Protection_Failure: dtc-props=Dtc_Props_e7a58a56, uds-dtc-value=0x005810
  diagnostic event EventPowerPath016CableProtectionFailure: aging-allowed=true, event-kind=SWC, prestorage-freeze-frame=false  # Event_Power_Path_016_Cable_Protection_Failure
  diagnostic event to trouble code uds mapping EventDtcMapPowerPath016CableProtectionFailure: diagnostic-event=EventPowerPath016CableProtectionFailure, trouble-code-uds=Power_Path_016_Cable_Protection_Failure  # Event_Dtc_Map_Power_Path_016_Cable_Protection_Failure
  diagnostic event to operation cycle mapping EventOperCycleMapPowerPath016CableProtectionFailure: diagnostic-event=EventPowerPath016CableProtectionFailure, operation-cycle=DefaultOperationCycle  # Event_Oper_Cycle_Map_Power_Path_016_Cable_Protection_Failure
  diagnostic event to debounce algorithm mapping EventDebounceMapPowerPath016CableProtectionFailure: debounce-algorithm=time_based, diagnostic-event=EventPowerPath016CableProtectionFailure  # EventDebounceMap_Power_Path_016_Cable_Protection_Failure
package /ZeC/DTC/DTC/Power_Path_023_Cable_Protection_Failure
  diagnostic trouble code uds Power_Path_023_Cable_Protection_Failure: dtc-props=Dtc_Props_ee9bbab1, uds-dtc-value=0x005817
  diagnostic event EventPowerPath023CableProtectionFailure: aging-allowed=true, event-kind=SWC, prestorage-freeze-frame=false  # Event_Power_Path_023_Cable_Protection_Failure
  diagnostic event to trouble code uds mapping EventDtcMapPowerPath023CableProtectionFailure: diagnostic-event=EventPowerPath023CableProtectionFailure, trouble-code-uds=Power_Path_023_Cable_Protection_Failure  # Event_Dtc_Map_Power_Path_023_Cable_Protection_Failure
  diagnostic event to operation cycle mapping EventOperCycleMapPowerPath023CableProtectionFailure: diagnostic-event=EventPowerPath023CableProtectionFailure, operation-cycle=DefaultOperationCycle  # Event_Oper_Cycle_Map_Power_Path_023_Cable_Protection_Failure
  diagnostic event to debounce algorithm mapping EventDebounceMapPowerPath023CableProtectionFailure: debounce-algorithm=time_based, diagnostic-event=EventPowerPath023CableProtectionFailure  # EventDebounceMap_Power_Path_023_Cable_Protection_Failure
package /ZeC/DTC/DTC/Power_Path_022_Cable_Protection_Failure
  diagnostic trouble code uds Power_Path_022_Cable_Protection_Failure: dtc-props=Dtc_Props_a882b08b, uds-dtc-value=0x005816
  diagnostic event EventPowerPath022CableProtectionFailure: aging-allowed=true, event-kind=SWC, prestorage-freeze-frame=false  # Event_Power_Path_022_Cable_Protection_Failure
  diagnostic event to trouble code uds mapping EventDtcMapPowerPath022CableProtectionFailure: diagnostic-event=EventPowerPath022CableProtectionFailure, trouble-code-uds=Power_Path_022_Cable_Protection_Failure  # Event_Dtc_Map_Power_Path_022_Cable_Protection_Failure
  diagnostic event to operation cycle mapping EventOperCycleMapPowerPath022CableProtectionFailure: diagnostic-event=EventPowerPath022CableProtectionFailure, operation-cycle=DefaultOperationCycle  # Event_Oper_Cycle_Map_Power_Path_022_Cable_Protection_Failure
  diagnostic event to debounce algorithm mapping EventDebounceMapPowerPath022CableProtectionFailure: debounce-algorithm=time_based, diagnostic-event=EventPowerPath022CableProtectionFailure  # EventDebounceMap_Power_Path_022_Cable_Protection_Failure
package /ZeC/DTC/DTC/Power_Path_025_Cable_Protection_Failure
  diagnostic trouble code uds Power_Path_025_Cable_Protection_Failure: dtc-props=Dtc_Props_fce7db7f, uds-dtc-value=0x005819
  diagnostic event EventPowerPath025CableProtectionFailure: aging-allowed=true, event-kind=SWC, prestorage-freeze-frame=false  # Event_Power_Path_025_Cable_Protection_Failure
  diagnostic event to trouble code uds mapping EventDtcMapPowerPath025CableProtectionFailure: diagnostic-event=EventPowerPath025CableProtectionFailure, trouble-code-uds=Power_Path_025_Cable_Protection_Failure  # Event_Dtc_Map_Power_Path_025_Cable_Protection_Failure
  diagnostic event to operation cycle mapping EventOperCycleMapPowerPath025CableProtectionFailure: diagnostic-event=EventPowerPath025CableProtectionFailure, operation-cycle=DefaultOperationCycle  # Event_Oper_Cycle_Map_Power_Path_025_Cable_Protection_Failure
  diagnostic event to debounce algorithm mapping EventDebounceMapPowerPath025CableProtectionFailure: debounce-algorithm=time_based, diagnostic-event=EventPowerPath025CableProtectionFailure  # EventDebounceMap_Power_Path_025_Cable_Protection_Failure
package /ZeC/DTC/DTC/Power_Path_024_Cable_Protection_Failure
  diagnostic trouble code uds Power_Path_024_Cable_Protection_Failure: dtc-props=Dtc_Props_bafed145, uds-dtc-value=0x005818
  diagnostic event EventPowerPath024CableProtectionFailure: aging-allowed=true, event-kind=SWC, prestorage-freeze-frame=false  # Event_Power_Path_024_Cable_Protection_Failure
  diagnostic event to trouble code uds mapping EventDtcMapPowerPath024CableProtectionFailure: diagnostic-event=EventPowerPath024CableProtectionFailure, trouble-code-uds=Power_Path_024_Cable_Protection_Failure  # Event_Dtc_Map_Power_Path_024_Cable_Protection_Failure
  diagnostic event to operation cycle mapping EventOperCycleMapPowerPath024CableProtectionFailure: diagnostic-event=EventPowerPath024CableProtectionFailure, operation-cycle=DefaultOperationCycle  # Event_Oper_Cycle_Map_Power_Path_024_Cable_Protection_Failure
  diagnostic event to debounce algorithm mapping EventDebounceMapPowerPath024CableProtectionFailure: debounce-algorithm=time_based, diagnostic-event=EventPowerPath024CableProtectionFailure  # EventDebounceMap_Power_Path_024_Cable_Protection_Failure
package /ZeC/DTC/DTC/Power_Path_028_Cable_Protection_Failure
  diagnostic trouble code uds Power_Path_028_Cable_Protection_Failure: dtc-props=Dtc_Props_1071f065, uds-dtc-value=0x00581c
  diagnostic event EventPowerPath028CableProtectionFailure: aging-allowed=true, event-kind=SWC, prestorage-freeze-frame=false  # Event_Power_Path_028_Cable_Protection_Failure
  diagnostic event to trouble code uds mapping EventDtcMapPowerPath028CableProtectionFailure: diagnostic-event=EventPowerPath028CableProtectionFailure, trouble-code-uds=Power_Path_028_Cable_Protection_Failure  # Event_Dtc_Map_Power_Path_028_Cable_Protection_Failure
  diagnostic event to operation cycle mapping EventOperCycleMapPowerPath028CableProtectionFailure: diagnostic-event=EventPowerPath028CableProtectionFailure, operation-cycle=DefaultOperationCycle  # Event_Oper_Cycle_Map_Power_Path_028_Cable_Protection_Failure
  diagnostic event to debounce algorithm mapping EventDebounceMapPowerPath028CableProtectionFailure: debounce-algorithm=time_based, diagnostic-event=EventPowerPath028CableProtectionFailure  # EventDebounceMap_Power_Path_028_Cable_Protection_Failure
package /ZeC/DTC/DTC/Power_Path_027_Cable_Protection_Failure
  diagnostic trouble code uds Power_Path_027_Cable_Protection_Failure: dtc-props=Dtc_Props_5668fa5f, uds-dtc-value=0x00581b
  diagnostic event EventPowerPath027CableProtectionFailure: aging-allowed=true, event-kind=SWC, prestorage-freeze-frame=false  # Event_Power_Path_027_Cable_Protection_Failure
  diagnostic event to trouble code uds mapping EventDtcMapPowerPath027CableProtectionFailure: diagnostic-event=EventPowerPath027CableProtectionFailure, trouble-code-uds=Power_Path_027_Cable_Protection_Failure  # Event_Dtc_Map_Power_Path_027_Cable_Protection_Failure
  diagnostic event to operation cycle mapping EventOperCycleMapPowerPath027CableProtectionFailure: diagnostic-event=EventPowerPath027CableProtectionFailure, operation-cycle=DefaultOperationCycle  # Event_Oper_Cycle_Map_Power_Path_027_Cable_Protection_Failure
  diagnostic event to debounce algorithm mapping EventDebounceMapPowerPath027CableProtectionFailure: debounce-algorithm=time_based, diagnostic-event=EventPowerPath027CableProtectionFailure  # EventDebounceMap_Power_Path_027_Cable_Protection_Failure
package /ZeC/DTC/DTC/Power_Path_030_Cable_Protection_Failure
  diagnostic trouble code uds Power_Path_030_Cable_Protection_Failure: dtc-props=Dtc_Props_5f56cab8, uds-dtc-value=0x00581e
  diagnostic event EventPowerPath030CableProtectionFailure: aging-allowed=true, event-kind=SWC, prestorage-freeze-frame=false  # Event_Power_Path_030_Cable_Protection_Failure
  diagnostic event to trouble code uds mapping EventDtcMapPowerPath030CableProtectionFailure: diagnostic-event=EventPowerPath030CableProtectionFailure, trouble-code-uds=Power_Path_030_Cable_Protection_Failure  # Event_Dtc_Map_Power_Path_030_Cable_Protection_Failure
  diagnostic event to operation cycle mapping EventOperCycleMapPowerPath030CableProtectionFailure: diagnostic-event=EventPowerPath030CableProtectionFailure, operation-cycle=DefaultOperationCycle  # Event_Oper_Cycle_Map_Power_Path_030_Cable_Protection_Failure
  diagnostic event to debounce algorithm mapping EventDebounceMapPowerPath030CableProtectionFailure: debounce-algorithm=time_based, diagnostic-event=EventPowerPath030CableProtectionFailure  # EventDebounceMap_Power_Path_030_Cable_Protection_Failure
package /ZeC/DTC/DTC/Power_Path_029_Cable_Protection_Failure
  diagnostic trouble code uds Power_Path_029_Cable_Protection_Failure: dtc-props=Dtc_Props_194fc082, uds-dtc-value=0x00581d
  diagnostic event EventPowerPath029CableProtectionFailure: aging-allowed=true, event-kind=SWC, prestorage-freeze-frame=false  # Event_Power_Path_029_Cable_Protection_Failure
  diagnostic event to trouble code uds mapping EventDtcMapPowerPath029CableProtectionFailure: diagnostic-event=EventPowerPath029CableProtectionFailure, trouble-code-uds=Power_Path_029_Cable_Protection_Failure  # Event_Dtc_Map_Power_Path_029_Cable_Protection_Failure
  diagnostic event to operation cycle mapping EventOperCycleMapPowerPath029CableProtectionFailure: diagnostic-event=EventPowerPath029CableProtectionFailure, operation-cycle=DefaultOperationCycle  # Event_Oper_Cycle_Map_Power_Path_029_Cable_Protection_Failure
  diagnostic event to debounce algorithm mapping EventDebounceMapPowerPath029CableProtectionFailure: debounce-algorithm=time_based, diagnostic-event=EventPowerPath029CableProtectionFailure  # EventDebounceMap_Power_Path_029_Cable_Protection_Failure
package /ZeC/DTC/DTC/Power_Path_026_Cable_Protection_Failure
  diagnostic trouble code uds Power_Path_026_Cable_Protection_Failure: dtc-props=Dtc_Props_9c43e411, uds-dtc-value=0x00581a
  diagnostic event EventPowerPath026CableProtectionFailure: aging-allowed=true, event-kind=SWC, prestorage-freeze-frame=false  # Event_Power_Path_026_Cable_Protection_Failure
  diagnostic event to trouble code uds mapping EventDtcMapPowerPath026CableProtectionFailure: diagnostic-event=EventPowerPath026CableProtectionFailure, trouble-code-uds=Power_Path_026_Cable_Protection_Failure  # Event_Dtc_Map_Power_Path_026_Cable_Protection_Failure
  diagnostic event to operation cycle mapping EventOperCycleMapPowerPath026CableProtectionFailure: diagnostic-event=EventPowerPath026CableProtectionFailure, operation-cycle=DefaultOperationCycle  # Event_Oper_Cycle_Map_Power_Path_026_Cable_Protection_Failure
  diagnostic event to debounce algorithm mapping EventDebounceMapPowerPath026CableProtectionFailure: debounce-algorithm=time_based, diagnostic-event=EventPowerPath026CableProtectionFailure  # EventDebounceMap_Power_Path_026_Cable_Protection_Failure
package /ZeC/DTC/DTC/Power_Path_031_Cable_Protection_Failure
  diagnostic trouble code uds Power_Path_031_Cable_Protection_Failure: dtc-props=Dtc_Props_957dd4f6, uds-dtc-value=0x00581f
  diagnostic event EventPowerPath031CableProtectionFailure: aging-allowed=true, event-kind=SWC, prestorage-freeze-frame=false  # Event_Power_Path_031_Cable_Protection_Failure
  diagnostic event to trouble code uds mapping EventDtcMapPowerPath031CableProtectionFailure: diagnostic-event=EventPowerPath031CableProtectionFailure, trouble-code-uds=Power_Path_031_Cable_Protection_Failure  # Event_Dtc_Map_Power_Path_031_Cable_Protection_Failure
  diagnostic event to operation cycle mapping EventOperCycleMapPowerPath031CableProtectionFailure: diagnostic-event=EventPowerPath031CableProtectionFailure, operation-cycle=DefaultOperationCycle  # Event_Oper_Cycle_Map_Power_Path_031_Cable_Protection_Failure
  diagnostic event to debounce algorithm mapping EventDebounceMapPowerPath031CableProtectionFailure: debounce-algorithm=time_based, diagnostic-event=EventPowerPath031CableProtectionFailure  # EventDebounceMap_Power_Path_031_Cable_Protection_Failure
package /ZeC/DTC/DTC/Power_Path_070_Cable_Protection_Failure
  diagnostic trouble code uds Power_Path_070_Cable_Protection_Failure: dtc-props=Dtc_Props_c1017e51, uds-dtc-value=0x005846
  diagnostic event EventPowerPath070CableProtectionFailure: aging-allowed=true, event-kind=SWC, prestorage-freeze-frame=false  # Event_Power_Path_070_Cable_Protection_Failure
  diagnostic event to trouble code uds mapping EventDtcMapPowerPath070CableProtectionFailure: diagnostic-event=EventPowerPath070CableProtectionFailure, trouble-code-uds=Power_Path_070_Cable_Protection_Failure  # Event_Dtc_Map_Power_Path_070_Cable_Protection_Failure
  diagnostic event to operation cycle mapping EventOperCycleMapPowerPath070CableProtectionFailure: diagnostic-event=EventPowerPath070CableProtectionFailure, operation-cycle=DefaultOperationCycle  # Event_Oper_Cycle_Map_Power_Path_070_Cable_Protection_Failure
  diagnostic event to debounce algorithm mapping EventDebounceMapPowerPath070CableProtectionFailure: debounce-algorithm=time_based, diagnostic-event=EventPowerPath070CableProtectionFailure  # EventDebounceMap_Power_Path_070_Cable_Protection_Failure
package /ZeC/DTC/DTC/Power_Path_069_Cable_Protection_Failure
  diagnostic trouble code uds Power_Path_069_Cable_Protection_Failure: dtc-props=Dtc_Props_b2a601f, uds-dtc-value=0x005845
  diagnostic event EventPowerPath069CableProtectionFailure: aging-allowed=true, event-kind=SWC, prestorage-freeze-frame=false  # Event_Power_Path_069_Cable_Protection_Failure
  diagnostic event to trouble code uds mapping EventDtcMapPowerPath069CableProtectionFailure: diagnostic-event=EventPowerPath069CableProtectionFailure, trouble-code-uds=Power_Path_069_Cable_Protection_Failure  # Event_Dtc_Map_Power_Path_069_Cable_Protection_Failure
  diagnostic event to operation cycle mapping EventOperCycleMapPowerPath069CableProtectionFailure: diagnostic-event=EventPowerPath069CableProtectionFailure, operation-cycle=DefaultOperationCycle  # Event_Oper_Cycle_Map_Power_Path_069_Cable_Protection_Failure
  diagnostic event to debounce algorithm mapping EventDebounceMapPowerPath069CableProtectionFailure: debounce-algorithm=time_based, diagnostic-event=EventPowerPath069CableProtectionFailure  # EventDebounceMap_Power_Path_069_Cable_Protection_Failure
package /ZeC/DTC/DTC/Power_Path_072_Cable_Protection_Failure
  diagnostic trouble code uds Power_Path_072_Cable_Protection_Failure: dtc-props=Dtc_Props_d37d1f9f, uds-dtc-value=0x005848
  diagnostic event EventPowerPath072CableProtectionFailure: aging-allowed=true, event-kind=SWC, prestorage-freeze-frame=false  # Event_Power_Path_072_Cable_Protection_Failure
  diagnostic event to trouble code uds mapping EventDtcMapPowerPath072CableProtectionFailure: diagnostic-event=EventPowerPath072CableProtectionFailure, trouble-code-uds=Power_Path_072_Cable_Protection_Failure  # Event_Dtc_Map_Power_Path_072_Cable_Protection_Failure
  diagnostic event to operation cycle mapping EventOperCycleMapPowerPath072CableProtectionFailure: diagnostic-event=EventPowerPath072CableProtectionFailure, operation-cycle=DefaultOperationCycle  # Event_Oper_Cycle_Map_Power_Path_072_Cable_Protection_Failure
  diagnostic event to debounce algorithm mapping EventDebounceMapPowerPath072CableProtectionFailure: debounce-algorithm=time_based, diagnostic-event=EventPowerPath072CableProtectionFailure  # EventDebounceMap_Power_Path_072_Cable_Protection_Failure
package /ZeC/DTC/DTC/Power_Path_071_Cable_Protection_Failure
  diagnostic trouble code uds Power_Path_071_Cable_Protection_Failure: dtc-props=Dtc_Props_8718746b, uds-dtc-value=0x005847
  diagnostic event EventPowerPath071CableProtectionFailure: aging-allowed=true, event-kind=SWC, prestorage-freeze-frame=false  # Event_Power_Path_071_Cable_Protection_Failure
  diagnostic event to trouble code uds mapping EventDtcMapPowerPath071CableProtectionFailure: diagnostic-event=EventPowerPath071CableProtectionFailure, trouble-code-uds=Power_Path_071_Cable_Protection_Failure  # Event_Dtc_Map_Power_Path_071_Cable_Protection_Failure
  diagnostic event to operation cycle mapping EventOperCycleMapPowerPath071CableProtectionFailure: diagnostic-event=EventPowerPath071CableProtectionFailure, operation-cycle=DefaultOperationCycle  # Event_Oper_Cycle_Map_Power_Path_071_Cable_Protection_Failure
  diagnostic event to debounce algorithm mapping EventDebounceMapPowerPath071CableProtectionFailure: debounce-algorithm=time_based, diagnostic-event=EventPowerPath071CableProtectionFailure  # EventDebounceMap_Power_Path_071_Cable_Protection_Failure
package /ZeC/DTC/DTC/Data_set_invalid
  diagnostic trouble code uds Data_set_invalid: dtc-props=Dtc_Props_d78b13b8, uds-dtc-value=0x001001
  diagnostic event EventDataSetInvalid: aging-allowed=true, event-kind=SWC, prestorage-freeze-frame=false  # Event_Data_set_invalid
  diagnostic event to trouble code uds mapping EventDtcMapDataSetInvalid: diagnostic-event=EventDataSetInvalid, trouble-code-uds=Data_set_invalid  # Event_Dtc_Map_Data_set_invalid
  diagnostic event to operation cycle mapping EventOperCycleMapDataSetInvalid: diagnostic-event=EventDataSetInvalid, operation-cycle=DefaultOperationCycle  # Event_Oper_Cycle_Map_Data_set_invalid
  diagnostic event to debounce algorithm mapping EventDebounceMapDataSetInvalid: debounce-algorithm=time_based, diagnostic-event=EventDataSetInvalid  # EventDebounceMap_Data_set_invalid
package /ZeC/DTC/DTC/Power_Path_066_Cable_Protection_Failure
  diagnostic trouble code uds Power_Path_066_Cable_Protection_Failure: dtc-props=Dtc_Props_21450f8, uds-dtc-value=0x005842
  diagnostic event EventPowerPath066CableProtectionFailure: aging-allowed=true, event-kind=SWC, prestorage-freeze-frame=false  # Event_Power_Path_066_Cable_Protection_Failure
  diagnostic event to trouble code uds mapping EventDtcMapPowerPath066CableProtectionFailure: diagnostic-event=EventPowerPath066CableProtectionFailure, trouble-code-uds=Power_Path_066_Cable_Protection_Failure  # Event_Dtc_Map_Power_Path_066_Cable_Protection_Failure
  diagnostic event to operation cycle mapping EventOperCycleMapPowerPath066CableProtectionFailure: diagnostic-event=EventPowerPath066CableProtectionFailure, operation-cycle=DefaultOperationCycle  # Event_Oper_Cycle_Map_Power_Path_066_Cable_Protection_Failure
  diagnostic event to debounce algorithm mapping EventDebounceMapPowerPath066CableProtectionFailure: debounce-algorithm=time_based, diagnostic-event=EventPowerPath066CableProtectionFailure  # EventDebounceMap_Power_Path_066_Cable_Protection_Failure
package /ZeC/DTC/DTC/Power_Path_065_Cable_Protection_Failure
  diagnostic trouble code uds Power_Path_065_Cable_Protection_Failure: dtc-props=Dtc_Props_c83f4eb6, uds-dtc-value=0x005841
  diagnostic event EventPowerPath065CableProtectionFailure: aging-allowed=true, event-kind=SWC, prestorage-freeze-frame=false  # Event_Power_Path_065_Cable_Protection_Failure
  diagnostic event to trouble code uds mapping EventDtcMapPowerPath065CableProtectionFailure: diagnostic-event=EventPowerPath065CableProtectionFailure, trouble-code-uds=Power_Path_065_Cable_Protection_Failure  # Event_Dtc_Map_Power_Path_065_Cable_Protection_Failure
  diagnostic event to operation cycle mapping EventOperCycleMapPowerPath065CableProtectionFailure: diagnostic-event=EventPowerPath065CableProtectionFailure, operation-cycle=DefaultOperationCycle  # Event_Oper_Cycle_Map_Power_Path_065_Cable_Protection_Failure
  diagnostic event to debounce algorithm mapping EventDebounceMapPowerPath065CableProtectionFailure: debounce-algorithm=time_based, diagnostic-event=EventPowerPath065CableProtectionFailure  # EventDebounceMap_Power_Path_065_Cable_Protection_Failure
package /ZeC/DTC/DTC/Power_Path_068_Cable_Protection_Failure
  diagnostic trouble code uds Power_Path_068_Cable_Protection_Failure: dtc-props=Dtc_Props_4d336a25, uds-dtc-value=0x005844
  diagnostic event EventPowerPath068CableProtectionFailure: aging-allowed=true, event-kind=SWC, prestorage-freeze-frame=false  # Event_Power_Path_068_Cable_Protection_Failure
  diagnostic event to trouble code uds mapping EventDtcMapPowerPath068CableProtectionFailure: diagnostic-event=EventPowerPath068CableProtectionFailure, trouble-code-uds=Power_Path_068_Cable_Protection_Failure  # Event_Dtc_Map_Power_Path_068_Cable_Protection_Failure
  diagnostic event to operation cycle mapping EventOperCycleMapPowerPath068CableProtectionFailure: diagnostic-event=EventPowerPath068CableProtectionFailure, operation-cycle=DefaultOperationCycle  # Event_Oper_Cycle_Map_Power_Path_068_Cable_Protection_Failure
  diagnostic event to debounce algorithm mapping EventDebounceMapPowerPath068CableProtectionFailure: debounce-algorithm=time_based, diagnostic-event=EventPowerPath068CableProtectionFailure  # EventDebounceMap_Power_Path_068_Cable_Protection_Failure
package /ZeC/DTC/DTC/Power_Path_067_Cable_Protection_Failure
  diagnostic trouble code uds Power_Path_067_Cable_Protection_Failure: dtc-props=Dtc_Props_440d5ac2, uds-dtc-value=0x005843
  diagnostic event EventPowerPath067CableProtectionFailure: aging-allowed=true, event-kind=SWC, prestorage-freeze-frame=false  # Event_Power_Path_067_Cable_Protection_Failure
  diagnostic event to trouble code uds mapping EventDtcMapPowerPath067CableProtectionFailure: diagnostic-event=EventPowerPath067CableProtectionFailure, trouble-code-uds=Power_Path_067_Cable_Protection_Failure  # Event_Dtc_Map_Power_Path_067_Cable_Protection_Failure
  diagnostic event to operation cycle mapping EventOperCycleMapPowerPath067CableProtectionFailure: diagnostic-event=EventPowerPath067CableProtectionFailure, operation-cycle=DefaultOperationCycle  # Event_Oper_Cycle_Map_Power_Path_067_Cable_Protection_Failure
  diagnostic event to debounce algorithm mapping EventDebounceMapPowerPath067CableProtectionFailure: debounce-algorithm=time_based, diagnostic-event=EventPowerPath067CableProtectionFailure  # EventDebounceMap_Power_Path_067_Cable_Protection_Failure
package /ZeC/DTC/DTC/Power_Path_073_Cable_Protection_Failure
  diagnostic trouble code uds Power_Path_073_Cable_Protection_Failure: dtc-props=Dtc_Props_956415a5, uds-dtc-value=0x005849
  diagnostic event EventPowerPath073CableProtectionFailure: aging-allowed=true, event-kind=SWC, prestorage-freeze-frame=false  # Event_Power_Path_073_Cable_Protection_Failure
  diagnostic event to trouble code uds mapping EventDtcMapPowerPath073CableProtectionFailure: diagnostic-event=EventPowerPath073CableProtectionFailure, trouble-code-uds=Power_Path_073_Cable_Protection_Failure  # Event_Dtc_Map_Power_Path_073_Cable_Protection_Failure
  diagnostic event to operation cycle mapping EventOperCycleMapPowerPath073CableProtectionFailure: diagnostic-event=EventPowerPath073CableProtectionFailure, operation-cycle=DefaultOperationCycle  # Event_Oper_Cycle_Map_Power_Path_073_Cable_Protection_Failure
  diagnostic event to debounce algorithm mapping EventDebounceMapPowerPath073CableProtectionFailure: debounce-algorithm=time_based, diagnostic-event=EventPowerPath073CableProtectionFailure  # EventDebounceMap_Power_Path_073_Cable_Protection_Failure
package /ZeC/DTC/DTC/Power_Path_079_Cable_Protection_Failure
  diagnostic trouble code uds Power_Path_079_Cable_Protection_Failure: dtc-props=Dtc_Props_fcfe1a2c, uds-dtc-value=0x00584f
  diagnostic event EventPowerPath079CableProtectionFailure: aging-allowed=true, event-kind=SWC, prestorage-freeze-frame=false  # Event_Power_Path_079_Cable_Protection_Failure
  diagnostic event to trouble code uds mapping EventDtcMapPowerPath079CableProtectionFailure: diagnostic-event=EventPowerPath079CableProtectionFailure, trouble-code-uds=Power_Path_079_Cable_Protection_Failure  # Event_Dtc_Map_Power_Path_079_Cable_Protection_Failure
  diagnostic event to operation cycle mapping EventOperCycleMapPowerPath079CableProtectionFailure: diagnostic-event=EventPowerPath079CableProtectionFailure, operation-cycle=DefaultOperationCycle  # Event_Oper_Cycle_Map_Power_Path_079_Cable_Protection_Failure
  diagnostic event to debounce algorithm mapping EventDebounceMapPowerPath079CableProtectionFailure: debounce-algorithm=time_based, diagnostic-event=EventPowerPath079CableProtectionFailure  # EventDebounceMap_Power_Path_079_Cable_Protection_Failure
package /ZeC/DTC/DTC/Power_Path_078_Cable_Protection_Failure
  diagnostic trouble code uds Power_Path_078_Cable_Protection_Failure: dtc-props=Dtc_Props_36d50462, uds-dtc-value=0x00584e
  diagnostic event EventPowerPath078CableProtectionFailure: aging-allowed=true, event-kind=SWC, prestorage-freeze-frame=false  # Event_Power_Path_078_Cable_Protection_Failure
  diagnostic event to trouble code uds mapping EventDtcMapPowerPath078CableProtectionFailure: diagnostic-event=EventPowerPath078CableProtectionFailure, trouble-code-uds=Power_Path_078_Cable_Protection_Failure  # Event_Dtc_Map_Power_Path_078_Cable_Protection_Failure
  diagnostic event to operation cycle mapping EventOperCycleMapPowerPath078CableProtectionFailure: diagnostic-event=EventPowerPath078CableProtectionFailure, operation-cycle=DefaultOperationCycle  # Event_Oper_Cycle_Map_Power_Path_078_Cable_Protection_Failure
  diagnostic event to debounce algorithm mapping EventDebounceMapPowerPath078CableProtectionFailure: debounce-algorithm=time_based, diagnostic-event=EventPowerPath078CableProtectionFailure  # EventDebounceMap_Power_Path_078_Cable_Protection_Failure
package /ZeC/DTC/DTC/Power_Path_075_Cable_Protection_Failure
  diagnostic trouble code uds Power_Path_075_Cable_Protection_Failure: dtc-props=Dtc_Props_3feb3485, uds-dtc-value=0x00584b
  diagnostic event EventPowerPath075CableProtectionFailure: aging-allowed=true, event-kind=SWC, prestorage-freeze-frame=false  # Event_Power_Path_075_Cable_Protection_Failure
  diagnostic event to trouble code uds mapping EventDtcMapPowerPath075CableProtectionFailure: diagnostic-event=EventPowerPath075CableProtectionFailure, trouble-code-uds=Power_Path_075_Cable_Protection_Failure  # Event_Dtc_Map_Power_Path_075_Cable_Protection_Failure
  diagnostic event to operation cycle mapping EventOperCycleMapPowerPath075CableProtectionFailure: diagnostic-event=EventPowerPath075CableProtectionFailure, operation-cycle=DefaultOperationCycle  # Event_Oper_Cycle_Map_Power_Path_075_Cable_Protection_Failure
  diagnostic event to debounce algorithm mapping EventDebounceMapPowerPath075CableProtectionFailure: debounce-algorithm=time_based, diagnostic-event=EventPowerPath075CableProtectionFailure  # EventDebounceMap_Power_Path_075_Cable_Protection_Failure
package /ZeC/DTC/DTC/Power_Path_074_Cable_Protection_Failure
  diagnostic trouble code uds Power_Path_074_Cable_Protection_Failure: dtc-props=Dtc_Props_f5c02acb, uds-dtc-value=0x00584a
  diagnostic event EventPowerPath074CableProtectionFailure: aging-allowed=true, event-kind=SWC, prestorage-freeze-frame=false  # Event_Power_Path_074_Cable_Protection_Failure
  diagnostic event to trouble code uds mapping EventDtcMapPowerPath074CableProtectionFailure: diagnostic-event=EventPowerPath074CableProtectionFailure, trouble-code-uds=Power_Path_074_Cable_Protection_Failure  # Event_Dtc_Map_Power_Path_074_Cable_Protection_Failure
  diagnostic event to operation cycle mapping EventOperCycleMapPowerPath074CableProtectionFailure: diagnostic-event=EventPowerPath074CableProtectionFailure, operation-cycle=DefaultOperationCycle  # Event_Oper_Cycle_Map_Power_Path_074_Cable_Protection_Failure
  diagnostic event to debounce algorithm mapping EventDebounceMapPowerPath074CableProtectionFailure: debounce-algorithm=time_based, diagnostic-event=EventPowerPath074CableProtectionFailure  # EventDebounceMap_Power_Path_074_Cable_Protection_Failure
package /ZeC/DTC/DTC/Power_Path_077_Cable_Protection_Failure
  diagnostic trouble code uds Power_Path_077_Cable_Protection_Failure: dtc-props=Dtc_Props_70cc0e58, uds-dtc-value=0x00584d
  diagnostic event EventPowerPath077CableProtectionFailure: aging-allowed=true, event-kind=SWC, prestorage-freeze-frame=false  # Event_Power_Path_077_Cable_Protection_Failure
  diagnostic event to trouble code uds mapping EventDtcMapPowerPath077CableProtectionFailure: diagnostic-event=EventPowerPath077CableProtectionFailure, trouble-code-uds=Power_Path_077_Cable_Protection_Failure  # Event_Dtc_Map_Power_Path_077_Cable_Protection_Failure
  diagnostic event to operation cycle mapping EventOperCycleMapPowerPath077CableProtectionFailure: diagnostic-event=EventPowerPath077CableProtectionFailure, operation-cycle=DefaultOperationCycle  # Event_Oper_Cycle_Map_Power_Path_077_Cable_Protection_Failure
  diagnostic event to debounce algorithm mapping EventDebounceMapPowerPath077CableProtectionFailure: debounce-algorithm=time_based, diagnostic-event=EventPowerPath077CableProtectionFailure  # EventDebounceMap_Power_Path_077_Cable_Protection_Failure
package /ZeC/DTC/DTC/Power_Path_076_Cable_Protection_Failure
  diagnostic trouble code uds Power_Path_076_Cable_Protection_Failure: dtc-props=Dtc_Props_79f23ebf, uds-dtc-value=0x00584c
  diagnostic event EventPowerPath076CableProtectionFailure: aging-allowed=true, event-kind=SWC, prestorage-freeze-frame=false  # Event_Power_Path_076_Cable_Protection_Failure
  diagnostic event to trouble code uds mapping EventDtcMapPowerPath076CableProtectionFailure: diagnostic-event=EventPowerPath076CableProtectionFailure, trouble-code-uds=Power_Path_076_Cable_Protection_Failure  # Event_Dtc_Map_Power_Path_076_Cable_Protection_Failure
  diagnostic event to operation cycle mapping EventOperCycleMapPowerPath076CableProtectionFailure: diagnostic-event=EventPowerPath076CableProtectionFailure, operation-cycle=DefaultOperationCycle  # Event_Oper_Cycle_Map_Power_Path_076_Cable_Protection_Failure
  diagnostic event to debounce algorithm mapping EventDebounceMapPowerPath076CableProtectionFailure: debounce-algorithm=time_based, diagnostic-event=EventPowerPath076CableProtectionFailure  # EventDebounceMap_Power_Path_076_Cable_Protection_Failure
package /ZeC/DTC/DTC/AD_INVERTER_defective
  diagnostic trouble code uds AD_INVERTER_defective: dtc-props=Dtc_Props_c8ff1f07, uds-dtc-value=0x001010  # AD-INVERTER_defective
  diagnostic event EventADINVERTERDefective: aging-allowed=true, event-kind=SWC, prestorage-freeze-frame=false  # Event_AD-INVERTER_defective
  diagnostic event to trouble code uds mapping EventDtcMapADINVERTERDefective: diagnostic-event=EventADINVERTERDefective, trouble-code-uds=AD_INVERTER_defective  # Event_Dtc_Map_AD-INVERTER_defective
  diagnostic event to operation cycle mapping EventOperCycleMapADINVERTERDefective: diagnostic-event=EventADINVERTERDefective, operation-cycle=DefaultOperationCycle  # Event_Oper_Cycle_Map_AD-INVERTER_defective
  diagnostic event to debounce algorithm mapping EventDebounceMapADINVERTERDefective: debounce-algorithm=counter_based, diagnostic-event=EventADINVERTERDefective  # EventDebounceMap_AD-INVERTER_defective
package /ZeC/DTC/DTC/Power_Path_081_Cable_Protection_Failure
  diagnostic trouble code uds Power_Path_081_Cable_Protection_Failure: dtc-props=Dtc_Props_e758e0e, uds-dtc-value=0x005851
  diagnostic event EventPowerPath081CableProtectionFailure: aging-allowed=true, event-kind=SWC, prestorage-freeze-frame=false  # Event_Power_Path_081_Cable_Protection_Failure
  diagnostic event to trouble code uds mapping EventDtcMapPowerPath081CableProtectionFailure: diagnostic-event=EventPowerPath081CableProtectionFailure, trouble-code-uds=Power_Path_081_Cable_Protection_Failure  # Event_Dtc_Map_Power_Path_081_Cable_Protection_Failure
  diagnostic event to operation cycle mapping EventOperCycleMapPowerPath081CableProtectionFailure: diagnostic-event=EventPowerPath081CableProtectionFailure, operation-cycle=DefaultOperationCycle  # Event_Oper_Cycle_Map_Power_Path_081_Cable_Protection_Failure
  diagnostic event to debounce algorithm mapping EventDebounceMapPowerPath081CableProtectionFailure: debounce-algorithm=time_based, diagnostic-event=EventPowerPath081CableProtectionFailure  # EventDebounceMap_Power_Path_081_Cable_Protection_Failure
package /ZeC/DTC/DTC/Control_Module_Improper_Shutdown
  diagnostic trouble code uds Control_Module_Improper_Shutdown: dtc-props=Dtc_Props_358996c7, uds-dtc-value=0x001011  # Control Module Improper Shutdown
  diagnostic event EventControlModuleImproperShutdown: aging-allowed=true, event-kind=SWC, prestorage-freeze-frame=false  # Event_Control Module Improper Shutdown
  diagnostic event to trouble code uds mapping EventDtcMapControlModuleImproperShutdown: diagnostic-event=EventControlModuleImproperShutdown, trouble-code-uds=Control_Module_Improper_Shutdown  # Event_Dtc_Map_Control Module Improper Shutdown
  diagnostic event to operation cycle mapping EventOperCycleMapControlModuleImproperShutdown: diagnostic-event=EventControlModuleImproperShutdown, operation-cycle=DefaultOperationCycle  # Event_Oper_Cycle_Map_Control Module Improper Shutdown
  diagnostic event to debounce algorithm mapping EventDebounceMapControlModuleImproperShutdown: debounce-algorithm=counter_based, diagnostic-event=EventControlModuleImproperShutdown  # EventDebounceMap_Control Module Improper Shutdown
package /ZeC/DTC/DTC/Power_Path_080_Cable_Protection_Failure
  diagnostic trouble code uds Power_Path_080_Cable_Protection_Failure: dtc-props=Dtc_Props_486c8434, uds-dtc-value=0x005850
  diagnostic event EventPowerPath080CableProtectionFailure: aging-allowed=true, event-kind=SWC, prestorage-freeze-frame=false  # Event_Power_Path_080_Cable_Protection_Failure
  diagnostic event to trouble code uds mapping EventDtcMapPowerPath080CableProtectionFailure: diagnostic-event=EventPowerPath080CableProtectionFailure, trouble-code-uds=Power_Path_080_Cable_Protection_Failure  # Event_Dtc_Map_Power_Path_080_Cable_Protection_Failure
  diagnostic event to operation cycle mapping EventOperCycleMapPowerPath080CableProtectionFailure: diagnostic-event=EventPowerPath080CableProtectionFailure, operation-cycle=DefaultOperationCycle  # Event_Oper_Cycle_Map_Power_Path_080_Cable_Protection_Failure
  diagnostic event to debounce algorithm mapping EventDebounceMapPowerPath080CableProtectionFailure: debounce-algorithm=time_based, diagnostic-event=EventPowerPath080CableProtectionFailure  # EventDebounceMap_Power_Path_080_Cable_Protection_Failure
package /ZeC/DTC/DTC/Power_Path_053_Cable_Protection_Failure
  diagnostic trouble code uds Power_Path_053_Cable_Protection_Failure: dtc-props=Dtc_Props_354d29f4, uds-dtc-value=0x005835
  diagnostic event EventPowerPath053CableProtectionFailure: aging-allowed=true, event-kind=SWC, prestorage-freeze-frame=false  # Event_Power_Path_053_Cable_Protection_Failure
  diagnostic event to trouble code uds mapping EventDtcMapPowerPath053CableProtectionFailure: diagnostic-event=EventPowerPath053CableProtectionFailure, trouble-code-uds=Power_Path_053_Cable_Protection_Failure  # Event_Dtc_Map_Power_Path_053_Cable_Protection_Failure
  diagnostic event to operation cycle mapping EventOperCycleMapPowerPath053CableProtectionFailure: diagnostic-event=EventPowerPath053CableProtectionFailure, operation-cycle=DefaultOperationCycle  # Event_Oper_Cycle_Map_Power_Path_053_Cable_Protection_Failure
  diagnostic event to debounce algorithm mapping EventDebounceMapPowerPath053CableProtectionFailure: debounce-algorithm=time_based, diagnostic-event=EventPowerPath053CableProtectionFailure  # EventDebounceMap_Power_Path_053_Cable_Protection_Failure
package /ZeC/DTC/DTC/Power_Path_052_Cable_Protection_Failure
  diagnostic trouble code uds Power_Path_052_Cable_Protection_Failure: dtc-props=Dtc_Props_735423ce, uds-dtc-value=0x005834
  diagnostic event EventPowerPath052CableProtectionFailure: aging-allowed=true, event-kind=SWC, prestorage-freeze-frame=false  # Event_Power_Path_052_Cable_Protection_Failure
  diagnostic event to trouble code uds mapping EventDtcMapPowerPath052CableProtectionFailure: diagnostic-event=EventPowerPath052CableProtectionFailure, trouble-code-uds=Power_Path_052_Cable_Protection_Failure  # Event_Dtc_Map_Power_Path_052_Cable_Protection_Failure
  diagnostic event to operation cycle mapping EventOperCycleMapPowerPath052CableProtectionFailure: diagnostic-event=EventPowerPath052CableProtectionFailure, operation-cycle=DefaultOperationCycle  # Event_Oper_Cycle_Map_Power_Path_052_Cable_Protection_Failure
  diagnostic event to debounce algorithm mapping EventDebounceMapPowerPath052CableProtectionFailure: debounce-algorithm=time_based, diagnostic-event=EventPowerPath052CableProtectionFailure  # EventDebounceMap_Power_Path_052_Cable_Protection_Failure
package /ZeC/DTC/DTC/Power_Path_055_Cable_Protection_Failure
  diagnostic trouble code uds Power_Path_055_Cable_Protection_Failure: dtc-props=Dtc_Props_b97f3d80, uds-dtc-value=0x005837
  diagnostic event EventPowerPath055CableProtectionFailure: aging-allowed=true, event-kind=SWC, prestorage-freeze-frame=false  # Event_Power_Path_055_Cable_Protection_Failure
  diagnostic event to trouble code uds mapping EventDtcMapPowerPath055CableProtectionFailure: diagnostic-event=EventPowerPath055CableProtectionFailure, trouble-code-uds=Power_Path_055_Cable_Protection_Failure  # Event_Dtc_Map_Power_Path_055_Cable_Protection_Failure
  diagnostic event to operation cycle mapping EventOperCycleMapPowerPath055CableProtectionFailure: diagnostic-event=EventPowerPath055CableProtectionFailure, operation-cycle=DefaultOperationCycle  # Event_Oper_Cycle_Map_Power_Path_055_Cable_Protection_Failure
  diagnostic event to debounce algorithm mapping EventDebounceMapPowerPath055CableProtectionFailure: debounce-algorithm=time_based, diagnostic-event=EventPowerPath055CableProtectionFailure  # EventDebounceMap_Power_Path_055_Cable_Protection_Failure
package /ZeC/DTC/DTC/Power_Path_054_Cable_Protection_Failure
  diagnostic trouble code uds Power_Path_054_Cable_Protection_Failure: dtc-props=Dtc_Props_ff6637ba, uds-dtc-value=0x005836
  diagnostic event EventPowerPath054CableProtectionFailure: aging-allowed=true, event-kind=SWC, prestorage-freeze-frame=false  # Event_Power_Path_054_Cable_Protection_Failure
  diagnostic event to trouble code uds mapping EventDtcMapPowerPath054CableProtectionFailure: diagnostic-event=EventPowerPath054CableProtectionFailure, trouble-code-uds=Power_Path_054_Cable_Protection_Failure  # Event_Dtc_Map_Power_Path_054_Cable_Protection_Failure
  diagnostic event to operation cycle mapping EventOperCycleMapPowerPath054CableProtectionFailure: diagnostic-event=EventPowerPath054CableProtectionFailure, operation-cycle=DefaultOperationCycle  # Event_Oper_Cycle_Map_Power_Path_054_Cable_Protection_Failure
  diagnostic event to debounce algorithm mapping EventDebounceMapPowerPath054CableProtectionFailure: debounce-algorithm=time_based, diagnostic-event=EventPowerPath054CableProtectionFailure  # EventDebounceMap_Power_Path_054_Cable_Protection_Failure
package /ZeC/DTC/DTC/Power_Path_049_Cable_Protection_Failure
  diagnostic trouble code uds Power_Path_049_Cable_Protection_Failure: dtc-props=Dtc_Props_f658075d, uds-dtc-value=0x005831
  diagnostic event EventPowerPath049CableProtectionFailure: aging-allowed=true, event-kind=SWC, prestorage-freeze-frame=false  # Event_Power_Path_049_Cable_Protection_Failure
  diagnostic event to trouble code uds mapping EventDtcMapPowerPath049CableProtectionFailure: diagnostic-event=EventPowerPath049CableProtectionFailure, trouble-code-uds=Power_Path_049_Cable_Protection_Failure  # Event_Dtc_Map_Power_Path_049_Cable_Protection_Failure
  diagnostic event to operation cycle mapping EventOperCycleMapPowerPath049CableProtectionFailure: diagnostic-event=EventPowerPath049CableProtectionFailure, operation-cycle=DefaultOperationCycle  # Event_Oper_Cycle_Map_Power_Path_049_Cable_Protection_Failure
  diagnostic event to debounce algorithm mapping EventDebounceMapPowerPath049CableProtectionFailure: debounce-algorithm=time_based, diagnostic-event=EventPowerPath049CableProtectionFailure  # EventDebounceMap_Power_Path_049_Cable_Protection_Failure
package /ZeC/DTC/DTC/Power_Path_048_Cable_Protection_Failure
  diagnostic trouble code uds Power_Path_048_Cable_Protection_Failure: dtc-props=Dtc_Props_b0410d67, uds-dtc-value=0x005830
  diagnostic event EventPowerPath048CableProtectionFailure: aging-allowed=true, event-kind=SWC, prestorage-freeze-frame=false  # Event_Power_Path_048_Cable_Protection_Failure
  diagnostic event to trouble code uds mapping EventDtcMapPowerPath048CableProtectionFailure: diagnostic-event=EventPowerPath048CableProtectionFailure, trouble-code-uds=Power_Path_048_Cable_Protection_Failure  # Event_Dtc_Map_Power_Path_048_Cable_Protection_Failure
  diagnostic event to operation cycle mapping EventOperCycleMapPowerPath048CableProtectionFailure: diagnostic-event=EventPowerPath048CableProtectionFailure, operation-cycle=DefaultOperationCycle  # Event_Oper_Cycle_Map_Power_Path_048_Cable_Protection_Failure
  diagnostic event to debounce algorithm mapping EventDebounceMapPowerPath048CableProtectionFailure: debounce-algorithm=time_based, diagnostic-event=EventPowerPath048CableProtectionFailure  # EventDebounceMap_Power_Path_048_Cable_Protection_Failure
package /ZeC/DTC/DTC/Power_Path_051_Cable_Protection_Failure
  diagnostic trouble code uds Power_Path_051_Cable_Protection_Failure: dtc-props=Dtc_Props_7a6a1329, uds-dtc-value=0x005833
  diagnostic event EventPowerPath051CableProtectionFailure: aging-allowed=true, event-kind=SWC, prestorage-freeze-frame=false  # Event_Power_Path_051_Cable_Protection_Failure
  diagnostic event to trouble code uds mapping EventDtcMapPowerPath051CableProtectionFailure: diagnostic-event=EventPowerPath051CableProtectionFailure, trouble-code-uds=Power_Path_051_Cable_Protection_Failure  # Event_Dtc_Map_Power_Path_051_Cable_Protection_Failure
  diagnostic event to operation cycle mapping EventOperCycleMapPowerPath051CableProtectionFailure: diagnostic-event=EventPowerPath051CableProtectionFailure, operation-cycle=DefaultOperationCycle  # Event_Oper_Cycle_Map_Power_Path_051_Cable_Protection_Failure
  diagnostic event to debounce algorithm mapping EventDebounceMapPowerPath051CableProtectionFailure: debounce-algorithm=time_based, diagnostic-event=EventPowerPath051CableProtectionFailure  # EventDebounceMap_Power_Path_051_Cable_Protection_Failure
package /ZeC/DTC/DTC/Power_Path_050_Cable_Protection_Failure
  diagnostic trouble code uds Power_Path_050_Cable_Protection_Failure: dtc-props=Dtc_Props_3c731913, uds-dtc-value=0x005832
  diagnostic event EventPowerPath050CableProtectionFailure: aging-allowed=true, event-kind=SWC, prestorage-freeze-frame=false  # Event_Power_Path_050_Cable_Protection_Failure
  diagnostic event to trouble code uds mapping EventDtcMapPowerPath050CableProtectionFailure: diagnostic-event=EventPowerPath050CableProtectionFailure, trouble-code-uds=Power_Path_050_Cable_Protection_Failure  # Event_Dtc_Map_Power_Path_050_Cable_Protection_Failure
  diagnostic event to operation cycle mapping EventOperCycleMapPowerPath050CableProtectionFailure: diagnostic-event=EventPowerPath050CableProtectionFailure, operation-cycle=DefaultOperationCycle  # Event_Oper_Cycle_Map_Power_Path_050_Cable_Protection_Failure
  diagnostic event to debounce algorithm mapping EventDebounceMapPowerPath050CableProtectionFailure: debounce-algorithm=time_based, diagnostic-event=EventPowerPath050CableProtectionFailure  # EventDebounceMap_Power_Path_050_Cable_Protection_Failure
package /ZeC/DTC/DTC/Power_Path_057_Cable_Protection_Failure
  diagnostic trouble code uds Power_Path_057_Cable_Protection_Failure: dtc-props=Dtc_Props_ab035c4e, uds-dtc-value=0x005839
  diagnostic event EventPowerPath057CableProtectionFailure: aging-allowed=true, event-kind=SWC, prestorage-freeze-frame=false  # Event_Power_Path_057_Cable_Protection_Failure
  diagnostic event to trouble code uds mapping EventDtcMapPowerPath057CableProtectionFailure: diagnostic-event=EventPowerPath057CableProtectionFailure, trouble-code-uds=Power_Path_057_Cable_Protection_Failure  # Event_Dtc_Map_Power_Path_057_Cable_Protection_Failure
  diagnostic event to operation cycle mapping EventOperCycleMapPowerPath057CableProtectionFailure: diagnostic-event=EventPowerPath057CableProtectionFailure, operation-cycle=DefaultOperationCycle  # Event_Oper_Cycle_Map_Power_Path_057_Cable_Protection_Failure
  diagnostic event to debounce algorithm mapping EventDebounceMapPowerPath057CableProtectionFailure: debounce-algorithm=time_based, diagnostic-event=EventPowerPath057CableProtectionFailure  # EventDebounceMap_Power_Path_057_Cable_Protection_Failure
package /ZeC/DTC/DTC/Power_Path_056_Cable_Protection_Failure
  diagnostic trouble code uds Power_Path_056_Cable_Protection_Failure: dtc-props=Dtc_Props_ed1a5674, uds-dtc-value=0x005838
  diagnostic event EventPowerPath056CableProtectionFailure: aging-allowed=true, event-kind=SWC, prestorage-freeze-frame=false  # Event_Power_Path_056_Cable_Protection_Failure
  diagnostic event to trouble code uds mapping EventDtcMapPowerPath056CableProtectionFailure: diagnostic-event=EventPowerPath056CableProtectionFailure, trouble-code-uds=Power_Path_056_Cable_Protection_Failure  # Event_Dtc_Map_Power_Path_056_Cable_Protection_Failure
  diagnostic event to operation cycle mapping EventOperCycleMapPowerPath056CableProtectionFailure: diagnostic-event=EventPowerPath056CableProtectionFailure, operation-cycle=DefaultOperationCycle  # Event_Oper_Cycle_Map_Power_Path_056_Cable_Protection_Failure
  diagnostic event to debounce algorithm mapping EventDebounceMapPowerPath056CableProtectionFailure: debounce-algorithm=time_based, diagnostic-event=EventPowerPath056CableProtectionFailure  # EventDebounceMap_Power_Path_056_Cable_Protection_Failure
package /ZeC/DTC/DTC/Power_Path_062_Cable_Protection_Failure
  diagnostic trouble code uds Power_Path_062_Cable_Protection_Failure: dtc-props=Dtc_Props_8b24d89, uds-dtc-value=0x00583e
  diagnostic event EventPowerPath062CableProtectionFailure: aging-allowed=true, event-kind=SWC, prestorage-freeze-frame=false  # Event_Power_Path_062_Cable_Protection_Failure
  diagnostic event to trouble code uds mapping EventDtcMapPowerPath062CableProtectionFailure: diagnostic-event=EventPowerPath062CableProtectionFailure, trouble-code-uds=Power_Path_062_Cable_Protection_Failure  # Event_Dtc_Map_Power_Path_062_Cable_Protection_Failure
  diagnostic event to operation cycle mapping EventOperCycleMapPowerPath062CableProtectionFailure: diagnostic-event=EventPowerPath062CableProtectionFailure, operation-cycle=DefaultOperationCycle  # Event_Oper_Cycle_Map_Power_Path_062_Cable_Protection_Failure
  diagnostic event to debounce algorithm mapping EventDebounceMapPowerPath062CableProtectionFailure: debounce-algorithm=time_based, diagnostic-event=EventPowerPath062CableProtectionFailure  # EventDebounceMap_Power_Path_062_Cable_Protection_Failure
package /ZeC/DTC/DTC/Power_Path_061_Cable_Protection_Failure
  diagnostic trouble code uds Power_Path_061_Cable_Protection_Failure: dtc-props=Dtc_Props_4eab47b3, uds-dtc-value=0x00583d
  diagnostic event EventPowerPath061CableProtectionFailure: aging-allowed=true, event-kind=SWC, prestorage-freeze-frame=false  # Event_Power_Path_061_Cable_Protection_Failure
  diagnostic event to trouble code uds mapping EventDtcMapPowerPath061CableProtectionFailure: diagnostic-event=EventPowerPath061CableProtectionFailure, trouble-code-uds=Power_Path_061_Cable_Protection_Failure  # Event_Dtc_Map_Power_Path_061_Cable_Protection_Failure
  diagnostic event to operation cycle mapping EventOperCycleMapPowerPath061CableProtectionFailure: diagnostic-event=EventPowerPath061CableProtectionFailure, operation-cycle=DefaultOperationCycle  # Event_Oper_Cycle_Map_Power_Path_061_Cable_Protection_Failure
  diagnostic event to debounce algorithm mapping EventDebounceMapPowerPath061CableProtectionFailure: debounce-algorithm=time_based, diagnostic-event=EventPowerPath061CableProtectionFailure  # EventDebounceMap_Power_Path_061_Cable_Protection_Failure
package /ZeC/DTC/DTC/Power_Path_063_Cable_Protection_Failure
  diagnostic trouble code uds Power_Path_063_Cable_Protection_Failure: dtc-props=Dtc_Props_c29953c7, uds-dtc-value=0x00583f
  diagnostic event EventPowerPath063CableProtectionFailure: aging-allowed=true, event-kind=SWC, prestorage-freeze-frame=false  # Event_Power_Path_063_Cable_Protection_Failure
  diagnostic event to trouble code uds mapping EventDtcMapPowerPath063CableProtectionFailure: diagnostic-event=EventPowerPath063CableProtectionFailure, trouble-code-uds=Power_Path_063_Cable_Protection_Failure  # Event_Dtc_Map_Power_Path_063_Cable_Protection_Failure
  diagnostic event to operation cycle mapping EventOperCycleMapPowerPath063CableProtectionFailure: diagnostic-event=EventPowerPath063CableProtectionFailure, operation-cycle=DefaultOperationCycle  # Event_Oper_Cycle_Map_Power_Path_063_Cable_Protection_Failure
  diagnostic event to debounce algorithm mapping EventDebounceMapPowerPath063CableProtectionFailure: debounce-algorithm=time_based, diagnostic-event=EventPowerPath063CableProtectionFailure  # EventDebounceMap_Power_Path_063_Cable_Protection_Failure
package /ZeC/DTC/DTC/Power_Path_058_Cable_Protection_Failure
  diagnostic trouble code uds Power_Path_058_Cable_Protection_Failure: dtc-props=Dtc_Props_cba76320, uds-dtc-value=0x00583a
  diagnostic event EventPowerPath058CableProtectionFailure: aging-allowed=true, event-kind=SWC, prestorage-freeze-frame=false  # Event_Power_Path_058_Cable_Protection_Failure
  diagnostic event to trouble code uds mapping EventDtcMapPowerPath058CableProtectionFailure: diagnostic-event=EventPowerPath058CableProtectionFailure, trouble-code-uds=Power_Path_058_Cable_Protection_Failure  # Event_Dtc_Map_Power_Path_058_Cable_Protection_Failure
  diagnostic event to operation cycle mapping EventOperCycleMapPowerPath058CableProtectionFailure: diagnostic-event=EventPowerPath058CableProtectionFailure, operation-cycle=DefaultOperationCycle  # Event_Oper_Cycle_Map_Power_Path_058_Cable_Protection_Failure
  diagnostic event to debounce algorithm mapping EventDebounceMapPowerPath058CableProtectionFailure: debounce-algorithm=time_based, diagnostic-event=EventPowerPath058CableProtectionFailure  # EventDebounceMap_Power_Path_058_Cable_Protection_Failure
package /ZeC/DTC/DTC/Power_Path_060_Cable_Protection_Failure
  diagnostic trouble code uds Power_Path_060_Cable_Protection_Failure: dtc-props=Dtc_Props_47957754, uds-dtc-value=0x00583c
  diagnostic event EventPowerPath060CableProtectionFailure: aging-allowed=true, event-kind=SWC, prestorage-freeze-frame=false  # Event_Power_Path_060_Cable_Protection_Failure
  diagnostic event to trouble code uds mapping EventDtcMapPowerPath060CableProtectionFailure: diagnostic-event=EventPowerPath060CableProtectionFailure, trouble-code-uds=Power_Path_060_Cable_Protection_Failure  # Event_Dtc_Map_Power_Path_060_Cable_Protection_Failure
  diagnostic event to operation cycle mapping EventOperCycleMapPowerPath060CableProtectionFailure: diagnostic-event=EventPowerPath060CableProtectionFailure, operation-cycle=DefaultOperationCycle  # Event_Oper_Cycle_Map_Power_Path_060_Cable_Protection_Failure
  diagnostic event to debounce algorithm mapping EventDebounceMapPowerPath060CableProtectionFailure: debounce-algorithm=time_based, diagnostic-event=EventPowerPath060CableProtectionFailure  # EventDebounceMap_Power_Path_060_Cable_Protection_Failure
package /ZeC/DTC/DTC/Power_Path_059_Cable_Protection_Failure
  diagnostic trouble code uds Power_Path_059_Cable_Protection_Failure: dtc-props=Dtc_Props_18c7d6e, uds-dtc-value=0x00583b
  diagnostic event EventPowerPath059CableProtectionFailure: aging-allowed=true, event-kind=SWC, prestorage-freeze-frame=false  # Event_Power_Path_059_Cable_Protection_Failure
  diagnostic event to trouble code uds mapping EventDtcMapPowerPath059CableProtectionFailure: diagnostic-event=EventPowerPath059CableProtectionFailure, trouble-code-uds=Power_Path_059_Cable_Protection_Failure  # Event_Dtc_Map_Power_Path_059_Cable_Protection_Failure
  diagnostic event to operation cycle mapping EventOperCycleMapPowerPath059CableProtectionFailure: diagnostic-event=EventPowerPath059CableProtectionFailure, operation-cycle=DefaultOperationCycle  # Event_Oper_Cycle_Map_Power_Path_059_Cable_Protection_Failure
  diagnostic event to debounce algorithm mapping EventDebounceMapPowerPath059CableProtectionFailure: debounce-algorithm=time_based, diagnostic-event=EventPowerPath059CableProtectionFailure  # EventDebounceMap_Power_Path_059_Cable_Protection_Failure
package /ZeC/DTC/DTC/Power_Path_064_Cable_Protection_Failure
  diagnostic trouble code uds Power_Path_064_Cable_Protection_Failure: dtc-props=Dtc_Props_8e26448c, uds-dtc-value=0x005840
  diagnostic event EventPowerPath064CableProtectionFailure: aging-allowed=true, event-kind=SWC, prestorage-freeze-frame=false  # Event_Power_Path_064_Cable_Protection_Failure
  diagnostic event to trouble code uds mapping EventDtcMapPowerPath064CableProtectionFailure: diagnostic-event=EventPowerPath064CableProtectionFailure, trouble-code-uds=Power_Path_064_Cable_Protection_Failure  # Event_Dtc_Map_Power_Path_064_Cable_Protection_Failure
  diagnostic event to operation cycle mapping EventOperCycleMapPowerPath064CableProtectionFailure: diagnostic-event=EventPowerPath064CableProtectionFailure, operation-cycle=DefaultOperationCycle  # Event_Oper_Cycle_Map_Power_Path_064_Cable_Protection_Failure
  diagnostic event to debounce algorithm mapping EventDebounceMapPowerPath064CableProtectionFailure: debounce-algorithm=time_based, diagnostic-event=EventPowerPath064CableProtectionFailure  # EventDebounceMap_Power_Path_064_Cable_Protection_Failure
package /ZeC/DTC/DTC/Data_set_implausible
  diagnostic trouble code uds Data_set_implausible: dtc-props=Dtc_Props_14158306, uds-dtc-value=0x001000
  diagnostic event EventDataSetImplausible: aging-allowed=true, event-kind=SWC, prestorage-freeze-frame=false  # Event_Data_set_implausible
  diagnostic event to trouble code uds mapping EventDtcMapDataSetImplausible: diagnostic-event=EventDataSetImplausible, trouble-code-uds=Data_set_implausible  # Event_Dtc_Map_Data_set_implausible
  diagnostic event to operation cycle mapping EventOperCycleMapDataSetImplausible: diagnostic-event=EventDataSetImplausible, operation-cycle=DefaultOperationCycle  # Event_Oper_Cycle_Map_Data_set_implausible
  diagnostic event to debounce algorithm mapping EventDebounceMapDataSetImplausible: debounce-algorithm=time_based, diagnostic-event=EventDataSetImplausible  # EventDebounceMap_Data_set_implausible
package /ZeC/DTC/DTC/CAN_06_ECU_3_No_Communication
  diagnostic trouble code uds CAN_06_ECU_3_No_Communication: dtc-props=Dtc_Props_14158306, uds-dtc-value=0x032607
  diagnostic event EventCAN06ECU3NoCommunication: aging-allowed=true, event-kind=SWC, prestorage-freeze-frame=false  # Event_CAN_06_ECU_3_No_Communication
  diagnostic event to trouble code uds mapping EventDtcMapCAN06ECU3NoCommunication: diagnostic-event=EventCAN06ECU3NoCommunication, trouble-code-uds=CAN_06_ECU_3_No_Communication  # Event_Dtc_Map_CAN_06_ECU_3_No_Communication
  diagnostic event to operation cycle mapping EventOperCycleMapCAN06ECU3NoCommunication: diagnostic-event=EventCAN06ECU3NoCommunication, operation-cycle=DefaultOperationCycle  # Event_Oper_Cycle_Map_CAN_06_ECU_3_No_Communication
  diagnostic event to debounce algorithm mapping EventDebounceMapCAN06ECU3NoCommunication: debounce-algorithm=counter_based, diagnostic-event=EventCAN06ECU3NoCommunication  # EventDebounceMap_CAN_06_ECU_3_No_Communication
package /ZeC/DTC/DTC/CAN_06_ECU_4_No_Communication
  diagnostic trouble code uds CAN_06_ECU_4_No_Communication: dtc-props=Dtc_Props_14158306, uds-dtc-value=0x032608
  diagnostic event EventCAN06ECU4NoCommunication: aging-allowed=true, event-kind=SWC, prestorage-freeze-frame=false  # Event_CAN_06_ECU_4_No_Communication
  diagnostic event to trouble code uds mapping EventDtcMapCAN06ECU4NoCommunication: diagnostic-event=EventCAN06ECU4NoCommunication, trouble-code-uds=CAN_06_ECU_4_No_Communication  # Event_Dtc_Map_CAN_06_ECU_4_No_Communication
  diagnostic event to operation cycle mapping EventOperCycleMapCAN06ECU4NoCommunication: diagnostic-event=EventCAN06ECU4NoCommunication, operation-cycle=DefaultOperationCycle  # Event_Oper_Cycle_Map_CAN_06_ECU_4_No_Communication
  diagnostic event to debounce algorithm mapping EventDebounceMapCAN06ECU4NoCommunication: debounce-algorithm=counter_based, diagnostic-event=EventCAN06ECU4NoCommunication  # EventDebounceMap_CAN_06_ECU_4_No_Communication
package /ZeC/DTC/DTC/CAN_06_ECU_1_No_Communication
  diagnostic trouble code uds CAN_06_ECU_1_No_Communication: dtc-props=Dtc_Props_14158306, uds-dtc-value=0x032605
  diagnostic event EventCAN06ECU1NoCommunication: aging-allowed=true, event-kind=SWC, prestorage-freeze-frame=false  # Event_CAN_06_ECU_1_No_Communication
  diagnostic event to trouble code uds mapping EventDtcMapCAN06ECU1NoCommunication: diagnostic-event=EventCAN06ECU1NoCommunication, trouble-code-uds=CAN_06_ECU_1_No_Communication  # Event_Dtc_Map_CAN_06_ECU_1_No_Communication
  diagnostic event to operation cycle mapping EventOperCycleMapCAN06ECU1NoCommunication: diagnostic-event=EventCAN06ECU1NoCommunication, operation-cycle=DefaultOperationCycle  # Event_Oper_Cycle_Map_CAN_06_ECU_1_No_Communication
  diagnostic event to debounce algorithm mapping EventDebounceMapCAN06ECU1NoCommunication: debounce-algorithm=counter_based, diagnostic-event=EventCAN06ECU1NoCommunication  # EventDebounceMap_CAN_06_ECU_1_No_Communication
package /ZeC/DTC/DTC/CAN_06_ECU_2_No_Communication
  diagnostic trouble code uds CAN_06_ECU_2_No_Communication: dtc-props=Dtc_Props_14158306, uds-dtc-value=0x032606
  diagnostic event EventCAN06ECU2NoCommunication: aging-allowed=true, event-kind=SWC, prestorage-freeze-frame=false  # Event_CAN_06_ECU_2_No_Communication
  diagnostic event to trouble code uds mapping EventDtcMapCAN06ECU2NoCommunication: diagnostic-event=EventCAN06ECU2NoCommunication, trouble-code-uds=CAN_06_ECU_2_No_Communication  # Event_Dtc_Map_CAN_06_ECU_2_No_Communication
  diagnostic event to operation cycle mapping EventOperCycleMapCAN06ECU2NoCommunication: diagnostic-event=EventCAN06ECU2NoCommunication, operation-cycle=DefaultOperationCycle  # Event_Oper_Cycle_Map_CAN_06_ECU_2_No_Communication
  diagnostic event to debounce algorithm mapping EventDebounceMapCAN06ECU2NoCommunication: debounce-algorithm=counter_based, diagnostic-event=EventCAN06ECU2NoCommunication  # EventDebounceMap_CAN_06_ECU_2_No_Communication
package /ZeC/DTC/DTC/Power_Path_104_Load_Failure
  diagnostic trouble code uds Power_Path_104_Load_Failure: dtc-props=Dtc_Props_849998ae, uds-dtc-value=0x005468
  diagnostic event EventPowerPath104LoadFailure: aging-allowed=true, event-kind=SWC, prestorage-freeze-frame=false  # Event_Power_Path_104_Load_Failure
  diagnostic event to trouble code uds mapping EventDtcMapPowerPath104LoadFailure: diagnostic-event=EventPowerPath104LoadFailure, trouble-code-uds=Power_Path_104_Load_Failure  # Event_Dtc_Map_Power_Path_104_Load_Failure
  diagnostic event to operation cycle mapping EventOperCycleMapPowerPath104LoadFailure: diagnostic-event=EventPowerPath104LoadFailure, operation-cycle=DefaultOperationCycle  # Event_Oper_Cycle_Map_Power_Path_104_Load_Failure
  diagnostic event to debounce algorithm mapping EventDebounceMapPowerPath104LoadFailure: debounce-algorithm=time_based, diagnostic-event=EventPowerPath104LoadFailure  # EventDebounceMap_Power_Path_104_Load_Failure
package /ZeC/DTC/DTC/DB_CANFD_06_Single_Wire_Mode
  diagnostic trouble code uds DB_CANFD_06_Single_Wire_Mode: dtc-props=Dtc_Props_14158306, uds-dtc-value=0x032603
  diagnostic event EventDBCANFD06SingleWireMode: aging-allowed=true, event-kind=SWC, prestorage-freeze-frame=false  # Event_DB_CANFD_06_Single_Wire_Mode
  diagnostic event to trouble code uds mapping EventDtcMapDBCANFD06SingleWireMode: diagnostic-event=EventDBCANFD06SingleWireMode, trouble-code-uds=DB_CANFD_06_Single_Wire_Mode  # Event_Dtc_Map_DB_CANFD_06_Single_Wire_Mode
  diagnostic event to operation cycle mapping EventOperCycleMapDBCANFD06SingleWireMode: diagnostic-event=EventDBCANFD06SingleWireMode, operation-cycle=DefaultOperationCycle  # Event_Oper_Cycle_Map_DB_CANFD_06_Single_Wire_Mode
  diagnostic event to debounce algorithm mapping EventDebounceMapDBCANFD06SingleWireMode: debounce-algorithm=counter_based, diagnostic-event=EventDBCANFD06SingleWireMode  # EventDebounceMap_DB_CANFD_06_Single_Wire_Mode
package /ZeC/DTC/DTC/Power_Path_103_Load_Failure
  diagnostic trouble code uds Power_Path_103_Load_Failure: dtc-props=Dtc_Props_d0fcf35a, uds-dtc-value=0x005467
  diagnostic event EventPowerPath103LoadFailure: aging-allowed=true, event-kind=SWC, prestorage-freeze-frame=false  # Event_Power_Path_103_Load_Failure
  diagnostic event to trouble code uds mapping EventDtcMapPowerPath103LoadFailure: diagnostic-event=EventPowerPath103LoadFailure, trouble-code-uds=Power_Path_103_Load_Failure  # Event_Dtc_Map_Power_Path_103_Load_Failure
  diagnostic event to operation cycle mapping EventOperCycleMapPowerPath103LoadFailure: diagnostic-event=EventPowerPath103LoadFailure, operation-cycle=DefaultOperationCycle  # Event_Oper_Cycle_Map_Power_Path_103_Load_Failure
  diagnostic event to debounce algorithm mapping EventDebounceMapPowerPath103LoadFailure: debounce-algorithm=time_based, diagnostic-event=EventPowerPath103LoadFailure  # EventDebounceMap_Power_Path_103_Load_Failure
package /ZeC/DTC/DTC/DB_CANFD_06_Error_Received_Value
  diagnostic trouble code uds DB_CANFD_06_Error_Received_Value: dtc-props=Dtc_Props_b618fb9, uds-dtc-value=0x032604
  diagnostic event EventDBCANFD06ErrorReceivedValue: aging-allowed=true, event-kind=SWC, prestorage-freeze-frame=false  # Event_DB_CANFD_06_Error_Received_Value
  diagnostic event to trouble code uds mapping EventDtcMapDBCANFD06ErrorReceivedValue: diagnostic-event=EventDBCANFD06ErrorReceivedValue, trouble-code-uds=DB_CANFD_06_Error_Received_Value  # Event_Dtc_Map_DB_CANFD_06_Error_Received_Value
  diagnostic event to operation cycle mapping EventOperCycleMapDBCANFD06ErrorReceivedValue: diagnostic-event=EventDBCANFD06ErrorReceivedValue, operation-cycle=DefaultOperationCycle  # Event_Oper_Cycle_Map_DB_CANFD_06_Error_Received_Value
  diagnostic event to debounce algorithm mapping EventDebounceMapDBCANFD06ErrorReceivedValue: debounce-algorithm=counter_based, diagnostic-event=EventDBCANFD06ErrorReceivedValue  # EventDebounceMap_DB_CANFD_06_Error_Received_Value
package /ZeC/DTC/DTC/DB_CANFD_06_Defect
  diagnostic trouble code uds DB_CANFD_06_Defect: dtc-props=Dtc_Props_14158306, uds-dtc-value=0x032601
  diagnostic event EventDBCANFD06Defect: aging-allowed=true, event-kind=SWC, prestorage-freeze-frame=false  # Event_DB_CANFD_06_Defect
  diagnostic event to trouble code uds mapping EventDtcMapDBCANFD06Defect: diagnostic-event=EventDBCANFD06Defect, trouble-code-uds=DB_CANFD_06_Defect  # Event_Dtc_Map_DB_CANFD_06_Defect
  diagnostic event to operation cycle mapping EventOperCycleMapDBCANFD06Defect: diagnostic-event=EventDBCANFD06Defect, operation-cycle=DefaultOperationCycle  # Event_Oper_Cycle_Map_DB_CANFD_06_Defect
  diagnostic event to debounce algorithm mapping EventDebounceMapDBCANFD06Defect: debounce-algorithm=counter_based, diagnostic-event=EventDBCANFD06Defect  # EventDebounceMap_DB_CANFD_06_Defect
package /ZeC/DTC/DTC/Power_Path_105_Load_Failure
  diagnostic trouble code uds Power_Path_105_Load_Failure: dtc-props=Dtc_Props_c2809294, uds-dtc-value=0x005469
  diagnostic event EventPowerPath105LoadFailure: aging-allowed=true, event-kind=SWC, prestorage-freeze-frame=false  # Event_Power_Path_105_Load_Failure
  diagnostic event to trouble code uds mapping EventDtcMapPowerPath105LoadFailure: diagnostic-event=EventPowerPath105LoadFailure, trouble-code-uds=Power_Path_105_Load_Failure  # Event_Dtc_Map_Power_Path_105_Load_Failure
  diagnostic event to operation cycle mapping EventOperCycleMapPowerPath105LoadFailure: diagnostic-event=EventPowerPath105LoadFailure, operation-cycle=DefaultOperationCycle  # Event_Oper_Cycle_Map_Power_Path_105_Load_Failure
  diagnostic event to debounce algorithm mapping EventDebounceMapPowerPath105LoadFailure: debounce-algorithm=time_based, diagnostic-event=EventPowerPath105LoadFailure  # EventDebounceMap_Power_Path_105_Load_Failure
package /ZeC/DTC/DTC/DB_CANFD_06_No_Communication
  diagnostic trouble code uds DB_CANFD_06_No_Communication: dtc-props=Dtc_Props_14158306, uds-dtc-value=0x032602
  diagnostic event EventDBCANFD06NoCommunication: aging-allowed=true, event-kind=SWC, prestorage-freeze-frame=false  # Event_DB_CANFD_06_No_Communication
  diagnostic event to trouble code uds mapping EventDtcMapDBCANFD06NoCommunication: diagnostic-event=EventDBCANFD06NoCommunication, trouble-code-uds=DB_CANFD_06_No_Communication  # Event_Dtc_Map_DB_CANFD_06_No_Communication
  diagnostic event to operation cycle mapping EventOperCycleMapDBCANFD06NoCommunication: diagnostic-event=EventDBCANFD06NoCommunication, operation-cycle=DefaultOperationCycle  # Event_Oper_Cycle_Map_DB_CANFD_06_No_Communication
  diagnostic event to debounce algorithm mapping EventDebounceMapDBCANFD06NoCommunication: debounce-algorithm=counter_based, diagnostic-event=EventDBCANFD06NoCommunication  # EventDebounceMap_DB_CANFD_06_No_Communication
package /ZeC/DTC/DTC/LIN_4_Databus_No_Comm
  diagnostic trouble code uds LIN_4_Databus_No_Comm: dtc-props=Dtc_Props_358996c7, uds-dtc-value=0x030420  # LIN 4 Databus_No_Comm
  diagnostic event EventLIN4DatabusNoComm: aging-allowed=true, event-kind=SWC, prestorage-freeze-frame=false  # Event_LIN 4 Databus_No_Comm
  diagnostic event to trouble code uds mapping EventDtcMapLIN4DatabusNoComm: diagnostic-event=EventLIN4DatabusNoComm, trouble-code-uds=LIN_4_Databus_No_Comm  # Event_Dtc_Map_LIN 4 Databus_No_Comm
  diagnostic event to operation cycle mapping EventOperCycleMapLIN4DatabusNoComm: diagnostic-event=EventLIN4DatabusNoComm, operation-cycle=DefaultOperationCycle  # Event_Oper_Cycle_Map_LIN 4 Databus_No_Comm
  diagnostic event to debounce algorithm mapping EventDebounceMapLIN4DatabusNoComm: debounce-algorithm=counter_based, diagnostic-event=EventLIN4DatabusNoComm  # EventDebounceMap_LIN 4 Databus_No_Comm
package /ZeC/DTC/DTC/Power_Path_109_Load_Failure
  diagnostic trouble code uds Power_Path_109_Load_Failure: dtc-props=Dtc_Props_27288969, uds-dtc-value=0x00546d
  diagnostic event EventPowerPath109LoadFailure: aging-allowed=true, event-kind=SWC, prestorage-freeze-frame=false  # Event_Power_Path_109_Load_Failure
  diagnostic event to trouble code uds mapping EventDtcMapPowerPath109LoadFailure: diagnostic-event=EventPowerPath109LoadFailure, trouble-code-uds=Power_Path_109_Load_Failure  # Event_Dtc_Map_Power_Path_109_Load_Failure
  diagnostic event to operation cycle mapping EventOperCycleMapPowerPath109LoadFailure: diagnostic-event=EventPowerPath109LoadFailure, operation-cycle=DefaultOperationCycle  # Event_Oper_Cycle_Map_Power_Path_109_Load_Failure
  diagnostic event to debounce algorithm mapping EventDebounceMapPowerPath109LoadFailure: debounce-algorithm=time_based, diagnostic-event=EventPowerPath109LoadFailure  # EventDebounceMap_Power_Path_109_Load_Failure
package /ZeC/DTC/DTC/Power_Path_108_Load_Failure
  diagnostic trouble code uds Power_Path_108_Load_Failure: dtc-props=Dtc_Props_2e16b98e, uds-dtc-value=0x00546c
  diagnostic event EventPowerPath108LoadFailure: aging-allowed=true, event-kind=SWC, prestorage-freeze-frame=false  # Event_Power_Path_108_Load_Failure
  diagnostic event to trouble code uds mapping EventDtcMapPowerPath108LoadFailure: diagnostic-event=EventPowerPath108LoadFailure, trouble-code-uds=Power_Path_108_Load_Failure  # Event_Dtc_Map_Power_Path_108_Load_Failure
  diagnostic event to operation cycle mapping EventOperCycleMapPowerPath108LoadFailure: diagnostic-event=EventPowerPath108LoadFailure, operation-cycle=DefaultOperationCycle  # Event_Oper_Cycle_Map_Power_Path_108_Load_Failure
  diagnostic event to debounce algorithm mapping EventDebounceMapPowerPath108LoadFailure: debounce-algorithm=time_based, diagnostic-event=EventPowerPath108LoadFailure  # EventDebounceMap_Power_Path_108_Load_Failure
package /ZeC/DTC/DTC/Power_Path_111_Load_Failure
  diagnostic trouble code uds Power_Path_111_Load_Failure: dtc-props=Dtc_Props_ab1a9d1d, uds-dtc-value=0x00546f
  diagnostic event EventPowerPath111LoadFailure: aging-allowed=true, event-kind=SWC, prestorage-freeze-frame=false  # Event_Power_Path_111_Load_Failure
  diagnostic event to trouble code uds mapping EventDtcMapPowerPath111LoadFailure: diagnostic-event=EventPowerPath111LoadFailure, trouble-code-uds=Power_Path_111_Load_Failure  # Event_Dtc_Map_Power_Path_111_Load_Failure
  diagnostic event to operation cycle mapping EventOperCycleMapPowerPath111LoadFailure: diagnostic-event=EventPowerPath111LoadFailure, operation-cycle=DefaultOperationCycle  # Event_Oper_Cycle_Map_Power_Path_111_Load_Failure
  diagnostic event to debounce algorithm mapping EventDebounceMapPowerPath111LoadFailure: debounce-algorithm=time_based, diagnostic-event=EventPowerPath111LoadFailure  # EventDebounceMap_Power_Path_111_Load_Failure
package /ZeC/DTC/DTC/LIN_4_Local_Databus_Electrical_Failure
  diagnostic trouble code uds LIN_4_Local_Databus_Electrical_Failure: dtc-props=Dtc_Props_358996c7, uds-dtc-value=0x030421  # LIN 4 Local_Databus_Electrical_Failure
  diagnostic event EventLIN4LocalDatabusElectricalFailure: aging-allowed=true, event-kind=SWC, prestorage-freeze-frame=false  # Event_LIN 4 Local_Databus_Electrical_Failure
  diagnostic event to trouble code uds mapping EventDtcMapLIN4LocalDatabusElectricalFailure: diagnostic-event=EventLIN4LocalDatabusElectricalFailure, trouble-code-uds=LIN_4_Local_Databus_Electrical_Failure  # Event_Dtc_Map_LIN 4 Local_Databus_Electrical_Failure
  diagnostic event to operation cycle mapping EventOperCycleMapLIN4LocalDatabusElectricalFailure: diagnostic-event=EventLIN4LocalDatabusElectricalFailure, operation-cycle=DefaultOperationCycle  # Event_Oper_Cycle_Map_LIN 4 Local_Databus_Electrical_Failure
  diagnostic event to debounce algorithm mapping EventDebounceMapLIN4LocalDatabusElectricalFailure: debounce-algorithm=counter_based, diagnostic-event=EventLIN4LocalDatabusElectricalFailure  # EventDebounceMap_LIN 4 Local_Databus_Electrical_Failure
package /ZeC/DTC/DTC/Power_Path_110_Load_Failure
  diagnostic trouble code uds Power_Path_110_Load_Failure: dtc-props=Dtc_Props_61318353, uds-dtc-value=0x00546e
  diagnostic event EventPowerPath110LoadFailure: aging-allowed=true, event-kind=SWC, prestorage-freeze-frame=false  # Event_Power_Path_110_Load_Failure
  diagnostic event to trouble code uds mapping EventDtcMapPowerPath110LoadFailure: diagnostic-event=EventPowerPath110LoadFailure, trouble-code-uds=Power_Path_110_Load_Failure  # Event_Dtc_Map_Power_Path_110_Load_Failure
  diagnostic event to operation cycle mapping EventOperCycleMapPowerPath110LoadFailure: diagnostic-event=EventPowerPath110LoadFailure, operation-cycle=DefaultOperationCycle  # Event_Oper_Cycle_Map_Power_Path_110_Load_Failure
  diagnostic event to debounce algorithm mapping EventDebounceMapPowerPath110LoadFailure: debounce-algorithm=time_based, diagnostic-event=EventPowerPath110LoadFailure  # EventDebounceMap_Power_Path_110_Load_Failure
package /ZeC/DTC/DTC/Power_Path_107_Load_Failure
  diagnostic trouble code uds Power_Path_107_Load_Failure: dtc-props=Dtc_Props_680fb3b4, uds-dtc-value=0x00546b
  diagnostic event EventPowerPath107LoadFailure: aging-allowed=true, event-kind=SWC, prestorage-freeze-frame=false  # Event_Power_Path_107_Load_Failure
  diagnostic event to trouble code uds mapping EventDtcMapPowerPath107LoadFailure: diagnostic-event=EventPowerPath107LoadFailure, trouble-code-uds=Power_Path_107_Load_Failure  # Event_Dtc_Map_Power_Path_107_Load_Failure
  diagnostic event to operation cycle mapping EventOperCycleMapPowerPath107LoadFailure: diagnostic-event=EventPowerPath107LoadFailure, operation-cycle=DefaultOperationCycle  # Event_Oper_Cycle_Map_Power_Path_107_Load_Failure
  diagnostic event to debounce algorithm mapping EventDebounceMapPowerPath107LoadFailure: debounce-algorithm=time_based, diagnostic-event=EventPowerPath107LoadFailure  # EventDebounceMap_Power_Path_107_Load_Failure
package /ZeC/DTC/DTC/Power_Path_106_Load_Failure
  diagnostic trouble code uds Power_Path_106_Load_Failure: dtc-props=Dtc_Props_a224adfa, uds-dtc-value=0x00546a
  diagnostic event EventPowerPath106LoadFailure: aging-allowed=true, event-kind=SWC, prestorage-freeze-frame=false  # Event_Power_Path_106_Load_Failure
  diagnostic event to trouble code uds mapping EventDtcMapPowerPath106LoadFailure: diagnostic-event=EventPowerPath106LoadFailure, trouble-code-uds=Power_Path_106_Load_Failure  # Event_Dtc_Map_Power_Path_106_Load_Failure
  diagnostic event to operation cycle mapping EventOperCycleMapPowerPath106LoadFailure: diagnostic-event=EventPowerPath106LoadFailure, operation-cycle=DefaultOperationCycle  # Event_Oper_Cycle_Map_Power_Path_106_Load_Failure
  diagnostic event to debounce algorithm mapping EventDebounceMapPowerPath106LoadFailure: debounce-algorithm=time_based, diagnostic-event=EventPowerPath106LoadFailure  # EventDebounceMap_Power_Path_106_Load_Failure
package /ZeC/DTC/DTC/Power_Path_117_Load_Failure
  diagnostic trouble code uds Power_Path_117_Load_Failure: dtc-props=Dtc_Props_9a842796, uds-dtc-value=0x005475
  diagnostic event EventPowerPath117LoadFailure: aging-allowed=true, event-kind=SWC, prestorage-freeze-frame=false  # Event_Power_Path_117_Load_Failure
  diagnostic event to trouble code uds mapping EventDtcMapPowerPath117LoadFailure: diagnostic-event=EventPowerPath117LoadFailure, trouble-code-uds=Power_Path_117_Load_Failure  # Event_Dtc_Map_Power_Path_117_Load_Failure
  diagnostic event to operation cycle mapping EventOperCycleMapPowerPath117LoadFailure: diagnostic-event=EventPowerPath117LoadFailure, operation-cycle=DefaultOperationCycle  # Event_Oper_Cycle_Map_Power_Path_117_Load_Failure
  diagnostic event to debounce algorithm mapping EventDebounceMapPowerPath117LoadFailure: debounce-algorithm=time_based, diagnostic-event=EventPowerPath117LoadFailure  # EventDebounceMap_Power_Path_117_Load_Failure
package /ZeC/DTC/DTC/Power_Path_116_Load_Failure
  diagnostic trouble code uds Power_Path_116_Load_Failure: dtc-props=Dtc_Props_dc9d2dac, uds-dtc-value=0x005474
  diagnostic event EventPowerPath116LoadFailure: aging-allowed=true, event-kind=SWC, prestorage-freeze-frame=false  # Event_Power_Path_116_Load_Failure
  diagnostic event to trouble code uds mapping EventDtcMapPowerPath116LoadFailure: diagnostic-event=EventPowerPath116LoadFailure, trouble-code-uds=Power_Path_116_Load_Failure  # Event_Dtc_Map_Power_Path_116_Load_Failure
  diagnostic event to operation cycle mapping EventOperCycleMapPowerPath116LoadFailure: diagnostic-event=EventPowerPath116LoadFailure, operation-cycle=DefaultOperationCycle  # Event_Oper_Cycle_Map_Power_Path_116_Load_Failure
  diagnostic event to debounce algorithm mapping EventDebounceMapPowerPath116LoadFailure: debounce-algorithm=time_based, diagnostic-event=EventPowerPath116LoadFailure  # EventDebounceMap_Power_Path_116_Load_Failure
package /ZeC/DTC/DTC/Power_Path_119_Load_Failure
  diagnostic trouble code uds Power_Path_119_Load_Failure: dtc-props=Dtc_Props_16b633e2, uds-dtc-value=0x005477
  diagnostic event EventPowerPath119LoadFailure: aging-allowed=true, event-kind=SWC, prestorage-freeze-frame=false  # Event_Power_Path_119_Load_Failure
  diagnostic event to trouble code uds mapping EventDtcMapPowerPath119LoadFailure: diagnostic-event=EventPowerPath119LoadFailure, trouble-code-uds=Power_Path_119_Load_Failure  # Event_Dtc_Map_Power_Path_119_Load_Failure
  diagnostic event to operation cycle mapping EventOperCycleMapPowerPath119LoadFailure: diagnostic-event=EventPowerPath119LoadFailure, operation-cycle=DefaultOperationCycle  # Event_Oper_Cycle_Map_Power_Path_119_Load_Failure
  diagnostic event to debounce algorithm mapping EventDebounceMapPowerPath119LoadFailure: debounce-algorithm=time_based, diagnostic-event=EventPowerPath119LoadFailure  # EventDebounceMap_Power_Path_119_Load_Failure
package /ZeC/DTC/DTC/Power_Path_118_Load_Failure
  diagnostic trouble code uds Power_Path_118_Load_Failure: dtc-props=Dtc_Props_50af39d8, uds-dtc-value=0x005476
  diagnostic event EventPowerPath118LoadFailure: aging-allowed=true, event-kind=SWC, prestorage-freeze-frame=false  # Event_Power_Path_118_Load_Failure
  diagnostic event to trouble code uds mapping EventDtcMapPowerPath118LoadFailure: diagnostic-event=EventPowerPath118LoadFailure, trouble-code-uds=Power_Path_118_Load_Failure  # Event_Dtc_Map_Power_Path_118_Load_Failure
  diagnostic event to operation cycle mapping EventOperCycleMapPowerPath118LoadFailure: diagnostic-event=EventPowerPath118LoadFailure, operation-cycle=DefaultOperationCycle  # Event_Oper_Cycle_Map_Power_Path_118_Load_Failure
  diagnostic event to debounce algorithm mapping EventDebounceMapPowerPath118LoadFailure: debounce-algorithm=time_based, diagnostic-event=EventPowerPath118LoadFailure  # EventDebounceMap_Power_Path_118_Load_Failure
package /ZeC/DTC/DTC/Power_Path_113_Load_Failure
  diagnostic trouble code uds Power_Path_113_Load_Failure: dtc-props=Dtc_Props_5991093f, uds-dtc-value=0x005471
  diagnostic event EventPowerPath113LoadFailure: aging-allowed=true, event-kind=SWC, prestorage-freeze-frame=false  # Event_Power_Path_113_Load_Failure
  diagnostic event to trouble code uds mapping EventDtcMapPowerPath113LoadFailure: diagnostic-event=EventPowerPath113LoadFailure, trouble-code-uds=Power_Path_113_Load_Failure  # Event_Dtc_Map_Power_Path_113_Load_Failure
  diagnostic event to operation cycle mapping EventOperCycleMapPowerPath113LoadFailure: diagnostic-event=EventPowerPath113LoadFailure, operation-cycle=DefaultOperationCycle  # Event_Oper_Cycle_Map_Power_Path_113_Load_Failure
  diagnostic event to debounce algorithm mapping EventDebounceMapPowerPath113LoadFailure: debounce-algorithm=time_based, diagnostic-event=EventPowerPath113LoadFailure  # EventDebounceMap_Power_Path_113_Load_Failure
package /ZeC/DTC/DTC/Power_Path_112_Load_Failure
  diagnostic trouble code uds Power_Path_112_Load_Failure: dtc-props=Dtc_Props_1f880305, uds-dtc-value=0x005470
  diagnostic event EventPowerPath112LoadFailure: aging-allowed=true, event-kind=SWC, prestorage-freeze-frame=false  # Event_Power_Path_112_Load_Failure
  diagnostic event to trouble code uds mapping EventDtcMapPowerPath112LoadFailure: diagnostic-event=EventPowerPath112LoadFailure, trouble-code-uds=Power_Path_112_Load_Failure  # Event_Dtc_Map_Power_Path_112_Load_Failure
  diagnostic event to operation cycle mapping EventOperCycleMapPowerPath112LoadFailure: diagnostic-event=EventPowerPath112LoadFailure, operation-cycle=DefaultOperationCycle  # Event_Oper_Cycle_Map_Power_Path_112_Load_Failure
  diagnostic event to debounce algorithm mapping EventDebounceMapPowerPath112LoadFailure: debounce-algorithm=time_based, diagnostic-event=EventPowerPath112LoadFailure  # EventDebounceMap_Power_Path_112_Load_Failure
package /ZeC/DTC/DTC/Power_Path_115_Load_Failure
  diagnostic trouble code uds Power_Path_115_Load_Failure: dtc-props=Dtc_Props_d5a31d4b, uds-dtc-value=0x005473
  diagnostic event EventPowerPath115LoadFailure: aging-allowed=true, event-kind=SWC, prestorage-freeze-frame=false  # Event_Power_Path_115_Load_Failure
  diagnostic event to trouble code uds mapping EventDtcMapPowerPath115LoadFailure: diagnostic-event=EventPowerPath115LoadFailure, trouble-code-uds=Power_Path_115_Load_Failure  # Event_Dtc_Map_Power_Path_115_Load_Failure
  diagnostic event to operation cycle mapping EventOperCycleMapPowerPath115LoadFailure: diagnostic-event=EventPowerPath115LoadFailure, operation-cycle=DefaultOperationCycle  # Event_Oper_Cycle_Map_Power_Path_115_Load_Failure
  diagnostic event to debounce algorithm mapping EventDebounceMapPowerPath115LoadFailure: debounce-algorithm=time_based, diagnostic-event=EventPowerPath115LoadFailure  # EventDebounceMap_Power_Path_115_Load_Failure
package /ZeC/DTC/DTC/CAN_06_ECU_5_No_Communication
  diagnostic trouble code uds CAN_06_ECU_5_No_Communication: dtc-props=Dtc_Props_14158306, uds-dtc-value=0x032609
  diagnostic event EventCAN06ECU5NoCommunication: aging-allowed=true, event-kind=SWC, prestorage-freeze-frame=false  # Event_CAN_06_ECU_5_No_Communication
  diagnostic event to trouble code uds mapping EventDtcMapCAN06ECU5NoCommunication: diagnostic-event=EventCAN06ECU5NoCommunication, trouble-code-uds=CAN_06_ECU_5_No_Communication  # Event_Dtc_Map_CAN_06_ECU_5_No_Communication
  diagnostic event to operation cycle mapping EventOperCycleMapCAN06ECU5NoCommunication: diagnostic-event=EventCAN06ECU5NoCommunication, operation-cycle=DefaultOperationCycle  # Event_Oper_Cycle_Map_CAN_06_ECU_5_No_Communication
  diagnostic event to debounce algorithm mapping EventDebounceMapCAN06ECU5NoCommunication: debounce-algorithm=counter_based, diagnostic-event=EventCAN06ECU5NoCommunication  # EventDebounceMap_CAN_06_ECU_5_No_Communication
package /ZeC/DTC/DTC/Power_Path_114_Load_Failure
  diagnostic trouble code uds Power_Path_114_Load_Failure: dtc-props=Dtc_Props_93ba1771, uds-dtc-value=0x005472
  diagnostic event EventPowerPath114LoadFailure: aging-allowed=true, event-kind=SWC, prestorage-freeze-frame=false  # Event_Power_Path_114_Load_Failure
  diagnostic event to trouble code uds mapping EventDtcMapPowerPath114LoadFailure: diagnostic-event=EventPowerPath114LoadFailure, trouble-code-uds=Power_Path_114_Load_Failure  # Event_Dtc_Map_Power_Path_114_Load_Failure
  diagnostic event to operation cycle mapping EventOperCycleMapPowerPath114LoadFailure: diagnostic-event=EventPowerPath114LoadFailure, operation-cycle=DefaultOperationCycle  # Event_Oper_Cycle_Map_Power_Path_114_Load_Failure
  diagnostic event to debounce algorithm mapping EventDebounceMapPowerPath114LoadFailure: debounce-algorithm=time_based, diagnostic-event=EventPowerPath114LoadFailure  # EventDebounceMap_Power_Path_114_Load_Failure
package /ZeC/DTC/DTC/Power_Path_087_Load_Failure
  diagnostic trouble code uds Power_Path_087_Load_Failure: dtc-props=Dtc_Props_4152b4d3, uds-dtc-value=0x005457
  diagnostic event EventPowerPath087LoadFailure: aging-allowed=true, event-kind=SWC, prestorage-freeze-frame=false  # Event_Power_Path_087_Load_Failure
  diagnostic event to trouble code uds mapping EventDtcMapPowerPath087LoadFailure: diagnostic-event=EventPowerPath087LoadFailure, trouble-code-uds=Power_Path_087_Load_Failure  # Event_Dtc_Map_Power_Path_087_Load_Failure
  diagnostic event to operation cycle mapping EventOperCycleMapPowerPath087LoadFailure: diagnostic-event=EventPowerPath087LoadFailure, operation-cycle=DefaultOperationCycle  # Event_Oper_Cycle_Map_Power_Path_087_Load_Failure
  diagnostic event to debounce algorithm mapping EventDebounceMapPowerPath087LoadFailure: debounce-algorithm=time_based, diagnostic-event=EventPowerPath087LoadFailure  # EventDebounceMap_Power_Path_087_Load_Failure
package /ZeC/DTC/DTC/Power_Path_086_Load_Failure
  diagnostic trouble code uds Power_Path_086_Load_Failure: dtc-props=Dtc_Props_14158306, uds-dtc-value=0x005456
  diagnostic event EventPowerPath086LoadFailure: aging-allowed=true, event-kind=SWC, prestorage-freeze-frame=false  # Event_Power_Path_086_Load_Failure
  diagnostic event to trouble code uds mapping EventDtcMapPowerPath086LoadFailure: diagnostic-event=EventPowerPath086LoadFailure, trouble-code-uds=Power_Path_086_Load_Failure  # Event_Dtc_Map_Power_Path_086_Load_Failure
  diagnostic event to operation cycle mapping EventOperCycleMapPowerPath086LoadFailure: diagnostic-event=EventPowerPath086LoadFailure, operation-cycle=DefaultOperationCycle  # Event_Oper_Cycle_Map_Power_Path_086_Load_Failure
  diagnostic event to debounce algorithm mapping EventDebounceMapPowerPath086LoadFailure: debounce-algorithm=time_based, diagnostic-event=EventPowerPath086LoadFailure  # EventDebounceMap_Power_Path_086_Load_Failure
package /ZeC/DTC/DTC/Power_Path_089_Load_Failure
  diagnostic trouble code uds Power_Path_089_Load_Failure: dtc-props=Dtc_Props_532ed51d, uds-dtc-value=0x005459
  diagnostic event EventPowerPath089LoadFailure: aging-allowed=true, event-kind=SWC, prestorage-freeze-frame=false  # Event_Power_Path_089_Load_Failure
  diagnostic event to trouble code uds mapping EventDtcMapPowerPath089LoadFailure: diagnostic-event=EventPowerPath089LoadFailure, trouble-code-uds=Power_Path_089_Load_Failure  # Event_Dtc_Map_Power_Path_089_Load_Failure
  diagnostic event to operation cycle mapping EventOperCycleMapPowerPath089LoadFailure: diagnostic-event=EventPowerPath089LoadFailure, operation-cycle=DefaultOperationCycle  # Event_Oper_Cycle_Map_Power_Path_089_Load_Failure
  diagnostic event to debounce algorithm mapping EventDebounceMapPowerPath089LoadFailure: debounce-algorithm=time_based, diagnostic-event=EventPowerPath089LoadFailure  # EventDebounceMap_Power_Path_089_Load_Failure
package /ZeC/DTC/DTC/Power_Path_088_Load_Failure
  diagnostic trouble code uds Power_Path_088_Load_Failure: dtc-props=Dtc_Props_1537df27, uds-dtc-value=0x005458
  diagnostic event EventPowerPath088LoadFailure: aging-allowed=true, event-kind=SWC, prestorage-freeze-frame=false  # Event_Power_Path_088_Load_Failure
  diagnostic event to trouble code uds mapping EventDtcMapPowerPath088LoadFailure: diagnostic-event=EventPowerPath088LoadFailure, trouble-code-uds=Power_Path_088_Load_Failure  # Event_Dtc_Map_Power_Path_088_Load_Failure
  diagnostic event to operation cycle mapping EventOperCycleMapPowerPath088LoadFailure: diagnostic-event=EventPowerPath088LoadFailure, operation-cycle=DefaultOperationCycle  # Event_Oper_Cycle_Map_Power_Path_088_Load_Failure
  diagnostic event to debounce algorithm mapping EventDebounceMapPowerPath088LoadFailure: debounce-algorithm=time_based, diagnostic-event=EventPowerPath088LoadFailure  # EventDebounceMap_Power_Path_088_Load_Failure
package /ZeC/DTC/DTC/Power_Path_092_Load_Failure
  diagnostic trouble code uds Power_Path_092_Load_Failure: dtc-props=Dtc_Props_bfb8fe07, uds-dtc-value=0x00545c
  diagnostic event EventPowerPath092LoadFailure: aging-allowed=true, event-kind=SWC, prestorage-freeze-frame=false  # Event_Power_Path_092_Load_Failure
  diagnostic event to trouble code uds mapping EventDtcMapPowerPath092LoadFailure: diagnostic-event=EventPowerPath092LoadFailure, trouble-code-uds=Power_Path_092_Load_Failure  # Event_Dtc_Map_Power_Path_092_Load_Failure
  diagnostic event to operation cycle mapping EventOperCycleMapPowerPath092LoadFailure: diagnostic-event=EventPowerPath092LoadFailure, operation-cycle=DefaultOperationCycle  # Event_Oper_Cycle_Map_Power_Path_092_Load_Failure
  diagnostic event to debounce algorithm mapping EventDebounceMapPowerPath092LoadFailure: debounce-algorithm=time_based, diagnostic-event=EventPowerPath092LoadFailure  # EventDebounceMap_Power_Path_092_Load_Failure
package /ZeC/DTC/DTC/CAN_06_ECU_6_No_Communication
  diagnostic trouble code uds CAN_06_ECU_6_No_Communication: dtc-props=Dtc_Props_14158306, uds-dtc-value=0x032610
  diagnostic event EventCAN06ECU6NoCommunication: aging-allowed=true, event-kind=SWC, prestorage-freeze-frame=false  # Event_CAN_06_ECU_6_No_Communication
  diagnostic event to trouble code uds mapping EventDtcMapCAN06ECU6NoCommunication: diagnostic-event=EventCAN06ECU6NoCommunication, trouble-code-uds=CAN_06_ECU_6_No_Communication  # Event_Dtc_Map_CAN_06_ECU_6_No_Communication
  diagnostic event to operation cycle mapping EventOperCycleMapCAN06ECU6NoCommunication: diagnostic-event=EventCAN06ECU6NoCommunication, operation-cycle=DefaultOperationCycle  # Event_Oper_Cycle_Map_CAN_06_ECU_6_No_Communication
  diagnostic event to debounce algorithm mapping EventDebounceMapCAN06ECU6NoCommunication: debounce-algorithm=counter_based, diagnostic-event=EventCAN06ECU6NoCommunication  # EventDebounceMap_CAN_06_ECU_6_No_Communication
package /ZeC/DTC/DTC/Power_Path_091_Load_Failure
  diagnostic trouble code uds Power_Path_091_Load_Failure: dtc-props=Dtc_Props_f9a1f43d, uds-dtc-value=0x00545b
  diagnostic event EventPowerPath091LoadFailure: aging-allowed=true, event-kind=SWC, prestorage-freeze-frame=false  # Event_Power_Path_091_Load_Failure
  diagnostic event to trouble code uds mapping EventDtcMapPowerPath091LoadFailure: diagnostic-event=EventPowerPath091LoadFailure, trouble-code-uds=Power_Path_091_Load_Failure  # Event_Dtc_Map_Power_Path_091_Load_Failure
  diagnostic event to operation cycle mapping EventOperCycleMapPowerPath091LoadFailure: diagnostic-event=EventPowerPath091LoadFailure, operation-cycle=DefaultOperationCycle  # Event_Oper_Cycle_Map_Power_Path_091_Load_Failure
  diagnostic event to debounce algorithm mapping EventDebounceMapPowerPath091LoadFailure: debounce-algorithm=time_based, diagnostic-event=EventPowerPath091LoadFailure  # EventDebounceMap_Power_Path_091_Load_Failure
package /ZeC/DTC/DTC/Power_Path_094_Load_Failure
  diagnostic trouble code uds Power_Path_094_Load_Failure: dtc-props=Dtc_Props_f09fc4da, uds-dtc-value=0x00545e
  diagnostic event EventPowerPath094LoadFailure: aging-allowed=true, event-kind=SWC, prestorage-freeze-frame=false  # Event_Power_Path_094_Load_Failure
  diagnostic event to trouble code uds mapping EventDtcMapPowerPath094LoadFailure: diagnostic-event=EventPowerPath094LoadFailure, trouble-code-uds=Power_Path_094_Load_Failure  # Event_Dtc_Map_Power_Path_094_Load_Failure
  diagnostic event to operation cycle mapping EventOperCycleMapPowerPath094LoadFailure: diagnostic-event=EventPowerPath094LoadFailure, operation-cycle=DefaultOperationCycle  # Event_Oper_Cycle_Map_Power_Path_094_Load_Failure
  diagnostic event to debounce algorithm mapping EventDebounceMapPowerPath094LoadFailure: debounce-algorithm=time_based, diagnostic-event=EventPowerPath094LoadFailure  # EventDebounceMap_Power_Path_094_Load_Failure
package /ZeC/DTC/DTC/Power_Path_093_Load_Failure
  diagnostic trouble code uds Power_Path_093_Load_Failure: dtc-props=Dtc_Props_b686cee0, uds-dtc-value=0x00545d
  diagnostic event EventPowerPath093LoadFailure: aging-allowed=true, event-kind=SWC, prestorage-freeze-frame=false  # Event_Power_Path_093_Load_Failure
  diagnostic event to trouble code uds mapping EventDtcMapPowerPath093LoadFailure: diagnostic-event=EventPowerPath093LoadFailure, trouble-code-uds=Power_Path_093_Load_Failure  # Event_Dtc_Map_Power_Path_093_Load_Failure
  diagnostic event to operation cycle mapping EventOperCycleMapPowerPath093LoadFailure: diagnostic-event=EventPowerPath093LoadFailure, operation-cycle=DefaultOperationCycle  # Event_Oper_Cycle_Map_Power_Path_093_Load_Failure
  diagnostic event to debounce algorithm mapping EventDebounceMapPowerPath093LoadFailure: debounce-algorithm=time_based, diagnostic-event=EventPowerPath093LoadFailure  # EventDebounceMap_Power_Path_093_Load_Failure
